[part 4 of 6: package /AUTOSAR/EcucDefs]
AUTOSAR XML (schema 4-0-3)
package /AUTOSAR/EcucDefs  (continued)
  module definition EcuM [0..1]: variants post-build  # Configuration of the EcuM (ECU State Manager) module.
    container EcuMConfiguration: multiple-configuration-container=true  # This container contains the configuration (parameters) of the ECU State Manager.
      container EcuMCommonConfiguration  # This container contains the common configuration (parameters) of the ECU State Manager.
        integer EcuMConfigConsistencyHash: 0..18446744073709551615, set at link  # A hash value generated across all pre-compile and link-time parameters of all BSW modules. This hash value is compared against a field in the EcuM_ConfigType and hence allows checking the consistency of the entire configuration.
        reference EcuMDefaultAppMode: set at post-build, destination=OsAppMode  # The default application mode loaded when the ECU comes out of reset.
        reference EcuMOSResource [1..*]: set at pre-compile, destination=OsResource  # This parameter is a reference to a OS ressource which is used to bring the ECU into sleep mode. | In case of multi core each core shall have an own OsResource.
        container EcuMDefaultShutdownTarget  # This container describes the default shutdown target to be selected by EcuM. The actual shutdown target may be overridden by the EcuM_SelectShutdownTarget service.
          enumeration EcuMDefaultState: {EcuMStateOff, EcuMStateReset, EcuMStateSleep}, set at post-build  # This parameter describes the state part of the default shutdown target selected when the ECU comes out of reset. If EcuMStateSleep is selected, the parameter EcuMDefaultSleepModeRef selects the specific sleep mode.
          symbolic name reference EcuMDefaultResetModeRef [0..1]: set at post-build, destination=EcuMResetMode  # If EcuMDefaultShutdownTarget is EcuMStateReset, this parameter selects the default reset mode. Otherwise this parameter may be ignored.
          symbolic name reference EcuMDefaultSleepModeRef [0..1]: set at post-build, destination=EcuMSleepMode  # If EcuMDefaultShutdownTarget is EcuMStateSleep, this parameter selects the default sleep mode. Otherwise this parameter may be ignored.
        container EcuMDemEventParameterRefs [0..1]  # Container for the references to DemEventParameter elements which shall be invoked using the API Dem_ReportErrorStatus in case the corresponding error occurs. The EventId is taken from the referenced DemEventParameter's DemEventId value. | The standardized errors are provided in this container and can be extended by vendor specific error references.
          symbolic name reference ECUM_E_ALL_RUN_REQUESTS_KILLED [0..1]: set at pre-compile, destination=DemEventParameter  # Reference to the DemEventParameter which shall be issued when the error "ECUM_E_ALL_RUN_REQUESTS_KILLED" has occured.
          symbolic name reference ECUM_E_CONFIGURATION_DATA_INCONSISTENT [0..1]: set at pre-compile, destination=DemEventParameter  # Reference to the DemEventParameter which shall be issued when the error "ECUM_E_CONFIGURATION_DATA_INCONSISTENT" has occured.
          symbolic name reference ECUM_E_RAM_CHECK_FAILED [0..1]: set at pre-compile, destination=DemEventParameter  # Reference to the DemEventParameter which shall be issued when the error "ECUM_E_RAM_CHECK_FAILED" has occured.
        container EcuMDriverInitListOne [0..1]  # Container for Init Block I. | This container holds a list of module IDs that will be initialised. Each module in the list will be called for initialisation in the list order. All modules in this list are initilialised before the OS is started and so these modules require no OS support.
          container EcuMDriverInitItem [1..*]  # These containers describe the entries in a driver init list.
            string EcuMModuleID: set at pre-compile  # Short name of the module to be initialized, e.g. Mcu, Gpt etc.
            string EcuMModuleService: set at pre-compile  # The service to be called to initialize that module, e.g. Init, PreInit, Start etc. | If the service is Init and the parameter EcuMModuleConfigurationRef has been set for that module, the corresponding pointer to the init structure (<Module>_ConfigType) and in case of multiple instantiation an uint8 value to identify the instance of the module(<MSN>_CtrlIdx) shall be passed as arguments.
        container EcuMDriverInitListZero [0..1]  # Container for Init Block 0. | This container holds a list of module IDs that will be initialised. Each module in the list will be called for initialisation in the list order. All modules in this list are initilialised before the post-build configuration has been loaded and the OS is initialized. Therefore, these modules may not use post-build configuration.
          container EcuMDriverInitItem [1..*]  # These containers describe the entries in a driver init list.
            string EcuMModuleID: set at pre-compile  # Short name of the module to be initialized, e.g. Mcu, Gpt etc.
            string EcuMModuleService: set at pre-compile  # The service to be called to initialize that module, e.g. Init, PreInit, Start etc. | If the service is Init and the parameter EcuMModuleConfigurationRef has been set for that module, the corresponding pointer to the init structure (<Module>_ConfigType) and in case of multiple instantiation an uint8 value to identify the instance of the module(<MSN>_CtrlIdx) shall be passed as arguments.
        container EcuMDriverRestartList [0..1]  # List of module IDs. | EcuM2719: A configuration tool shall fill the callout EcuM_AL_DriverRestart with initialization calls to the listed drivers in the order in which they occur in the list. EcuM2720: Entries in this list must appear in the same order as in the combined list of EcuM_DriverInitListOne and EcuM_DriverInitListTwo. This list may be a real subset though. In all other cases, the generation tool shall report an error. The included container has the same structure as EcuM_DriverInitItem
          container EcuMDriverInitItem [1..*]  # These containers describe the entries in a driver init list.
            string EcuMModuleID: set at pre-compile  # Short name of the module to be initialized, e.g. Mcu, Gpt etc.
            string EcuMModuleService: set at pre-compile  # The service to be called to initialize that module, e.g. Init, PreInit, Start etc. | If the service is Init and the parameter EcuMModuleConfigurationRef has been set for that module, the corresponding pointer to the init structure (<Module>_ConfigType) and in case of multiple instantiation an uint8 value to identify the instance of the module(<MSN>_CtrlIdx) shall be passed as arguments.
        container EcuMSleepMode [1..*]  # These containers describe the configured sleep modes. | The names of these containers specify the symbolic names of the different sleep modes.
          integer EcuMSleepModeId: 0..255, set at pre-compile, symbolic-name-value=true  # This ID identifies this sleep mode in services like EcuM_SelectShutdownTarget.
          boolean EcuMSleepModeSuspend: set at pre-compile  # Flag, which is set true, if the CPU is suspended, halted, or powered off in the sleep mode. If the CPU keeps running in this sleep mode, then this flag must be set to false.
          symbolic name reference EcuMSleepModeMcuModeRef: set at pre-compile, destination=McuModeSettingConf  # This parameter is a reference to the corresponding MCU mode for this sleep mode.
          symbolic name reference EcuMWakeupSourceMask [1..*]: set at pre-compile, destination=EcuMWakeupSource  # These parameters are references to the wakeup sources that shall be enabled for this sleep mode.
        container EcuMWakeupSource [1..*]  # These containers describe the configured wakeup sources.
          float EcuMValidationTimeout [0..1]: 0..Inf, set at pre-compile  # The validation timeout (period for which the ECU State Manager will wait for the validation of a wakeup event) can be defined for each wakeup source independently. The timeout is specified in seconds. | When the timeout is not instantiated, there is no validation routine and the ECU Manager shall not validate the wakeup source.
          integer EcuMWakeupSourceId: 0..31, set at pre-compile, symbolic-name-value=true  # This parameter defines the identifier of this wakeup source.
          boolean EcuMWakeupSourcePolling: set at pre-compile  # This parameter describes if the wakeup source needs polling.
          symbolic name reference EcuMComMChannelRef [0..1]: set at pre-compile, destination=ComMChannel  # This parameter is a reference to a Network (channel) defined in the Communication Manager. No reference indicates that the wakeup source is not a communication channel.
          symbolic name reference EcuMResetReasonRef: set at pre-compile, destination=McuResetReasonConf  # This parameter describes the mapping of reset reasons detected by the MCU driver into wakeup sources.
      container EcuMFixedConfiguration [0..1]  # This container contains the configuration (parameters) of the EcuMFixed. | Only applicable if EcuMFixed is implemented.
        float EcuMNvramReadallTimeout: 0..Inf, set at post-build  # Period given in seconds for which the ECU State Manager will wait until it considers a ReadAll job of the NVRAM Manager as failed.
        float EcuMNvramWriteallTimeout: 0..Inf, set at post-build  # Period given in seconds for which the ECU State Manager will wait until it considers a WriteAll job of the NVRAM Manager as failed.
        float EcuMRunMinimumDuration: 0..Inf, set at post-build  # Duration given in seconds for which the ECU State Manager will | stay in RUN state even when no one requests RUN. This duration should be long at least as long as a SW-Cs needs to request RUN.
        choice reference EcuMFixedModuleConfigurationRef [0..*]: set at post-build, destination=[AdcConfigSet, CanConfigSet, CanIfInitCfg, CanNmGlobalConfig, CanSMConfiguration, CanTpConfig, CanTrcvConfigSet, ComConfig, ComMConfigSet, DbgMultipleConfigurationContainer, DcmConfigSet, DemConfigSet, DioConfig, DltMultipleConfigurationContainer, EepInitConfiguration, EthConfigSet, EthIfConfigSet, EthTrcvConfigSet, FiMConfigSet, FlsConfigSet, FlsTstConfigSet, FrArTpMultipleConfig, FrIfConfig, FrMultipleConfiguration, FrNmChannelConfig, FrSMConfig, FrTpMultipleConfig, GptChannelConfigSet, IcuConfigSet, IpduMConfig, J1939TpConfiguration, LinGlobalConfig, LinIfGlobalConfig, LinSMConfigSet, LinTpGlobalConfig, McuModuleConfiguration, PduRRoutingTables, PortConfigSet, PwmChannelConfigSet, RtePostBuildVariantConfiguration, SoAdDoIpConfig, SpiDriver, UdpNmGlobalConfig, WdgMConfigSet, WdgSettingsConfig, XcpConfig]  # These parameters contain references to the init structure of the corresponding BSW module.
        symbolic name reference EcuMComMCommunicationAllowedList [0..*]: set at pre-compile, destination=ComMChannel  # These parameters contain references to the ComMChannels for which EcuM has to call ComM_CommunicationAllowed.
        symbolic name reference EcuMNormalMcuModeRef: set at pre-compile, destination=McuModeSettingConf  # This parameter is a reference to the normal MCU mode to be restored after a sleep.
        container EcuMDriverInitListThree [0..1]  # Container for Init Block III. | This container holds a list of module IDs that will be initialised. Each module in the list will be called for initialisation in the list order. All modules in this list are initilialised after the OS is started and so these modules may use OS support. These modules may also rely on the Nvram ReadAll job to have provided all data.
          container EcuMDriverInitItem [1..*]  # These containers describe the entries in a driver init list.
            string EcuMModuleID: set at pre-compile  # Short name of the module to be initialized, e.g. Mcu, Gpt etc.
            string EcuMModuleService: set at pre-compile  # The service to be called to initialize that module, e.g. Init, PreInit, Start etc. | If the service is Init and the parameter EcuMModuleConfigurationRef has been set for that module, the corresponding pointer to the init structure (<Module>_ConfigType) and in case of multiple instantiation an uint8 value to identify the instance of the module(<MSN>_CtrlIdx) shall be passed as arguments.
        container EcuMDriverInitListTwo [0..1]  # Container for Init Block II. | This container holds a list of module IDs that will be initialised. Each module in the list will be called for initialisation in the list order. All modules in this list are initilialised after the OS is started and so these modules may use OS support. These modules may not rely on the Nvram ReadAll job to have provided all data.
          container EcuMDriverInitItem [1..*]  # These containers describe the entries in a driver init list.
            string EcuMModuleID: set at pre-compile  # Short name of the module to be initialized, e.g. Mcu, Gpt etc.
            string EcuMModuleService: set at pre-compile  # The service to be called to initialize that module, e.g. Init, PreInit, Start etc. | If the service is Init and the parameter EcuMModuleConfigurationRef has been set for that module, the corresponding pointer to the init structure (<Module>_ConfigType) and in case of multiple instantiation an uint8 value to identify the instance of the module(<MSN>_CtrlIdx) shall be passed as arguments.
        container EcuMFixedUserConfig [1..*]  # These containers describe the identifiers that are needed to refer to a software component or another appropriate entity in the system which is designated to request the RUN state. Application requestors refer to entities above RTE, system requestors to entities below RTE (e.g. Communication Manager).
          integer EcuMFixedUser: 0..255, set at pre-compile, symbolic-name-value=true  # Parameter used to identify one user.
        container EcuMTTII [0..*]  # These containers describe the structures and the following configuration items describe its elements. These structures are concatenated to build a list as indicated by Figure 27 - Configuration Container Diagram. | The list must contain at least one element when ECUM_TTII_ENABLED is set to true.
          integer EcuMDivisor: 0..18446744073709551615, set at pre-compile  # This parameter defines the divisor preload value.
          symbolic name reference EcuMSleepModeRef: set at pre-compile, destination=EcuMSleepMode  # This configuration parameter is a reference to a configured sleep mode that is used for TTII.
          symbolic name reference EcuMSuccessorRef [0..1]: set at pre-compile, destination=EcuMSleepMode  # This parameter is a reference to the next sleep mode in the TTII protocol.
      container EcuMFlexConfiguration [0..1]  # This container contains the configuration (parameters) of the EcuMFlex. | Only applicable if EcuMFlex is implemented.
        choice reference EcuMFlexModuleConfigurationRef [0..*]: set at post-build, destination=[AdcConfigSet, CanConfigSet, DemConfigSet, FlsConfigSet, GptChannelConfigSet, IcuConfigSet, LinGlobalConfig, McuModuleConfiguration, PortConfigSet, PwmChannelConfigSet, SpiDriver, WdgMConfigSet, WdgSettingsConfig]  # These parameters contain references to the init structure of the corresponding BSW module.
        symbolic name reference EcuMNormalMcuModeRef: set at pre-compile, destination=McuModeSettingConf  # This parameter is a reference to the normal MCU mode to be restored after a sleep.
        container EcuMAlarmClock [0..*]  # These containers describe the configured alarm clocks. | The name of these conatiners allows giving a symbolic name to one alarm clock.
          integer EcuMAlarmClockId: 0..255, set at pre-compile, symbolic-name-value=true  # This ID identifies this alarmclock.
          float EcuMAlarmClockTimeOut: 0..Inf, set at pre-compile  # This parameter allows to define a timout for this alarm clock.
          symbolic name reference EcuMAlarmClockUser: set at pre-compile, destination=EcuMFlexUserConfig  # This parameter allows an alarm to be assigned to a user.
        container EcuMFlexUserConfig [1..*]  # These containers describe the identifiers that are needed to refer to a software component or another appropriate entity in the system which uses the EcuMFlex Interfaces.
          integer EcuMFlexUser: 0..255, set at pre-compile, symbolic-name-value=true  # Parameter used to identify one user.
          reference EcuMFlexEcucPartitionRef [0..1]: set at pre-compile, destination=EcucPartition  # Denotes in which "EcucPartition" the user of the EcuM is executed.
        container EcuMGoDownAllowedUsers [0..1]  # This container describes the collection of allowed users which are allowed to call the EcuM_GoDown API.
          symbolic name reference EcuMGoDownAllowedUserRef [1..*]: set at pre-compile, destination=EcuMFlexUserConfig  # These parameters describe the references to the users which are allowed to call the EcuM_GoDown API.
        container EcuMResetMode [1..*]  # These containers describe the configured reset modes. | The name of these containers allows one of the following symbolic names to be given to the different reset modes: - ECUM_RESET_MCU - ECUM_RESET_WDGM - ECUM_RESET_IO.
          integer EcuMResetModeId: 0..255, set at pre-compile, symbolic-name-value=true  # This ID identifies this reset mode in services like EcuM_SelectShutdownTarget.
        container EcuMSetClockAllowedUsers [0..1]  # This container describes the collection of allowed users which are allowed to call the EcuM_SetClock API.
          symbolic name reference EcuMSetClockAllowedUserRef [1..*]: set at pre-compile, destination=EcuMFlexUserConfig  # These parameters describe the references to the users which are allowed to call the EcuM_SetClock API.
        container EcuMShutdownCause [1..*]  # These containers describe the configured shut down or reset causes. | The name of these containers allows to give one of the following symbolic names to the diffenrent shut down causes: - ECUM_CAUSE_ECU_STATE - ECU state machine entered a state for shutdown, - ECUM_CAUSE_WDGM - WdgM detected failure, - ECUM_CAUSE_DCM - Dcm requests shutdown (split into UDS services?), - and values from configuration.
          integer EcuMShutdownCauseId: 0..255, set at pre-compile, symbolic-name-value=true  # This ID identifies this shut down cause.
        container EcuMShutdownTarget [1..*]  # These containers describe the configured shut down targets. | The name of these containers allows to give symbolic names to the different shut down targets.
          integer EcuMShutdownTargetId: 0..255, set at pre-compile, symbolic-name-value=true  # This ID identifies this shut down target in services like EcuM_SelectShutdownTarget.
    container EcuMFixedGeneral [0..1]  # This container holds the general, pre-compile configuration parameters for the EcuMFixed. | Only applicable if EcuMFixed is implemented.
      boolean EcuMIncludeComM: set at pre-compile  # This configuration parameter defines whether the communication manager is supported by EcuM. This feature is presented for development purpose to compile out the communication manager in the early debugging phase.
      boolean EcuMIncludeNvM: set at pre-compile  # This configuration parameter defines whether the non volatile memory manager is supported by EcuM. This feature is presented for development purpose to compile out the volatile memory manager in the early debugging phase.
      boolean EcuMIncludeNvramMgr: set at pre-compile  # If NVRAM manager is enabled but both flash and EEPROM driver are missing, then an error shall be flagged by the configuration tool
      boolean EcuMTTIIEnabled: set at pre-compile  # Boolean switch to enable / disable TTII
      symbolic name reference EcuMTTIIWakeupSourceRef: set at pre-compile, destination=EcuMWakeupSource  # This configuration parameter references the initial sleep mode to be used by TTII when TTII is activated after a RUN mode. | EcuM2785: Whenever RUN mode is reached, the TTII protocol shall be reset to use the wakeup source referenced by this parameter. This configuration parameter is a human readable name for a TTII wakeup source which is only needed by the configuration tool. For imlementation on the ECU, this parameter may be dropped and replaced by a generated list index of EcuM_TTII.
    container EcuMFlexGeneral [0..1]  # This container holds the general, pre-compile configuration parameters for the EcuMFlex. | Only applicable if EcuMFlex is implemented.
      boolean EcuMAlarmClockPresent: set at pre-compile  # This flag indicates whether the optional AlarmClock feature is present.
      boolean EcuMEnableDefBehaviour [0..1]: set at pre-compile  # Switches the defensive behaviour on or off.
      boolean EcuMResetLoopDetection: set at pre-compile  # If false, no reset loop detection is performed.
      symbolic name reference EcuMAlarmWakeupSource [0..1]: set at pre-compile, destination=EcuMWakeupSource  # This parameter describes the reference to the EcuMWakeupSource being used for the EcuM AlarmClock.
    container EcuMGeneral  # This container holds the general, pre-compile configuration parameters.
      boolean EcuMDevErrorDetect: set at pre-compile  # If false, no debug artifacts (e.g. calls to DET) shall remain in the executable object. Initialization of DET, however is controlled by configuration of optional BSW modules.
      boolean EcuMIncludeDem: set at pre-compile  # If enabled, the according BSW module will be included to the ECU State Manager.
      boolean EcuMIncludeDet: set at pre-compile  # If defined, the according BSW module will be initialized by the ECU State Manager
      float EcuMMainFunctionPeriod: 0..Inf, set at pre-compile  # This parameter defines the schedule period of EcuM_MainFunction. | Unit: [s]
      boolean EcuMVersionInfoApi: set at pre-compile  # Switches the version info API on or off
  module definition Eep [0..*]: variants post-build/pre-compile  # Configuration of the Eep (internal or external EEPROM driver) module. | Its multiplicity describes the number of EEPROM drivers present, so there will be one container for each EEPROM driver in the ECUC template. When no EEPROM driver is present then the multiplicity is 0.
    container EepGeneral  # Container for general configuration parameters of the EEPROM driver. These parameters are always pre-compile.
      boolean EepDevErrorDetect: set at pre-compile, default-value=true  # Pre-processor switch to enable and disable development error detection. | true: Development error detection enabled. false: Development error detection disabled.
      integer EepDriverIndex: 0..254, set at pre-compile, symbolic-name-value=true  # Index of the driver, used by EA.
      boolean EepUseInterrupts: set at pre-compile, default-value=false  # Switches to activate or deactivate interrupt controlled job processing. | true: Interrupt controlled job processing enabled. false: Interrupt controlled job processing disabled.
      boolean EepVersionInfoApi: set at pre-compile, default-value=false  # Pre-processor switch to enable / disable the API to read out the modules version information. | true: Version info API enabled. false: Version info API disabled.
      boolean EepWriteCycleReduction: set at pre-compile, default-value=false  # Switches to activate or deactivate write cycle reduction (EEPROM value is read and compared before being overwritten). | true: Write cycle reduction enabled. false: Write cycle reduction disabled.
    container EepInitConfiguration: multiple-configuration-container=true  # Container for runtime configuration parameters of the EEPROM driver. | Implementation Type: Eep_ConfigType.
      integer EepBaseAddress: 0..4294967295, set at post-build in variant post-build / pre-compile in variant pre-compile  # This parameter is the EEPROM device base address. | Implementation Type: Eep_AddressType.
      enumeration EepDefaultMode: {MEMIF_MODE_FAST, MEMIF_MODE_SLOW}, set at post-build in variant post-build / pre-compile in variant pre-compile, default-value=MEMIF_MODE_SLOW  # This parameter is the default EEPROM device mode after initialization. | Implementation Type: MemIf_ModeType.
      integer EepFastReadBlockSize: 0..4294967295, set at post-build in variant post-build / pre-compile in variant pre-compile  # Number of bytes read within one job processing cycle in fast mode. If the hardware does not support burst mode this parameter shall be set to the same value as EepNormalReadBlockSize. | Implementation Type: Eep_LengthType.
      integer EepFastWriteBlockSize: 0..4294967295, set at post-build in variant post-build / pre-compile in variant pre-compile  # Number of bytes written within one job processing cycle in fast mode. If the hardware does not support burst mode this parameter shall be set to the same value as EepNormalWriteBlockSize. | Implementation Type: Eep_LengthType.
      float EepJobCallCycle [0..1]: 0..Inf, set at post-build in variant post-build / pre-compile in variant pre-compile  # Call cycle time of the EEPROM driver's main function. Unit: [s]
      function name EepJobEndNotification [0..1]: set at post-build in variant post-build / pre-compile in variant pre-compile  # This parameter is a reference to a callback function for positive job result (see EEP045).
      function name EepJobErrorNotification [0..1]: set at post-build in variant post-build / pre-compile in variant pre-compile  # This parameter is a reference to a callback function for negative job result (see EEP046).
      integer EepNormalReadBlockSize: 0..4294967295, set at post-build in variant post-build / pre-compile in variant pre-compile  # Number of bytes read within one job processing cycle in normal mode. | Implementation Type: Eep_LengthType.
      integer EepNormalWriteBlockSize: 0..4294967295, set at post-build in variant post-build / pre-compile in variant pre-compile  # Number of bytes written within one job processing cycle in normal mode. | Implementation Type: Eep_LengthType.
      integer EepSize: 0..4294967295, set at post-build in variant post-build / pre-compile in variant pre-compile  # This parameter is the used size of EEPROM device in bytes. | Implementation Type: Eep_LengthType.
      container EepDemEventParameterRefs [0..1]  # Container for the references to DemEventParameter elements which shall be invoked using the API Dem_ReportErrorStatus API in case the corresponding error occurs. The EventId is taken from the referenced DemEventParameter's DemEventId value. The standardized errors are provided in the container and can be extended by vendor specific error references.
        symbolic name reference EEP_E_COMPARE_FAILED [0..1]: set at post-build in variant post-build / pre-compile in variant pre-compile, destination=DemEventParameter  # Reference to the DemEventParameter which shall be issued when the error "EEPROM compare failed (HW)" has occurred.
        symbolic name reference EEP_E_ERASE_FAILED [0..1]: set at post-build in variant post-build / pre-compile in variant pre-compile, destination=DemEventParameter  # Reference to the DemEventParameter which shall be issued when the error "EEPROM erase failed (HW)" has occurred.
        symbolic name reference EEP_E_READ_FAILED [0..1]: set at post-build in variant post-build / pre-compile in variant pre-compile, destination=DemEventParameter  # Reference to the DemEventParameter which shall be issued when the error "EEPROM read failed (HW)" has occurred.
        symbolic name reference EEP_E_WRITE_FAILED [0..1]: set at post-build in variant post-build / pre-compile in variant pre-compile, destination=DemEventParameter  # Reference to the DemEventParameter which shall be issued when the error "EEPROM write failed (HW)" has occurred.
      container EepExternalDriver [0..1]  # This container is present for external EEPROM drivers only. Internal EEPROM drivers do not use the parameter listed in this container, hence its multiplicity is 0 for internal drivers.
        symbolic name reference EepSpiReference [1..*]: set at post-build in variant post-build / pre-compile in variant pre-compile, destination=SpiSequence  # Reference to SPI sequence (required for external EEPROM drivers).
    container EepPublishedInformation  # Additional published parameters not covered by CommonPublishedInformation container. | Note that these parameters do not have any configuration class setting, since they are published information.
      integer EepAllowedWriteCycles: 0..4294967295, set at published-information  # Specified maximum number of write cycles under worst case conditions of specific EEPROM hardware (e.g. +90°C)
      float EepEraseTime: 0..Inf, set at published-information  # Maximum time for erasing one EEPROM data unit.
      integer EepEraseUnitSize: 0..4294967295, set at published-information  # Size of smallest erasable EEPROM data unit in bytes.
      integer EepEraseValue: 0..255, set at published-information  # Value of an erased EEPROM cell.
      integer EepMinimumAddressType: 0..4294967295, set at published-information  # Minimum expected size of Eep_AddressType.
      integer EepMinimumLengthType: 0..4294967295, set at published-information  # Minimum expected size of Eep_LengthType.
      integer EepReadUnitSize: 0..4294967295, set at published-information  # Size of smallest readable EEPROM data unit in bytes.
      integer EepSpecifiedEraseCycles: 0..4294967295, set at published-information  # Number of erase cycles specified for the EEP device (usually given in the device data sheet).
      integer EepTotalSize: 0..4294967295, set at published-information  # Total size of EEPROM in bytes. | Implementation Type: Eep_LengthType.
      float EepWriteTime: 0..Inf, set at published-information  # Maximum time for writing one EEPROM data unit.
      integer EepWriteUnitSize: 0..4294967295, set at published-information  # Size of smallest writeable EEPROM data unit in bytes.
  module definition Eth [0..*]: variants link-time/post-build/pre-compile  # Configuration of the Eth (Ethernet Driver) module.
    container EthConfigSet: multiple-configuration-container=true  # All included containers and parameters that may be part of a multiple configuration set.
      container EthCtrlConfig [1..*]  # Configuration of the individual controller
        boolean EthCtrlEnableMii: set at pre-compile  # Enables / Disables Media Independent Interface (MII) for transceiver access
        boolean EthCtrlEnableRxInterrupt: set at pre-compile  # Enables / Disables receive interrupt
        boolean EthCtrlEnableTxInterrupt: set at pre-compile  # Enables / Disables transmit interrupt
        integer EthCtrlIdx: 0..255, set at link in variant link-time / post-build in variant post-build / pre-compile in variant pre-compile, symbolic-name-value=true  # Specifies the instance ID of the configured controller.
        integer EthCtrlRxBufLenByte: 0..1522, set at link in variant link-time / post-build in variant post-build / pre-compile in variant pre-compile  # Limits the maximum receive buffer length (frame length) in bytes.
        integer EthCtrlTxBufLenByte: 0..1522, set at link in variant link-time / post-build in variant post-build / pre-compile in variant pre-compile  # Limits the maximum transmit buffer length (frame length) in bytes.
        integer EthRxBufTotal: 0..255, set at link in variant link-time / post-build in variant post-build / pre-compile in variant pre-compile  # Configures the number of receive buffers.
        integer EthTxBufTotal: 0..255, set at link in variant link-time / post-build in variant post-build / pre-compile in variant pre-compile  # Configures the number of transmit buffers.
        container EthDemEventParameterRefs [0..1]  # Container for the references to DemEventParameter elements which shall be invoked using the API Dem_ReportErrorStatus in case the corresponding error occurs. The EventId is taken from the referenced DemEventParameter's DemEventId value. The standardized errors are provided in the container and can be extended by vendor specific error references.
          symbolic name reference ETH_E_ACCESS [0..1]: set at link in variant link-time / post-build in variant post-build / pre-compile in variant pre-compile, destination=DemEventParameter  # Reference to the DemEventParameter which shall be issued when the error "Controller access failed" has occured.
    container EthGeneral  # General configuration of Ethernet Driver module
      boolean EthDevErrorDetect: set at pre-compile  # Enables / Disables development error detection.
      integer EthIndex: 0..255, set at pre-compile  # Specifies the InstanceId of this module instance. If only one instance is present it shall have the Id 0.
      integer EthMaxCtrlsSupported: 1..255, set at pre-compile  # Limits the total number of supported controllers.
      boolean EthVersionInfoApi: set at pre-compile  # Enables / Disables version info API
      boolean EthVersionInfoApiMacro: set at pre-compile  # Enables / Disables version info API macro implementation
  module definition EthIf [0..1]: variants link-time/post-build/pre-compile  # Configuration of the EthIf (Ethernet Interface) module.
    container EthIfConfigSet: multiple-configuration-container=true  # Collecting container for all parameters with post-build configuration classes.
      container EthIfConnection2EthCtrlMapping [1..*]  # Maps a particular connection in the Ethernet Interface to the physical Ethernet Controller.
        symbolic name reference EthIfEthCtrlRef: set at link in variant link-time / post-build in variant post-build / pre-compile in variant pre-compile, destination=EthCtrlConfig  # Reference to the controller in Ethernet Driver on which this connection will be transmitted / received. Connections are specified in the Socket Adapter [9].
        symbolic name reference EthIfSoAdConnectionRef: set at link in variant link-time / post-build in variant post-build / pre-compile in variant pre-compile, destination=SoAdSocketConnection
      container EthIfFrameOwnerConfig [1..*]  # Configuration of Ethernet frame owner
        integer EthIfFrameType: 0..65535, set at link in variant link-time / post-build in variant post-build / pre-compile in variant pre-compile  # Selects the Ethernet frame type.
        integer EthIfOwner: 0..255, set at link in variant link-time / post-build in variant post-build / pre-compile in variant pre-compile  # Selects the owner of an Ethernet frame type. The owner is a zero based index into the callback function configuration 'EthIfRxIndicationConfig'. I.e. an Ethernet frame of type IPv4 (0x800) at index 0 will call the first callback function configured in 'EthIfRxIndicationConfig'.
      container EthIfRxIndicationConfig [1..*]  # Configuration of receive callback functions.
        function name EthIfRxIndicationFunction: set at link in variant link-time / post-build in variant post-build / pre-compile in variant pre-compile  # Specifies receive indication callback function.
      container EthIfTrcvLinkStateChgConfig [1..*]  # Specifies link state change callback function
        function name EthIfTrcvLinkStateChgFunction: set at link in variant link-time / post-build in variant post-build / pre-compile in variant pre-compile  # Specifies link state change callback function
      container EthIfTxConfirmationConfig [1..*]  # Configuration of transmit indication callback functions.
        function name EthIfTxConfirmationFunction: set at link in variant link-time / post-build in variant post-build / pre-compile in variant pre-compile  # Specifies transmit indication callback function
    container EthIfGeneral  # This container contains the general configuration parameters of the Ethernet Interface.
      boolean EthIfDevErrorDetect: set at pre-compile  # Enables / Disables development error detection.
      boolean EthIfEnableRxInterrupt: set at pre-compile  # Enables / Disables receive interrupt.
      boolean EthIfEnableTxInterrupt: set at pre-compile  # Enables / Disables the transmit interrupt.
      float EthIfMainFunctionPeriod: 0..Inf, set at pre-compile  # Specifies the period of main function EthIf_MainFunctionRx and EthIf_MainFunctionTx in seconds. Ethernet Interface does not require this information but the BSW scheduler.
      integer EthIfMaxTrcvsTotal: 1..255, set at pre-compile  # Limits the total number of transceivers.
      integer EthIfMaxTxBufsTotal: 1..255, set at pre-compile  # Limits the total number of transmit buffers.
      string EthIfPublicCddHeaderFile [0..*]: set at pre-compile, max-length=32, min-length=1  # Defines header files for callback functions which shall be included in case of CDDs. Range of characters is 1.. 32.
      integer EthIfTrcvLinkStateChgMainReload: 1..255, set at pre-compile  # Specifies the frequency of transceiver link state change checks in each | period of main function EthIf_MainFunctionTx.
      boolean EthIfVersionInfoApi: set at pre-compile  # Enables / Disables version info API
      boolean EthIfVersionInfoApiMacro: set at pre-compile  # Enables / Disables version info API macro implementation.
  module definition EthSm [0..1]: variants pre-compile  # Configuration of the Ethernet State Manager
    container EthSmGeneral  # This container contains the global parameter of the Ethernet State Manager.
      boolean EthSmDevErrorDetect: set at pre-compile  # Enables and disables the development errer detection and notification mechanism.
      boolean EthSmDummyMode: set at pre-compile  # Disables the API to the EthIf. The API to the ComM is available but the functionality is deactivated. The function calls from the ComM will be answered with the return value E_OK.
      float EthSmMainFunctionPeriod: 0.005..1, set at pre-compile  # Specifies the period in seconds that the MainFunction has to be triggered with.
      boolean EthSmVersionInfoApi: set at pre-compile  # Enables and disables the version info API.
    container EthSmNetwork [1..*]  # This container contains the Ethernet network-specific parameters of each Ethernet network. It also contains the controller and transceiver IDs assigned to a Ethernet network.
      float EthSmConfirmationTimeout: 0..Inf, set at pre-compile  # Timeout in seconds for the calls to EthIf: | EthIf_ControllerInit EthIf_TransceiverInit EthIf_SetControllerMode EthIf_SetTransceiverMode
      symbolic name reference EthSMComMNetworkHandleRef: set at pre-compile, destination=ComMChannel  # Unique handle to identify one certain Ethernet network. Reference to one of the network handles configured for the ComM.
      symbolic name reference EthSmControllerId: set at pre-compile, destination=EthCtrlConfig  # ID of the Ethernet controller assigned to the configured network handle. Reference to one of the controllers of Eth configuration.
      symbolic name reference EthSmTransceiverId: set at pre-compile, destination=EthTrcvConfig  # ID of the ethernet transceiver assigned to the configured network handle. Reference to one of the transceivers of EthTrcv configuration.
  module definition EthTrcv [0..*]: variants link-time/post-build/pre-compile  # Configuration of Ethernet Transceiver Driver module
    container EthTrcvConfigSet: multiple-configuration-container=true  # All underlying parameters may be part of a multiple configuration set.
      container EthTrcvConfig [1..*]  # Configuration of the individual transceiver
        integer EthTrcvCtrlIdx: 0..255, set at link in variant link-time / post-build in variant post-build / pre-compile in variant pre-compile  # Specifies the controller used for MII access to the transceiver
        integer EthTrcvIdx: 0..255, set at link in variant link-time / post-build in variant post-build / pre-compile in variant pre-compile, symbolic-name-value=true  # Specifies the instance ID of the configured transceiver.
        integer EthTrcvMiiIdx: 0..255, set at link in variant link-time / post-build in variant post-build / pre-compile in variant pre-compile  # Specifies the transceiver index used for MII access to the transceiver
        container EthTrcvDemEventParameterRefs [0..1]  # Container for the references to DemEventParameter elements which shall be invoked using the API Dem_ReportErrorStatus API in case the corresponding error occurs. The EventId is taken from the referenced DemEventParameter's DemEventId value. The standardized errors are provided in the container and can be extended by vendor specific error references.
          symbolic name reference ETHTRCV_E_ACCESS [0..1]: set at link in variant link-time / post-build in variant post-build / pre-compile in variant pre-compile, destination=DemEventParameter  # Reference to the DemEventParameter which shall be issued when the error "Transceiver access failed" has occured.
    container EthTrcvGeneral  # General configuration of Ethernet Transceiver Driver module
      boolean EthTrcvDevErrorDetect: set at pre-compile  # Enables / Disables development error detection
      boolean EthTrcvGetBaudRateApi: set at pre-compile  # Enables / Disables EthTrcv_GetBaudRate API
      boolean EthTrcvGetDuplexModeApi: set at pre-compile  # Enables / Disables EthTrcv_GetDuplexMode API
      boolean EthTrcvGetLinkStateApi: set at pre-compile  # Enables / Disables EthTrcv_GetLinkState API
      boolean EthTrcvGetTransceiverModeApi: set at pre-compile  # Enables / Disables EthTrcv_GetTransceiverMode API
      integer EthTrcvIndex: 0..255, set at pre-compile  # Specifies the InstanceId of this module instance. If only one instance is present it shall have the Id 0.
      integer EthTrcvMaxTrcvsSupported: 0..255, set at pre-compile, default-value=1
      boolean EthTrcvSetTransceiverModeApi: set at pre-compile  # Enables / Disables EthTrcv_SetTransceiverMode API
      boolean EthTrcvStartAutoNegotiationApi: set at pre-compile  # Enables / Disables EthTrcv_StartAutoNegotiation API
      boolean EthTrcvVersionInfoApi: set at pre-compile  # Enables / Disables version info API
      boolean EthTrcvVersionInfoApiMacro: set at pre-compile  # Enables / Disables version info API macro implementation
      integer EthTrcvWaitCount: 0..4294967295, set at pre-compile, default-value=0  # Wait count for transceiver state changes.
  module definition Fee [0..1]: variants pre-compile  # Configuration of the Fee (Flash EEPROM Emulation) module.
    container FeeBlockConfiguration [1..*]  # Configuration of block specific parameters for the Flash EEPROM Emulation module.
      integer FeeBlockNumber: 1..65534, set at pre-compile, symbolic-name-value=true  # Block identifier (handle). | 0x0000 and 0xFFFF shall not be used for block numbers (see FEE006). Range: min = 2^NVM_DATASET_SELECTION_BITS max = 0xFFFF -2^NVM_DATASET_SELECTION_BITS Note: Depending on the number of bits set aside for dataset selection several other block numbers shall also be left out to ease implementation.
      integer FeeBlockSize: 1..65535, set at pre-compile  # Size of a logical block in bytes.
      boolean FeeImmediateData: set at pre-compile  # Marker for high priority data. | true: Block contains immediate data. false: Block does not contain immediate data.
      integer FeeNumberOfWriteCycles: 0..4294967295, set at pre-compile  # Number of write cycles required for this block.
      symbolic name reference FeeDeviceIndex: set at pre-compile, destination=FlsGeneral  # Device index (handle). | Range: 0 .. 254 (0xFF reserved for broadcast call to GetStatus function).
    container FeeGeneral  # Container for general parameters. These parameters are not specific to a block.
      boolean FeeDevErrorDetect: set at pre-compile  # Pre-processor switch to enable and disable development error detection. | true: Development error detection enabled. false: Development error detection disabled.
      integer FeeIndex: 0..254, set at pre-compile  # Specifies the InstanceId of this module instance. If only one instance is present it shall have the Id 0.
      function name FeeNvmJobEndNotification [0..1]: set at pre-compile  # Mapped to the job end notification routine provided by the upper layer module (NvM_JobEndNotification).
      function name FeeNvmJobErrorNotification [0..1]: set at pre-compile  # Mapped to the job error notification routine provided by the upper layer module (NvM_JobErrorNotification).
      boolean FeePollingMode: set at pre-compile  # Pre-processor switch to enable and disable the polling mode for this module. | true: Polling mode enabled, callback functions (provided to FLS module) disabled. false: Polling mode disabled, callback functions (provided to FLS module) enabled.
      boolean FeeSetModeSupported: set at pre-compile  # Compiler switch to enable/disable the 'SetMode' functionality of the FEE module. | TRUE: SetMode functionality supported / code present, FALSE: SetMode functionality not supported / code not present. Note: This configuration setting has to be consistent with that of all underlying flash device drivers (configuration parameter FlsSetModeApi).
      boolean FeeVersionInfoApi: set at pre-compile  # Pre-processor switch to enable / disable the API to read out the modules version information. | true: Version info API enabled. false: Version info API disabled.
      integer FeeVirtualPageSize: 0..65535, set at pre-compile  # The size in bytes to which logical blocks shall be aligned.
    container FeePublishedInformation  # Additional published parameters not covered by CommonPublishedInformation container. | Note that these parameters do not have any configuration class setting, since they are published information.
      integer FeeBlockOverhead: 0..65535, set at published-information  # Management overhead per logical block in bytes. | Note: If the management overhead depends on the block size or block location a formula has to be provided that allows the configurator to calculate the management overhead correctly.
      float FeeMaximumBlockingTime: 0..Inf, set at published-information  # The maximum time the FEE module's API routines shall be blocked (delayed) by internal operations. | Note: Internal operations in that case means operations that are not explicitly invoked from the upper layer module but need to be handled for proper operation of this module or the underlying memory driver.
      integer FeePageOverhead: 0..65535, set at published-information  # Management overhead per page in bytes. | Note: If the management overhead depends on the block size or block location a formula has to be provided that allows the configurator to calculate the management overhead correctly.
  module definition FiM [0..1]: variants post-build/pre-compile  # Configuration of the FiM (Function Inhibition Manager) module.
    container FiMConfigSet: multiple-configuration-container=true  # This container contains the configuration parameters and sub containers of the FiM module supporting multiple configuration sets. | This container is a MultipleConfigurationContainer, i.e. this container and its sub-containers exist once per configuration set.
      container FiMEventSummary [0..*]  # The summarized EventId definition record consists of a summarized event ID and a specific EventId. | This record means that a particular FID that has to be disabled in case of summarized event (defined above) is to be disabled in any of the specific events. A possible solution could be assigning events as summarized events along with a list of specific events. During the configuration process the summarized event substitutes the referenced single events. However, it is not outlined how this requirement is solved - whether by configuration process or by implementation within the FiM. The FiM configuration tool could also build up a suitable data structure for summarized events and deal with it in the FiM implementation.
        symbolic name reference FiMInputSumEventRef [1..*]: set at post-build in variant post-build / pre-compile in variant pre-compile, destination=DemEventParameter
        symbolic name reference FiMOutputSumEventRef: set at post-build in variant post-build / pre-compile in variant pre-compile, destination=FiMSummaryEventId
      container FiMFID [0..*]  # This container includes symbolic names of all FIDs.
        integer FiMFunctionId: 0..65535, set at pre-compile, symbolic-name-value=true  # The configuration parameter is used as an ID which represents a functionality. FiMFunctionId is the unique identifier assigned during FIM configuration. | Implementation Type: FiM_FunctionIdType.
      container FiMInhibitionConfiguration [0..*]  # This container includes all configuration parameters concerning the relationship between event and FID.
        enumeration FiMInhInhibitionMask: {FIM_LAST_FAILED, FIM_NOT_TESTED, FIM_TESTED, FIM_TESTED_AND_FAILED}, set at post-build in variant post-build / pre-compile in variant pre-compile  # The configuration parameter is used to specify the inhibition mask for an event - FID relation.
        reference FiMInhFunctionIdRef: set at post-build in variant post-build / pre-compile in variant pre-compile, destination=FiMFID
        container FiMInhEventId  # The configuration parameter is used for an existing DEM event and summarized events as well.
          choice container FiMInhRefChoice
            container FiMInhChoiceDemRef [0..1]
              symbolic name reference FiMInhEventRef: destination=DemEventParameter
            container FiMInhChoiceSumRef [0..1]
              symbolic name reference FiMInhSumRef [1..*]: destination=FiMSummaryEventId
      container FiMSummaryEventId [0..*]  # This container defines the name of a summarized event.
        integer FiMEventSumId: 0..65535, set at post-build in variant post-build / pre-compile in variant pre-compile, symbolic-name-value=true  # The summarized EventId definition record defines the existence of a summarized event with a specific name. This summarized event can be referenced in the EventSummary (as FimSummaryEventId) and Inhibition configuration (as FimInhEventId).
    container FiMGeneral
      boolean FiMDataFixed: set at pre-compile  # Enable or disable calibration of inhibit relations The scope of the parameter is to meet the requirement (FIM008) to have the option to calibrate inhibit data on the one hand side and also to provide the option to protect inhibit data for consistency reasons.
      boolean FiMDevErrorDetect: set at pre-compile  # This configuration parameter is used to switch on or to switch off the detection of development errors during development.
      boolean FiMEventUpdateTriggeredByDem: set at pre-compile  # This configuration parameter specifies the way FIM obtains status of EventIds. | TRUE: the DEM informs FIM about changes of event status, FALSE: the FIM polls event status from the DEM module either cyclically or on demand.
      integer FiMMaxEventFidLinks: 1..65535, set at pre-compile  # This configuration parameter specifies the total maximum number of links between EventIds and FIDs.
      integer FiMMaxEventsPerFid: 1..65535, set at pre-compile  # This configuration parameter specifies the maximum number of EventIds that can be linked to a single FID.
      integer FiMMaxFidsPerEvent: 1..65535, set at pre-compile  # This configuration parameter specifies the maximum number of FIDs that can be linked to a single event.
      integer FiMMaxSummaryEvents: 0..65535, set at pre-compile  # This configuration parameter specifies the maximum number of summarized events that can be configured.
      integer FiMMaxSummaryLinks: 0..65535, set at pre-compile  # This configuration parameter specifies the total maximum number of links between EventIds and summarized events.
      integer FiMMaxTotalLinks: 1..65535, set at pre-compile  # This configuration parameter specifies the total maximum number of links between EventIds and FIDs plus the number of links between EventIds and summarized events.
      float FiMTaskTime: 0..0.1, set at pre-compile, origin=AUTOSAR_ECUC V1.0.0  # Allow to configure the time for the periodic cyclic task. Please note: This configuration value shall be equal to the value in the Basic Software Scheduler configuration of the RTE module. | The AUTOSAR configuration standard is to use SI units, so this parameter is defined as float value in seconds. DEM configuration tools must convert this float value to the appropriate value format for the use in the software implementation of DEM. min: A negative value is not allowed. max: FID must be set after a maximal time of 100ms after DEM status is set. upperMultiplicity: Exactly one TaskTime must be specified per configuration. lowerMultiplicity: Exactly one TaskTime must be specified per configuration.
      boolean FiMVersionInfoApi: set at pre-compile  # This configuration parameter is used to switch on or to switch off the API to get the version information.
  module definition Fls [0..*]: variants post-build/pre-compile  # Configuration of the Fls (internal or external flash driver) module. | Its multiplicity describes the number of flash drivers present, so there will be one container for each flash driver in the ECUC template. When no flash driver is present then the multiplicity is 0.
    container FlsConfigSet: multiple-configuration-container=true  # Container for runtime configuration parameters of the flash driver. | Implementation Type: Fls_ConfigType.
      integer FlsAcErase: 0..4294967295, set at post-build in variant post-build / pre-compile in variant pre-compile  # Address offset in RAM to which the erase flash access code shall be loaded. | Used as function pointer to access the erase flash access code.
      integer FlsAcWrite: 0..4294967295, set at post-build in variant post-build / pre-compile in variant pre-compile  # Address offset in RAM to which the write flash access code shall be loaded. | Used as function pointer to access the write flash access code.
      float FlsCallCycle: 0..1, set at post-build in variant post-build / pre-compile in variant pre-compile  # Cycle time of calls of the flash driver's main function (in seconds).
      enumeration FlsDefaultMode: {MEMIF_MODE_FAST, MEMIF_MODE_SLOW}, set at post-build in variant post-build / pre-compile in variant pre-compile, default-value=MEMIF_MODE_SLOW  # This parameter is the default FLS device mode after initialization. | Implementation Type: MemIf_ModeType.
      function name FlsJobEndNotification [0..1]: set at post-build in variant post-build / pre-compile in variant pre-compile  # Mapped to the job end notification routine provided by some upper layer module, typically the Fee module.
      function name FlsJobErrorNotification [0..1]: set at post-build in variant post-build / pre-compile in variant pre-compile  # Mapped to the job error notification routine provided by some upper layer module, typically the Fee module.
      integer FlsMaxReadFastMode: 0..4294967295, set at post-build in variant post-build / pre-compile in variant pre-compile  # The maximum number of bytes to read or compare in one cycle of the flash driver's job processing function in fast mode.
      integer FlsMaxReadNormalMode: 0..4294967295, set at post-build in variant post-build / pre-compile in variant pre-compile  # The maximum number of bytes to read or compare in one cycle of the flash driver's job processing function in normal mode.
      integer FlsMaxWriteFastMode: 0..4294967295, set at post-build in variant post-build / pre-compile in variant pre-compile  # The maximum number of bytes to write in one cycle of the flash driver's job processing function in fast mode.
      integer FlsMaxWriteNormalMode: 0..4294967295, set at post-build in variant post-build / pre-compile in variant pre-compile  # The maximum number of bytes to write in one cycle of the flash driver's job processing function in normal mode.
      integer FlsProtection: 0..4294967295, set at post-build in variant post-build / pre-compile in variant pre-compile  # Erase/write protection settings. Only relevant if supported by hardware.
      container FlsDemEventParameterRefs [0..1]  # Container for the references to DemEventParameter elements which shall be invoked using the Dem_ReportErrorStatus API in case the corresponding error occurs. The EventId is taken from the referenced DemEventParameter's DemEventId value. The standardized errors are provided in the container and can be extended by vendor specific error references.
        symbolic name reference FLS_E_COMPARE_FAILED [0..1]: set at post-build in variant post-build / pre-compile in variant pre-compile, destination=DemEventParameter  # Reference to the DemEventParameter which shall be issued when the error "Flash compare failed (HW)" has occurred.
        symbolic name reference FLS_E_ERASE_FAILED [0..1]: set at post-build in variant post-build / pre-compile in variant pre-compile, destination=DemEventParameter  # Reference to the DemEventParameter which shall be issued when the error "Flash erase failed (HW)" has occurred.
        symbolic name reference FLS_E_READ_FAILED [0..1]: set at post-build in variant post-build / pre-compile in variant pre-compile, destination=DemEventParameter  # Reference to the DemEventParameter which shall be issued when the error "Flash read failed (HW)" has occurred.
        symbolic name reference FLS_E_UNEXPECTED_FLASH_ID [0..1]: set at post-build in variant post-build / pre-compile in variant pre-compile, destination=DemEventParameter  # Reference to the DemEventParameter which shall be issued when the error "Expected hardware ID not matched" has occurred.
        symbolic name reference FLS_E_WRITE_FAILED [0..1]: set at post-build in variant post-build / pre-compile in variant pre-compile, destination=DemEventParameter  # Reference to the DemEventParameter which shall be issued when the error "Flash write failed (HW)" has occurred.
      container FlsExternalDriver [0..1]  # This container is present for external Flash drivers only. Internal Flash drivers do not use the parameter listed in this container, hence its multiplicity is 0 for internal drivers.
        symbolic name reference FlsSpiReference [1..*]: set at pre-compile, destination=SpiSequence  # Reference to SPI sequence (required for external Flash drivers).
      container FlsSectorList  # List of flashable sectors and pages.
        container FlsSector [1..*]  # Configuration description of a flashable sector
          integer FlsNumberOfSectors: 0..65535, set at pre-compile  # Number of continuous sectors with identical values for FlsSectorSize and | FlsPageSize. The parameter FlsSectorStartAddress denotes the start address of the first sector.
          integer FlsPageSize: 0..4294967295, set at pre-compile  # Size of one page of this sector. | Implementation Type: Fls_LengthType.
          integer FlsSectorSize: 0..4294967295, set at pre-compile  # Size of this sector. | Implementation Type: Fls_LengthType.
          integer FlsSectorStartaddress: 0..4294967295, set at pre-compile  # Start address of this sector. | Implementation Type: Fls_AddressType.
    container FlsGeneral  # Container for general parameters of the flash driver. These parameters are always pre-compile.
      boolean FlsAcLoadOnJobStart: set at pre-compile, default-value=false  # The flash driver shall load the flash access code to RAM whenever an erase or write job is started and unload (overwrite) it after that job has been finished or canceled. | true: Flash access code loaded on job start / unloaded on job end or error. false: Flash access code not loaded to / unloaded from RAM at all.
      integer FlsBaseAddress: 0..4294967295, set at pre-compile  # The flash memory start address (see also FLS208 and FLS209). | FLS169_Conf: This parameter defines the lower boundary for read / write / erase and compare jobs.
      boolean FlsCancelApi: set at pre-compile  # Compile switch to enable and disable the Fls_Cancel function. | true: API supported / function provided. false: API not supported / function not provided
      boolean FlsCompareApi: set at pre-compile  # Compile switch to enable and disable the Fls_Compare function. | true: API supported / function provided. false: API not supported / function not provided
      boolean FlsDevErrorDetect: set at pre-compile, default-value=true  # Pre-processor switch to enable and disable development error detection (see FLS077). | true: Development error detection enabled. false: Development error detection disabled.
      integer FlsDriverIndex: 0..254, set at pre-compile, symbolic-name-value=true  # Index of the driver, used by FEE.
      boolean FlsGetJobResultApi: set at pre-compile  # Compile switch to enable and disable the Fls_GetJobResult function. | true: API supported / function provided. false: API not supported / function not provided
      boolean FlsGetStatusApi: set at pre-compile  # Compile switch to enable and disable the Fls_GetStatus function. | true: API supported / function provided. false: API not supported / function not provided
      boolean FlsSetModeApi: set at pre-compile  # Compile switch to enable and disable the Fls_SetMode function. | true: API supported / function provided. false: API not supported / function not provided
      integer FlsTotalSize: 0..4294967295, set at pre-compile  # The total amount of flash memory in bytes (see also FLS208 and FLS209). | FLS170_Conf: This parameter in conjunction with FLS_BASE_ADDRESS defines the upper boundary for read / write / erase and compare jobs.
      boolean FlsUseInterrupts: set at pre-compile, default-value=false  # Job processing triggered by hardware interrupt. | true: Job processing triggered by interrupt (hardware controlled). false: Job processing not triggered by interrupt (software controlled)
      boolean FlsVersionInfoApi: set at pre-compile  # Pre-processor switch to enable / disable the API to read out the modules version information. | true: Version info API enabled. false: Version info API disabled.
    container FlsPublishedInformation  # Additional published parameters not covered by CommonPublishedInformation container. | Note that these parameters do not have any configuration class setting, since they are published information.
      integer FlsAcLocationErase: 0..4294967295, set at published-information  # Position in RAM, to which the erase flash access code has to be loaded. | Only relevant if the erase flash access code is not position independent. If this information is not provided it is assumed that the erase flash access code is position independent and that therefore the RAM position can be freely configured.
      integer FlsAcLocationWrite: 0..4294967295, set at published-information  # Position in RAM, to which the write flash access code has to be loaded. | Only relevant if the write flash access code is not position independent. If this information is not provided it is assumed that the write flash access code is position independent and that therefore the RAM position can be freely configured.
      integer FlsAcSizeErase: 0..4294967295, set at published-information  # Number of bytes in RAM needed for the erase flash access code.
      integer FlsAcSizeWrite: 0..4294967295, set at published-information  # Number of bytes in RAM needed for the write flash access code.
      float FlsEraseTime: 0..Inf, set at published-information  # Maximum time to erase one complete flash sector.
      integer FlsErasedValue: 0..4294967295, set at published-information  # The contents of an erased flash memory cell.
      string FlsExpectedHwId: set at published-information  # Unique identifier of the hardware device that is expected by this driver (the device for which this driver has been implemented). | Only relevant for external flash drivers.
      integer FlsSpecifiedEraseCycles: 0..4294967295, set at published-information  # Number of erase cycles specified for the flash device (usually given in the device data sheet). | FLS198: If the number of specified erase cycles depends on the operating environment (temperature, voltage, ...) during reprogramming of the flash device, the minimum number for which a data retention of at least 15 years over the temperature range from -40°C .. +125°C can be guaranteed shall be given. Note: If there are different numbers of specified erase cycles for different flash sectors of the device this parameter has to be extended to a parameter list (similar to the sector list above).
      float FlsWriteTime: 0..Inf, set at published-information  # Maximum time to program one complete flash page.
  module definition FlsTst [0..1]: variants post-build/pre-compile
    container FlsTstConfigSet: multiple-configuration-container=true  # Multiple Configuration Set Container
      integer FlsTstBlockNumberBgnd: 0..4294967295, set at post-build in variant post-build / pre-compile in variant pre-compile  # This parameter shall represent the number of test blocks available for the background test. | calculationFormula = Number of configured FlsTstBlocks in the FlsTstBlockBgndConfigSet (or 0 if no FlsTstBlocks are configured).
      integer FlsTstBlockNumberFgnd: 0..4294967295, set at post-build in variant post-build / pre-compile in variant pre-compile  # This parameter shall represent the number of test blocks available for the foreground test. | calculationFormula = Number of configured FlsTstBlocks in the FlsTstBlockFgndConfigSet (or 0 if no FlsTstBlocks are configured).
      function name FlsTstTestCompletedNotification: set at post-build in variant post-build / pre-compile in variant pre-compile  # Pointer to function, which shall be called after finishing the background Flash test interval.
      container FlsTstBlockBgndConfigSet [0..1]  # This container defines the blocks in background mode.
        container FlsTstBlock [1..*]  # This container specifies configuration parameters for an individual test block.
          integer FlsTstBlockBaseAddress: 0..18446744073709551615, set at post-build in variant post-build / pre-compile in variant pre-compile  # Start Address of the Flash block.
          integer FlsTstBlockIndex: 0..4294967295, set at post-build in variant post-build / pre-compile in variant pre-compile, symbolic-name-value=true  # Foreground Test: Index identifies block to be tested by FlsTst_StartFgnd(); | Background Test: The scheduling for background test shall follow an order defined by this index. '0' means highest priority.
          integer FlsTstBlockSize: 0..4294967295, set at post-build in variant post-build / pre-compile in variant pre-compile  # This parameter shall represent the Flash Test block size.
          integer FlsTstNumberOfTestedCells: 0..4294967295, set at pre-compile  # Configures the Number of cells to be tested in background mode during one scheduled task (FlsTst_MainFunction() call).
          integer FlsTstSignatureAddress: 0..18446744073709551615, set at post-build in variant post-build / pre-compile in variant pre-compile  # Address of the signature reference value of the Flash test block.
          enumeration FlsTstTestAlgorithm: {FLSTST_16BIT_CRC, FLSTST_32BIT_CRC, FLSTST_8BIT_CRC, FLSTST_CHECKSUM, FLSTST_DUPLICATED_MEMORY, FLSTST_ECC}, set at post-build in variant post-build / pre-compile in variant pre-compile  # This is the configuration of the test algorithm for foreground mode and background mode. The availability of algorithm is implementation specific.
      container FlsTstBlockFgndConfigSet [0..1]  # This container defines the blocks in foreground mode.
        container FlsTstBlock [1..*]  # This container specifies configuration parameters for an individual test block.
          integer FlsTstBlockBaseAddress: 0..18446744073709551615, set at post-build in variant post-build / pre-compile in variant pre-compile  # Start Address of the Flash block.
          integer FlsTstBlockIndex: 0..4294967295, set at post-build in variant post-build / pre-compile in variant pre-compile, symbolic-name-value=true  # Foreground Test: Index identifies block to be tested by FlsTst_StartFgnd(); | Background Test: The scheduling for background test shall follow an order defined by this index. '0' means highest priority.
          integer FlsTstBlockSize: 0..4294967295, set at post-build in variant post-build / pre-compile in variant pre-compile  # This parameter shall represent the Flash Test block size.
          integer FlsTstNumberOfTestedCells: 0..4294967295, set at pre-compile  # Configures the Number of cells to be tested in background mode during one scheduled task (FlsTst_MainFunction() call).
          integer FlsTstSignatureAddress: 0..18446744073709551615, set at post-build in variant post-build / pre-compile in variant pre-compile  # Address of the signature reference value of the Flash test block.
          enumeration FlsTstTestAlgorithm: {FLSTST_16BIT_CRC, FLSTST_32BIT_CRC, FLSTST_8BIT_CRC, FLSTST_CHECKSUM, FLSTST_DUPLICATED_MEMORY, FLSTST_ECC}, set at post-build in variant post-build / pre-compile in variant pre-compile  # This is the configuration of the test algorithm for foreground mode and background mode. The availability of algorithm is implementation specific.
    container FlsTstConfigurationOfOptApiServices
      boolean FlsTstGetCurrentStateApi: set at pre-compile, default-value=false  # Adds / removes the service FlsTst_GetCurrentState() from the code.
      boolean FlsTstGetErrorDetailsApi: set at pre-compile, default-value=false  # Adds / removes the service FlsTst_GetErrorDetails() from the code.
      boolean FlsTstGetTestResultBgndApi: set at pre-compile, default-value=false  # Adds / removes the service FlsTst_GetTestResultBgnd() from the code.
      boolean FlsTstGetTestResultFgndApi: set at pre-compile, default-value=false  # Adds / removes the service FlsTst_GetTestResultFgnd() from the code.
      boolean FlsTstGetTestSignatureBgndApi: set at pre-compile, default-value=false  # Adds / removes the service FlsTst_GetTestSignatureBgnd() from the code.
      boolean FlsTstGetTestSignatureFgndApi: set at pre-compile, default-value=false  # Adds / removes the service FlsTst_GetTestSignatureFgnd() from the code.
      boolean FlsTstStartFgndApi: set at pre-compile, default-value=false  # Adds / removes the service FlsTst_StartFgnd() from the code.
      boolean FlsTstSuspendResumeApi: set at pre-compile, default-value=false  # Adds / removes the services FlsTst_Suspend() and FlsTst_Resume() from the code.
      boolean FlsTstTestEccApi: set at pre-compile, default-value=false  # Adds / removes the service FlsTst_TestEcc() from the code.
      boolean FlsTstVersionInfoApi: set at pre-compile, default-value=false  # Adds / removes the service FlsTst_GetVersionInfo() from the code.
    container FlsTstDemEventParameterRefs [0..1]  # Container for the references to DemEventParameter elements which shall be invoked using the API Dem_ReportErrorStatus API in case the corresponding error occurs. The EventId is taken from the referenced DemEventParameter's DemEventId value. The standardized errors are provided in the container and can be extended by vendor specific error references.
      symbolic name reference FLSTST_E_FLSTST_FAILURE [0..1]: set at pre-compile, destination=DemEventParameter  # Reference to the DemEventParameter which shall be issued when the error "Flash Failure" has occurred.
    container FlsTstGeneral
      boolean FlsTstDevErrorDetect: set at pre-compile, default-value=false  # Switch for enabling the development error detection.
      integer FlsTstNumberOfTestedCellsAtomic: 0..4294967295, set at pre-compile  # Configures the Number of cells to be tested in background mode without checking user requests (Abort, Suspend).
      boolean FlsTstTestCompletedNotificationSupported: set at pre-compile, default-value=true  # Switch to indicate that the notification is supported.
      integer FlsTstTestIntervalIdEndValue: 0..4294967295, set at pre-compile  # Defines the end value of the Test Interval Id.
      boolean FlsTstTestResultSignature: set at pre-compile, default-value=false  # Configures the result of the test in background mode: | True: Test Result is a signature (see FlsTst155, FlsTst054) False: Test Result is ok/not ok (see FlsTst153, FlsTst042)
  module definition Fr [0..*]: variants post-build/pre-compile  # Configuration of the Fr (FlexRay driver) module.
    container FrGeneral  # General configuration (parameters) of the FlexRay Driver module.
      boolean FrBufferReconfig: set at pre-compile  # Enables or disables buffer reconfiguration at runtime.
      integer FrCtrlTestCount: 0..255, set at pre-compile, default-value=1  # Maxmimum number of iterations the FlexRay controller hardware test is performed during controller initialization.
      boolean FrDevErrorDetect: set at pre-compile  # Switches the Development Error Detection and Notification | on or off. true: Development Error Detection and Notification enabled. false: Development Error Detection and Notification disabled.
      integer FrIndex: 0..255, set at pre-compile  # Specifies the InstanceId of this module instance. If only one instance is present it shall have the Id 0.
      integer FrNumCtrlSupported: 1..256, set at pre-compile  # Determines the maximum number of communication controllers that the driver supports.
      boolean FrRxStringentCheck: set at pre-compile, default-value=false  # If stringent check is enabled (true), received frames are only | accepted if no slot status error occured.
      boolean FrRxStringentLengthCheck: set at pre-compile, default-value=false  # If stringent check is enabled (true), received frames are only | accepted the received payload length matches the configured payload length.
      boolean FrVersionInfoApi: set at pre-compile  # Enables/disables the existence of the Fr_GetVersionInfo API.
    container FrMultipleConfiguration: multiple-configuration-container=true  # Configuration of the individual controllers.
      container FrController [1..*]  # Configuration of the individual controller.
        integer FrCtrlIdx: 0..255, set at post-build in variant post-build / pre-compile in variant pre-compile, symbolic-name-value=true  # Determines index of CC within Fr.
        boolean FrPAllowHaltDueToClock: set at post-build in variant post-build / pre-compile in variant pre-compile  # Boolean flag that controls the transition to the POC:halt state due to a clock synchronization errors. If set to true, the CC is allowed to transition to POC:halt. If set to false, the CC will not transition to the POC:halt state but will enter or remain in the POC:normal passive state (self healing would still be possible)
        integer FrPAllowPassiveToActive: 0..31, set at post-build in variant post-build / pre-compile in variant pre-compile  # Number of consecutive even/odd cycle pairs that must have valid clock correction terms before the CC will be allowed to transition from the POC:normal passive state to POC:normal active state. If set to zero, the CC is not allowed to transition from POC:normal passive to POC:normal active
        enumeration FrPChannels: {FR_CHANNEL_A, FR_CHANNEL_AB, FR_CHANNEL_B}, set at post-build in variant post-build / pre-compile in variant pre-compile  # Channels to which the node is connected. | Implementation Type: Fr_ChannelType
        integer FrPClusterDriftDamping: 0..20, set at post-build in variant post-build / pre-compile in variant pre-compile  # Local cluster drift damping factor used for rate correction [Microticks]. | Remark: Upper limit 10 for FlexRay Protocol 3.0 compliance.
        integer FrPDecodingCorrection: 12..143, set at post-build in variant post-build / pre-compile in variant pre-compile  # Value used by the receiver to calculate the difference between primary time reference point and secondary time reference point [Microticks]. | Remark: Lower limit 14 for FlexRay Protocol 2.1 Rev. A compliance. Upper limit 136 for FlexRay Protocol 3.0 compliance.
        integer FrPDelayCompensationA: 0..211, set at post-build in variant post-build / pre-compile in variant pre-compile  # Value used to compensate for reception delays on the indicated channel. This covers assumed propagation delay up to cPropagationDelayMax for microticks in the range of 0.0125us to 0.05us [Microticks]. | Remark: Lower limit 4 for FlexRay Protocol 3.0 compliance. Remark: Upper limit 200 for FlexRay Protocol 2.1 Rev A compliance.
        integer FrPDelayCompensationB: 0..211, set at post-build in variant post-build / pre-compile in variant pre-compile  # Value used to compensate for reception delays on the indicated channel. This covers assumed propagation delay up to cPropagationDelayMax for microticks in the range of 0.0125us to 0.05us [Microticks]. | Remark: Lower limit 4 for FlexRay Protocol 3.0 compliance. Remark: Upper limit 200 for FlexRay Protocol 2.1 Rev A compliance.
        boolean FrPExternalSync: set at post-build in variant post-build / pre-compile in variant pre-compile  # Flag indicating whether the node is externally synchronized (operating as time gateway sink in an TT-E cluster) or locally synchronized. | If FrPExternalSync is set to 'true' then FrPTwoKeySlotMode must also be set to 'true'. Remarks: Set to 'false' for FlexRay Protocol 2.1 Rev. A compliance.
        boolean FrPFallBackInternal: set at post-build in variant post-build / pre-compile in variant pre-compile  # Flag indicating whether a time gateway sink node will switch to local clock operation when synchronization with the time gateway source node is lost (FrPFallBackInternal = true) or will instead go to POC:ready (FrPFallBackInternal =false). | Remarks: Set to 'false' for FlexRay Protocol 2.1 Rev. A compliance.
        integer FrPKeySlotId: 0..1023, set at post-build in variant post-build / pre-compile in variant pre-compile  # ID of the key slot, i.e., the slot used to transmit the startup frame, sync frame, or designated key slot frame. If this parameter is set to zero the node does not have a key slot.
        boolean FrPKeySlotOnlyEnabled: set at post-build in variant post-build / pre-compile in variant pre-compile  # Flag indicating whether or not the node shall enter key slot only mode following startup. | Remarks: This parameter maps to FlexRay Protocol 2.1 Rev. A parameter pSingleSlotEnabled.
        boolean FrPKeySlotUsedForStartup: set at post-build in variant post-build / pre-compile in variant pre-compile  # Flag indicating whether the key slot is used to transmit a startup frame. | If FrPKeySlotUsedForStartup is set to true then FrPKeySlotUsedForSync must also be set to true. If FrPTwoKeySlotMode is set to true then both FrPKeySlotUsedForSync and FrPKeySlotUsedForStartup must also be set to true.
        boolean FrPKeySlotUsedForSync: set at post-build in variant post-build / pre-compile in variant pre-compile  # Flag indicating whether the key slot is used to transmit a sync frame. | If FrPKeySlotUsedForStartup is set to true then FrPKeySlotUsedForSync must also be set to true. If FrPTwoKeySlotMode is set to true then both FrPKeySlotUsedForSync and FrPKeySlotUsedForStartup must also be set to true.
        integer FrPLatestTx: 0..7988, set at post-build in variant post-build / pre-compile in variant pre-compile  # Number of the last minislot in which a frame transmission can start in the dynamic segment. | Remark: Upper limit 7980 for FlexRay Protocol 2.1 Rev A compliance.
        integer FrPMacroInitialOffsetA: 2..68, set at post-build in variant post-build / pre-compile in variant pre-compile  # Integer number of macroticks between the static slot boundary and the following macrotick boundary of the secondary time reference point based on the nominal macrotick duration [Macroticks].
        integer FrPMacroInitialOffsetB: 2..68, set at post-build in variant post-build / pre-compile in variant pre-compile  # Integer number of macroticks between the static slot boundary and the following macrotick boundary of the secondary time reference point based on the nominal macrotick duration [Macroticks].
        integer FrPMicroInitialOffsetA: 0..239, set at post-build in variant post-build / pre-compile in variant pre-compile  # Number of microticks between the secondary time reference point | and the macrotick boundary immediately following the secondary time reference point. The parameter depends on FrPDelayCompensationA and therefore it has to be set independently for each channel [Microticks].
        integer FrPMicroInitialOffsetB: 0..239, set at post-build in variant post-build / pre-compile in variant pre-compile  # Number of microticks between the secondary time reference point | and the macrotick boundary immediately following the secondary time reference point. The parameter depends on FrPDelayCompensationB and therefore it has to be set independently for each channel [Microticks].
        integer FrPMicroPerCycle: 640..1280000, set at post-build in variant post-build / pre-compile in variant pre-compile  # Nominal number of microticks in the communication cycle of the local node. If nodes have different microtick durations this number will differ from node to node [Microticks]. | Remark: Lower limit 960 for FlexRay Protocol 3.0 compliance. Upper limit 640000 for FlexRay Protocol 2.1 Rev A compliance.
        boolean FrPNmVectorEarlyUpdate: set at post-build in variant post-build / pre-compile in variant pre-compile  # Flag indicating when the update of the Network Management Vector | in the CHI shall take place. If FrPNmVectorEarlyUpdate is set to false, the update shall take place after the NIT. If FrPNmVectorEarlyUpdate is set to true, the update shall take place after the end of the static segment. Remarks: Set to 'false' for FlexRay Protocol 2.1 Rev. A compliance.
        integer FrPOffsetCorrectionOut: 13..16082, set at post-build in variant post-build / pre-compile in variant pre-compile  # Magnitude of the maximum permissible offset correction value [Microticks]. Remark: Upper limit 15567 for FlexRay Protocol 2.1 Rev A compliance. Remark: Lower limit 15 for FlexRay Protocol 3.0 compliance.
        integer FrPOffsetCorrectionStart: 7..15999, set at post-build in variant post-build / pre-compile in variant pre-compile  # Start of the offset correction phase within the NIT, expressed as the number of macroticks from the start of cycle [Macroticks]. | Remark: This parameter maps to FlexRay Protocol 2.1 Rev. A parameter gOffsetCorrectionStart. Remark: Lower limit 9 for FlexRay Protocol 2.1 Rev A compliance.
        integer FrPPayloadLengthDynMax: 0..127, set at post-build in variant post-build / pre-compile in variant pre-compile  # Maximum payload length for dynamic frames [16 bit words].
        integer FrPRateCorrectionOut: 2..3846, set at post-build in variant post-build / pre-compile in variant pre-compile  # Magnitude of the maximum permissible rate correction value and the maximum drift offset between two nodes operating with unsynchronized clocks for one communication cycle [Microticks]. | Remarks: This parameter maps to FlexRay Protocol 2.1 Rev. A parameter pdMaxDrift. Lower limit 3 for FlexRay Protocol 3.0 compliance. Upper limit 1923 for FlexRay Protocol 2.1 Rev A compliance.
        enumeration FrPSamplesPerMicrotick: {N1SAMPLES, N2SAMPLES, N4SAMPLES}, set at post-build in variant post-build / pre-compile in variant pre-compile  # Number of samples per microtick. Remark: Allowed range N1SAMPLES, N2SAMPLES for FlexRay Protocol 3.0 compliance.
        integer FrPSecondKeySlotId: 0..1023, set at post-build in variant post-build / pre-compile in variant pre-compile  # ID of the second key slot, in which a second startup frame shall be sent when operating as a coldstart node in a TT-L or TT-D cluster. If this parameter is set to zero the node does not have a second key slot. | Remark: Set to 0 for FlexRay Protocol 2.1 Rev A compliance.
        boolean FrPTwoKeySlotMode: set at post-build in variant post-build / pre-compile in variant pre-compile  # Flag indicating whether node operates as a coldstart node in a TT-E or TT-L cluster. | If pTwoKeySlotMode is set to true then both pKeySlotUsedForSync and pKeySlotUsedForStartup must also be set to true. If pExternalSync is set to true then pTwoKeySlotMode must also be set to true. Remark: Set to false for FlexRay Protocol 2.1 Rev A compliance.
        enumeration FrPWakeupChannel: {FR_CHANNEL_A, FR_CHANNEL_B}, set at post-build in variant post-build / pre-compile in variant pre-compile  # Channel used by the node to send a wakeup pattern. | FrPWakeupChannel must be selected from among the channels configured by FrPChannels.
        integer FrPWakeupPattern: 0..63, set at post-build in variant post-build / pre-compile in variant pre-compile  # Number of repetitions of the wakeup symbol that are combined to form a wakeup pattern when the node enters the POC:wakeup send state. | Remark: Lower limit 2 for FlexRay Protocol 2.1 Rev A compliance.
        integer FrPdAcceptedStartupRange: 0..2743, set at post-build in variant post-build / pre-compile in variant pre-compile  # Expanded range of measured clock deviation allowed for startup frames during integration [Microticks]. | Remark: Upper limit 1875 for FlexRay Protocol 2.1 Rev A compliance. Remark: Lower limit 29 for FlexRay Protocol 3.0 compliance.
        integer FrPdListenTimeout: 1284..2567692, set at post-build in variant post-build / pre-compile in variant pre-compile  # Value for the startup listen timeout and wakeup listen timeout. Although this is a node local parameter, the real time equivalent of this value should be the same for all nodes in the cluster [Microticks]. | Remark: Lower limit 1926 for FlexRay Protocol 3.0 compliance. Upper limit 1283846 for FlexRay Protocol 2.1 Rev. A compliance.
        enumeration FrPdMicrotick: {T100NS, T12_5NS, T25NS, T50NS}, set at post-build in variant post-build / pre-compile in variant pre-compile  # Duration of a microtick. | Remark: Allowed range T12_5NS, T25NS, T50NS for FlexRay Protocol 3.0 compliance.
        container FrAbsoluteTimer [1..*]  # Specifies the absolute timer configuration parameters of the Fr.
          integer FrAbsTimerIdx: 0..254, set at post-build in variant post-build / pre-compile in variant pre-compile, symbolic-name-value=true  # Contains the index of an absolute timer contained in Fr on a certain FlexRay CC.
        container FrControllerDemEventParameterRefs [0..1]  # Container for the references to DemEventParameter elements which shall be invoked using the API Dem_ReportErrorStatus API in case the corresponding error occurs. The EventId is taken from the referenced DemEventParameter's DemEventId value. The standardized errors are provided in the container and can be extended by vendor specific error references.
          symbolic name reference FrDemCtrlTestResultRef [0..1]: set at post-build in variant post-build / pre-compile in variant pre-compile, destination=DemEventParameter  # Reference to DEM event Id that is reported for FlexRay | controller hardware test failure. If this parameter is not configured, no event reporting happens.
        container FrFifo [0..*]  # One First In First Out (FIFO) queued receive structure, defining the admittance criteria to the FIFO, and mandating the ability to admit messages into the FIFO based on Message Id filtering criteria.
          boolean FrAdmitWithoutMessageId: set at post-build in variant post-build / pre-compile in variant pre-compile  # Determines whether or not frames received in the dynamic segment that don't contain a message ID will be admitted into the FIFO.
          integer FrBaseCycle: 0..63, set at post-build in variant post-build / pre-compile in variant pre-compile  # FIFO cycle counter acceptance criteria.
          enumeration FrChannels: {FR_CHANNEL_A, FR_CHANNEL_AB, FR_CHANNEL_B}, set at post-build in variant post-build / pre-compile in variant pre-compile  # FIFO channel admittance criteria.
          integer FrCycleRepetition: 1..64, set at post-build in variant post-build / pre-compile in variant pre-compile  # FIFO cylce counter acceptance criteria. Valid values are 1,2,4,5,8,10,16,20,32,40,50,64. | Remark: Values 1,2,4,8,16,32,64 are valid only for FlexRay Protocol 2.1 Rev A compliance.
          integer FrFifoDepth: 1..2048, set at post-build in variant post-build / pre-compile in variant pre-compile  # Fifo Depth.
          integer FrMsgIdMask: 0..65535, set at post-build in variant post-build / pre-compile in variant pre-compile  # FIFO message identifier acceptance criteria (Mask filter).
          integer FrMsgIdMatch: 0..65535, set at post-build in variant post-build / pre-compile in variant pre-compile  # FIFO message identifier acceptance criteria (Match filter).
          container FrRange [1..*]  # FIFO Frame Id range acceptance criteria.
            integer FrRangeMax: 0..2047, set at post-build in variant post-build / pre-compile in variant pre-compile  # Last FrameId of this range that will be accepted by the FIFO.
            integer FrRangeMin: 0..2047, set at post-build in variant post-build / pre-compile in variant pre-compile  # First FrameId of this range that will be accepted by the FIFO.
  module definition FrArTp [0..1]: variants post-build/pre-compile  # Configuration of the FrArTp (FlexRay Transport Protocol) module.
    container FrArTpGeneral  # This container contains the general configuration (parameters) of the FlexRay TP.
      integer FrArTpChanNum: 1..32, set at pre-compile  # Preprocessor switch for defining the number of concurrent channels the module supports. Up to 32 channels shall be definable here.
      boolean FrArTpDevErrorDetect: set at pre-compile  # Preprocessor switch for enabling development error detection.
      boolean FrArTpHaveAckRt: set at pre-compile  # Preprocessor switch for enabling the Acknowledgement and retry mechanisms.
      boolean FrArTpHaveGrpSeg: set at pre-compile  # Preprocessor switch for enabling segmentation of 1:n messages.
      boolean FrArTpHaveLm: set at pre-compile  # Preprocessor switch for enabling the mechanism for message longer than allowed by.
      boolean FrArTpHaveTc: set at pre-compile  # Preprocessor switch for enabling Transmit Cancellation.
      float FrArTpMainFuncCycle: 0..1.024, set at post-build in variant post-build / pre-compile in variant pre-compile  # This parameter contains the calling period of the TPs Main Function. The parameter is specified in seconds.
      boolean FrArTpVersionInfoApi: set at pre-compile  # Preprocessor switch for enabling the Version info API.
    container FrArTpMultipleConfig: multiple-configuration-container=true  # This container holds one or several multiple configuration sets.
      container FrArTpChannel [1..*]  # This container contains the configuration (parameters) of one FlexRay TP channel.
        enumeration FrArTpAckType: {FRARTP_ACK_WITHOUT_RT, FRARTP_ACK_WITH_RT, FRARTP_NO}, set at post-build in variant post-build / pre-compile in variant pre-compile  # This parameter defines the type of acknowledgement which is used for the specific channel.
        enumeration FrArTpAdrType: {FRARTP_OB, FRARTP_TB}, set at post-build in variant post-build / pre-compile in variant pre-compile  # This parameter states the addressing type this connection has. The meanings of the values are one byte and two byte.
        integer FrArTpChannelId: 0..255, set at post-build in variant post-build / pre-compile in variant pre-compile, symbolic-name-value=true  # The Id of the channel.
        integer FrArTpConNum: 0..65536, set at post-build in variant post-build / pre-compile in variant pre-compile  # This parameter states the number of connections used in this channel. At least 256 shall be configurable here.
        boolean FrArTpGrpSeg: set at post-build in variant post-build / pre-compile in variant pre-compile  # Here can be specified, whether segmentation within a 1:n connection is allowed or not.
        enumeration FrArTpLm: {FRARTP_ISO, FRARTP_ISO6, FRARTP_L4G}, set at post-build in variant post-build / pre-compile in variant pre-compile  # This specifies the maximum message length for the particular channel.
        integer FrArTpMaxAr: 0..255, set at post-build in variant post-build / pre-compile in variant pre-compile  # This parameter defines the maximum number of trying to send a frame when a TIMEOUT AR occurs (depending on whether retry is configured).
        integer FrArTpMaxAs: 0..255, set at post-build in variant post-build / pre-compile in variant pre-compile  # This parameter defines the maximum number of trying t osend a frame when a TIMEOUT AS occurs (depending on whether retry is configured)
        integer FrArTpMaxBs: 0..255, set at post-build in variant post-build / pre-compile in variant pre-compile  # This parameter defines number of consecutive CFs between two FCs (block size). Valid values are 1 .. 16 when retry is activated, and 0 .. 255 otherwise.
        integer FrArTpMaxBufReq: 0..255, set at post-build in variant post-build / pre-compile in variant pre-compile  # This parameter defines the maximum number of times the FrArTp should send a wait frame FC(WT). It is also used to limit the number of retries for PduR_FrArTpCopyTxData and PduR_FrArTpCopyRxData when no timer is active.
        integer FrArTpMaxFrIf: 0..255, set at post-build in variant post-build / pre-compile in variant pre-compile  # This parameter defines the maximum number of trying to send a frame when the FrIf returns an error.
        integer FrArTpMaxRn: 0..255, set at post-build in variant post-build / pre-compile in variant pre-compile  # This parameter defines the maximum number of retries (if retry is configured for the particular channel).
        float FrArTpStMin: 0..1, set at post-build in variant post-build / pre-compile in variant pre-compile  # This parameter defines the minimum amount of time between two succeeding CFs in seconds. Valid values are 0, 100µs, 200µs .. 900µs, 1ms, 2ms .. 127ms. The value can be changed at runtime using the FrArTp_ChangeParameter interface.
        boolean FrArTpTc: set at post-build in variant post-build / pre-compile in variant pre-compile  # With this switch Transmit Cancellation can be turned on or off for this channel.
        float FrArTpTimeBr: 0..65.535, set at pre-compile  # This parameter defines the time in seconds between receiving the last CF of a block or an FF-x (or SF-x) and sending out an FC or AF. | It is obvious that FRARTP_TIME_BR + FRARTP_TIMEOUT_AR < FRARTP_TIMEOUT_BS must hold (because the transmission duration on the bus has also to be considered). This parameter is defined in ISO 15765-2. It is contained in the configuration as a performance requirement.
        float FrArTpTimeBuffer: 0..0.255, set at post-build in variant post-build / pre-compile in variant pre-compile  # This parameter defines the time in seconds of waiting for the next try (if retry is activated) to get a Tx or Rx buffer.
        float FrArTpTimeCs: 0..65.535, set at pre-compile  # This parameter defines the time in seconds between the sending of two consecutive CFs or between reception of an FC or AF and sending of the next CF . It is obvious that FRARTP_TIME_CS + FRARTP_TIMEOUT_AS < FRARTP_TIMEOUT_CR must hold (because the transmission duration on the bus has also to be considered). This parameter is defined in ISO 15765-2. It is contained in the configuration as a performance requirement.
        float FrArTpTimeFrIf: 0..0.255, set at post-build in variant post-build / pre-compile in variant pre-compile  # This parameter defines the time in seconds of waiting for the next try (if retry is activated) to send via FrIf_Transmit.
        float FrArTpTimeoutAr: 0..65.535, set at post-build in variant post-build / pre-compile in variant pre-compile  # This parameter states the timeout in seconds between the PDU transmit request of the Transport Layer to the FlexRay Interface and the corresponding confirmation of the FlexRay Interface on the receiver side (for FC or AF).
        float FrArTpTimeoutAs: 0..65.535, set at post-build in variant post-build / pre-compile in variant pre-compile  # This parameter states the timeout in seconds between the PDU transmit request for the first PDU of the group used in the current connection of the Transport Layer to the FlexRay Interface and the corresponding confirmation of the FlexRay Interface (when having sent the last PDU of the | group used in this connection) on the sender side (SF-x, FF-x, CF).
        float FrArTpTimeoutBs: 0..65.535, set at post-build in variant post-build / pre-compile in variant pre-compile  # This parameter defines the timeout in seconds for waiting for an FC or AF on the sender side in a 1:1 connection.
        float FrArTpTimeoutCr: 0..65.535, set at post-build in variant post-build / pre-compile in variant pre-compile  # This parameter defines the timeout value in seconds for waiting for a CF or FF-x (in case of retry) after receiving the last CF or after sending an FC or AF on the receiver side.
        boolean FrArTpUsePduFc: set at post-build in variant post-build / pre-compile in variant pre-compile  # This switch defines, whether within this channel the dedicated FC/ACK PDU (FrArTpPduFc) shall be used or not. If this is not used FC / ACK frames are sent using the normal IDs, otherwise only FrArTpPduFc shall be used for sending / receiving FC / ACK frames.
        container FrArTpConnection [1..*]  # This container contains the configuration (parameters) of one FlexRay TP connection. | A connection can only belong to one channel.
          integer FrArTpLa: 0..65535, set at post-build in variant post-build / pre-compile in variant pre-compile  # This parameter defines the Local Address for the respective connection. | When the local instance is the sender, this is the Source Address within the TP frame. When the local instance is the receiver, this is the Target Address within the TP frame. Note that in case of 1 byte addressing only the values from 0x0000 - 0x00FF are valid.
          boolean FrArTpMultRec: set at post-build in variant post-build / pre-compile in variant pre-compile  # This parameter defines, whether this connection is an 1:1 ('false') or an 1:n ('true') connection. | Of course, if the channel to which the connection is configured has retry or acknowledgement enabled, no retry or acknowledgement will occur in case the connection is an 1:n connection.
          integer FrArTpRa: 0..65535, set at post-build in variant post-build / pre-compile in variant pre-compile  # This parameter defines the Remote Address for the respective connection. | When the local instance is the sender, this is the Target Address within the TP frame. When the local instance is the receiver, this is the Source Address within the TP frame. Note that in case of 1 byte addressing only the values from 0x0000 - 0x00FF are valid.
          reference FrArTpConPduRef [1..*]: set at post-build in variant post-build / pre-compile in variant pre-compile, destination=FrArTpPdu  # Each value defines a PDU to be used for this connection. Thus each value is a PDU-ID given in FrArTpPdu and this array cannot be longer than the array FrArTpPdu. | Please note: Only PDUs of the same size shall be used within a connection. Of course the PDU having the TxConfirmation configured has to be used by every connection.
          container FrArTpRxSdu [0..1]  # Describes the Rx SDU
            integer FrArTpSduRxId: 0..65536, set at post-build in variant post-build / pre-compile in variant pre-compile, symbolic-name-value=true  # This is a unique identifier for a received message. This Id is used in the CancelReceive API call. | ImplementationType: PduIdType
            reference FrArTpRxSduRef: set at post-build in variant post-build / pre-compile in variant pre-compile, destination=Pdu  # Reference to a PDU in the global PDU structure.
          container FrArTpTxSdu [0..1]  # Describes the Tx SDU
            integer FrArTpSduTxId: 0..65536, set at post-build in variant post-build / pre-compile in variant pre-compile, symbolic-name-value=true  # This is a unique identifier for a received or a to be transmitted message. With this (and by means of e.g. a lookup table) the PDU Router can route the message appropriately without dealing with the particularities of the Transport Layer. This parameter can also be seen as the identifier of a connection. | ImplementationType: PduIdType
            reference FrArTpTxSduRef: set at post-build in variant post-build / pre-compile in variant pre-compile, destination=Pdu  # Reference to a PDU in the global PDU structure.
        container FrArTpPdu [1..*]  # Container to hold the PDU parameters. | ImplementationType: PduInfoType
          enumeration FrArTpPduDirection: {FRARTP_RX, FRARTP_TX}, set at post-build in variant post-build / pre-compile in variant pre-compile  # This parameter defines the direction of the PDU.
          integer FrArTpPduId: 0..65536, set at post-build in variant post-build / pre-compile in variant pre-compile, symbolic-name-value=true  # This is the identifier of the FlexRay Interface PDUs (Fr N-PDU, Fr L-SDU) in which the Transport Layer Frames of this channel should be transmitted. | ImplementationType: PduIdType
          reference FrArTpPduRef: set at post-build in variant post-build / pre-compile in variant pre-compile, destination=Pdu
        container FrArTpPduFc [0..2]  # This is the identifier of the FlexRay Interface PDUs (Fr N-PDU, Fr L-SDU) in which the Transport Layer Flow Control and Acknowledgement Frames of this channel should be transmitted. | ImplementationType: PduInfoType
          enumeration FrArTpPduFcDirection: {FRARTP_FC_RX, FRARTP_FC_TX}, set at post-build in variant post-build / pre-compile in variant pre-compile  # This parameter defines the direction of the PDU.
          integer FrArTpPduFcId: 0..65536, set at post-build in variant post-build / pre-compile in variant pre-compile, symbolic-name-value=true  # This is the identifier of the FlexRay Interface PDUs (Fr N-PDU, Fr L-SDU) in which the Transport Layer Flow Control and Acknowledgement Frames of this channel should be transmitted.
          reference FrArTpPduFcRef: set at post-build in variant post-build / pre-compile in variant pre-compile, destination=Pdu
  module definition FrIf [0..1]: variants link-time/post-build/pre-compile  # Configuration of the FrIf (FlexRay Interface) module.
    container FrIfConfig: multiple-configuration-container=true  # Configuration of the FlexRay Interface. This container is a MultipleConfigurationContainer, i.e. this container and its sub-containers exist once per configuration set.
      container FrIfCluster [1..*]  # This container specifies a FrIf Cluster and all related data which is required to enable communication of the Cluster. A Cluster may consist of more than one Controller.
        integer FrIfClstIdx: 0..63, set at link in variant link-time / post-build in variant post-build / pre-compile in variant pre-compile, symbolic-name-value=true  # This parameter provides a zero-based consecutive index of the FlexRay Clusters. Upper layer BSW modules and the FrIf itself use this index to identify a FlexRay Cluster.
        boolean FrIfDetectNITError: set at link in variant link-time / post-build in variant post-build / pre-compile in variant pre-compile  # Indicates whether NIT error status of each cluster shall be detected or not.
        enumeration FrIfGChannels: {FR_CHANNEL_A, FR_CHANNEL_AB, FR_CHANNEL_B}, set at link in variant link-time / post-build in variant post-build / pre-compile in variant pre-compile  # The channels that are used by the cluster. | Implementation Type: Fr_ChannelType
        integer FrIfGColdStartAttempts: 2..31, set at link in variant link-time / post-build in variant post-build / pre-compile in variant pre-compile  # Maximum number of times a node in the cluster is permitted to attempt to start the cluster by initiating schedule synchronization
        integer FrIfGCycleCountMax: 7..63, set at link in variant link-time / post-build in variant post-build / pre-compile in variant pre-compile  # Maximum cycle counter value in a given cluster. | Remark: Set to 63 for FlexRay Protocol 2.1 Rev. A compliance.
        integer FrIfGListenNoise: 2..16, set at link in variant link-time / post-build in variant post-build / pre-compile in variant pre-compile  # Upper limit for the start up listen timeout and wake up listen timeout in the presence of noise. It is used as a multiplier of the node | parameter pdListenTimeout.
        integer FrIfGMacroPerCycle: 8..16000, set at link in variant link-time / post-build in variant post-build / pre-compile in variant pre-compile  # Number of macroticks in a communication cycle. | Note: Lower limit 10 for FlexRay Protocol 2.1 Rev. A compliance
        integer FrIfGMaxWithoutClockCorrectFatal: 1..15, set at link in variant link-time / post-build in variant post-build / pre-compile in variant pre-compile  # Threshold used for testing the vClockCorrectionFailed counter. Defines the number of consecutive even/odd Cycle pairs with missing clock correction terms that will cause the protocol to transition from the POC:normal active or POC:normal passive state into the POC:halt state. [Even/odd cycle pairs].
        integer FrIfGMaxWithoutClockCorrectPassive: 1..15, set at link in variant link-time / post-build in variant post-build / pre-compile in variant pre-compile  # Threshold used for testing the vClockCorrectionFailed counter. Defines the number of consecutive even/odd Cycle pairs with missing clock correction terms that will cause the protocol to transition from the POC:normal active state to the POC:normal passive state. [Even/Odd cycle pairs]
        integer FrIfGNetworkManagementVectorLength: 0..12, set at link in variant link-time / post-build in variant post-build / pre-compile in variant pre-compile  # Length of the Network Management vector in a cluster [bytes]
        integer FrIfGNumberOfMinislots: 0..7988, set at link in variant link-time / post-build in variant post-build / pre-compile in variant pre-compile  # Number of minislots in the dynamic segment | Remark: Upper limit 7986 for FlexRay Protocol 2.1 Rev. A compliance
        integer FrIfGNumberOfStaticSlots: 2..1023, set at link in variant link-time / post-build in variant post-build / pre-compile in variant pre-compile  # Number of static slots in the static segment
        integer FrIfGPayloadLengthStatic: 0..127, set at link in variant link-time / post-build in variant post-build / pre-compile in variant pre-compile  # Payload length of a static frame [16 bit words]
        integer FrIfGSyncFrameIDCountMax: 2..15, set at link in variant link-time / post-build in variant post-build / pre-compile in variant pre-compile  # Maximum number of distinct syncframe identifiers present in a given cluster. This parameter maps to FlexRay Protocol 2.1 Rev. A parameter gSyncNodeMax.
        integer FrIfGdActionPointOffset: 1..63, set at link in variant link-time / post-build in variant post-build / pre-compile in variant pre-compile  # Number of macroticks the action point is offset from the beginning of a static slot.
        enumeration FrIfGdBit: {T100NS, T200NS, T400NS}, set at link in variant link-time / post-build in variant post-build / pre-compile in variant pre-compile  # Nominal bit time in seconds
        integer FrIfGdCasRxLowMax: 28..254, set at link in variant link-time / post-build in variant post-build / pre-compile in variant pre-compile  # Upper limit of the CAS acceptance windows [gdBit] | Remark: Range 67 to 99 for FlexRay Protocol 2.1 Rev. A compliance
        float FrIfGdCycle: 2.4E-5..0.016, set at link in variant link-time / post-build in variant post-build / pre-compile in variant pre-compile  # Length of the cycle, expressed in [s] | Remark: Lower limit 0.000024 for FlexRay Protocol 3.0 compliance.
        integer FrIfGdDynamicSlotIdlePhase: 0..2, set at link in variant link-time / post-build in variant post-build / pre-compile in variant pre-compile  # Duration of the idle phase within a dynamic slot [Minislots].
        integer FrIfGdIgnoreAfterTx: 0..15, set at link in variant link-time / post-build in variant post-build / pre-compile in variant pre-compile  # Duration for which the bitstrobing is paused after transmission [gdBit]. | Remark: Set to 0 for FlexRay Protocol 2.1 Rev. A compliance.
        float FrIfGdMacrotick: 1E-6..6E-6, set at link in variant link-time / post-build in variant post-build / pre-compile in variant pre-compile  # Duration of the cluster wide nominal macrotick, expressed in s
        integer FrIfGdMiniSlotActionPointOffset: 1..31, set at link in variant link-time / post-build in variant post-build / pre-compile in variant pre-compile  # Number of Macroticks the Minislot action point is offset from the beginning of a Minislot [Macroticks].
        integer FrIfGdMinislot: 2..63, set at link in variant link-time / post-build in variant post-build / pre-compile in variant pre-compile  # Duration of a minislot [Macroticks]
        integer FrIfGdNit: 2..15978, set at link in variant link-time / post-build in variant post-build / pre-compile in variant pre-compile  # Duration of the Network Idle Time [Macroticks] | Remark: Upper limit 805 for FlexRay Protocol 2.1 Rev. A compliance.
        enumeration FrIfGdSampleClockPeriod: {T12_5NS, T25NS, T50NS}, set at link in variant link-time / post-build in variant post-build / pre-compile in variant pre-compile  # Sample clock period
        integer FrIfGdStaticSlot: 3..664, set at link in variant link-time / post-build in variant post-build / pre-compile in variant pre-compile  # Duration of a static slot [Macroticks]. | Remark: Range 4-661 for FlexRay Protocol 2.1 Rev. A compliance.
        integer FrIfGdSymbolWindow: 0..162, set at link in variant link-time / post-build in variant post-build / pre-compile in variant pre-compile  # Duration of the symbol window [Macroticks]. | Remark: Range 0-142 for FlexRay Protocol 2.1 Rev. A compliance.
        integer FrIfGdSymbolWindowActionPointOffset: 1..63, set at link in variant link-time / post-build in variant post-build / pre-compile in variant pre-compile  # Number of macroticks the action point offset is from the beginning of the symbol window [Macroticks]. | Remark: Set to GdActionPointOffset for FlexRay Protocol 2.1 Rev. A compliance.
        integer FrIfGdTSSTransmitter: 1..15, set at link in variant link-time / post-build in variant post-build / pre-compile in variant pre-compile  # Number of bits in the Transmission Start Sequence [gdBits]. | Remark: Lower limit 3 for FlexRay Protocol 2.1 Rev. A compliance.
        integer FrIfGdWakeupRxIdle: 8..59, set at link in variant link-time / post-build in variant post-build / pre-compile in variant pre-compile  # Number of bits used by the node to test the duration of the 'idle' or HIGH phase of a received wakeup [gdBit]. Remarks: This parameter maps to FlexRay Protocol 2.1 Rev. A parameter gdWakeupSymbolRxIdle. Lower limit 14 for FlexRay Protocol 2.1 Rev. A compliance.
        integer FrIfGdWakeupRxLow: 8..59, set at link in variant link-time / post-build in variant post-build / pre-compile in variant pre-compile  # Number of bits used by the node to test the duration of the LOW phase of a received wakeup [gdBit]. | Remarks: This parameter maps to FlexRay Protocol 2.1 Rev. A parameter gdWakeupSymbolRxLow. Lower limit 11 for FlexRay Protocol 2.1 Rev. A compliance.
        integer FrIfGdWakeupRxWindow: 76..485, set at link in variant link-time / post-build in variant post-build / pre-compile in variant pre-compile  # The size of the window used to detect wakeups [gdBit]. | Remarks: This parameter maps to FlexRay Protocol 2.1 Rev. A parameter gdWakeupSymbolRxWindow. Upper limit 301 for FlexRay Protocol 2.1 Rev. A compliance.
        integer FrIfGdWakeupTxActive: 15..60, set at link in variant link-time / post-build in variant post-build / pre-compile in variant pre-compile  # Number of bits used by the node to transmit the LOW phase of awakeup symbol and the HIGH and LOW phases of a WUDOP [gdBit]. | Remarks: This parameter maps to FlexRay Protocol 2.1 Rev. A parameter gdWakeupSymbolTxLow.
        integer FrIfGdWakeupTxIdle: 45..180, set at link in variant link-time / post-build in variant post-build / pre-compile in variant pre-compile  # Number of bits used by the node to transmit the 'idle' part of a | wakeup symbol [gdBit]. Remarks: This parameter maps to FlexRay Protocol 2.1 Rev. A parameter gdWakeupSymbolTxIdle.
        float FrIfMainFunctionPeriod: 0..Inf, set at link in variant link-time / post-build in variant post-build / pre-compile in variant pre-compile  # The execution cycle of the FrIf_MainFunction_<cluster>() in seconds. The FrIf does not require this information but the BSW scheduler, which invokes the cluster main functions, needs it in order to plan its tasks.
        integer FrIfMaxIsrDelay: 0..10240000, set at link in variant link-time / post-build in variant post-build / pre-compile in variant pre-compile  # The maximum delay in macroticks the FrIf_JoblistExec_<cluster>() function is processed after the absolute timer interrupt was triggered.
        integer FrIfSafetyMargin: 0..10240000, set at link in variant link-time / post-build in variant post-build / pre-compile in variant pre-compile  # Additional timespan in macroticks which takes jitter into account to be able to set the JobListPointer to the next possible job which can be executed in case the FlexRay Job List Execution Function has be resynchronized.
        container FrIfClusterDemEventParameterRefs [0..1]  # Container for the references to DemEventParameter elements which shall be invoked using the API Dem_ReportErrorStatus API in case the corresponding error occurs. The EventId is taken from the referenced DemEventParameter's DemEventId value. The standardized errors are provided in the container and can be extended by vendor specific error references.
          symbolic name reference FRIF_E_ACS_CH_A [0..1]: set at link in variant link-time / post-build in variant post-build / pre-compile in variant pre-compile, destination=DemEventParameter  # Reference to the DemEventParameter which shall be issued when an error in ACS on channel A was detected. If the reference is not configured the error shall not be reported (neither to DET nor to DEM).
          symbolic name reference FRIF_E_ACS_CH_B [0..1]: set at link in variant link-time / post-build in variant post-build / pre-compile in variant pre-compile, destination=DemEventParameter  # Reference to the DemEventParameter which shall be issued when an error in ACS on channel B was detected. If the reference is not configured the error shall not be reported (neither to DET nor to DEM).
          symbolic name reference FRIF_E_NIT_CH_A [0..1]: set at link in variant link-time / post-build in variant post-build / pre-compile in variant pre-compile, destination=DemEventParameter  # Reference to the DemEventParameter which shall be issued when an error in NIT on channel A was detected. If the reference is not configured the error shall not be reported (neither to DET nor to DEM).
          symbolic name reference FRIF_E_NIT_CH_B [0..1]: set at link in variant link-time / post-build in variant post-build / pre-compile in variant pre-compile, destination=DemEventParameter  # Reference to the DemEventParameter which shall be issued when an error in NIT on channel B was detected. If the reference is not configured the error shall not be reported (neither to DET nor to DEM).
          symbolic name reference FRIF_E_SW_CH_A [0..1]: set at link in variant link-time / post-build in variant post-build / pre-compile in variant pre-compile, destination=DemEventParameter  # Reference to the DemEventParameter which shall be issued when an error in SW on channel A was detected. If the reference is not configured the error shall not be reported (neither to DET nor to DEM).
          symbolic name reference FRIF_E_SW_CH_B [0..1]: set at link in variant link-time / post-build in variant post-build / pre-compile in variant pre-compile, destination=DemEventParameter  # Reference to the DemEventParameter which shall be issued when an error in SW on channel B was detected. If the reference is not configured the error shall not be reported (neither to DET nor to DEM).
        container FrIfController [1..*]  # This container contains the configuration of FlexRay CC.
          integer FrIfCtrlIdx: 0..31, set at link in variant link-time / post-build in variant post-build / pre-compile in variant pre-compile, symbolic-name-value=true  # This parameter provides a zero-based consecutive index of the FlexRay Communication Controllers. Upper layer BSW modules and the FrIf itself use this index to identify a FlexRay CC.
          symbolic name reference FrIfFrCtrlRef: set at link in variant link-time / post-build in variant post-build / pre-compile in variant pre-compile, destination=FrController  # Reference to a Controller, which is handled by a specific Driver. This reference is unique for the ECU.
          container FrIfFrameTriggering [1..*]  # A Frame triggering contains the communication parameters of the FlexRay Frame as well as a reference to the Frame Construction Plan.
            boolean FrIfAllowDynamicLSduLength: set at link in variant link-time / post-build in variant post-build / pre-compile in variant pre-compile  # Allows L-PDU length reduction ('FrIfLSduLength' defines max. length) and indicates that the related CC buffer has to be reconfigured for the actual length and Header-CRC before transmission of the L-PDU.
            boolean FrIfAlwaysTransmit: set at link in variant link-time / post-build in variant post-build / pre-compile in variant pre-compile  # Defines wether the driver's API function Fr_TransmitTxLPdu() shall always be called for this L-PDU.
            integer FrIfBaseCycle: 0..63, set at link in variant link-time / post-build in variant post-build / pre-compile in variant pre-compile  # This parameter contains the FlexRay Base Cycle used to transmit this FlexRay Frame.
            enumeration FrIfChannel: {FRIF_CHANNEL_A, FRIF_CHANNEL_AB, FRIF_CHANNEL_B}, set at link in variant link-time / post-build in variant post-build / pre-compile in variant pre-compile  # This parameter contains the FlexRay Channel used to transmit this FlexRay Frame.
            integer FrIfCycleRepetition: 1..64, set at link in variant link-time / post-build in variant post-build / pre-compile in variant pre-compile  # This parameter contains the FlexRay Cycle Repetition used to transmit this FlexRay Frame.. | possible Values: 1,2,4,8,16,32,64
            integer FrIfLSduLength: 0..254, set at link in variant link-time / post-build in variant post-build / pre-compile in variant pre-compile  # The payload length of the Frame is given here. This parameter is required for validation if configured PDUs and update information fits into the Frame at configuration time [bytes].
            integer FrIfMessageId [0..1]: 0..65535, set at link in variant link-time / post-build in variant post-build / pre-compile in variant pre-compile  # The first two bytes of the payload segment of the FlexRay frame format for frames transmitted in the | dynamic segment can be used as receiver filterable data called the message ID.
            boolean FrIfPayloadPreamble: set at link in variant link-time / post-build in variant post-build / pre-compile in variant pre-compile  # Switching the Payload Preamble bit.
            integer FrIfSlotId: 1..2047, set at link in variant link-time / post-build in variant post-build / pre-compile in variant pre-compile  # This parameter contains the FlexRay Slot ID used to transmit this FlexRay Frame.
            reference FrIfFrameStructureRef: set at link in variant link-time / post-build in variant post-build / pre-compile in variant pre-compile, destination=FrIfFrameStructure  # Reference to the Construction Plan of the FlexRay Frame.
            container FrIfFrameTriggeringDemEventParameterRefs [0..1]  # Container for the references to DemEventParameter elements which shall be invoked using the API Dem_ReportErrorStatus API in case the corresponding error occurs. The EventId is taken from the referenced DemEventParameter's DemEventId value. The standardized errors are provided in the container and can be extended by vendor specific error references.
              symbolic name reference FrIfDemFTSlotStatusRef [0..1]: set at link in variant link-time / post-build in variant post-build / pre-compile in variant pre-compile, destination=DemEventParameter  # Reference to DEM event Id that is reported when FlexRay driver module detects slot errors. If this parameter is not configured, no event reporting happens.
          container FrIfLPdu [1..*]  # Reference to a L-PDU index
            integer FrIfLPduIdx: 0..4095, set at link in variant link-time / post-build in variant post-build / pre-compile in variant pre-compile, symbolic-name-value=true  # This parameter identifies the L-PDU in the interaction between FlexRay Interface and FlexRay Driver.
            boolean FrIfReconfigurable: set at link in variant link-time / post-build in variant post-build / pre-compile in variant pre-compile  # This parameter specifies that this LPdu is reconfigurable using FrIf_ReconfigLPdu. This means that this LPdu can be assigned to a different FrameTriggering at runtime. However, this reconfiguration is limited by hardware constraints. The direction of the LPdu cannot be reconfigured.
            reference FrIfVBTriggeringRef: set at link in variant link-time / post-build in variant post-build / pre-compile in variant pre-compile, destination=FrIfFrameTriggering  # Reference to the assigned Frame triggering.
          container FrIfTransceiver [1..2]  # Up to two FlexRay Transceivers may connect a Controller to a Cluster. This container realizes a Controller-Transceiver assignment.
            enumeration FrIfClusterChannel: {FRIF_CHANNEL_A, FRIF_CHANNEL_B}, set at link in variant link-time / post-build in variant post-build / pre-compile in variant pre-compile  # This parameter identifies to which one of the two Channels (A, B, A and B) of the Cluster the Transceiver is connected. FrIfClusterChannel shall map to Fr_ChannelType: FRIF_CHANNEL_A == FR_CHANNEL_A FRIF_CHANNEL_B == FR_CHANNEL_B FR_CHANNEL_AB shall not be used.
            symbolic name reference FrIfFrTrcvChannelRef: set at link in variant link-time / post-build in variant post-build / pre-compile in variant pre-compile, destination=FrTrcvChannel  # Reference to a Transceiver Driver Channel. This reference is unique for the ECU.
        container FrIfJobList  # This container specifies a list of all FlexRay Jobs of the Cluster to be performed by FrIf_JobListExec_<ClstIdx>().
          symbolic name reference FrIfAbsTimerRef: set at link in variant link-time / post-build in variant post-build / pre-compile in variant pre-compile, destination=FrAbsoluteTimer  # Reference to the absolute timer to be used to trigger the interrupt whose ISR contains the FrIf_JobListExec_<ClstIdx>() function.
          container FrIfJob [1..*]  # A job may contain more than one operation that are executed at a specific point in time.
            integer FrIfCycle: 0..63, set at link in variant link-time / post-build in variant post-build / pre-compile in variant pre-compile  # The FlexRay Cycle in which the communication operation will execute this job
            integer FrIfMacrotick: 0..10240000, set at link in variant link-time / post-build in variant post-build / pre-compile in variant pre-compile  # Macrotick offset in the Cycle [Macrotick]
            container FrIfCommunicationOperation [1..*]  # A separate operation which is part of a FlexRay Job and defines what type of action is executed.
              enumeration FrIfCommunicationAction: {DECOUPLED_TRANSMISSION, FREE_OP_A, FREE_OP_B, PREPARE_LPDU, RECEIVE_AND_INDICATE, RECEIVE_AND_STORE, RX_INDICATION, TX_CONFIRMATION}, set at link in variant link-time / post-build in variant post-build / pre-compile in variant pre-compile  # The action to be performed in the FlexRay Operation
              integer FrIfCommunicationOperationIdx: 0..255, set at link in variant link-time / post-build in variant post-build / pre-compile in variant pre-compile  # For each FlexRay Communication Job, this index spans a range of zero-based consecutive values and thus defines the order of the FlexRay Communication Operation in the respective FlexRay Communication Job.
              integer FrIfRxComOpMaxLoop: 1..512, set at link in variant link-time / post-build in variant post-build / pre-compile in variant pre-compile  # Defines the maximum number of loops for the receive RECEIVE_AND_INDICATE (Use case: emptying a FIFO).
              reference FrIfLPduIdxRef: set at link in variant link-time / post-build in variant post-build / pre-compile in variant pre-compile, destination=FrIfLPdu  # Reference to a L-PDu index
      container FrIfFrameStructure [1..*]  # The Frame structure specifies a Construction Plan how a Frame is assembled with PDUs and their respective Update-Bits.
        enumeration FrIfByteOrder: {BIG_ENDIAN, LITTLE_ENDIAN}, set at link in variant link-time / post-build in variant post-build / pre-compile in variant pre-compile  # This parameter defines the ByteOrder of all Pdus that are mapped into the Frame. | The absolute position of a Pdu in the Frame is determined by the definition of the ByteOrder parameter: If BIG_ENDIAN is specified, the FrIfPduOffset indicates the position of the most significant bit in the Frame. If LITTLE_ENDIAN is specified, the FrIfPduOffset indicates the position of the least significant bit in the Frame.
        container FrIfPdusInFrame [1..*]  # This container holds all the information about a PDU in a FlexRay Frame.
          integer FrIfPduOffset: 0..253, set at link in variant link-time / post-build in variant post-build / pre-compile in variant pre-compile  # The value specifies the offset of the PDU within the Frame [bytes].
          integer FrIfPduUpdateBitOffset [0..1]: 0..2031, set at link in variant link-time / post-build in variant post-build / pre-compile in variant pre-compile  # This value specifies where the PDU's Update-Bit is stored in the Frame (bit location of PDU's Update-Bit in the FlexRay Frame).
          reference FrIfPduRef: set at link in variant link-time / post-build in variant post-build / pre-compile in variant pre-compile, destination=FrIfPdu  # This is the reference to the local definition of a PDU.
      container FrIfPdu [1..*]  # Contains PDU information. A PDU may be either a transmission PDU or a reception PDU.
        choice container FrIfPduDirection  # A PDU is either transmit or receive
          container FrIfRxPdu [0..1]  # Receive PDU
            function name FrIfRxIndicationName [0..1]: set at link in variant link-time / post-build in variant post-build / pre-compile in variant pre-compile  # This parameter defines the name of the <User_RxIndication>. This parameter depends on the parameter FRIF_USERRXINDICATION_UL. If FRIF_USERRXINDICATION_UL equals FR_TP, FR_NM, PDUR or XCP, the name of the <User_RxIndication> is fixed. If FRIF_USERRXINDICATION_UL equals CDD, the name of the <User_RxIndication> is selectable.
            enumeration FrIfUserRxIndicationUL: {CDD, FR_NM, FR_TP, PDUR, XCP}, set at link in variant link-time / post-build in variant post-build / pre-compile in variant pre-compile  # This parameter defines the upper layer (UL) module to which the indication of the successfully received FRIFRXPDU has to be routed via <User_RxIndication>. This <User_RxIndication> has to be invoked when the indication of the configured FRIFRXPDU will be received by a Rx indication event from the FR Driver module. If no upper layer (UL) module is configured, no <User_RxIndication> has to be called in case of a Rx indication event of the FRIFRXPDU from the FR Driver module.
            reference FrIfRxPduRef: set at link in variant link-time / post-build in variant post-build / pre-compile in variant pre-compile, destination=Pdu  # Reference to the external PDU definition.
          container FrIfTxPdu [0..1]  # This container specifies transmission PDUs.
            boolean FrIfConfirm: set at link in variant link-time / post-build in variant post-build / pre-compile in variant pre-compile  # Defines whether the transmission of a PDU should be checked and confirmed to the PDU owning BSW module.
            integer FrIfCounterLimit: 1..255, set at link in variant link-time / post-build in variant post-build / pre-compile in variant pre-compile  # This value states the maximum number of indication of ready PDU data to the FrIf (i.e. maximum number of invocations of FrIf_Transmit) without an intermediate transmission of the PDU.
            boolean FrIfImmediate: set at link in variant link-time / post-build in variant post-build / pre-compile in variant pre-compile  # Defines whether the PDU is transmitted immediate or decoupled.
            boolean FrIfNoneMode [0..1]: set at link in variant link-time / post-build in variant post-build / pre-compile in variant pre-compile, default-value=false  # Using the "None-Mode" which means that there is no API FrIf_Transmit call of the upper layer for this PDU.
            function name FrIfTxConfirmationName [0..1]: set at link in variant link-time / post-build in variant post-build / pre-compile in variant pre-compile  # This parameter defines the name of the <User_TxConfirmation>. This parameter depends on the parameter FrIfUserTxUL. If FrIfUserTxUL equals FR_TP, FR_NM, PDUR or XCP, the name of the <User_TxConfirmation> is fixed. If FrIfUserTxUL equals CDD, the name of the <User_TxConfirmation> is selectable.
            integer FrIfTxPduId: 0..65535, set at link in variant link-time / post-build in variant post-build / pre-compile in variant pre-compile, symbolic-name-value=true  # The global PDU identifier, which has to be used by the upper layer BSW module. The identifier has to be zero based and consecutive.
            function name FrIfUserTriggerTransmitName [0..1]: set at link in variant link-time / post-build in variant post-build / pre-compile in variant pre-compile  # This parameter defines the name of the <User_TriggerTransmit>. This parameter depends on the parameter FrIfUserTxUL. If FrIfUserTxUL equals FR_TP, FR_NM, PDUR or XCP, the name of the <User_TriggerTransmit> is fixed. If FrIfUserTxUL equals CDD, the name of the <User_TriggerTransmit> is selectable.
            enumeration FrIfUserTxUL: {CDD, FR_NM, FR_TP, PDUR, XCP}, set at link in variant link-time / post-build in variant post-build / pre-compile in variant pre-compile  # This parameter defines the upper layer (UL) module to which the trigger of the to be transmitted FRIFTXPDUID (via the <User_TriggerTransmit>) or the confirmation of the successfully transmitted FRIFTXPDUID has to be routed (via the <User_TxConfirmation>).
            reference FrIfTxPduRef: set at link in variant link-time / post-build in variant post-build / pre-compile in variant pre-compile, destination=Pdu  # Reference to the external PDU definition.
    container FrIfGeneral  # This container contains the general configuration parameters of the FlexRay Interface.
      integer FrIfAbsTimerIdx: 1..15, set at pre-compile  # Maximum number of supported absolut timers.
      boolean FrIfAllSlotsSupport: set at pre-compile  # Configuration parameter to enable/disable FrIf support to enable/disable of switching from key-slot / single-slot mode to all slot mode.
      boolean FrIfCancelTransmitSupport: set at pre-compile  # Configuration parameter to enable/disable FrIf support to request the cancellation of the I-PDU transmission to FrDrv.
      boolean FrIfDevErrorDetect: set at pre-compile  # Switches the Development Error Detection and Notification on or off | true: Development Error Detection and Notification on false: Development Error Detection and Notification off
      boolean FrIfDisableLPduSupport: set at pre-compile  # Configuration parameter to enable/disable FrIf support to disables the hardware resource of a LPdu for transmission/reception.
      boolean FrIfDisableTransceiverBranchSupport: set at pre-compile  # Configuration parameter to enable/disable FrIf support to disable branches of an active star.
      boolean FrIfEnableTransceiverBranchSupport: set at pre-compile  # Configuration parameter to enable/disable FrIf support to enable branches of an active star.
      boolean FrIfGetClockCorrectionSupport: set at pre-compile  # Configuration parameter to enable/disable FrIf support to enable/disable of polling the FlexRay Driver to getting CC clock correction values.
      boolean FrIfGetGetChannelStatusSupport: set at pre-compile  # Configuration parameter to enable/disable FrIf support to enable/disable of polling the FlexRay Driver to getting error information about the FlexRay communications bus.
      boolean FrIfGetNmVectorSupport: set at pre-compile  # Configuration parameter to enable/disable FrIf support to request the FlexRay hardware NMVector.
      boolean FrIfGetNumOfStartupFramesSupport: set at pre-compile  # Configuration parameter to enable/disable FrIf support to enable/disable of polling the FlexRay Driver for the actual number of received startup frames on the bus.
      boolean FrIfGetSyncFrameListSupport: set at pre-compile  # Configuration parameter to enable/disable FrIf support to enable/disable of polling the FlexRay Driver to getting a list of actual received sync frames.
      boolean FrIfGetTransceiverErrorSupport: set at pre-compile  # Configuration parameter to enable/disable FrIf support to get the FlexRay Transceiver errors by calling the FlexRay Transceiver module.
      boolean FrIfGetWakeupRxStatusSupport: set at pre-compile  # Configuration parameter to enable/disable FrIf support to get the wakeup received information from the FlexRay controller.
      integer FrIfNumClstSupported: 1..15, set at pre-compile  # Maximum number of FlexRay Clusters that the FlexRay Interface supports.
      integer FrIfNumCtrlSupported: 1..15, set at pre-compile  # Maximum number of FlexRay CCs that the FlexRay Interface supports
      string FrIfPublicCddHeaderFile [0..*]: set at pre-compile  # Defines header files for callback functions which shall be included in case of CDDs. Range of characters is 1.. 32.
      boolean FrIfReadCCConfigApi: set at pre-compile  # Configuration parameter to enable/disable the optional FrIf_ReadCCConfig API.
      boolean FrIfReconfigLPduSupport: set at pre-compile  # Configuration parameter to enable/disable FrIf support to enable/disable the reconfiguration of a given LPdu according to the parameters (FrameId, Channel, CycleRepetition, CycleOffset, PayloadLength, HeaderCRC) at runtime.
      integer FrIfUnusedBitValue [0..1]: 0..1, set at pre-compile  # Set unused bits to a defined value.
      boolean FrIfVersionInfoApi: set at pre-compile  # Enables/disables the existence of the FrIf_GetVersionInfo() API service | true: FrIf_GetVersionInfo() API service exists false: FrIf_GetVersionInfo() API service does not exist
  module definition FrNm [0..1]: variants link-time/post-build/pre-compile  # The Flexray Nm module
    container FrNmChannelConfig: multiple-configuration-container=true  # This container contains the configuration parameters for all FlexRay NM channels.
      container FrNmChannel [1..*]  # This container contains the configuration parameters for a FlexRay NM Channel.
        container FrNmChannelIdentifiers  # This container contains instance specific identifiers related to the respective FlexRay Channel.
          integer FrNmCarWakeUpBitPosition [0..1]: 0..7, set at link in variant link-time+post-build / pre-compile in variant pre-compile  # Specifies the Bit position of the CWU within the NM-Message.
          integer FrNmCarWakeUpBytePosition [0..1]: 2..7, set at link in variant link-time+post-build / pre-compile in variant pre-compile  # Specifies the Byte position of the CWU within the NM-Message.
          boolean FrNmCarWakeUpFilterEnabled [0..1]: set at link in variant link-time+post-build / pre-compile in variant pre-compile  # If CWU filtering is supported, only the CWU bit within the NM message with source node identifier | FrNmCarWakeUpFilterNodeId is considered as CWU request. FALSE - CWU Filtering is not supported TRUE - CWU Filtering is supported
          integer FrNmCarWakeUpFilterNodeId [0..1]: 0..255, set at link in variant link-time+post-build / pre-compile in variant pre-compile  # Source node identifier for CWU filtering. If CWU filtering is supported, only the CWU bit within the NM | message with source node identifier FrNmCarWakeUpFilterNodeId is considered as CWU request.
          boolean FrNmCarWakeUpRxEnabled: set at link in variant link-time+post-build / pre-compile in variant pre-compile  # Enables or disables support of CarWakeUp bit evaluation in received NM messages. | FALSE - CarWakeUp not supported TRUE - CarWakeUp supported
          boolean FrNmControlBitVectorActive: set at link in variant link-time+post-build / pre-compile in variant pre-compile  # This parameter is used to activate or deactivate the control bit vector support for a Fr Nm Channel.
          integer FrNmNodeId: 0..255, set at link in variant link-time / post-build in variant post-build / pre-compile in variant pre-compile  # NM node identifier configured for the respective FlexRay Channel. | It is used for identifying the respective NM node in the NM-cluster. It must be unique for each NM node within one NM cluster.
          enumeration FrNmPduScheduleVariant: {FRNM_PDU_SCHEDULE_VARIANT_1, FRNM_PDU_SCHEDULE_VARIANT_2, FRNM_PDU_SCHEDULE_VARIANT_3, FRNM_PDU_SCHEDULE_VARIANT_4, FRNM_PDU_SCHEDULE_VARIANT_5, FRNM_PDU_SCHEDULE_VARIANT_6, FRNM_PDU_SCHEDULE_VARIANT_7}, set at link in variant link-time+post-build / pre-compile in variant pre-compile, origin=ECUC_AUTOSAR  # This parameter defines the PDU scheduling variant that should be used for this channel. | Option 1 NM-Vote and NM-Data in static segment (one PDU) Option 2 NM-Vote and NM-Data in dynamic segment (one PDU) Option 3 NM-Vote and NM-Data in static segment (separate PDU) Option 4 NM-Vote in static segment and NM-Data in dynamic segment Option 5 NM-Vote in dynamic segment and NM-Data in static segment Option 6 NM-Vote and NM-Data in dynamic segment (separate PDU) Option 7 Combined NM-Vote and CBV in static segment and NM-Data in dynamic segment
          boolean FrNmPnEnabled: set at link in variant link-time / post-build in variant post-build / pre-compile in variant pre-compile, default-value=false  # Enables or disables support of partial networking. | false: Partial networking Range not supported true: Partial networking supported
          boolean FrNmPnEraCalcEnabled: set at link in variant link-time+post-build / pre-compile in variant pre-compile, default-value=false  # Specifies if FrNm calculates the PN request information for external requests. (ERA) | false: PN request are not calculated true: PN request are calculated
          boolean FrNmRepeatMessageBitActive: set at link in variant link-time+post-build / pre-compile in variant pre-compile  # This parameter is used to activate or deactivate the repeat message bit support for a Fr Nm Channel.
          boolean FrNmSynchronizationPointEnabled: set at link in variant link-time+post-build / pre-compile in variant pre-compile  # This parameter defines if this channel shall provide the synchronization point indication to the NM Interface.
          reference FrNmPnEraRxNSduRef: set at link in variant link-time+post-build / pre-compile in variant pre-compile, destination=Pdu  # Reference to a Pdu in the COM-Stack. | Only one SduRef is required for FrNm because the EIRA is the aggregation over all FlexRay Channels.
          symbolic name reference FrNmChannelHandle: set at link in variant link-time / post-build in variant post-build / pre-compile in variant pre-compile, destination=FrIfCluster  # Channel identifier configured for the respective instance of the NM. | The FrNmChannelHandle shall be encoded in the FrNmRxPduId parameter which is passed to FrNm_RxIndication() function called by the FrIf.
          symbolic name reference FrNmComMNetworkHandleRef: set at link in variant link-time / post-build in variant post-build / pre-compile in variant pre-compile, destination=ComMChannel  # This reference points to the unique channel defined by the ComMChannel and provides access to the unique channel index value in ComMChannelId.
          container FrNmRxPdu [1..2]  # This container describes the FlexRay NM RX PDU:s.
            boolean FrNmRxPduContainsData: set at link in variant link-time / post-build in variant post-build / pre-compile in variant pre-compile  # This parameted defines if the PDU contains NM Data.
            boolean FrNmRxPduContainsVote: set at link in variant link-time / post-build in variant post-build / pre-compile in variant pre-compile  # This parameted defines if the PDU contains NM Vote information.
            integer FrNmRxPduId: 0..65535, set at link in variant link-time / post-build in variant post-build / pre-compile in variant pre-compile, symbolic-name-value=true  # PDU identifier configured for the respective FlexRay Channel. | It is used for referring to the FlexRay Interface receive function. It must be consistent with the value configured in the FlexRay Interface. This ID is used for the combined reception of NM Vote and NM Data or for the reception of the NM Vote if NM Data is received in a separate PDU. ImplementationType: PduIdType
            reference FrNmRxPduRef: set at link in variant link-time / post-build in variant post-build / pre-compile in variant pre-compile, destination=Pdu  # The reference to a PDU in the global PDU structure described in the AUTOSAR ECU Configuration Specification. This reference will be used by the FrIf module to derive the PDU Id.
          container FrNmTxPdu [0..2]  # This container describes the FlexRay NM TX PDU:s.
            integer FrNmTxConfirmationPduId: 0..65535, set at link in variant link-time+post-build / pre-compile in variant pre-compile, symbolic-name-value=true  # Handle Id to be used by the Lower Layer to confirm the transmission of the FrNmTxPdu to the LowerLayer.
            boolean FrNmTxPduContainsData: set at link in variant link-time / post-build in variant post-build / pre-compile in variant pre-compile  # This parameted defines if the PDU contains NM Data.
            boolean FrNmTxPduContainsVote: set at link in variant link-time / post-build in variant post-build / pre-compile in variant pre-compile  # This parameted defines if the PDU contains NM Vote information.
            reference FrNmTxPduRef: set at link in variant link-time / post-build in variant post-build / pre-compile in variant pre-compile, destination=Pdu  # The reference to a PDU in the global PDU structure described in the AUTOSAR ECU Configuration Specification. This reference is used to derive the PDU Id that is defined by the FrIf module.
          container FrNmUserDataTxPdu [0..1]  # This optional container is used to configure the UserNm PDU. This container is only available if FrNmComUserDataSupport is enabled.
            integer FrNmTxUserDataPduId: 0..65535, set at link in variant link-time+post-build / pre-compile in variant pre-compile, symbolic-name-value=true  # This parameter defines the Handle ID of the NM User Data I-PDU.
            reference FrNmTxUserDataPduRef: set at link in variant link-time+post-build / pre-compile in variant pre-compile, destination=Pdu  # Reference to the NM User Data I-PDU in the global PDU collection.
        container FrNmChannelTiming  # This container contains instance-specific timing related to the respective FlexRay Channel.
          enumeration FrNmDataCycle: {FRNM_CYCLE_VALUE_1, FRNM_CYCLE_VALUE_16, FRNM_CYCLE_VALUE_2, FRNM_CYCLE_VALUE_32, FRNM_CYCLE_VALUE_4, FRNM_CYCLE_VALUE_64, FRNM_CYCLE_VALUE_8}, set at link in variant link-time+post-build / pre-compile in variant pre-compile  # Number of FlexRay Schedule Cycles needed to transmit the NM Data of all ECUs on the FlexRay bus
          float FrNmMainFunctionPeriod: 0.001..0.02, set at link in variant link-time+post-build / pre-compile in variant pre-compile  # This parameter defines the processing cycle of the main function of FrNm module in seconds.
          float FrNmMsgTimeoutTime: 0..65.535, set at link in variant link-time / post-build in variant post-build / pre-compile in variant pre-compile  # Timeout of a NM-message. It determines in seconds how long the NM shall wait with notification of transmission failure while communication errors occur on the bus.
          integer FrNmReadySleepCnt: 1..65535, set at link in variant link-time+post-build / pre-compile in variant pre-compile  # Numbers of repetitions in the ready sleep state before NM switches to bus sleep mode. | On a value of "1", the NM-State Machine will leave the Ready Sleep State after one NM Repetition Cycle with no "keep awake" votes.
          float FrNmRemoteSleepIndTime: 0..65.535, set at link in variant link-time+post-build / pre-compile in variant pre-compile  # Timeout for Remote Sleep Indication. It defines the time in seconds how long it shall take to recognize that all other nodes are ready to sleep. | The value "0" denotes that no Remote Sleep Indication functionality is configured.
          float FrNmRepeatMessageTime: 0..65.535, set at link in variant link-time+post-build / pre-compile in variant pre-compile  # Timeout for Repeat Message State. Defines the time in seconds how long the NM shall stay in the Repeat Message State. | The value "0" denotes that no Repeat Message State is configured, which means that Repeat Message State is transient and implies that it is left immediately after entry and consequently no startup stability is guaranteed and no node detection procedure is possible.
          enumeration FrNmRepetitionCycle: {FRNM_CYCLE_VALUE_1, FRNM_CYCLE_VALUE_16, FRNM_CYCLE_VALUE_2, FRNM_CYCLE_VALUE_32, FRNM_CYCLE_VALUE_4, FRNM_CYCLE_VALUE_64, FRNM_CYCLE_VALUE_8}, set at link in variant link-time+post-build / pre-compile in variant pre-compile  # Number of Flexray Schedule Cycles used to repeat the transmission of the Nm vote of all ECUs on the Flexray Bus.
          float FrNmSyncLossTimer: 0..65535, set at link in variant link-time / post-build in variant post-build / pre-compile in variant pre-compile  # Initial value for the SyncLossTimer in seconds.
          boolean FrNmVoteInhibitionEnabled: set at pre-compile  # Pre-processor switch for enabling the inhibition of vote changes from the next-to-last repetition cycle to the last repetition cycle before the Ready Sleep Counter expires.
          enumeration FrNmVotingCycle: {FRNM_CYCLE_VALUE_1, FRNM_CYCLE_VALUE_16, FRNM_CYCLE_VALUE_2, FRNM_CYCLE_VALUE_32, FRNM_CYCLE_VALUE_4, FRNM_CYCLE_VALUE_64, FRNM_CYCLE_VALUE_8}, set at link in variant link-time+post-build / pre-compile in variant pre-compile  # Number of FlexRay Schedule Cycles needed to transmit the Nm vote of all ECUs on the FlexRay Bus.
    container FrNmGlobalConfig  # This container contains all global configuration parameters for the FrNm module.
      container FrNmGlobalConstants  # This container contains module constants related to the FlexRay NM functionality.
        integer FrNmNumberOfClusters: 1..255, set at link in variant link-time+post-build / pre-compile in variant pre-compile  # Number of AUTOSAR FR NM clusters allowed within one ECU.
      container FrNmGlobalFeatures  # This container contains module features related to the FlexRay NM functionality.
        boolean FrNmBusSynchronizationEnabled: set at pre-compile  # Pre-processor switch for enabling the bus synchronisation.
        boolean FrNmComUserDataSupport: set at pre-compile  # Enable/disable the user data support.
        boolean FrNmControlBitVectorEnabled: set at pre-compile  # Pre-processor switch for enabling control bit vector support. | calculationFormula = If (FrNmNodeDetectionEnabled == False) then Equal(False) else Equal(False or True)
        boolean FrNmCoordinatorSyncSupport: set at pre-compile  # Enables/disables the coordinator synchronisation support.
        boolean FrNmCycleCounterEmulation: set at pre-compile  # Pre-processor switch for enabling the cycle counter emulation.
        boolean FrNmDualChannelPduEnable: set at pre-compile  # Pre-processor switch for enabling the support of dual channel transmission and reception of NM messages.
        boolean FrNmHwVoteEnable: set at pre-compile  # Pre-processor switch for enabling the processing of FlexRay Hardware aggregated NM-Votes.
        boolean FrNmNodeDetectionEnabled: set at pre-compile  # Pre-processor switch for enabling node detection support. | calculationFormula = If (FrNmPassiveModeEnabled == False) then Equal(NmNodeDetectionEnabled) else Equal(False)
        boolean FrNmPassiveModeEnabled: set at pre-compile  # Pre-processor switch for enabling Passive Mode Configuration support. | calculationFormula = Equal(NmPassiveModeEnabled)
        boolean FrNmPduRxIndicationEnabled: set at pre-compile  # Pre-processor switch for enabling PDU reception indication.
        boolean FrNmPnEiraCalcEnabled: set at link in variant link-time+post-build / pre-compile in variant pre-compile, default-value=false  # Specifies if FrNm calculates the PN request information for internal an external requests. (EIRA) | true: PN request are calculated false: PN request are not calculated
        float FrNmPnResetTime: 0.001..65.535, set at link in variant link-time+post-build / pre-compile in variant pre-compile  # Specifies the runtime of the reset timer in seconds. This reset time is valid for the reset of PN requests in the EIRA and in the ERA. The value shall be the same for every channel. Thus it is a global config parameter.
        boolean FrNmRemoteSleepIndicationEnabled: set at pre-compile  # Pre-processor switch for enabling remote sleep indication. | calculationFormula = If (FrNmPassiveModeEnabled == True) then Equal(False) else Equal(False or True)
        boolean FrNmRepeatMessageBitEnabled: set at pre-compile  # Pre-processor switch for enabling the repeat message bit support.
        boolean FrNmSourceNodeIdentifierEnabled: set at pre-compile  # Pre-processor switch for enabling SourceNodeIdentifier support.
        boolean FrNmStateChangeIndicationEnabled: set at pre-compile  # Pre-processor switch for enabling state change indication.
        boolean FrNmUserDataEnabled: set at pre-compile  # Pre-processor switch for enabling user data support.
        boolean FrNmVotingNextToLastRepetitionCycleDisable: set at pre-compile  # Pre-processor switch for disabling vote changes in the last two | repetition cycles before the Ready Sleep Counter expires.
        reference FrNmPnEiraRxNSduRef: set at link in variant link-time+post-build / pre-compile in variant pre-compile, destination=Pdu  # Reference to a Pdu in the COM-Stack. | Only one SduRef is required for FrNm because the EIRA is the aggregation over all FlexRay Channels.
        container FrNmPnInfo  # PN information configuration
          integer FrNmPnInfoLength: 0..7, set at link in variant link-time+post-build / pre-compile in variant pre-compile  # Specifies the length of the PN request information in the NM message.
          integer FrNmPnInfoOffset: 1..7, set at link in variant link-time+post-build / pre-compile in variant pre-compile, default-value=0  # Specifies the offset of the PN request information in the NM message.
          container FrNmPnFilterMaskByte [0..7]  # Filter mask byte configuration
            integer FrNmPnFilterMaskByteIndex: 0..6, set at link in variant link-time+post-build / pre-compile in variant pre-compile  # Index of the filter mask byte. Specifies the position within the filter mask byte array.
            integer FrNmPnFilterMaskByteValue: 0..255, set at link in variant link-time+post-build / pre-compile in variant pre-compile, default-value=0  # Parameter to configure the filter mask byte.
      container FrNmGlobalProperties  # This container contains module properties related to the FlexRay NM functionality.
        boolean FrNmDevErrorDetect: set at pre-compile  # Pre-processor switch for enabling development error detection
        boolean FrNmMainAcrossFrCycle: set at link in variant link-time+post-build / pre-compile in variant pre-compile  # Parameter describing if the execution of FrNm_Main function crosses the FlexRay cycle boundary or not.
        boolean FrNmVersionInfoApi: set at pre-compile  # Pre-processor switch for enabling version info API support.
  module definition FrSM [0..1]: variants link-time/post-build/pre-compile  # Configuration of the FlexRay State Manager
    container FrSMConfig: multiple-configuration-container=true  # This container comprises the cluster specific configuration of the FlexRay State Manager.
      container FrSMCluster [1..*]  # This container specifies a FlexRay cluster and all related data. A FlexRay cluster may consist of more than one controller per ECU.
        boolean FrSMCheckWakeupReason: set at link in variant link-time / post-build in variant post-build / pre-compile in variant pre-compile  # If FrSMCheckWakeupReason is true, the FrSM will check the wakeup reason in order to skip the wakeup in case of wakeup by bus. If FrSMCheckWakeupReason is false, the FrSM will always try to perform a wakeup.
        boolean FrSMDelayStartupWithoutWakeup: set at link in variant link-time / post-build in variant post-build / pre-compile in variant pre-compile  # If true, timer t1 shall be started instead of immediately calling FrIf_AllowColdstart in case of a startup without wakeup.
        float FrSMDurationT1: 0..Inf, set at link in variant link-time / post-build in variant post-build / pre-compile in variant pre-compile  # The duration of timer t1 in seconds. | A value of 0 shall imply that the timer is not used.
        float FrSMDurationT2: 0..Inf, set at link in variant link-time / post-build in variant post-build / pre-compile in variant pre-compile  # The duration of timer t2 in seconds. | A value of 0 shall imply that the timer is not used. The value of this parameter shall be larger than the value of FrSMDurationT1 parameter.
        float FrSMDurationT3: 0..Inf, set at link in variant link-time / post-build in variant post-build / pre-compile in variant pre-compile  # The duration of timer t3 in seconds. The value of this parameter shall be larger than the value of FrSMDurationT1 parameter. | A value of 0 shall imply that the timer is not used. It shall only be possible to configure a value 0 if no FrNm is used.
        boolean FrSMIsColdstartEcu: set at link in variant link-time / post-build in variant post-build / pre-compile in variant pre-compile  # True: The ECU is a coldstart node for this FlexRay cluster. | False: The ECU is no coldstart node for this FlexRay cluster.
        boolean FrSMIsWakeupEcu: set at link in variant link-time / post-build in variant post-build / pre-compile in variant pre-compile  # True: FrSM shall perform a wakeup for this cluster. | False: FrSM shall never perform a wakeup for this FlexRay cluster.
        float FrSMMainFunctionCycleTime: 0..Inf, set at link in variant link-time+post-build / pre-compile in variant pre-compile  # This parameter defines the cycle time in seconds of the periodic calling of FrSM main function.
        integer FrSMMinNumberOfColdstarter [0..1]: 0..255, set at link in variant link-time / post-build in variant post-build / pre-compile in variant pre-compile  # This parameter defines the number of coldstarter that should not be underrun. If this parameter is not configured the mainfunction shall not check the number of startup frames.
        integer FrSMNumWakeupPatterns: 0..65535, set at link in variant link-time / post-build in variant post-build / pre-compile in variant pre-compile  # Maximum number of Wakeup Patterns the node may send before going to FRSM_STARTUP.
        integer FrSMStartupRepetitions [0..1]: 0..65535, set at link in variant link-time / post-build in variant post-build / pre-compile in variant pre-compile  # The number of times an ECU may repeat the startup procedure for a FlexRay cluster.
        integer FrSMStartupRepetitionsWithWakeup [0..1]: 0..65535, set at link in variant link-time / post-build in variant post-build / pre-compile in variant pre-compile  # The number of times an ECU may repeat the startup procedure including a wakeup for a FlexRay cluster.
        symbolic name reference FrSMComMNetworkHandleRef: set at link in variant link-time / post-build in variant post-build / pre-compile in variant pre-compile, destination=ComMChannel  # Reference to the unique handle to identify one certain FlexRay network correspond to one of the network handles of the ComM configuration.
        symbolic name reference FrSMFrIfClusterRef: set at link in variant link-time+post-build / pre-compile in variant pre-compile, destination=FrIfCluster  # References the cluster configuration in the FlexRay Interface configuration. | Note that the assigned controllers and transceivers are defined in the FrIf configuration and can be accessed via this reference.
        container FrSMClusterDemEventParameterRefs [0..1]  # Container for the references to DemEventParameter elements which shall be invoked using the API Dem_ReportErrorStatus in case the corresponding error occurs. The EventId is taken from the referenced DemEventParameter's DemEventId value. | The standardized errors are provided in this container and can be extended by vendor specific error references.
          symbolic name reference FRSM_E_CLUSTER_STARTUP [0..1]: set at link in variant link-time+post-build / pre-compile in variant pre-compile, destination=DemEventParameter  # Reference to the DemEventParameter which shall be issued when the error "FRSM_E_CLUSTER_STARTUP" has occured. If the reference is not configured the error shall be reported as DET error.
          symbolic name reference FRSM_E_CLUSTER_SYNC_LOSS [0..1]: set at link in variant link-time+post-build / pre-compile in variant pre-compile, destination=DemEventParameter  # Reference to the DemEventParameter which shall be issued when the error "FRSM_E_CLUSTER_SYNC_LOSS" has occurred. If the reference is not configured the error shall be reported as DET error.
    container FrSMGeneral  # This container contains the general configuration parameters of the FlexRay State Manager.
      boolean FrSMDevErrorDetect: set at pre-compile, default-value=false  # Enables and disables the development error detection and | notification mechanism.
      function name FrSMSyncLossErrorIndicationName [0..1]: set at link in variant link-time+post-build / pre-compile in variant pre-compile  # Name of <Cdd>_SyncLossErrorIndication function that shall be called on loss of synchronization. If this parameter is omitted no indication shall take place.
      boolean FrSMVersionInfoApi: set at pre-compile, default-value=false  # Enables and disables the version info API
  module definition FrTp [0..1]: variants post-build/pre-compile  # Configuration of the FlexRay Transport Protocol module according to ISO 10681-2.
    container FrTpGeneral  # This container contains the general configuration parameters of the FlexRay Transport Protocol module.
      boolean FrTpAckRt: set at pre-compile  # Preprocessor switch for enabling the Acknowledgement and retry mechanisms. | True: Acknowledge and Retry is enabled False: Acknowledge and Retry is disabled
      integer FrTpChanNum: 1..32, set at pre-compile  # Preprocessor switch for defining the number of concurrent channels the module supports. Up to 32 channels shall be definable here.
      boolean FrTpChangeParamApi: set at pre-compile  # Preprocessor switch for enabling the API to change FrTp communication | parameters. True: ChangeParameter API is enabled False: ChangeParameter API is disabled.
      boolean FrTpDevErrorDetect: set at pre-compile  # Preprocessor switch for enabling development error detection. | True: Development Error Detection is enabled False: Development Error Detection is disabled
      boolean FrTpFullDuplexEnable: set at pre-compile, default-value=false  # Preprocessor switch for enabling full duplex mechanisms for all channels. | True: Full duplex is enabled False: Fullduplex is disabled (Half duplex is enabled)
      float FrTpMainFuncCycle: 0..Inf, set at pre-compile  # This parameter contains the calling period of the TPs Main Function. The parameter is specified in seconds.
      boolean FrTpTransmitCancellation: set at pre-compile  # Preprocessor switch for enabling Transmit Cancellation. | True: Transmit Cancellation is enabled False: Transmit Cancellation is disabled
      boolean FrTpUnknownMsgLength: set at pre-compile  # Preprocessor switch to support data transfer with unknown message length. | True: Transmission with unknown message length is enabled False: Transmission with unknown message length is disabled
      boolean FrTpVersionInfoApi: set at pre-compile  # Preprocessor switch for enabling the Version info API. | True: Version Info API is enabled False: Version Info API is disabled
    container FrTpMultipleConfig: multiple-configuration-container=true  # This container holds one or several multiple configuration sets.
      container FrTpConnection [1..*]  # This container contains the connection specific parameters to transfer N-PDUs via FlexRay TP.
        boolean FrTpBandwidthLimitation: set at post-build in variant post-build / pre-compile in variant pre-compile  # This parameter indicates wheather the connection requires a bandwidth limitation or not. If FrTpBandwidthLimitation=True the sender shall send a StartFrame always on the first PDU of a PDU-Pool.
        integer FrTpLa: 0..65535, set at post-build in variant post-build / pre-compile in variant pre-compile  # This parameter defines the Local Address for the respective connection. When the local instance is the sender, this is the Source Address within the TP frame. When the local instance is the receiver, this is the Target Address within the TP frame.
        boolean FrTpMultipleReceiverCon: set at post-build in variant post-build / pre-compile in variant pre-compile  # This parameter defines, whether this connection is an 1:1 ('false') or an 1:n ('true') connection. If data segmentation is required this parameter is used to check whether segmentation is possible or not. If the connection is 1:n segmentation is not possible and an error will occur.
        integer FrTpRa: 0..65535, set at post-build in variant post-build / pre-compile in variant pre-compile  # This parameter defines the Remote Address for the respective connection. When the local instance is the sender, this is the Target Address within the TP frame. When the local instance is the receiver, this is the Source Address within the TP frame.
        reference FrTpConCtrlRef: set at post-build in variant post-build / pre-compile in variant pre-compile, destination=FrTpConnectionControl  # FrTpConnectionControlReference: | This parameter defines a reference to a connection control container.
        reference FrTpRxPduPoolRef [0..1]: set at post-build in variant post-build / pre-compile in variant pre-compile, destination=FrTpRxPduPool  # This parameter defines a reference to a RxPduPool.
        reference FrTpTxPduPoolRef [0..1]: set at post-build in variant post-build / pre-compile in variant pre-compile, destination=FrTpTxPduPool  # This parameter defines a reference to a TxPduPool.
        container FrTpRxSdu [0..1]  # This parameter defines the Rx Service Data Unit Identifier (Sdu Id) which uniquely identifies a data transfer (inter-module communication) between FrTp and PDUR.
          integer FrTpRxSduId: 0..65535, set at post-build in variant post-build / pre-compile in variant pre-compile, symbolic-name-value=true  # This unique identifier is used for change parameter request or receive cancellation from PduR to FrTp. | ImplementationType: PduIdType
          reference FrTpRxSduRef: set at post-build in variant post-build / pre-compile in variant pre-compile, destination=Pdu  # Reference to a PDU in the global PDU structure.
        container FrTpTxSdu [0..1]  # This parameter defines the Tx Service Data Unit Identifier (Sdu Id) which uniquely identifies a data transfer (inter-module communication) between FrTp and PDUR.
          integer FrTpTxSduId: 0..65535, set at post-build in variant post-build / pre-compile in variant pre-compile, symbolic-name-value=true  # This is a unique identifier for a to be transmitted message from the PduR to the FrTp. | ImplementationType: PduIdType
          reference FrTpTxSduRef: set at post-build in variant post-build / pre-compile in variant pre-compile, destination=Pdu  # Reference to a PDU in the global PDU structure.
      container FrTpConnectionControl [1..*]  # This container contains the configuration parameters to control a FlexRay TP connection.
        enumeration FrTpAckType: {FRTP_ACK_WITH_RT, FRTP_NO}, set at post-build in variant post-build / pre-compile in variant pre-compile  # This parameter defines the type of acknowledgement which is used for the specific channel.
        integer FrTpMaxAr: 0..255, set at post-build in variant post-build / pre-compile in variant pre-compile  # This parameter defines the maximum number of trying to send a frame when a TIMEOUT AR occurs.
        integer FrTpMaxAs: 0..255, set at post-build in variant post-build / pre-compile in variant pre-compile  # This parameter defines the maximum number of trying to send a frame when a TIMEOUT AS occurs.
        integer FrTpMaxBufferSize: 1..65535, set at post-build in variant post-build / pre-compile in variant pre-compile  # Limits the maximal buffer size the FrTp can choose in order to limit the amount of Tx buffer that will be requested at the sender side in a segmented transfer.
        integer FrTpMaxFCWait: 0..255, set at post-build in variant post-build / pre-compile in variant pre-compile  # This parameter defines the maximum number of FlowControl N-PDUs with FlowState "WAIT"
        integer FrTpMaxFrIf: 0..255, set at post-build in variant post-build / pre-compile in variant pre-compile  # This parameter defines the maximum number of trying to send a frame when the FrIf returns an error.
        integer FrTpMaxNbrOfNPduPerCycle: 0..31, set at post-build in variant post-build / pre-compile in variant pre-compile  # This parameter is part of the ISO 10681-2 protocol's FlowControl parameter "Bandwidth Control (BC)". It limits the number of N-Pdus the sender is allowed to transmit within a FlexRay cycle.
        integer FrTpMaxRn: 0..255, set at post-build in variant post-build / pre-compile in variant pre-compile  # This parameter defines the maximum number of retries (if retry is configured).
        integer FrTpSCexp: 0..7, set at post-build in variant post-build / pre-compile in variant pre-compile  # This parameter is part of the ISO 10681-2 protocol's FlowControl parameter "Bandwidth Control (BC)". It represents the exponent to calculate the minimum number of "Separation Cycles" the sender has to wait for the next transmission of an FrTp N-Pdu.
        float FrTpTimeBr: 0..0.255, set at post-build in variant post-build / pre-compile in variant pre-compile  # This parameter defines the time in seconds the FrTp requires to transmit a corresponding FlowControl Frame. According to ISO 10681-2 this parameter is a performance requirement.
        float FrTpTimeBuffer: 0..65.535, set at post-build in variant post-build / pre-compile in variant pre-compile  # This parameter defines the time in seconds of waiting for the next try to get a Tx or Rx buffer.
        float FrTpTimeFrIf: 0..0.255, set at post-build in variant post-build / pre-compile in variant pre-compile  # This parameter defines the time in seconds of waiting for the next try (if retry is activated) to send via FrIf_Transmit.
        float FrTpTimeoutAr: 0..65.535, set at post-build in variant post-build / pre-compile in variant pre-compile  # This parameter states the timeout in seconds between the PDU transmit request of the Transport Layer to the FlexRay Interface and the corresponding confirmation of the FlexRay Interface on the receiver side (for FC or AF).
        float FrTpTimeoutAs: 0..65.535, set at post-build in variant post-build / pre-compile in variant pre-compile  # This parameter specifies the timeout in seconds the FrIf shall confirm a transmitted Pdu to the FrTp.
        float FrTpTimeoutBs: 0..65.535, set at post-build in variant post-build / pre-compile in variant pre-compile  # This parameter defines the timeout in seconds for waiting for an FC or AF on the sender side in a 1:1 connection.
        float FrTpTimeoutCr: 0..65.535, set at post-build in variant post-build / pre-compile in variant pre-compile  # This parameter defines the timeout value in seconds a receiver is waiting for a CF or a LF.
      container FrTpRxPduPool [0..*]  # This container contains all Pdus that are assigned to that Pdu Pool.
        container FrTpRxPdu [0..*]  # Container to hold the PDU parameters. | ImplementationType: PduInfoType
          integer FrTpRxPduId: 0..65535, set at post-build in variant post-build / pre-compile in variant pre-compile, symbolic-name-value=true  # This is a unique identifier for a received message which is forwarded from the FrIf to the FrTp. | ImplementationType: PduIdType
          reference FrTpRxPduRef: set at post-build in variant post-build / pre-compile in variant pre-compile, destination=Pdu  # Reference to a PDU in the global PDU structure.
      container FrTpTxPduPool [0..*]  # This container contains all Pdus that are assigned to that Pdu Pool.
        container FrTpTxPdu [1..*]  # Container to hold the PDU parameters. | ImplementationType: PduInfoType
          integer FrTpTxConfirmationPduId: 0..65535, set at post-build in variant post-build / pre-compile in variant pre-compile, symbolic-name-value=true  # Handle Id to be used by the FrIf to confirm the transmission of the FrTpTxPdu to the FrIf module.
          reference FrTpTxPduRef: set at post-build in variant post-build / pre-compile in variant pre-compile, destination=Pdu  # Reference to a PDU in the global PDU structure.
