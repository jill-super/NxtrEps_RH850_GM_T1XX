[part 5 of 6: package /AUTOSAR/EcucDefs]
AUTOSAR XML (schema 4-0-3)
package /AUTOSAR/EcucDefs  (continued)
  module definition FrTrcv [0..*]: variants pre-compile  # Configuration of the FrTrcv (FlexRay Transceiver driver) module.
    container FrTrcvChannel [1..*]  # Container gives FlexRay transceiver driver information about a single FlexRay transceiver channel. | Any FlexRay transceiver driver has such FlexRay transceiver channels.
      integer FrTrcvChannelId: 0..255, set at pre-compile, symbolic-name-value=true  # Unique identifier of the FlexRay Transceiver Channel.
      boolean FrTrcvChannelUsed: set at pre-compile, default-value=true  # Shall the related FlexRay transceiver channel be used?
      boolean FrTrcvControlsPowerSupply: set at pre-compile, default-value=false  # Is ECU power supply controlled by this transceiver?
      function name FrTrcvEnableInterruptCallout [0..1]: set at pre-compile  # This parameter defines the existence and the name of a callout function that enables the interrupt pin for the wakeup. If this parameter is omitted no callout shall take place.
      enumeration FrTrcvInitState: {FRTRCV_TRCVMODE_NORMAL, FRTRCV_TRCVMODE_RECEIVEONLY, FRTRCV_TRCVMODE_SLEEP, FRTRCV_TRCVMODE_STANDBY}, set at pre-compile, default-value=FRTRCV_OP_MODE_NORMAL  # State of FlexRay transceiver after power on. | ImplementationType: FrTrcv_TrcvModeType
      enumeration FrTrcvMaxBaudrate: {FR_10M, FR_2M5, FR_5M0}, set at pre-compile  # Max baudrate for transceiver hardware type. Only used for validation purposes. Value shall be configured by configuration tool based on | FRTRCV_HARDWARE_NAME and internal information about ability of this hardware typel.
      boolean FrTrcvWakeupByBusUsed: set at pre-compile  # Is wake up by node supported? If FlexRay transceiver hardware does not support wake up by node value is always FALSE. If FlexRay transceiver hardware supports wake up by node value is TRUE or FALSE depending whether it is used or not.
      symbolic name reference FrTrcvIcuChannelRef [0..1]: set at pre-compile, destination=IcuChannel  # Reference to the IcuChannel to enable/disable the interrupts for wakeups.
      symbolic name reference FrTrcvWakeupSourceRef [0..1]: set at pre-compile, destination=EcuMWakeupSource  # Reference to a wakeup source in the EcuM configuration. If | FrTrcvWakeUpSupport is configured as FRTRCV_WAKEUP_NOT_SUPPORTED the FrTrcvWakeupSourceRef is not needed. Implementation Type: reference to EcuM_WakeupSourceType
      choice container FrTrcvAccess
        container FrTrcvDioAccess [0..1]  # Container gives FR transceiver driver information about accessing ports and port pins. If a FR transceiver hardware has no Dio interface, there is no instance of this container.
          container FrTrcvDioChannelAccess [1..*]  # In this Container the relation between FR transceiver hardware pin names and Dio port access information is given.
            string FrTrcvHardwareInterfaceName: set at pre-compile  # FR transceiver hardware interface name. It is typically the name of a pin. From a Dio point of view it is either a port, a single channel or a channel group. Depending on this fact either FRTRCV_DIO_PORT_SYMBOLIC_NAME or FRTRCV_DIO_CHANNEL_SYMBOLIC_NAME or FRTRCV_DIO_CHANNEL_GROUP_SYMBOLIC_NAME shall reference a Dio configuration. The FR transceiver driver implementation description shall list up this name for the appropriate FR transceiver hardware.
            choice reference FrTrcvDioSymNameRef: set at pre-compile, destination=[DioChannel, DioChannelGroup, DioPort]  # Choice Reference to a DIO Port, DIO Channel or DIO Channel Group. This reference replaces the FRTRCV_DIO_PORT_SYM_NAME, FRTRCV_DIO_CHANNEL_SYM_NAME and FRTRCV_DIO_GROUP_SYM_NAME references in the Fr Trcv SWS.
        container FrTrcvSpiSequence [0..1]  # Container gives FlexRay transceiver driver information about one SPI sequence. One SPI sequence used by FlexRay transceiver driver is in exclusive use for it. No other driver is allowed to access this sequence. FlexRay transceiver driver may use one sequence to access n FlexRay transceiver hardwares chips of the same type or n sequences are used to access one single FlexRay transceiver hardware chip. If a FlexRay transceiver hardware has no SPI interface, there is no instance of this container.
          reference FrTrcvSpiSequenceName: set at pre-compile, destination=SpiSequence  # Reference to a Spi sequence configuration container.
      container FrTrcvBranchIdContainer  # Only one SymbolicNameValue can be defined per container. Therefore this container is necessary.
        integer FrTrcvBranchId: 0..255, set at pre-compile, symbolic-name-value=true  # Unique branch id. It is used by CDDs and internally.
      container FrTrcvChannelDemEventParameterRefs [0..1]  # Container for the references to DemEventParameter elements which shall be invoked using the API Dem_ReportErrorStatus API in case the corresponding error occurs. The EventId is taken from the referenced DemEventParameter's DemEventId value. The standardized errors are provided in the container and can be extended by vendor specific error references.
        symbolic name reference FRTRCV_E_FR_BUSERROR_TRCV [0..1]: set at pre-compile, destination=DemEventParameter  # Reference to configured DEM event to report "Error Status of Class B (SPI) transceiver bus errors where TrcvIdx is the transceiver index"
        symbolic name reference FRTRCV_E_FR_ERRN_TRCV [0..1]: set at pre-compile, destination=DemEventParameter  # Reference to configured DEM event to report "Error Status of Class A (GPIO) transceiver"
    container FrTrcvGeneral  # Container gives FlexRay transceiver driver basic information.
      function name FrTrcvDemReportErrorStatusConfiguration [0..1]: set at pre-compile  # Name of a C function which substitutes Dem_ReportErrorStatus.
      boolean FrTrcvDevErrorDetect: set at pre-compile  # Switches development error detection and notification on and off. | If switched on, #define FRTRCV_DEV _ERROR_DETECT ON shall be generated. If switched off, #define FRTRCV_DEV_ERROR _DETECT OFF shall be generated. Define shall be part of file FrTrcv_Cfg.h.
      boolean FrTrcvErrorCheckDuringCommunication: set at pre-compile  # Enable a functionality to check transceiver's state during communication.
      boolean FrTrcvErrorCheckInInit: set at pre-compile  # Enable a functionality to check transceiver's state while initialization process of FrTrcv.
      boolean FrTrcvGetVersionInfo: set at pre-compile  # Switches version information API on and off. If switched off, function need not be present in compiled code.
      integer FrTrcvIndex: 0..255, set at pre-compile  # Specifies the InstanceId of this module instance. If only one instance is present it shall have the Id 0.
      float FrTrcvMainFunctionCycleTime: 0..Inf, set at pre-compile  # Cyclic call time for function FrTrcvMainFunction in seconds. A call time of 0ms indicates no calls for this function. In this case function need not be present in compiled code.
      integer FrTrcvRetryCountInInit: 0..255, set at pre-compile  # Specifies the number of retry count when error occurs while initialization process of FrTrcv.
      integer FrTrcvWaitCount: 0..4294967295, set at pre-compile, default-value=0  # Wait count for transceiver state changes.
      enumeration FrTrcvWakeUpSupport: {FRTRCV_WAKEUP_BY_POLLING, FRTRCV_WAKEUP_NOT_SUPPORTED}, set at pre-compile  # Informs whether wake up is supported by polling or whether it is not supported. | In case no wake up is supported by FlexRay transceiver hardware setting has to be always NO. Only in case wake up is supported by polling main function FlexRayTrcv_main has to be present in source code. In case of support for wake up either by polling wake up ability may be switched on or off for each channel of one FlexRay transceiver channel independently by FrTrcvWakeupByBusUsed.
  module definition Gpt [0..1]: variants post-build/pre-compile  # Configuration of the Gpt (General Purpose Timer) module.
    container GptChannelConfigSet: multiple-configuration-container=true  # This container is the base of a Configuration Set which contains the configured GPT channels. This way, different configuration sets can be defined for post-build process.
      container GptChannelConfiguration [1..*]  # Configuration of an individual GPT channel.
        integer GptChannelId: 0..4294967295, set at post-build in variant post-build / pre-compile in variant pre-compile, symbolic-name-value=true  # Channel Id of the GPT channel. This value will be assigned to the symbolic name derived of the GptChannelConfiguration container short name.
        enumeration GptChannelMode: {GPT_CH_MODE_CONTINUOUS, GPT_CH_MODE_ONESHOT}, set at post-build in variant post-build / pre-compile in variant pre-compile  # Specifies the behaviour of the timer channel after the target time is reached.
        float GptChannelTickFrequency: 0..Inf, set at post-build in variant post-build / pre-compile in variant pre-compile  # Specifies the tick frequency of the timer channel in Hz.
        integer GptChannelTickValueMax: 0..18446744073709551615, set at post-build in variant post-build / pre-compile in variant pre-compile  # Maximum value in ticks, the timer channel is able to count. With the next tick, the timer rolls over to zero.
        boolean GptEnableWakeup: set at post-build in variant post-build / pre-compile in variant pre-compile  # Enables wakeup capability of MCU for a channel.
        function name GptNotification [0..1]: set at post-build in variant post-build / pre-compile in variant pre-compile  # Function pointer to callback function (for non-wakeup notification)
        reference GptChannelClkSrcRef: set at post-build in variant post-build / pre-compile in variant pre-compile, destination=GptClockReferencePoint  # Reference to the GptClockReferencePoint from which the channel | clock is derived.
        container GptWakeupConfiguration [0..1]  # Function pointer to callback function (for non-wakeup notification).
          symbolic name reference GptWakeupSourceRef: set at post-build in variant post-build / pre-compile in variant pre-compile, destination=EcuMWakeupSource  # In case the wakeup-capability is true this value is transmitted to the Ecu State Manager. | Implementation Type: reference to EcuM_WakeupSourceType
    container GptConfigurationOfOptApiServices  # This container contains all configuration switches for configuring optional API services of the GPT driver.
      boolean GptDeinitApi: set at pre-compile  # Adds / removes the service Gpt_DeInit() from the code.
      boolean GptEnableDisableNotificationApi: set at pre-compile  # Adds / removes the services Gpt_EnableNotification() and Gpt_DisableNotification from the code.
      boolean GptTimeElapsedApi: set at pre-compile  # Adds / removes the service Gpt_GetTimeElapsed() from the code
      boolean GptTimeRemainingApi: set at pre-compile  # Adds / removes the service Gpt_GetTimeRemaining() from the code.
      boolean GptVersionInfoApi: set at pre-compile  # Adds / removes the service Gpt_GetVersionInfo() from the code.
      boolean GptWakeupFunctionalityApi: set at pre-compile  # Adds / removes the services Gpt_SetMode(), Gpt_EnableWakeup() Gpt_DisableWakeup() and Gpt_CheckWakeup() from the code.
    container GptDriverConfiguration  # This container contains the module-wide configuration (parameters) of the GPT Driver
      boolean GptDevErrorDetect: set at pre-compile  # Enables/Disables development error detection.
      boolean GptReportWakeupSource: set at pre-compile  # Enables/Disables wakeup source reporting.
      container GptClockReferencePoint [1..*]  # This container contains a parameter, which represents a reference to a container of the type McuClockReferencePoint (defined in module MCU). | A container is needed to support multiple clock references (hardware dependent).
        reference GptClockReference: set at pre-compile, destination=McuClockReferencePoint  # Reference to a container of the type McuClockReferencePoint, to select an input clock. | The configuration editor for the GPT module can support the integrator by only allowing a selection of those clock reference points that can be connected physically to the GPT hardware peripheral. The desired frequency (desired by GPT) has to be the same as the selected and provided frequency of the MCU configuration. This has to be checked automatically.
  module definition Icu [0..*]: variants post-build/pre-compile  # Configuration of the Icu (Input Capture Unit) module.
    container IcuConfigSet: multiple-configuration-container=true  # This container is the base for a multiple configuration set
      integer IcuMaxChannel: 0..65535, set at post-build in variant post-build / pre-compile in variant pre-compile  # This parameter contains the number of Channels configured. It will be gathered by tools during the configuration stage. | calculationFormula = Number of configured Icu Channels Implementation Type: Icu_ChannelType
      container IcuChannel [1..*]  # Configuration of an individual ICU channel.
        integer IcuChannelId: 0..65535, set at post-build in variant post-build / pre-compile in variant pre-compile, symbolic-name-value=true  # Channel Id of the ICU channel. This value will be assigned to the symbolic name derived of the IcuChannel container short name.
        enumeration IcuDefaultStartEdge: {ICU_BOTH_EDGES, ICU_FALLING_EDGE, ICU_RISING_EDGE}, set at post-build in variant post-build / pre-compile in variant pre-compile  # Configures the default-activation-edge which shall be used for this channel if there was no activation-edge configured by the call of service Icu_SetActivationCondition(). | In case the Measurement Mode is "IcuSignalMeasurement" and the properties "DutyCycle" or "Period" are set, the edge configured here is used as Default Period Start Edge. Implementation Type: Icu_ActivationType
        enumeration IcuMeasurementMode: {ICU_MODE_EDGE_COUNTER, ICU_MODE_SIGNAL_EDGE_DETECT, ICU_MODE_SIGNAL_MEASUREMENT, ICU_MODE_TIMESTAMP}, set at post-build in variant post-build / pre-compile in variant pre-compile  # Configures the measurement mode of this channel. | Implementation Type: Icu_MeasurementModeType
        boolean IcuWakeupCapability: set at post-build in variant post-build / pre-compile in variant pre-compile  # Information about the wakeup-capability of this channel. | true: Channel is wakeup capable. false: Channel is not wakeup capable.
        container IcuSignalEdgeDetection [0..1]  # This container contains the configuration (parameters) in case the measurement mode is "IcuSignalEdgeDetection"
          function name IcuSignalNotification [0..1]: set at post-build in variant post-build / pre-compile in variant pre-compile  # Notification function for signal notification.
        container IcuSignalMeasurement [0..1]  # This container contains the configuration (parameters) in case the measurement mode is "IcuSignalMeasurement"
          enumeration IcuSignalMeasurementProperty: {ICU_ACTIVE_TIME, ICU_DUTY_CYCLE, ICU_HIGH_TIME, ICU_LOW_TIME, ICU_PERIOD_TIME}, set at post-build in variant post-build / pre-compile in variant pre-compile  # Configures the property that could be measured in case the mode is "IcuSignalMeasurement". | This property can not be changed during runtime. Implementation Type: Icu_SignalMeasurementPropertyType
        container IcuTimestampMeasurement [0..1]  # This container contains the configuration (parameters) in case the measurement mode is "IcuTimestamp"
          enumeration IcuTimestampMeasurementProperty: {ICU_CIRCULAR_BUFFER, ICU_LINEAR_BUFFER}, set at post-build in variant post-build / pre-compile in variant pre-compile  # Configures the handling of the buffer in case the mode is "Timestamp" | Implementation Type: Icu_TimestampBufferType
          function name IcuTimestampNotification [0..1]: set at post-build in variant post-build / pre-compile in variant pre-compile  # Notification function if the number of requested timestamps | (Notification interval > 0) are acquired.
        container IcuWakeup [0..1]  # This container contains the configuration (parameters) needed to configure a wakeup capable channel
          symbolic name reference IcuChannelWakeupInfo [0..1]: set at post-build in variant post-build / pre-compile in variant pre-compile, destination=EcuMWakeupSource  # If the wakeup-capability is true the wakeup source referenced is transmitted to the ECU State Manager (EcuM) . | Implementation Type: reference to EcuM_WakeupSourceType
    container IcuGeneral  # Configuration of general ICU parameters.
      boolean IcuDevErrorDetect: set at pre-compile  # Switches the Development Error Detection and Notification | on or off. true: Enabled. false: Disabled.
      integer IcuIndex: 0..255, set at pre-compile  # Specifies the InstanceId of this module instance. If only one instance is present it shall have the Id 0.
      boolean IcuReportWakeupSource: set at pre-compile  # Switch for enabling Wakeup source reporting. | true: Report Wakeup source. false: Do not report Wakeup source.
    container IcuOptionalApis  # This container contains all configuration switches for configuring optional API services of the ICU driver.
      boolean IcuDeInitApi: set at pre-compile  # Adds / removes the service Icu_DeInit() from the code. | true: Icu_DeInit() can be used. false: Icu_DeInit() can not be used.
      boolean IcuDisableWakeupApi: set at pre-compile  # Adds / removes the service Icu_DisableWakeup() from the code. | true: Icu_DisableWakeup() can be used. false: Icu_DisableWakeup() can not be used.
      boolean IcuEdgeCountApi: set at pre-compile  # Adds / removes all services related to the edge counting functionality as listed below, from the code: Icu_ResetEdgeCount(), Icu_EnableEdgeCount(), Icu_DisableEdgeCount(), Icu_GetEdgeNumbers(). | true: The services listed above can be used. false: The services listed above can not be used.
      boolean IcuEdgeDetectApi: set at pre-compile  # Adds / removes the services related to the edge detection functionality, from the code: | Icu_EnableEdgeDetection() and Icu_DisableEdgeDetection(). true: These services can be used. false: These services can not be used.
      boolean IcuEnableWakeupApi: set at pre-compile  # Adds / removes the service Icu_EnableWakeup() from the code. | true: Icu_EnableWakeup() can be used. false: Icu_EnableWakeup() can not be used.
      boolean IcuGetDutyCycleValuesApi: set at pre-compile  # Adds / removes the service Icu_GetDutyCycleValues() from the code. | true: Icu_GetDutyCycleValues() can be used. false: Icu_GetDutyCycleValues() can not be used.
      boolean IcuGetInputStateApi: set at pre-compile  # Adds / removes the service Icu_GetInputState() from the code. | true: Icu_GetInputState() can be used. false: Icu_GetInputState() can not be used.
      boolean IcuGetTimeElapsedApi: set at pre-compile  # Adds / removes the service Icu_GetTimeElapsed() from the code. | true: Icu_GetTimeElapsed() can be used. false: Icu_GetTimeElapsed() can not be used.
      boolean IcuGetVersionInfoApi: set at pre-compile  # Adds / removes the service Icu_GetVersionInfo() from the code. | true: Icu_GetVersionInfo() can be used. false: Icu_GetVersionInfo() can not be used.
      boolean IcuSetModeApi: set at pre-compile  # Adds / removes the service Icu_SetMode() from the code. | true: Icu_SetMode() can be used. false: Icu_SetMode() can not be used.
      boolean IcuSignalMeasurementApi: set at pre-compile  # Adds / removes the services Icu_StartSignalMeasurement() and Icu_StopSignalMeasurement() from the code. | true: Icu_StartSignalMeasurement() and Icu_StopSignalMeasurement() can be used. false: Icu_StartSignalMeasurement() and Icu_StopSignalMeasurement() can not be used.
      boolean IcuTimestampApi: set at pre-compile  # Adds / removes all services related to the timestamping functionality as listed below from the code: Icu_StartTimestamp(), Icu_StopTimestamp(), Icu_GetTimestampIndex(). | true: The services listed above can be used. false: The services listed above can not be used.
      boolean IcuWakeupFunctionalityApi: set at pre-compile  # Adds / removes the service Icu_CheckWakeup() from the code. | true: Icu_CheckWakeup() can be used. false: Icu_CheckWakeup() cannot be used.
  module definition IpduM [0..1]: variants link-time/post-build/pre-compile  # Configuration of the IpduM (Ipdu Multiplexer) module.
    container IpduMConfig: multiple-configuration-container=true  # This container contains the sub containers of the IpduM module. The IpduMTxPathway subcontainer includes information about sent I-PDUs. The IpduMRxPathway includes information about received I-PDUs. | This container is a MultipleConfigurationContainer, i.e. this container and its sub-containers exist once per configuration set.
      container IpduMRxPathway [0..*]  # Contains the configuration parameters received I-PDUs by the IpduM module.
        container IpduMRxIndication  # Contains the configuration for incoming RxIndication calls.
          enumeration IpduMByteOrder: {BIG_ENDIAN, LITTLE_ENDIAN}, set at link in variant link-time / post-build in variant post-build / pre-compile in variant pre-compile  # This parameter defines the ByteOrder for all IpduMSegments (static and dynamic part) and for the selectorField within the MultiplexedPdu. | The absolute position of a segment in the MultiplexedIPdu is determined by the definition of the ByteOrder parameter: If BIG_ENDIAN is specified, the SegmentPosition indicates the bit position of the most significant bit in an IPDU. If LITTLE_ENDIAN is specified, the SegmentPosition indicates the bit position of the least significant bit in an IPDU.
          integer IpduMRxHandleId: 0..65535, set at link in variant link-time / post-build in variant post-build / pre-compile in variant pre-compile, symbolic-name-value=true  # This is the I-PDU ID of the incoming I-PDU. If an incoming RxIndication's I-PDU ID matches this value then it is unpacked according to the specification in this container.
          reference IpduMRxIndicationPduRef: set at link in variant link-time / post-build in variant post-build / pre-compile in variant pre-compile, destination=Pdu  # Reference to the received Pdu representation in the ECU Configuration Description exchange file.
          container IpduMRxDynamicPart [1..*]  # This container contains the configuration for the dynamic part of incoming RxIndication calls. When an incoming received I-PDU's selector field matches the IpduM_Selector_Value, the new outgoing I-PDU for the dynamic part is constructed as defined by the segments of this container and sent out with the I-PDU ID referenced by IpduMOutgoingDynamicPduRef.
            integer IpduMRxSelectorValue: 0..255, set at link in variant link-time / post-build in variant post-build / pre-compile in variant pre-compile  # This is the selector value that this container refers to.
            reference IpduMOutgoingDynamicPduRef: set at link in variant link-time / post-build in variant post-build / pre-compile in variant pre-compile, destination=Pdu  # When the new I-PDU is sent out it is sent with this I-PDU ID. Reference to the sent PDU representation in the ECU Configuration Description exchange file.
            container IpduMSegment [1..*]  # This contains the location and the length of a segment. A segment must fit inside the I-PDU. The segment in the source I-PDU that is located at the IpduMSegmentPosition is copied to the same position in the destination I-PDU.
              integer IpduMSegmentLength: 1..2032, set at link in variant link-time / post-build in variant post-build / pre-compile in variant pre-compile  # Length of the segment in bits.
              integer IpduMSegmentPosition: 0..2031, set at link in variant link-time / post-build in variant post-build / pre-compile in variant pre-compile  # Segments bit position in the multiplexed Pdu.
          container IpduMRxStaticPart [0..1]  # This container contains the configuration for the static part of incoming RxIndication calls. On reception, the new outgoing I-PDU for the static part is constructed as defined by the segments of this container and sent out with the I-PDU ID referenced by IpduMOutgoingStaticPduRef.
            reference IpduMOutgoingStaticPduRef: set at link in variant link-time / post-build in variant post-build / pre-compile in variant pre-compile, destination=Pdu  # When the new I-PDU is sent out it is sent with this I-PDU ID. Reference to the sent Pdu representation in the ECU Configuration Description exchange file.
            container IpduMSegment [1..*]  # This contains the location and the length of a segment. A segment must fit inside the I-PDU. The segment in the source I-PDU that is located at the IpduMSegmentPosition is copied to the same position in the destination I-PDU.
              integer IpduMSegmentLength: 1..2032, set at link in variant link-time / post-build in variant post-build / pre-compile in variant pre-compile  # Length of the segment in bits.
              integer IpduMSegmentPosition: 0..2031, set at link in variant link-time / post-build in variant post-build / pre-compile in variant pre-compile  # Segments bit position in the multiplexed Pdu.
          container IpduMSelectorFieldPosition  # This contains the location and the length of the selector field.
            integer IpduMSelectorFieldLength: 1..8, set at link in variant link-time / post-build in variant post-build / pre-compile in variant pre-compile  # Length of the selector field in bits.
            integer IpduMSelectorFieldPosition: 0..2031, set at link in variant link-time / post-build in variant post-build / pre-compile in variant pre-compile  # Selector field bit position in the multiplexed Pdu.
      container IpduMTxPathway [0..*]  # Contains the configuration parameters transmitted I-PDUs by the IpduM module.
        container IpduMTxRequest  # This is used to specify the configuration for Transmit requests. | There will one instance of this container for each I-PDU that can be requested for transmission (the outgoing I-PDUs) by the IpduM.
          enumeration IpduMByteOrder: {BIG_ENDIAN, LITTLE_ENDIAN}, set at link in variant link-time / post-build in variant post-build / pre-compile in variant pre-compile  # This parameter defines the ByteOrder for all IpduMSegments (static and dynamic part) and for the selectorField within the MultiplexedPdu. | The absolute position of a segment in the MultiplexedIPdu is determined by the definition of the ByteOrder parameter: If BIG_ENDIAN is specified, the SegmentPosition indicates the bit position of the most significant bit in an IPDU. If LITTLE_ENDIAN is specified, the SegmentPosition indicates the bit position of the least significant bit in an IPDU.
          integer IpduMIPduUnusedAreasDefault [0..1]: 0..255, set at link in variant link-time / post-build in variant post-build / pre-compile in variant pre-compile  # IpduM module fills not used areas of an I-PDU with this bit-pattern | If this attribute is omitted the IpduM module does not fill the I-PDU.
          integer IpduMTxConfirmationPduId [0..1]: 0..65535, set at link in variant link-time / post-build in variant post-build / pre-compile in variant pre-compile, symbolic-name-value=true  # The handle Id to be used by the PduR to confirm the transmission of this Pdu. | The existence of this parameter is essential for the PduR generation tool to actually find a symbolicNameValue for the OutgoingPdu.
          float IpduMTxConfirmationTimeout [0..1]: 0..3600, set at link in variant link-time / post-build in variant post-build / pre-compile in variant pre-compile  # This timeout (in seconds) defines the timeout period for monitoring the reception of the TxConfirmation. | It is not used when an I-PDU is requested using the trigger transmit API.
          enumeration IpduMTxTriggerMode: {DYNAMIC_PART_TRIGGER, NONE, STATIC_OR_DYNAMIC_PART_TRIGGER, STATIC_PART_TRIGGER}, set at link in variant link-time / post-build in variant post-build / pre-compile in variant pre-compile  # Selects whether to send the multiplexed I-PDU immediately or at some later date.
          reference IpduMInitialDynamicPart: set at link in variant link-time / post-build in variant post-build / pre-compile in variant pre-compile, destination=IpduMTxDynamicPart  # Reference to the dynamic part that shall be used to initialize this multiplexed TX-I-PDU.
          reference IpduMOutgoingPduRef: set at link in variant link-time / post-build in variant post-build / pre-compile in variant pre-compile, destination=Pdu  # Reference to the PDU defining the outgoing I-PDU. | When the outgoing I-PDU is sent this is the I-PDU ID to give it. It is the IpduM I-PDU ID of the assembled I-PDU.
          container IpduMSelectorFieldPosition  # This contains the location and the length of the selector field.
            integer IpduMSelectorFieldLength: 1..8, set at link in variant link-time / post-build in variant post-build / pre-compile in variant pre-compile  # Length of the selector field in bits.
            integer IpduMSelectorFieldPosition: 0..2031, set at link in variant link-time / post-build in variant post-build / pre-compile in variant pre-compile  # Selector field bit position in the multiplexed Pdu.
          container IpduMTxDynamicPart [1..*]  # Configuration parameters for an instance of a TxRequest call into the IpduM. When a Tx Request with the IpduMTxDynamicHandleId is received by the IpduM, all segments as defined by this container are copied from the incoming I-PDU into the outgoing I-PDU buffer and then the send mode honoured. This container is used by the dynamic part of a TxRequest configuration. Therefore, for each outgoing I-PDU there will be one instance of this container for the dynamic part.
            boolean IpduMJitUpdate [0..1]: set at link in variant link-time / post-build in variant post-build / pre-compile in variant pre-compile, default-value=false  # If configured to true fetch the data of this part Just-In-Time via the triggerTransmit API of the PduR.
            boolean IpduMTxDynamicConfirmation: set at link in variant link-time / post-build in variant post-build / pre-compile in variant pre-compile  # A transmit request can be confirmed by the lower layer. If this parameter is set to true a confirmation of the I-PDU in COM representing the dynamic part is generated.
            integer IpduMTxDynamicHandleId: 0..65535, set at link in variant link-time / post-build in variant post-build / pre-compile in variant pre-compile, symbolic-name-value=true  # This is an incoming handle id. When the handle of an incoming Tx Request matches this, the bits fields (see IpduMSegment) are copied and the IpduMTxTriggerMode is honored.
            reference IpduMTxDynamicPduRef: set at link in variant link-time / post-build in variant post-build / pre-compile in variant pre-compile, destination=Pdu  # Reference to the Pdu representation in the ECU Configuration Description exchange file to be transmitted.
            container IpduMSegment [1..*]  # This contains the location and the length of a segment. A segment must fit inside the I-PDU. The segment in the source I-PDU that is located at the IpduMSegmentPosition is copied to the same position in the destination I-PDU.
              integer IpduMSegmentLength: 1..2032, set at link in variant link-time / post-build in variant post-build / pre-compile in variant pre-compile  # Length of the segment in bits.
              integer IpduMSegmentPosition: 0..2031, set at link in variant link-time / post-build in variant post-build / pre-compile in variant pre-compile  # Segments bit position in the multiplexed Pdu.
          container IpduMTxStaticPart [0..1]  # Configuration parameters for an instance of a Tx_Request call into the IpduM. When a Tx Request with the IpduMTxStaticHandleId is received by the IpduM, all segments as defined by this container are copied from the incoming I-PDU into the outgoing I-PDU buffer and then the send mode honoured. This container is used for the static part of a TxRequest configuration. Therefore, for each outgoing I-PDU there will be one instance of this container for the static part if it exists.
            boolean IpduMJitUpdate [0..1]: set at link in variant link-time / post-build in variant post-build / pre-compile in variant pre-compile, default-value=false  # If configured to true fetch the data of this part Just-In-Time via the triggerTransmit API of the PduR.
            boolean IpduMTxStaticConfirmation: set at link in variant link-time / post-build in variant post-build / pre-compile in variant pre-compile  # A transmit request can be confirmed by the lower layer. If this parameter is set to true a confirmation of the I-PDU in COM representing the static part is generated.
            integer IpduMTxStaticHandleId: 0..65535, set at link in variant link-time / post-build in variant post-build / pre-compile in variant pre-compile, symbolic-name-value=true  # This is an incoming handle id. When the handle of an incoming Tx Request matches this, the segments are copied (IPduMSegment) and the IpduMTxTriggerMode is honored.
            reference IpduMTxStaticPduRef: set at link in variant link-time / post-build in variant post-build / pre-compile in variant pre-compile, destination=Pdu  # Reference to the Pdu representation in the ECU Configuration Description exchange file to be transmitted.
            container IpduMSegment [1..*]  # This contains the location and the length of a segment. A segment must fit inside the I-PDU. The segment in the source I-PDU that is located at the IpduMSegmentPosition is copied to the same position in the destination I-PDU.
              integer IpduMSegmentLength: 1..2032, set at link in variant link-time / post-build in variant post-build / pre-compile in variant pre-compile  # Length of the segment in bits.
              integer IpduMSegmentPosition: 0..2031, set at link in variant link-time / post-build in variant post-build / pre-compile in variant pre-compile  # Segments bit position in the multiplexed Pdu.
    container IpduMGeneral  # Contains the general configuration parameters of IpduM.
      float IpduMConfigurationTimeBase: 0..3600, set at pre-compile  # The cycle time with which IpduM_MainFunction should be invoked (in seconds).
      boolean IpduMDevErrorDetect: set at pre-compile  # Active/Deactivate the detection of development errors, for production code this parameter has to be False. | True: error detection activated False: error detection deactivated
      boolean IpduMStaticPartExists: set at pre-compile  # This is to allow optimizations in the case the IpduM will never be used with a static part. | Note that this is a pre-compile option. If this is set to False then it will not be possible to add static parts after compilation. True: A static part may exist. False: A static part will never exist.
      boolean IpduMVersionInfoApi: set at pre-compile  # Active/Deactivate the version information API. | true: version information activated false: version information deactivated
    container IpduMPublishedInformation  # Additional published parameters not covered by | CommonPublishedInformation container. Note that these parameters do not have any configuration class setting, since they are published information.
      boolean IpduMRxDirectComInvocation: set at published-information  # If set to TRUE the COM invocation optimization as defined in | IPDUM140 is implemented.
  module definition J1939Dcm [0..1]: variants link-time/post-build/pre-compile  # The SAE J1939 Dcm module
    container J1939DcmConfigSet: multiple-configuration-container=true  # This container contains the configuration parameters and sub containers of the J1939DCM module supporting multiple configuration sets. | This container is a MultipleConfigurationContainer, i.e. this container and its sub-containers exist once per configuration set.
      container J1939DcmChannel [1..*]  # Contains the J1939DcmChannel parameters.
        enumeration J1939DcmBusType: {J1939DCM_ISO9141, J1939DCM_J1587, J1939DCM_J1850, J1939DCM_J1922, J1939DCM_J1939_NETWORK_1, J1939DCM_J1939_NETWORK_2, J1939DCM_J1939_NETWORK_3, J1939DCM_OTHER}, set at pre-compile  # Identifies the communication port
        symbolic name reference J1939DcmComMChannelRef: set at link in variant link-time / post-build in variant post-build / pre-compile in variant pre-compile, destination=ComMChannel  # Reference to the ComMChannel.
      container J1939DcmNode [1..*]  # Contains the parameters for the support of a logical J1939 node (identified by an ECU address).
        reference J1939DcmNodeChannelRef [1..*]: set at link in variant link-time+post-build / pre-compile in variant pre-compile, destination=J1939DcmChannel  # References to all J1939DcmChannels this node has access to.
        symbolic name reference J1939DcmNmNodeRef [1..*]: set at link in variant link-time+post-build / pre-compile in variant pre-compile, destination=J1939NmNode  # Reference to the corresponding J1939Nm node.
        container J1939DcmDiagnosticMessageSupport [1..*]  # Contains parameters to configure the diagnostic message support
          enumeration J1939DcmDmxSupport: {J1939DCM_DM10_SUPPORT, J1939DCM_DM11_SUPPORT, J1939DCM_DM12_SUPPORT, J1939DCM_DM13_SUPPORT, J1939DCM_DM14_SUPPORT, J1939DCM_DM15_SUPPORT, J1939DCM_DM16_SUPPORT, J1939DCM_DM17_SUPPORT, J1939DCM_DM18_SUPPORT, J1939DCM_DM19_SUPPORT, J1939DCM_DM1_SUPPORT, J1939DCM_DM20_SUPPORT, J1939DCM_DM21_SUPPORT, J1939DCM_DM22_SUPPORT, J1939DCM_DM23_SUPPORT, J1939DCM_DM24_SUPPORT, J1939DCM_DM25_SUPPORT, J1939DCM_DM26_SUPPORT, J1939DCM_DM27_SUPPORT, J1939DCM_DM28_SUPPORT, J1939DCM_DM29_SUPPORT, J1939DCM_DM2_SUPPORT, J1939DCM_DM30_SUPPORT, J1939DCM_DM31_SUPPORT, J1939DCM_DM32_SUPPORT, J1939DCM_DM33_SUPPORT, J1939DCM_DM34_SUPPORT, J1939DCM_DM35_SUPPORT, J1939DCM_DM36_SUPPORT, J1939DCM_DM37_SUPPORT, J1939DCM_DM38_SUPPORT, J1939DCM_DM39_SUPPORT, J1939DCM_DM3_SUPPORT, J1939DCM_DM40_SUPPORT, J1939DCM_DM41_SUPPORT, J1939DCM_DM42_SUPPORT, J1939DCM_DM43_SUPPORT, J1939DCM_DM44_SUPPORT, J1939DCM_DM45_SUPPORT, J1939DCM_DM46_SUPPORT, J1939DCM_DM47_SUPPORT, J1939DCM_DM48_SUPPORT, J1939DCM_DM49_SUPPORT, J1939DCM_DM4_SUPPORT, J1939DCM_DM50_SUPPORT, J1939DCM_DM51_SUPPORT, J1939DCM_DM52_SUPPORT, J1939DCM_DM5_SUPPORT, J1939DCM_DM6_SUPPORT, J1939DCM_DM7_SUPPORT, J1939DCM_DM8_SUPPORT, J1939DCM_DM9_SUPPORT}, set at pre-compile  # This parameter is used to identify the actual DMx message.
          container J1939DcmRxPdu [0..1]  # Contains parameters to configure the J1939DcmRxPdu.
            integer J1939DcmRxPduId: 0..65535, set at link in variant link-time+post-build / pre-compile in variant pre-compile, symbolic-name-value=true  # The I-PDU identifier used for communication with PduR.
            reference J1939DcmRxPduRef: set at link in variant link-time / post-build in variant post-build / pre-compile in variant pre-compile, destination=Pdu  # Reference to the global Pdu element in the Ecuc module.
          container J1939DcmTxPdu [0..1]  # Contains parameters to configure the J1939DcmTxPdu.
            integer J1939DcmTxPduId: 0..65535, set at link in variant link-time+post-build / pre-compile in variant pre-compile, symbolic-name-value=true  # The I-PDU identifier used to identify the Tx message.
            reference J1939DcmTxPduRef: set at link in variant link-time / post-build in variant post-build / pre-compile in variant pre-compile, destination=Pdu  # Reference to the global Pdu element in the Ecuc module.
    container J1939DcmGeneral  # Contains the general configuration parameters of the module.
      integer J1939DcmCommonBufferSize: 1..65535, set at pre-compile  # Size of common buffer (in Bytes). The buffer size should be as large as the longest command or response message.
      integer J1939DcmDM1BufferSize [0..1]: 1..65535, set at pre-compile  # Size of DM1 buffer (in Bytes). The buffer size should be as large as the longest DM1 response message.
      boolean J1939DcmDevErrorDetect: set at pre-compile  # Pre-processor switch for enabling development error detection support.
      float J1939DcmMainFunctionPeriod: 0.001..0.255, set at link in variant link-time+post-build / pre-compile in variant pre-compile  # Call cycle in seconds of J1939Dcm_MainFunction.
      integer J1939DcmMaxDTCsPerMainFunction [0..1]: 1..255, set at pre-compile  # Maximum threshold of DTCs filtered in a single MainFunction cycle.
      integer J1939DcmMaxFreezeFramesPerMainFunction [0..1]: 1..255, set at pre-compile  # Maximum threshold of FreezeFrames filtered in a single MainFunction cycle.
      integer J1939DcmMaxRatiosPerMainFunction [0..1]: 1..255, set at pre-compile  # Maximum threshold of Ratios filtered in a single MainFunction cycle.
      boolean J1939DcmVersionInfoApi: set at pre-compile  # Pre-processor switch for enabling version info API support.
  module definition J1939Nm [0..1]: variants link-time/post-build/pre-compile  # The SAE J1939 Nm module
    container J1939NmConfigSet: multiple-configuration-container=true  # This container is a MultipleConfigurationContainer, i.e. this container and its sub-containers exist once per configuration set.
      container J1939NmChannel [1..*]: post-build-changeable=true  # Physical CAN channel handled by J1939Nm.
        symbolic name reference J1939NmComMNetworkHandleRef: set at link in variant link-time+post-build / pre-compile in variant pre-compile, destination=ComMChannel  # Reference to the channel defined by the ComMChannel providing access to the unique channel index ComMChannelId.
        container J1939NmRxPdu  # Contains the configuration of the I-PDU used to receive the AddressClaimed PG.
          integer J1939NmRxPduId: 0..65535, set at link in variant link-time+post-build / pre-compile in variant pre-compile, symbolic-name-value=true  # The I-PDU identifier used for RxIndication from CanIf.
          reference J1939NmRxPduRef: set at link in variant link-time+post-build / pre-compile in variant pre-compile, destination=Pdu  # Reference to the Pdu object representing the I-PDU.
        container J1939NmTxPdu  # Contains the configuration of the I-PDU used to transmit the AddressClaimed PG.
          integer J1939NmTxPduId: 0..65535, set at link in variant link-time+post-build / pre-compile in variant pre-compile, symbolic-name-value=true  # The I-PDU identifier used for TxConfirmation from CanIf.
          reference J1939NmTxPduRef: set at link in variant link-time+post-build / pre-compile in variant pre-compile, destination=Pdu  # Reference to the Pdu object representing the I-PDU.
      container J1939NmNode [1..*]: post-build-changeable=true  # Logical node representing one function handled by J1939Nm.
        integer J1939NmNodeId: 0..255, set at pre-compile, symbolic-name-value=true  # Unique identifier of this node. May be chosen to be identical with J1939NmNodePreferredAddress, if the same address shall not be used by different nodes on different channels.
        boolean J1939NmNodeNameArbitraryAddressCapable: set at pre-compile  # Arbitrary Address Capable field of the NAME of this node.
        integer J1939NmNodeNameECUInstance: 0..7, set at link in variant link-time / post-build in variant post-build / pre-compile in variant pre-compile  # ECU Instance field of the NAME of this node.
        integer J1939NmNodeNameFunction: 0..255, set at link in variant link-time / post-build in variant post-build / pre-compile in variant pre-compile  # Function field of the NAME of this node.
        integer J1939NmNodeNameFunctionInstance: 0..31, set at link in variant link-time / post-build in variant post-build / pre-compile in variant pre-compile  # Function Instance field of the NAME of this node.
        integer J1939NmNodeNameIdentityNumber: 0..2097151, set at link in variant link-time / post-build in variant post-build / pre-compile in variant pre-compile  # Identity Number field of the NAME of this node.
        integer J1939NmNodeNameIndustryGroup: 0..7, set at link in variant link-time / post-build in variant post-build / pre-compile in variant pre-compile  # Industry Group field of the NAME of this node.
        integer J1939NmNodeNameManufacturerCode: 0..2047, set at link in variant link-time / post-build in variant post-build / pre-compile in variant pre-compile  # Manufacturer Code field of the NAME of this node.
        integer J1939NmNodeNameVehicleSystem: 0..127, set at link in variant link-time / post-build in variant post-build / pre-compile in variant pre-compile  # Vehicle System field of the NAME of this node.
        integer J1939NmNodeNameVehicleSystemInstance: 0..15, set at link in variant link-time / post-build in variant post-build / pre-compile in variant pre-compile  # Vehicle System Instance field of the NAME of this node.
        integer J1939NmNodePreferredAddress: 0..253, set at link in variant link-time / post-build in variant post-build / pre-compile in variant pre-compile  # Source address of this node used for address claiming.
        boolean J1939NmNodeStartUpDelay: set at pre-compile  # If enabled, the communication will start after a delay of 250ms after transmission of the initial AddressClaimed. If disabled, communication will start immediately at start-up. | Please note: According to J1939/81, the 250ms delay is not required for single address CAs with desired source addresses in the ranges 0..127 or 248..253.
        reference J1939NmNodeChannelRef [1..*]: set at link in variant link-time+post-build / pre-compile in variant pre-compile, destination=J1939NmChannel  # Reference to the channels this node has access to.
    container J1939NmDemEventParameterRefs [0..1]  # Container for the references to DemEventParameter elements which shall be invoked using the API Dem_ReportErrorStatus in case the corresponding error occurs. The EventId is taken from the referenced DemEventParameter's DemEventId value. The standardized errors are provided in the container and can be extended by vendor specific error references.
      symbolic name reference J1939NM_E_ADDRESS_LOST: set at pre-compile, destination=DemEventParameter  # Reference to the DemEventParameter which shall be issued when the ECU failed to claim one of its addresses.
    container J1939NmGeneral  # Contains the general configuration parameters of the module.
      boolean J1939NmDevErrorDetect: set at pre-compile  # Pre-processor switch for enabling development error detection support.
      float J1939NmMainFunctionPeriod: 0.001..0.255, set at link in variant link-time+post-build / pre-compile in variant pre-compile  # Call cycle in seconds of J1939Nm_MainFunction.
      float J1939NmTxConfirmationTimeout: 0..65.535, set at link in variant link-time+post-build / pre-compile in variant pre-compile  # Time in seconds to wait for a confirmation after transmission of a message. The behaviour when the time elapses depends on the transmitted message.
      function name J1939NmUserCallout [0..1]: set at pre-compile  # Pre-processor switch for enabling the <User_AddressClaimedIndication> and defining the name of the callout function.
      string J1939NmUserCalloutHeaderFile [0..1]: set at pre-compile  # Header file which is included by J1939Nm when J1939NmUserCallout is enabled. This header file must provide the prototype of the <User_AddressClaimedIndication> defined in J1939NmUserCallout.
      boolean J1939NmVersionInfoApi: set at pre-compile  # Pre-processor switch for enabling version info API support.
  module definition J1939Rm [0..1]: variants link-time/post-build/pre-compile  # The SAE J1939 Nm module
    container J1939RmConfigSet: multiple-configuration-container=true  # This container is a MultipleConfigurationContainer, i.e. this container and its sub-containers exist once per configuration set.
      container J1939RmChannel [1..*]: post-build-changeable=true  # Contains the parameters for a CAN channel supported by the J1939 Request Manager.
        integer J1939RmAckQueueSize: 0..255, set at link in variant link-time+post-build / pre-compile in variant pre-compile  # Number of transmitted acknowledgements that can be stored.
        integer J1939RmRequestQueueSize: 0..255, set at link in variant link-time+post-build / pre-compile in variant pre-compile  # Number of transmitted requests that can be stored.
        integer J1939RmRequestTimeoutMonitors: 0..255, set at link in variant link-time+post-build / pre-compile in variant pre-compile  # Number of transmitted requests that can be monitored for timeout.
        symbolic name reference J1939RmComMNetworkHandleRef: set at link in variant link-time+post-build / pre-compile in variant pre-compile, destination=ComMChannel  # Reference to the channel defined by the ComMChannel providing access to the unique channel index ComMChannelId.
        container J1939RmAckmRxPdu [0..1]  # Contains the configuration of the I-PDU used to receive the Acknowledgement PG.
          integer J1939RmAckmRxPduId: 0..65535, set at link in variant link-time+post-build / pre-compile in variant pre-compile, symbolic-name-value=true  # The I-PDU identifier used for RxIndication from PduR.
          reference J1939RmAckmRxPduRef: set at link in variant link-time+post-build / pre-compile in variant pre-compile, destination=Pdu  # Reference to the Pdu object representing the I-PDU.
        container J1939RmAckmTxPdu [0..1]  # Contains the configuration of the I-PDU used to transmit the Acknowledgement PG.
          integer J1939RmAckmTxPduId: 0..65535, set at link in variant link-time+post-build / pre-compile in variant pre-compile, symbolic-name-value=true  # The I-PDU identifier used for TxConfirmation from PduR.
          reference J1939RmAckmTxPduRef: set at link in variant link-time+post-build / pre-compile in variant pre-compile, destination=Pdu  # Reference to the Pdu object representing the I-PDU.
        container J1939RmRqstRxPdu [0..1]  # Contains the configuration of the I-PDU used to receive the Request PG.
          integer J1939RmRqstRxPduId: 0..65535, set at link in variant link-time+post-build / pre-compile in variant pre-compile, symbolic-name-value=true  # The I-PDU identifier used for RxIndication from PduR.
          reference J1939RmRqstRxPduRef: set at link in variant link-time+post-build / pre-compile in variant pre-compile, destination=Pdu  # Reference to the Pdu object representing the I-PDU.
        container J1939RmRqstTxPdu [0..1]  # Contains the configuration of the I-PDU used to transmit the Request PG.
          integer J1939RmRqstTxPduId: 0..65535, set at link in variant link-time+post-build / pre-compile in variant pre-compile, symbolic-name-value=true  # The I-PDU identifier used for TxConfirmation from PduR.
          reference J1939RmRqstTxPduRef: set at link in variant link-time+post-build / pre-compile in variant pre-compile, destination=Pdu  # Reference to the Pdu object representing the I-PDU.
      container J1939RmNode [1..*]: post-build-changeable=true  # Contains the parameters for the support of a logical J1939 node (identified by an ECU address).
        reference J1939RmNodeChannelRef [1..*]: set at link in variant link-time+post-build / pre-compile in variant pre-compile, destination=J1939RmChannel  # Reference to the channels this node has access to.
        symbolic name reference J1939RmNmNodeRef: set at link in variant link-time+post-build / pre-compile in variant pre-compile, destination=J1939NmNode  # Reference to the corresponding J1939Nm node.
        container J1939RmUser [1..*]: post-build-changeable=true  # Contains the configuration of a module that uses the request and acknowledgement interfaces of J1939Rm.
          boolean J1939RmUserAckIndication: set at pre-compile  # Enable AckIndication for this module. In case of CDD, the name is <apiServicePrefix>_AckIndication. In case of RTE, the port is defined as J1939RmRPort<J1939RmUserId>, and the operation is called AckIndication. This parameter shall not be set for J1939RmUserType J1939RM_USER_J1939NM, J1939RM_USER_J1939DCM, or J1939RM_USER_COM.
          integer J1939RmUserAckPGN [0..*]: 0..262143, set at link in variant link-time / post-build in variant post-build / pre-compile in variant pre-compile  # PGN supported to be acknowledged to this module. The PGNs supported by different modules should usually be disjunctive. This parameter shall not be set for J1939RmUserType J1939RM_USER_J1939NM, J1939RM_USER_J1939DCM, and J1939RM_USER_COM.
          integer J1939RmUserComIPduRequestQueueSize [0..1]: 0..255, set at link in variant link-time+post-build / pre-compile in variant pre-compile  # Number of received requests that can be stored for COM I-PDUs of this user.
          integer J1939RmUserId [0..1]: 0..65535, set at pre-compile, symbolic-name-value=true  # Identifier used by a module using J1939Rm. This parameter is only required when the module uses transmission of requests.
          integer J1939RmUserPGN [0..*]: 0..262143, set at link in variant link-time / post-build in variant post-build / pre-compile in variant pre-compile  # PGN supported to be requested from this module. The PGNs supported by different modules should usually be disjunctive. This parameter is predefined to AC (0x0EE00) for J1939RmUserType J1939RM_USER_J1939NM and is derived from the J1939Dcm PDUs in the system description for J1939RmUserType J1939RM_USER_J1939DCM. It shall not be set for J1939RmUserType J1939RM_USER_COM.
          boolean J1939RmUserRequestIndication: set at pre-compile  # Enable RequestIndication for this module. In case of J1939Nm or J1939Dcm, the name is fixed. In case of CDD, the name is <apiServicePrefix>_RequestIndication. In case of RTE, the port is defined as J1939RmRPort<J1939RmUserId>, and the operation is called RequestIndication. This parameter shall not be set for J1939RmUserType J1939RM_USER_COM.
          boolean J1939RmUserSendAck: set at pre-compile  # Enable the SendAck API for this module. In case of RTE, the port is defined as J1939RmPPort<J1939RmUserId>, and the operation is called SendAck. This parameter shall not be set for J1939RmUserType J1939RM_USER_J1939NM or J1939RM_USER_COM.
          boolean J1939RmUserSendRequest: set at pre-compile  # Enable the SendRequest API for this module. In case of RTE, the port is defined as J1939RmPPort<J1939RmUserId>, and the operation is called SendRequest. This parameter shall not be set for J1939RmUserType J1939RM_USER_J1939NM, J1939RM_USER_J1939DCM, or J1939RM_USER_COM.
          boolean J1939RmUserTimeoutSupervision: set at pre-compile  # Enable RequestTimeoutIndication and CancelRequestTimeout for this module. RequestTimeoutIndication: In case of CDD, the name is <apiServicePrefix>_RequestTimeoutIndication. | In case of RTE, the port is defined as J1939RmRPort<J1939RmUserId>, and the operation is called RequestTimeoutIndication. CancelRequestTimeout: In case of RTE, the port is defined as J1939RmPPort<J1939RmUserId>, and the operation is called CancelRequestTimeout. This parameter shall not be set for J1939RmUserType J1939RM_USER_J1939NM, J1939RM_USER_J1939DCM, or J1939RM_USER_COM.
          enumeration J1939RmUserType: {J1939RM_CDD, J1939RM_RTE, J1939RM_USER_COM, J1939RM_USER_J1939DCM, J1939RM_USER_J1939NM}, set at pre-compile  # Type of module using J1939Rm.
          foreign reference J1939RmUserCddRef [0..1]: set at pre-compile, destination-type=ECUC-MODULE-CONFIGURATION-VALUES  # Reference to the CDD module description. This parameter is only required for J1939RmUserType J1939RM_USER_CDD.
          container J1939RmComIPdu [0..*]: post-build-changeable=true  # Contains the configuration of an I-PDU that is to be transmitted on request by COM. This configuration container is only relevant for J1939RmUserType J1939RM_USER_COM.
            integer J1939RmComIPduDA: 0..253, set at link in variant link-time / post-build in variant post-build / pre-compile in variant pre-compile  # Destination address of the COM I-PDU.
            integer J1939RmComIPduPGN: 0..262143, set at link in variant link-time / post-build in variant post-build / pre-compile in variant pre-compile  # PGN of the COM I-PDU.
            integer J1939RmComIPduSA: 0..253, set at link in variant link-time / post-build in variant post-build / pre-compile in variant pre-compile  # Source address of the COM I-PDU.
            container J1939RmLowerComIPdu  # Contains the configuration of the I-PDU that is sent from J1939Rm to CanIf or J1939Tp.
              integer J1939RmLowerComIPduId: 0..65535, set at link in variant link-time+post-build / pre-compile in variant pre-compile, symbolic-name-value=true  # The I-PDU identifier used for communication with PduR.
              reference J1939RmLowerComIPduRef: set at link in variant link-time+post-build / pre-compile in variant pre-compile, destination=Pdu  # Reference to the Pdu object representing the I-PDU.
            container J1939RmUpperComIPdu  # Contains the configuration of the I-PDU that is sent from COM to J1939Rm.
              integer J1939RmUpperComIPduId: 0..65535, set at link in variant link-time+post-build / pre-compile in variant pre-compile, symbolic-name-value=true  # The I-PDU identifier used for communication with PduR.
              reference J1939RmUpperComIPduRef: set at link in variant link-time+post-build / pre-compile in variant pre-compile, destination=Pdu  # Reference to the Pdu object representing the I-PDU.
    container J1939RmGeneral  # Contains the general configuration parameters of the module.
      boolean J1939RmDevErrorDetect: set at pre-compile  # Pre-processor switch for enabling development error detection support.
      float J1939RmMainFunctionPeriod: 0.001..0.255, set at link in variant link-time+post-build / pre-compile in variant pre-compile  # Execution cycle of J1939Rm_MainFunction in seconds.
      boolean J1939RmSupportAckIndication: set at pre-compile  # Pre-processor switch for enabling support of acknowledgement indications.
      boolean J1939RmSupportAckTransmission: set at pre-compile  # Pre-processor switch for enabling support of acknowledgement transmission.
      boolean J1939RmSupportRequestIndication: set at pre-compile  # Pre-processor switch for enabling support of request indications.
      boolean J1939RmSupportRequestTransmission: set at pre-compile  # Pre-processor switch for enabling support of request transmission.
      boolean J1939RmSupportTimeoutSupervision: set at pre-compile  # Pre-processor switch for enabling support of request timeout supervision.
      float J1939RmTxConfirmationTimeout: 0..65.535, set at link in variant link-time+post-build / pre-compile in variant pre-compile  # Time in seconds to wait for a confirmation after transmission of a message. The behaviour when the time elapses depends on the transmitted message.
      boolean J1939RmVersionInfoApi: set at pre-compile  # Pre-processor switch for enabling version info API support.
  module definition J1939Tp [0..1]: variants link-time/post-build/pre-compile  # Configuration of the J1939Tp (J1939 Transport Protocol) module.
    container J1939TpConfiguration: multiple-configuration-container=true  # This container contains the configuration parameters and sub containers of the J1939Tp module that define the communication paths. This container is a MultipleConfigurationContainer, i.e. this container and its sub-containers exist once per configuration set.
      container J1939TpDemEventParameterRefs [0..1]  # Container for the references to DemEventParameter elements which shall be passed to the API Dem_ReportErrorStatus. The EventId is taken from the referenced DemEventParameter's DemEventId value. | The standardized errors are provided in the container and can be extended by vendor specific error references.
        symbolic name reference J1939TP_E_COMMUNICATION [0..1]: set at post-build in variant link-time+post-build / pre-compile in variant pre-compile, destination=DemEventParameter  # Reference to the DemEventParameter which shall be issued after successful or unsuccessful communication.
      container J1939TpRxChannel [0..*]  # This container describes a reception channel of the J1939Tp module. One channel is used for all N-SDUs that share the same source address (SA) and the same destination address (BAM: DA = 0xFF, CMDT: DA != 0xFF).
        enumeration J1939TpRxProtocolType: {J1939TP_PROTOCOL_BAM, J1939TP_PROTOCOL_CMDT}, set at pre-compile  # Protocol type of the referencing connection, which is either BAM or CMDT. | Please note: The protocol type is determined at configuration time by the PDU format of the PGN of an N-SDU: If the first byte of the PGN is smaller than 0xF0, CMDT will be used, otherwise BAM.
        container J1939TpRxCmNPdu  # This N-PDU represents the TP.CM frame of a J1939 transport protocol session. TP.CM is used both by BAM and CMDT to initialize the connection. For CMDT, it is also used to abort the connection.
          integer J1939TpRxCmNPduId: 0..65535, set at post-build in variant link-time+post-build / pre-compile in variant pre-compile, symbolic-name-value=true  # The N-PDU identifier used for communication with CanIf.
          reference J1939TpRxCmNPduRef: set at post-build in variant link-time+post-build / pre-compile in variant pre-compile, destination=Pdu  # Reference to the Pdu object representing the N-PDU.
        container J1939TpRxDtNPdu  # This N-PDU represents the TP.DT frame of a J1939 transport protocol session. TP.DT is used both by BAM and CMDT to transfer the contents of an N-SDU.
          integer J1939TpRxDtNPduId: 0..65535, set at post-build in variant link-time+post-build / pre-compile in variant pre-compile, symbolic-name-value=true  # The N-PDU identifier used for communication with CanIf.
          reference J1939TpRxDtNPduRef: set at post-build in variant link-time+post-build / pre-compile in variant pre-compile, destination=Pdu  # Reference to the Pdu object representing the N-PDU.
        container J1939TpRxPg [1..*]
          boolean J1939TpRxPgDynLength: set at pre-compile  # This flag is set to TRUE when the N-SDU refers to a PGN with variable length. | Please note: When this attribute is TRUE, the sub container J1939TpRxDirectNPdu is required.
          integer J1939TpRxPgPGN: 0..262143, set at pre-compile  # Defines the PGN which is represented by the N-SDU.
          container J1939TpRxDirectNPdu [0..1]  # This N-PDU represents the short frame that is used for a dynamic length PGN when it has a length of less that 8 bytes. | Please note: This sub container is only necessary when J1939TpRxPgDynLength is TRUE.
            integer J1939TpRxDirectNPduId: 0..65535, set at post-build in variant link-time+post-build / pre-compile in variant pre-compile, symbolic-name-value=true  # The N-PDU identifier used for communication with CanIf.
            reference J1939TpRxDirectNPduRef: set at post-build in variant link-time+post-build / pre-compile in variant pre-compile, destination=Pdu  # Reference to the Pdu object representing the N-PDU.
          container J1939TpRxNSdu  # This container describes the parameters that are relevant for the reception of a specific N-SDU.
            reference J1939TpRxNSduRef: set at post-build in variant link-time+post-build / pre-compile in variant pre-compile, destination=Pdu  # Reference to the Pdu object representing the N-SDU.
        container J1939TpTxFcNPdu [0..1]  # This N-PDU represents the TP.CM frame that is used in reverse direction for a J1939 transport protocol session using the CMDT protocol type. TP.CM in reverse direction is used for intermediate and final acknowledgement of received data and to abort the connection. | Please note: This sub container is only required when J1939TpRxProtocolType is J1939TP_PROTOCOL_CMDT.
          integer J1939TpTxFcNPduTxConfId: 0..65535, set at post-build in variant link-time+post-build / pre-compile in variant pre-compile, symbolic-name-value=true  # The N-PDU identifier used for Tx confirmation from CanIf.
          reference J1939TpTxFcNPduRef: set at post-build in variant link-time+post-build / pre-compile in variant pre-compile, destination=Pdu  # Reference to the Pdu object representing the N-PDU. | Please note: When two channels have identical but exchanged source and destination addresses, the Pdu referenced by this parameter is shared with J1939TpTxCmNPduRef of the corresponding J1939TpTxChannel.
      container J1939TpTxChannel [0..*]  # This container describes a transmission channel of the J1939Tp module. One channel is used for all N-SDUs that share the same source address (SA) and the same destination address (BAM: DA = 0xFF, CMDT: DA != 0xFF).
        enumeration J1939TpTxProtocolType: {J1939TP_PROTOCOL_BAM, J1939TP_PROTOCOL_CMDT}, set at pre-compile  # Protocol type of the referencing connection, which is either BAM or CMDT. | Please note: The protocol type is determined at configuration time by the PDU format of the PGN of an N-SDU: If the first byte of the PGN is smaller than 0xF0, CMDT will be used, otherwise BAM.
        container J1939TpRxFcNPdu [0..1]  # This N-PDU represents the TP.CM frame that is used in reverse direction for a J1939 transport protocol session using the CMDT protocol type. TP.CM in reverse direction is used for intermediate and final acknowledgement of received data and to abort the connection. | Please note: This sub container is only required when J1939TpRxProtocolType is J1939TP_PROTOCOL_CMDT.
          integer J1939TpRxFcNPduId: 0..65535, set at post-build in variant link-time+post-build / pre-compile in variant pre-compile, symbolic-name-value=true  # The N-PDU identifier used for communication with CanIf.
          reference J1939TpRxFcNPduRef: set at post-build in variant link-time+post-build / pre-compile in variant pre-compile, destination=Pdu  # Reference to the Pdu object representing the N-PDU. | Please note: When two channels have identical but exchanged source and destination addresses, the Pdu referenced by this parameter is shared with J1939TpRxCmNPduRef of the corresponding J1939TpRxChannel.
        container J1939TpTxCmNPdu  # This N-PDU represents the TP.CM frame of a J1939 transport protocol session. TP.CM is used both by BAM and CMDT to initialize the connection. For CMDT, it is also used to abort the connection.
          integer J1939TpTxCmNPduTxConfId: 0..65535, set at post-build in variant link-time+post-build / pre-compile in variant pre-compile, symbolic-name-value=true  # The N-PDU identifier used for Tx confirmation from CanIf.
          reference J1939TpTxCmNPduRef: set at post-build in variant link-time+post-build / pre-compile in variant pre-compile, destination=Pdu  # Reference to the Pdu object representing the N-PDU.
        container J1939TpTxDtNPdu  # This N-PDU represents the TP.DT frame of a J1939 transport protocol session. TP.DT is used both by BAM and CMDT to transfer the contents of an N-SDU.
          integer J1939TpTxDtNPduTxConfId: 0..65535, set at post-build in variant link-time+post-build / pre-compile in variant pre-compile, symbolic-name-value=true  # The N-PDU identifier used for Tx confirmation from CanIf.
          reference J1939TpTxDtNPduRef: set at post-build in variant link-time+post-build / pre-compile in variant pre-compile, destination=Pdu  # Reference to the Pdu object representing the N-PDU.
        container J1939TpTxPg [1..*]
          boolean J1939TpTxPgDynLength: set at pre-compile  # This flag is set to TRUE when the N-SDU refers to a PGN with variable length. | Please note: When this attribute is TRUE, the sub container J1939TpTxDirectNPdu is required.
          integer J1939TpTxPgPGN: 0..262143, set at pre-compile  # Defines the PGN which is represented by the N-SDU.
          container J1939TpTxDirectNPdu [0..1]  # This N-PDU represents the short frame that is used for a dynamic length PGN when it has a length of less that 8 bytes. | Please note: This sub container is only necessary when J1939TpTxPgDynLength is TRUE.
            integer J1939TpTxDirectNPduTxConfId: 0..65535, set at post-build in variant link-time+post-build / pre-compile in variant pre-compile, symbolic-name-value=true  # The N-PDU identifier used for Tx confirmation from CanIf.
            reference J1939TpTxDirectNPduRef: set at post-build in variant link-time+post-build / pre-compile in variant pre-compile, destination=Pdu  # Reference to the Pdu object representing the N-PDU.
          container J1939TpTxNSdu  # This container describes the parameters that are relevant for the transmission of a specific N-SDU.
            integer J1939TpTxNSduId: 0..65535, set at post-build in variant link-time+post-build / pre-compile in variant pre-compile, symbolic-name-value=true  # The N-SDU identifier used for communication with PduR.
            reference J1939TpTxNSduRef: set at post-build in variant link-time+post-build / pre-compile in variant pre-compile, destination=Pdu  # Reference to the Pdu object representing the N-SDU.
    container J1939TpGeneral  # This container describes the general configuration parameters of the J1939Tp module.
      boolean J1939TpDevErrorDetect: set at pre-compile  # Switches the Development Error Detection and Notification.
      float J1939TpMainFunctionPeriod: 0..0.255, set at pre-compile  # Allow to configure the time for the MainFunction (in seconds). | Please note: This configuration value shall be equal to the value in the ScheduleManager module.
      integer J1939TpMaxPacketsPerBlock: 2..255, set at pre-compile  # Maximum number of N-PDUs the J1939Tp shall send before waiting for an authorization to continue transmission of the following TP.DT frames. This parameter is only relevant the transmission of messages via CMDT. For further details on this parameter value see SAE J1939/21.
      integer J1939TpPacketsPerBlock: 2..255, set at pre-compile  # Number of N-PDUs the J1939Tp module allows the sender to send before waiting for an authorization to continue transmission of the following TP.DT frames. This parameter is only relevant for reception of messages via CMDT. For further details on this parameter value see SAE J1939/21.
      float J1939TpTxConfTimeout: 0..65.535, set at pre-compile  # Timeout in seconds for the CanIf Tx confirmation. After this time the J1939Tp assumes that an N-PDU could not be transmitted. | Please note: The Tx confirmation timeout should be set to a value that enabled detection of a lost Tx confirmation in time, and that ensures that normal transmission delay caused by lower message priority does not lead to an error.
      boolean J1939TpVersionInfoApi: set at pre-compile  # The function J1939Tp_GetVersionInfo is configurable (On/Off) by this configuration parameter.
  module definition Lin [0..*]: variants post-build/pre-compile  # Configuration of the Lin (LIN driver) module.
    container LinGeneral  # This container contains the parameters related to each LIN Driver Unit.
      boolean LinDevErrorDetect: set at pre-compile  # Switches the Development Error Detection and Notification ON or OFF.
      integer LinIndex: 0..255, set at pre-compile  # Specifies the InstanceId of this module instance. If only one instance is present it shall have the Id 0.
      integer LinTimeoutDuration: 0..65535, set at pre-compile  # Specifies the maximum number of loops for blocking function until a timeout is raised in short term wait loops
      boolean LinVersionInfoApi: set at pre-compile  # Switches the Lin_GetVersionInfo function ON or OFF.
    container LinGlobalConfig: multiple-configuration-container=true  # This container contains the global configuration parameter of the Lin driver. This container is a MultipleConfigurationContainer, i.e. this container and its sub-containers exit once per configuration set.
      container LinChannel [1..*]  # This container contains the configuration (parameters) of the LIN Controller(s).
        integer LinChannelBaudRate: 1000..20000, set at post-build in variant post-build / pre-compile in variant pre-compile  # Specifies the baud rate of the LIN channel
        integer LinChannelId: 0..65535, set at pre-compile, symbolic-name-value=true  # Identifies the LIN channel. Replaces LIN_CHANNEL_INDEX_NAME from the LIN SWS.
        boolean LinChannelWakeupSupport: set at pre-compile  # Specifies if the LIN hardware channel supports wake up functionality
        reference LinClockRef: set at post-build in variant post-build / pre-compile in variant pre-compile, destination=McuClockReferencePoint  # Reference to the LIN clock source configuration, which is set in the MCU driver configuration.
        symbolic name reference LinChannelEcuMWakeupSource [0..1]: set at pre-compile, destination=EcuMWakeupSource  # This parameter contains a reference to the Wakeup Source for this controller as defined in the ECU State Manager.
      container LinDemEventParameterRefs [0..1]  # Container for the references to DemEventParameter elements which shall be invoked using the API Dem_ReportErrorStatus API in case the corresponding error occurs. The EventId is taken from the referenced DemEventParameter's DemEventId value. The standardized errors are provided in the container and can be extended by vendor specific error references.
        symbolic name reference LIN_E_TIMEOUT [0..1]: set at post-build in variant post-build / pre-compile in variant pre-compile, destination=DemEventParameter  # Reference to the DemEventParameter which shall be issued when the error "Timeout caused by hardware error" has occured. If the reference is not configured the error shall be reported as DET error.
  module definition LinIf [0..1]: variants link-time/post-build/pre-compile  # Configuration of the LinIf (LIN Interface) module.
    container LinIfGeneral
      boolean LinIfCancelTransmitSupported: set at pre-compile  # Global Pre-Compile Switch to reliably prevent the generation of the dummy LinIf_CancelTransmit API.
      boolean LinIfDevErrorDetect: set at pre-compile  # Switches the Development Error Detection and Notification ON or OFF.
      boolean LinIfMultipleDriversSupported: set at pre-compile  # States if multiple drivers are included in the LIN Interface or not. The reason for this parameter is to reduce the size of LIN Interface if multiple drivers are not used.
      boolean LinIfMultipleTrcvDriverSupported: set at pre-compile  # States if multiple transceiver drivers are included in the LIN Interface or not. The reason for this parameter is to reduce the size of LIN Interface if multiple transceiver drivers are not used.
      boolean LinIfNcOptionalRequestSupported: set at pre-compile  # States if the node configuration commands Assign NAD and Conditional Change NAD are supported.
      string LinIfPublicCddHeaderFile [0..*]: set at pre-compile, max-length=32, min-length=1  # Defines header files for callback functions which shall be included in case of CDDs. Range of characters is 1.. 32.
      boolean LinIfTpSupported: set at pre-compile  # States if the TP is included in the LIN Interface or not. The reason for this parameter is to reduce the size of LIN Interface if the TP is not used.
      boolean LinIfTrcvDriverSupported: set at pre-compile  # States if transceiver drivers are included in the LIN Interface or not. The reason for this parameter is to reduce the size of LIN Interface if transceiver drivers are not used.
      boolean LinIfVersionInfoApi: set at pre-compile  # Switches the LinIf_GetVersionInfo function ON or OFF.
    container LinIfGlobalConfig: multiple-configuration-container=true  # This container contains the global configuration parameter of the LinIf. | It is a MultipleConfigurationContainer, i.e. this container and its sub-containers exit once per configuration set.
      float LinIfTimeBase: 0..0.255, set at link in variant link-time / post-build in variant post-build / pre-compile in variant pre-compile  # The delay between processing two frames is a multiple of the LIN Interface time-base in seconds.
      container LinIfChannel [1..*]
        integer LinIfChannelId: 0..255, set at link in variant link-time+post-build / pre-compile in variant pre-compile, symbolic-name-value=true  # This parameter holds the unique channel index value. The value shall be the same as the ComMChannelId of the ComMChannel referenced by LinIfComMNetworkHandleRef. | Implementation Type: NetworkHandleType
        enumeration LinIfGotoSleepConfirmationUL: {CDD, LIN_SM}, set at link in variant link-time / post-build in variant post-build / pre-compile in variant pre-compile  # This parameter defines the upper layer (UL) module to which the confirmation of the goto-sleep command shall be sent.
        enumeration LinIfScheduleRequestConfirmationUL: {CDD, LIN_SM}, set at link in variant link-time / post-build in variant post-build / pre-compile in variant pre-compile  # This parameter defines the upper layer (UL) module to which the confirmation of the successfully performed schedule table change.
        enumeration LinIfStartupState: {NORMAL, SLEEP}, set at link in variant link-time+post-build / pre-compile in variant pre-compile  # Defines the state of each LIN channel after startup
        enumeration LinIfWakeupConfirmationUL: {CDD, LIN_SM}, set at link in variant link-time / post-build in variant post-build / pre-compile in variant pre-compile  # This parameter defines the upper layer (UL) module to which the confirmation of the wake-up shall be sent.
        symbolic name reference LinIfChannelRef: set at link in variant link-time+post-build / pre-compile in variant pre-compile, destination=LinChannel  # Reference to the used channel in Lin. | Replaces LINIF_CHANNEL_INDEX
        symbolic name reference LinIfComMNetworkHandleRef: set at link in variant link-time+post-build / pre-compile in variant pre-compile, destination=ComMChannel  # Unique handle to identify one certain LIN network. Reference to one of the network handles configured for the ComM.
        container LinIfFrame [0..*]  # Generic container for all types of LIN frames. The shortName of this container is used as LinIfFrameName.
          enumeration LinIfChecksumType: {CLASSIC, ENHANCED}, set at link in variant link-time / post-build in variant post-build / pre-compile in variant pre-compile  # Type of checksum that the frame is using.
          enumeration LinIfFrameType: {ASSIGN, ASSIGN_FRAME_ID_RANGE, ASSIGN_NAD, CONDITIONAL, EVENT_TRIGGERED, FREE, MRF, SAVE_CONFIGURATION, SPORADIC, SRF, UNASSIGN, UNCONDITIONAL}, set at link in variant link-time / post-build in variant post-build / pre-compile in variant pre-compile  # Type of frame that is described (e.g. sporadic frame). | The sporadic slot is not found among the frame types. A sporadic slot is a set of sporadic frames.
          integer LinIfLength: 1..8, set at link in variant link-time / post-build in variant post-build / pre-compile in variant pre-compile  # Length of the LIN SDU in bytes.
          integer LinIfPid: 0..255, set at link in variant link-time / post-build in variant post-build / pre-compile in variant pre-compile  # Protected ID of the LIN frame. There is no reason to calculate the Parity in run-time.
          container LinIfFixedFrameSdu [0..1]  # In case this is a fixed frame this is the SDU (response). | This container represent an eight byte array. The Byte order shall be MSB first.
            container LinIfFixedFrameSduByte [8..8]  # This container represents a byte within the 8 byte array.
              integer LinIfFixedFrameSduBytePos: 0..7, set at link in variant link-time / post-build in variant post-build / pre-compile in variant pre-compile  # Index of the Byte in the SDU (response) 8 byte array.
              integer LinIfFixedFrameSduByteVal: 0..255, set at link in variant link-time / post-build in variant post-build / pre-compile in variant pre-compile  # Byte value in the SDU (response) 8-byte array.
          choice container LinIfPduDirection  # Direction of the frame
            container LinIfInternalPdu [0..1]  # Represents a Diagnostic or Configuration frame : no Message ID (no PduId).
            container LinIfRxPdu [0..1]  # represents a received PDU/frame
              function name LinIfRxIndicationUL [0..1]: set at link in variant link-time / post-build in variant post-build / pre-compile in variant pre-compile  # This parameter defines the name of the <User_RxIndication>. This parameter depends on the parameter LinIfUserRxIndicationUL. | If LinIfUserRxIndicationUL equals PDUR, the name of the <User_RxIndication> is fixed. If LinIfUserRxIndicationUL equals CDD, the name of the <User_RxIndication> is selectable.
              enumeration LinIfUserRxIndicationUL: {CDD, PDUR}, set at link in variant link-time / post-build in variant post-build / pre-compile in variant pre-compile  # This parameter defines the upper layer (UL) module to which the indication of the successfully received LINRXPDUID has to be routed via <User_RxIndication>. | This <User_RxIndication> has to be invoked when the indication of the configured LINRXPDUID will be received by a Rx indication event from the LIN Driver module.
              reference LinIfRxPduRef: set at link in variant link-time / post-build in variant post-build / pre-compile in variant pre-compile, destination=Pdu  # Reference to the PDU that is received in this frame.
            container LinIfSlaveToSlavePdu [0..1]  # represents a slave-to-slave PDU/frame. Master does only send the header but doesn't receive the response. | Added for completeness
            container LinIfTxPdu [0..1]  # represents a transmitted PDU/frame
              function name LinIfTxConfirmationUL [0..1]: set at link in variant link-time / post-build in variant post-build / pre-compile in variant pre-compile  # This parameter defines the name of the <User_TxConfirmation>. This parameter depends on the parameter LinIfUserTxUL. | If LinIfUserTxUL equals PDUR, the name of the <User_TxConfirmation> is fixed. If LinIfUserTxUL equals CDD, the name of the <User_TxConfirmation> is selectable.
              integer LinIfTxPduId: 0..65535, set at link in variant link-time / post-build in variant post-build / pre-compile in variant pre-compile, symbolic-name-value=true  # Identifier of the Pdu for the upper layer.
              function name LinIfTxTriggerTransmitUL [0..1]: set at link in variant link-time / post-build in variant post-build / pre-compile in variant pre-compile  # This parameter defines the name of the <User_TriggerTransmit>. This parameter depends on the parameter LinIfUserTxUL. If LinIfUserTxUL equals PDUR, the name of the <User_TriggerTransmit> is fixed. | If LinIfUserTxUL equals CDD, the name of the <User_TriggerTransmit> is selectable.
              enumeration LinIfUserTxUL: {CDD, PDUR}, set at link in variant link-time / post-build in variant post-build / pre-compile in variant pre-compile  # This parameter defines the upper layer (UL) module to which the trigger of the transmitted LinTxPdu (via the <User_TriggerTransmit>) or the confirmation of the successfully transmitted LinTxPdu has to be routed (via the <User_TxConfirmation>).
              reference LinIfTxPduRef: set at link in variant link-time / post-build in variant post-build / pre-compile in variant pre-compile, destination=Pdu  # Reference to the PDU that is transmitted in this frame.
          container LinIfSubstitutionFrames [0..*]  # List of unconditional Frames that can be sent in a sporadic Frame slot.
            integer LinIfFramePriority: 0..255, set at link in variant link-time / post-build in variant post-build / pre-compile in variant pre-compile  # Priority of an unconditional frame if used as a sporadic frame.
            reference LinIfSubstitutionFrameRef: set at link in variant link-time / post-build in variant post-build / pre-compile in variant pre-compile, destination=LinIfFrame  # Reference to an unconditional Frame that can be sent in a sporadic Frame slot.
        container LinIfMaster  # Each Master can only be connected to one physical channel. This could be compared to the Node parameter in a LDF file.
          float LinIfClusterTimeBase: 0..0.255, set at link in variant link-time / post-build in variant post-build / pre-compile in variant pre-compile  # Defines a time-base for one LIN cluster in seconds (normally 0.002, 0.005 or 0.010s).
          float LinIfJitter: 0..0.255, set at pre-compile  # The jitter specifies the differences between the maximum and minimum delay from time base tick to the header sending start point in seconds.
        container LinIfScheduleTable [1..*]  # Describes a schedule table. Each LinIfChannel may have several schedule tables. Each schedule table can only be connected to one channel.
          enumeration LinIfResumePosition: {CONTINUE_AT_IT_POINT, START_FROM_BEGINNING}, set at link in variant link-time / post-build in variant post-build / pre-compile in variant pre-compile  # Defines, where a schedule table shall be proceeded in case if it has been interrupted by a RUN-ONCE table.
          enumeration LinIfRunMode: {RUN_CONTINUOUS, RUN_ONCE}, set at link in variant link-time / post-build in variant post-build / pre-compile in variant pre-compile  # The schedule table can be executed in two different modes.
          enumeration LinIfScheduleMode: {LINTP_APPLICATIVE_SCHEDULE, LINTP_DIAG_REQUEST, LINTP_DIAG_RESPONSE}, set at link in variant link-time / post-build in variant post-build / pre-compile in variant pre-compile  # The schedule table can be executed in three different modes.
          integer LinIfScheduleTableIndex: 0..255, set at link in variant link-time / post-build in variant post-build / pre-compile in variant pre-compile, symbolic-name-value=true  # This is the unique index used by upper layers to identify a schedule. Note that the NULL_SCHEDULE for each channel has index 0.
          string LinIfScheduleTableName [0..1]: set at link in variant link-time / post-build in variant post-build / pre-compile in variant pre-compile  # Optional schedule name used to cross-reference with a LDF. This parameter shall always be accompanied by LIN_IF_SCHEDULE_INDEX.
          container LinIfEntry [0..*]  # Describes an entry in the schedule table (also known as Frame Slot).
            float LinIfDelay: 0..0.255, set at link in variant link-time / post-build in variant post-build / pre-compile in variant pre-compile  # Delay to next entry in schedule table in seconds.
            integer LinIfEntryIndex: 0..255, set at link in variant link-time / post-build in variant post-build / pre-compile in variant pre-compile  # Position of the Frame Entry in the Schedule Table. The first entry index in the schedule table is 0.
            reference LinIfCollisionResolvingRef [0..1]: set at link in variant link-time / post-build in variant post-build / pre-compile in variant pre-compile, destination=LinIfScheduleTable  # Reference to the schedule table, which resolves the collision.
            reference LinIfFrameRef [1..*]: set at link in variant link-time / post-build in variant post-build / pre-compile in variant pre-compile, destination=LinIfFrame  # Reference to the frames that belong to this schedule table entry.
        container LinIfSlave [0..*]  # The Node attributes of the Slaves are provided with these parameter. The ShortName of this container is used as LinIfNodeName.
          integer LinIfConfiguredNad: 0..255, set at link in variant link-time+post-build / pre-compile in variant pre-compile  # Definition of the initial node address
          integer LinIfFunctionId: 0..255, set at link in variant link-time+post-build / pre-compile in variant pre-compile  # LIN function ID
          string LinIfProtocolVersion: set at link in variant link-time+post-build / pre-compile in variant pre-compile  # Defines the LIN Protocol version which is used by the slave.
          integer LinIfSupplierId: 0..65535, set at link in variant link-time+post-build / pre-compile in variant pre-compile  # LIN Supplier ID
          integer LinIfVariant: 0..255, set at link in variant link-time+post-build / pre-compile in variant pre-compile  # Specifies the Variant ID
        container LinIfTransceiverDrvConfig [0..1]  # This container contains the configuration (parameters) of all addressed LIN transceivers by each underlying LIN Transceiver Driver.
          boolean LinIfTrcvWakeupNotification: set at link in variant link-time+post-build / pre-compile in variant pre-compile, default-value=false  # Selects whether wakeup indication notification is supported. | True: Enabled False: Disabled
          symbolic name reference LinIfTrcvIdRef: set at link in variant link-time+post-build / pre-compile in variant pre-compile, destination=LinTrcvChannel  # Logical handle of the underlying LIN transceiver to be served by the LIN Interface.
  module definition LinNm [0..1]: variants link-time/pre-compile  # Configuration Parameters for the Lin Nm module.
    container LinNmGlobalConfig  # This container contains the global configuration parameter of the LinNm.
      boolean LinNmBusSynchronizationEnabled: set at pre-compile  # Pre-processor switch for enabling bus synchronization support of the LinNm. This feature is required for NM Coordinator nodes only.
      boolean LinNmComControlEnabled: set at pre-compile  # Pre-processor switch for enabling the Communication Control support.
      boolean LinNmComUserDataSupport: set at pre-compile  # Pre-processor switch for enabling the NM COM user data support
      boolean LinNmCoordinatorSyncSupport: set at pre-compile  # Enables/disables the coordinator synchronisation support.
      boolean LinNmDevErrorDetect: set at pre-compile  # Pre-processor switch for enabling development error detection support.
      boolean LinNmNodeDetectionEnabled: set at pre-compile  # Pre-processor switch for enabling the Node Detection feature.
      boolean LinNmNodeIdEnabled: set at pre-compile  # Pre-processor switch for enabling transmission of the source node identifier in NM messages.
      boolean LinNmPassiveModeEnabled: set at pre-compile  # Pre-processor switch for enabling support of the Passive Mode of the LinNm.
      boolean LinNmRemoteSleepIndicationEnabled: set at pre-compile  # Pre-processor switch for enabling Remote Sleep Indication support. This feature is required for NM Coordinator nodes only.
      boolean LinNmStateChangeIndEnabled: set at pre-compile  # Pre-processor switch for enabling the Network Management state change notification.
      boolean LinNmSynchronizationPointEnabled: set at pre-compile, default-value=false  # Pre-processor switch for enabling the Synchronize NM feature.
      boolean LinNmUserDataEnabled: set at pre-compile  # Pre-processor switch for enabling User Data support.
      boolean LinNmVersionInfoApi: set at pre-compile  # Pre-processor switch for enabling version info API support.
      container LinNmChannelConfig [1..*]  # This container contains the channel specific configuration parameter of the LinNm.
        symbolic name reference LinNmComMNetworkHandleRef: set at link in variant link-time / pre-compile in variant pre-compile, destination=ComMChannel  # This reference points to the unique channel defined by the ComMChannel and provides access to the unique channel index value in ComMChannelId.
  module definition LinSM [0..1]: variants link-time/post-build/pre-compile  # Configuration of the Lin State Manager module.
    container LinSMConfigSet: multiple-configuration-container=true  # This container describes one of multiple configuration sets of LinSm. | This is a MultipleConfigurationContainer, i.e. this container and its sub-containers exist once per configuration set.
      container LinSMChannel [1..*]  # Describes each LIN channel the LinSM is connected to.
        float LinSMConfirmationTimeout: 0..Inf, set at link in variant link-time+post-build / pre-compile in variant pre-compile  # Timeout in seconds for the goto sleep and wakeup calls to LinIf. The timeout must be longer than a goto-sleep command on the bus (i.e. it is bit rate dependent).
        boolean LinSMSleepSupport: set at link in variant link-time+post-build / pre-compile in variant pre-compile  # Some LIN clusters does not need sleep, they will just shut off. This parameter will affect the behavior to achieve the no communication state.
        boolean LinSMTransceiverPassiveMode [0..1]: set at link in variant link-time+post-build / pre-compile in variant pre-compile  # Selects STANDBY (true) or SLEEP (false) transceiver mode when entering LINSM_NO_COM.
        symbolic name reference LinSMComMNetworkHandleRef: set at link in variant link-time+post-build / pre-compile in variant pre-compile, destination=ComMChannel  # Unique handle to identify one certain LIN network. Reference to one of the network handles configured in the ComM.
        container LinSMSchedule [1..*]  # The schedule references to a schedule that is located in the LinIf configuration. Moreover, the PDU groups are located in the COM configuration. Note that there are two references to PDU groups. The simple reason is that a PDU group is only allowed to contain one direction (TX or RX).
          integer LinSMScheduleIndex: 0..255, set at link in variant link-time / post-build in variant post-build / pre-compile in variant pre-compile, symbolic-name-value=true  # This index parameter can be used by the BswM as a SymbolicNameReference target. The LinSM just forwards the request from the BswM to LinIf. Note that the value of the LinSMScheduleIndex shall be the same as the value from the LinIf.
          symbolic name reference LinSMScheduleIndexRef: set at link in variant link-time / post-build in variant post-build / pre-compile in variant pre-compile, destination=LinIfScheduleTable  # Reference to a schedule table in the LinIf configuration
    container LinSMGeneral  # This container contains general parameters of LIN State Manager module.
      boolean LinSMDevErrorDetect: set at pre-compile  # Switches the Development Error Detection and Notification ON or OFF.
      float LinSMMainProcessingPeriod: 0..Inf, set at pre-compile  # Fixed period that the MainFunction shall be called.
      boolean LinSMVersionInfoApi: set at pre-compile  # Switches the LinSM_GetVersionInfo function ON or OFF.
  module definition LinTp [0..1]: variants link-time/post-build/pre-compile  # Singleton descriptor for the LIN Transport Protocol.
    container LinTpGeneral  # Container that holds all LIN transport protocol general parameters.
      boolean LinTpVersionInfoApi: set at pre-compile  # Switches the LinTp_GetVersionInfo function ON or OFF.
    container LinTpGlobalConfig: multiple-configuration-container=true  # This container contains the global configuration parameter of the LinTp. | It is a MultipleConfigurationContainer, i.e. this container and its sub-containers exit once per configuration set.
      integer LinTpMaxNumberOfRespPendingFrames: 0..65535, set at link in variant link-time / post-build in variant post-build / pre-compile in variant pre-compile  # Configures the maximum number of allowed response pending frames.
      integer LinTpNumberOfRxNSdu: 0..65535, set at link in variant link-time / post-build in variant post-build / pre-compile in variant pre-compile  # Number of transport protocol messages that can be received for all channels this node is connected to.
      integer LinTpNumberOfTxNSdu: 0..65535, set at link in variant link-time / post-build in variant post-build / pre-compile in variant pre-compile  # Number of transport protocol messages that can be transmitted for all channels this node is connected to.
      float LinTpP2Max: 0..5, set at link in variant link-time / post-build in variant post-build / pre-compile in variant pre-compile  # P2 Timeout when a response pending frame is expected in seconds.
      float LinTpP2Timing: 0..5, set at link in variant link-time / post-build in variant post-build / pre-compile in variant pre-compile  # Definition of the P2 timeout observation parameter in seconds.
      container LinTpChannelConfig [0..*]  # This container contains the channel specific configuration parameter of LinTp.
        boolean LinTpDropNotRequestedNad: set at link in variant link-time / post-build in variant post-build / pre-compile in variant pre-compile, default-value=false  # Configures if TP Frames of not requested LIN-Slaves are dropped or not. | false: Do drop TP Frames of Not requested LIN-Slaves true: Drop not TP Frames of Not requested LIN-Slaves
        boolean LinTpScheduleChangeDiag: set at link in variant link-time / post-build in variant post-build / pre-compile in variant pre-compile, default-value=false  # Enables or disables the call of BswM_LinTp_RequestMode() to diagnostic request/response schedule. | false: BswM is not called true: BswM is called
      container LinTpRxNSdu [0..*]  # For each received N-SDU on any channel the node is connected to.
        integer LinTpDl: 1..4095, set at link in variant link-time / post-build in variant post-build / pre-compile in variant pre-compile  # Data Length Code of this RxNsdu. In case of variable length message, this value indicates the minimum data length. | Range of minimum length is 1 to 4095. Note that this is not relevant for Tx. The reason for this is to have identical structures for Tx and Rx.
        float LinTpNcr [0..1]: 0..1, set at post-build in variant post-build / pre-compile in variant pre-compile  # Value in seconds of the N_Cr timeout. N_Cr is the time until reception of the next Consecutive Frame N_PDU.
        integer LinTpRxNSduId: 0..65535, set at link in variant link-time / post-build in variant post-build / pre-compile in variant pre-compile, symbolic-name-value=true  # The identifier of the Transport Protocol message. This ID will be the one that is communicated with upper layers.
        integer LinTpRxNSduNad: 0..255, set at link in variant link-time / post-build in variant post-build / pre-compile in variant pre-compile  # A N-SDU transported on LIN is identified using the NAD for the specific slave.
        reference LinTpRxNSduPduRef: set at link in variant link-time / post-build in variant post-build / pre-compile in variant pre-compile, destination=Pdu  # Reference to the global PDU
        symbolic name reference LinTpRxNSduChannelRef: set at link in variant link-time / post-build in variant post-build / pre-compile in variant pre-compile, destination=LinIfChannel  # Index of the channel this N-SDU belongs to.
      container LinTpTxNSdu [0..*]  # For each transmitted N-SDU on any channel the node is connected to.
        float LinTpNas: 0..1, set at post-build in variant post-build / pre-compile in variant pre-compile  # Value in second of the N_As timeout. N_As is the time for transmission of a LIN frame (any N_PDU) on the part of the sender.
        float LinTpNcs [0..1]: 0..Inf, set at post-build in variant post-build / pre-compile in variant pre-compile  # Value in seconds of the performance requirement of N_Cs. N_Cs is the time which elapses between the transmit request of a CF N-PDU until the transmit request of the next CF N-PDU.
        integer LinTpTxNSduId: 0..65535, set at link in variant link-time / post-build in variant post-build / pre-compile in variant pre-compile, symbolic-name-value=true  # The identifier of the Transport Protocol message. This ID will be the one that is communicated with upper layers.
        integer LinTpTxNSduNad: 0..255, set at link in variant link-time / post-build in variant post-build / pre-compile in variant pre-compile  # A N-SDU transported on LIN is identified using the NAD for the specific slave.
        reference LinTpTxNSduPduRef: set at link in variant link-time / post-build in variant post-build / pre-compile in variant pre-compile, destination=Pdu  # Reference to the global PDU
        symbolic name reference LinTpTxNSduChannelRef: set at link in variant link-time / post-build in variant post-build / pre-compile in variant pre-compile, destination=LinIfChannel  # Index of the channel this N-SDU belongs to.
  module definition LinTrcv [0..*]: variants pre-compile  # Configuration of LIN Transceiver Driver module
    container LinTrcvChannel [1..*]  # Container gives LIN transceiver driver information about a single LIN transceiver channel. Any LIN transceiver driver has such LIN transceiver channels.
      integer LinTrcvChannelId: 0..255, set at pre-compile, symbolic-name-value=true  # Unique identifier of the LIN Transceiver Channel.
      boolean LinTrcvChannelUsed: set at pre-compile, default-value=true  # Shall the related LIN transceiver channel be used? | True: Is used False Is not used
      enumeration LinTrcvInitState: {LINTRCV_TRCV_MODE_NORMAL, LINTRCV_TRCV_MODE_SLEEP, LINTRCV_TRCV_MODE_STANDBY}, set at pre-compile  # State of LIN transceiver after call to LinTrcv_Init.
      boolean LinTrcvWakeupByBusUsed: set at pre-compile, default-value=false  # Is wake up by bus supported? If LIN transceiver hardware does not support wake up by bus value is always FALSE. If LIN transceiver hardware supports wake up by bus value is TRUE or FALSE depending whether it is used or not. | TRUE = Is used. FALSE = Is not used.
      symbolic name reference LinTrcvIcuChannelRef [0..1]: set at pre-compile, destination=IcuChannel  # Reference to the IcuChannel to enable/disable the interrupts for wakeups.
      symbolic name reference LinTrcvWakeupSourceRef [0..1]: set at pre-compile, destination=EcuMWakeupSource  # Reference to a wakeup source in the EcuM configuration. This reference is only needed if LinTrcvWakeupByBusUsed is true. Implementation Type: reference to EcuM_WakeupSourceType.
      choice container LinTrcvAccess  # Container gives LIN transceiver driver access about a single LIN transceiver channel.
        container LinTrcvDioAccess [0..1]  # Container gives LIN transceiver driver information about accessing ports and port pins. In addition relation between LIN transceiver hardware pin names and Dio port access information is given. If a LIN transceiver hardware has no Dio interface, there is no instance of this container.
          string LinTrcvHardwareInterfaceName: set at pre-compile  # LIN transceiver hardware interface name. It is typically the name of a pin. From a Dio point of view it is either a port, a single channel or a channel group. Depending on this fact either LINTRCV_DIO_PORT_SYMBOLIC_NAME or LINTRCV_DIO_CHANNEL_SYMBOLIC_NAME or LINTRCV_DIO_CHANNEL_GROUP_SYMBOLIC_NAME shall reference a Dio configuration. The LIN transceiver driver implementation description shall list up this name for the appropriate LIN transceiver hardware.
          choice reference LinTrcvDioSymRefName: set at pre-compile, destination=[DioChannel, DioChannelGroup, DioPort]  # Choice Reference to a DIO Port, DIO Channel or DIO Channel Group. This reference replaces the LINTRCV_DIO_PORT_SYM_NAME, LINTRCV_DIO_CHANNEL_SYM_NAME and LINTRCV_DIO_GROUP_SYM_NAME references in the Lin Trcv SWS.
        container LinTrcvSpiSequence [0..1]  # Container gives LIN transceiver driver information about one SPI sequence. | One SPI sequence used by LIN transceiver driver is in exclusive use for it. No other driver is allowed to access this sequence. LIN transceiver driver may use one sequence to access n LIN transceiver hardwares chips of the same type or n sequences are used to access one single LIN transceiver hardware chip. If a LIN transceiver hardware has no SPI interface, there is no instance of this container.
          symbolic name reference LinTrcvSpiSequenceName: set at pre-compile, destination=SpiSequence  # Reference to a Spi sequence configuration container.
    container LinTrcvGeneral  # Container gives LIN transceiver driver basic information.
      boolean LinTrcvDevErrorDetect: set at pre-compile  # Switches development error detection and notification on and off. If switched on, #define LINTRCV_DEV_ERROR_DETECT ON shall be generated. If switched off, #define LINTRCV_DEV_ERROR_DETECT OFF shall be generated. Define shall be part of file LinTrcv_Cfg.h. | True: Is used False: Is not used
      boolean LinTrcvGetVersionInfo: set at pre-compile, default-value=false  # Switches version information API on and off. If switched off, function need not be present in compiled code. | True: Is used False: Is not used
      integer LinTrcvIndex: 0..255, set at pre-compile  # Specifies the InstanceId of this module instance. If only one instance is present it shall have the Id 0.
      integer LinTrcvWaitCount: 0..4294967295, set at pre-compile, default-value=0  # Wait count for transceiver state changes.
      boolean LinTrcvWakeUpSupport: set at pre-compile  # Informs whether wake up is supported or not. In case wake up is not supported by LIN transceiver hardware the setting shall be false. The wake up ability may be switched on or off for each channel of one LIN transceiver by LinTrcvWakeupSourceRef. | True: Is used False: Is not used
  module definition Mcu [0..1]: variants post-build/pre-compile  # Configuration of the Mcu (Microcontroler Unit) module.
    container McuGeneralConfiguration  # This container contains the configuration (parameters) of the MCU driver.
      boolean McuDevErrorDetect: set at pre-compile  # Pre-processor switch for enabling the development error detection and reporting.
      boolean McuGetRamStateApi: set at pre-compile  # Pre-processor switch to enable/disable the API Mcu_GetRamState. | (e.g. If the H/W does not support the functionality, this parameter can be used to disable the Api).
      boolean McuInitClock: set at pre-compile, default-value=true  # If this parameter is set to FALSE, the clock initialization has to be disabled from the MCU driver. This concept applies when there are some write once clock registers and a bootloader is present. If this parameter is set to TRUE, the MCU driver is responsible of the clock initialization.
      boolean McuNoPll: set at pre-compile, default-value=true  # This parameter shall be set True, if the H/W does not have a PLL or the PLL circuitry is enabled after the power on without S/W intervention. In this case MCU_DistributePllClock has to be disabled and MCU_GetPllStatus has to return MCU_PLL_STATUS_UNDEFINED. Otherwise this parameters has to be set False
      boolean McuPerformResetApi: set at pre-compile  # Pre-processor switch to enable / disable the use of the function Mcu_PerformReset()
      boolean McuVersionInfoApi: set at pre-compile  # Pre-processor switch to enable / disable the API to read out the modules version information.
    container McuModuleConfiguration: multiple-configuration-container=true  # This container contains the configuration (parameters) of the MCU driver
      enumeration McuClockSrcFailureNotification: {DISABLED, ENABLED}, set at post-build in variant post-build / pre-compile in variant pre-compile  # Enables/Disables clock failure notification. In case this feature is not supported by HW the setting should be disabled.
      integer McuNumberOfMcuModes: 1..255, set at post-build in variant post-build / pre-compile in variant pre-compile  # This parameter shall represent the number of Modes available for the MCU. | calculationFormula = Number of configured McuModeSettingConf
      integer McuRamSectors: 1..4294967295, set at post-build in variant post-build / pre-compile in variant pre-compile  # This parameter shall represent the number of RAM sectors available for the MCU. | calculationFormula = Number of configured McuRamSectorSettingConf
      integer McuResetSetting [0..1]: 1..255, set at pre-compile  # This parameter relates to the MCU specific reset configuration. This applies to the function Mcu_PerformReset, which performs a microcontroller reset using the hardware feature of the microcontroller.
      container McuClockSettingConfig [1..*]  # This container contains the configuration (parameters) for the Clock settings of the MCU. Please see MCU031 for more information on the MCU clock settings.
        integer McuClockSettingId: 1..255, set at post-build in variant post-build / pre-compile in variant pre-compile, symbolic-name-value=true  # The Id of this McuClockSettingConfig to be used as argument for the API call "Mcu_InitClock".
        container McuClockReferencePoint [1..*]  # This container defines a reference point in the Mcu Clock tree. It defines the frequency which then can be used by other modules as an input value. Lower multiplictiy is 1, as even in the simpliest case (only one frequency is used), there is one frequency to be defined.
          float McuClockReferencePointFrequency: 0..Inf, set at post-build in variant post-build / pre-compile in variant pre-compile  # This is the frequency for the specific instance of the McuClockReferencePoint container. It shall be given in Hz.
      container McuDemEventParameterRefs [0..1]  # Container for the references to DemEventParameter elements which shall be invoked using the API Dem_ReportErrorStatus API in case the corresponding error occurs. The EventId is taken from the referenced DemEventParameter's DemEventId value. The standardized errors are provided in the container and can be extended by vendor specific error references.
        symbolic name reference MCU_E_CLOCK_FAILURE [0..1]: set at pre-compile, destination=DemEventParameter  # Reference to configured DEM event to report "Clock source failure".
      container McuModeSettingConf [1..*]  # This container contains the configuration (parameters) for the Mode setting of the MCU. Please see MCU035 for more information on the MCU mode settings.
        integer McuMode: 1..255, set at post-build in variant post-build / pre-compile in variant pre-compile, symbolic-name-value=true  # The parameter represents the MCU Mode settings.
      container McuRamSectorSettingConf [0..*]  # This container contains the configuration (parameters) for the RAM Sector setting. Please see MCU030 for more information on RAM sec-tor settings.
        integer McuRamDefaultValue: 0..255, set at post-build in variant post-build / pre-compile in variant pre-compile  # This parameter shall represent the Data pre-setting to be initialized
        integer McuRamSectionBaseAddress: 0..4294967295, set at post-build in variant post-build / pre-compile in variant pre-compile  # This parameter shall represent the MCU RAM section base address
        integer McuRamSectionSize: 0..4294967295, set at post-build in variant post-build / pre-compile in variant pre-compile  # This parameter represents the MCU RAM Section size in bytes.
    container McuPublishedInformation  # Container holding all MCU specific published information parameters
      container McuResetReasonConf [1..*]  # This container contains the configuration for the different type of reset reason that can be retrieved from Mcu_GetResetReason Api.
        integer McuResetReason: 0..255, set at published-information, symbolic-name-value=true  # The parameter represents the different type of reset that a Micro supports. This parameter is referenced by the parameter EcuMResetReason in the ECU State manager module.
  module definition MemIf [0..1]: variants pre-compile  # Configuration of the MemIf (Memory Abstraction Interface) module.
    container MemIfGeneral  # Configuration of the memory abstraction interface (Memif) module.
      boolean MemIfDevErrorDetect: set at pre-compile  # Pre-processor switch to enable and disable development error detection. | true: Development error detection enabled. false: Development error detection disabled.
      integer MemIfNumberOfDevices: 1..255, set at pre-compile  # Concrete number of underlying memory abstraction modules. | Calculation Formula: Count number of configured EA and FEE modules.
      boolean MemIfVersionInfoApi: set at pre-compile  # Pre-processor switch to enable / disable the API to read out the modules version information. | true: Version info API enabled. false: Version info API disabled.
  module definition MemMap [0..1]: variants pre-compile  # Configuration of the MemMap module.
    container MemMapAddressingModeSet [0..*]  # Defines a set of addressing modes which might apply to a SwAddrMethod.
      string MemMapSupportedAddressingMethodOption [0..*]: set at pre-compile, regular-expression=[a-zA-Z]([a-zA-Z0-9]|_[a-zA-Z0-9])*_?  # This constrains the usage of this addressing mode set for Generic Mappings to swAddrMethods. | The attribute option of a swAddrMethod mapped via MemMapGenericMapping to this MemMapAddressingModeSet shall be equal to one of the configured MemMapSupportedAddressMethodOption's
      enumeration MemMapSupportedMemoryAllocationKeywordPolicy [0..*]: {MEMMAP_ALLOCATION_KEYWORD_POLICY_ADDR_METHOD_SHORT_NAME, MEMMAP_ALLOCATION_KEYWORD_POLICY_ADDR_METHOD_SHORT_NAME_AND_ALIGNMENT}, set at pre-compile  # This constrains the usage of this addressing mode set for Generic Mappings to swAddrMethods. | The attribute MemoryAllocationKeywordPolicy of a swAddrMethod mapped via MemMapGenericMapping to this MemMapAddressingModeSet shall be equal to one of the configured MemMapSupportedMemoryAllocationKeywordPolicy's
      string MemMapSupportedSectionInitializationPolicy [0..*]: set at pre-compile  # This constrains the usage of this addressing mode set for Generic Mappings to swAddrMethods. | The sectionIntializationPolicy attribute value of a swAddrMethod mapped via MemMapGenericMapping to this MemMapAddressingModeSet shall be equal to one of the configured MemMapSupportedSectionIntializationPolicy's Please note that SectionInitializationPolicyType describes the intended initialization of MemorySections. The following values are standardized in AUTOSAR Methodology: * '''NO-INIT''': No initialization and no clearing is performed. Such data elements must not be read before one has written a value into it. * '''INIT''': To be used for data that are initialized by every reset to the specified value (initValue). * '''POWER-ON-INIT''': To be used for data that are initialized by "Power On" to the specified value (initValue). Note: there might be several resets between power on resets. * '''CLEARED''': To be used for data that are initialized by every reset to zero. * '''POWER-ON-CLEARED''': To be used for data that are initialized by "Power On" to zero. Note: there might be several resets between power on resets. Please note that the values are defined similar to the representation of enumeration types in the XML schema to ensure backward compatibility.
      enumeration MemMapSupportedSectionType [0..*]: {MEMMAP_SECTION_TYPE_CALIBRATION_OFFLINE, MEMMAP_SECTION_TYPE_CALIBRATION_ONLINE, MEMMAP_SECTION_TYPE_CAL_PRM, MEMMAP_SECTION_TYPE_CODE, MEMMAP_SECTION_TYPE_CONFIG_DATA, MEMMAP_SECTION_TYPE_CONST, MEMMAP_SECTION_TYPE_EXCLUDE_FROM_FLASH, MEMMAP_SECTION_TYPE_USER_DEFINED, MEMMAP_SECTION_TYPE_VAR, MEMMAP_SECTION_TYPE_VAR_FAST, MEMMAP_SECTION_TYPE_VAR_NO_INIT, MEMMAP_SECTION_TYPE_VAR_POWER_ON_INIT}, set at pre-compile  # This constrains the usage of this addressing mode set for Generic Mappings to swAddrMethods. | The attribute sectionType of a swAddrMethod mapped via MemMapGenericMapping or MemMapSectionSpecificMapping to this MemMapAddressingModeSet shall be equal to one of the configured MemMapSupportedSectionType's.
      container MemMapAddressingMode [1..*]  # Defines a addressing mode with a set of #pragma statements implementing the start and the stop of a section.
        multiline string MemMapAddressingModeStart: set at pre-compile  # Defines a set of #pragma statements implementing the start of a section.
        multiline string MemMapAddressingModeStop: set at pre-compile  # Defines a set of #pragma statements implementing the start of a section.
        string MemMapAlignmentSelector [1..*]: set at pre-compile, regular-expression=[1-9][0-9]*|0x[0-9a-f]*|0[0-7]*|0b[0-1]*|UNSPECIFIED|UNKNOWN|BOOLEAN|  # Defines a the alignments for which the MemMapAddressingMode applies. | The to be used alignment is defined in the alignment attribute of the MemorySection. If the MemMapAlignmentSelector fits to alignment attribute of the MemorySection the set of #pragmas of the related MemMapAddressingMode shall be used to implement the start and the stop of a section. Please note that the same MemMapAddressingMode can be applicable for several alignments, e.g. "8" bit and "UNSPECIFIED".
    container MemMapAllocation [0..*]  # Defines a set of addressing modes which might apply to a SwAddrMethod.
      container MemMapGenericMapping [0..*]  # Defines which SwAddrMethod is implemented with which MemMapAddressingModeSet. | The pragmas for the implementation of the MemorySelectorKeywords are taken from the MemMapAddressingModeStart and MemMapAddressingModeStop parameters of the MemMapAddressingModeSet for the individual alignments. That this mapping becomes valid requires matching MemMapSupportedSectionType's, MemMapSupportedSectionInitializationPolicy's and MemMapSupportedAddressingMethodOption's. The MemMapGenericMapping applies only if it is not overruled by an MemMapSectionSpecificMapping
        foreign reference MemMapSwAddressMethodRef: set at pre-compile, destination-type=SW-ADDR-METHOD  # Reference to the SwAddrMethod which applies to the MemMapGenericMapping.
        reference MemMapAddressingModeSetRef: set at pre-compile, destination=MemMapAddressingModeSet  # Reference to the MemMapAddressingModeSet which applies to the MemMapGenericMapping.
      container MemMapSectionSpecificMapping [0..*]  # Defines which MemorySection of a BSW Module or a Software Component is implemented with which MemMapAddressingModeSet. | The pragmas for the implementation of the MemorySelectorKeywords are taken from the MemMapAddressingModeStart and MemMapAddressingModeStop parameters of the MemMapAddressingModeSet for the specific alignment of the MemorySection. The MemMapSectionSpecificMapping precedes a mapping defined by MemMapGenericMapping.
        foreign reference MemMapMemorySectionRef: set at pre-compile, destination-type=MEMORY-SECTION  # Reference to the MemorySection which applies to the MemMapSectionSpecificMapping.
        reference MemMapAddressingModeSetRef: set at pre-compile, destination=MemMapAddressingModeSet  # Reference to the MemMapAddressingModeSet which applies to the MemMapModuleSectionSpecificMapping.
  module definition Nm [0..1]: variants link-time/pre-compile  # The Generic Network Management Interface module
    container NmChannelConfig [1..*]  # This container contains the configuration (parameters) of the bus channel(s). The channel parameter shall be harmonized within the whole communication stack.
      boolean NmActiveCoordinator [0..1]: set at pre-compile  # This parameter indicates whether a NM Coordinator is an active gateway (NmActiveCoordinator = TRUE) or a passive.
      integer NmChannelId: 0..255, set at link in variant link-time / pre-compile in variant pre-compile, symbolic-name-value=true  # This parameter holds the unique channel index value. The value shall be the same as the ComMChannelId of the ComMChannel referenced by NmComMChannelRef. | Implementation Type: NetworkHandleType
      boolean NmChannelSleepMaster: set at link in variant link-time / pre-compile in variant pre-compile  # This parameter shall be set to indicate if the sleep of this network can be absolutely decided by the local node only and that no other nodes can oppose that decision. | If this parameter is set to TRUE, the Nm shall assume that the channel is always ready to go to sleep and that no callouts to Nm_RemoteSleepIndication or Nm_RemoteSleepCancellation will be made from the <BusNm> representing this channel. If this parameter is set to FALSE, the Nm shall not assume that the network is ready to sleep until a callout has been made to Nm_RemoteSleepCancellation.
      integer NmCoordClusterIndex [0..1]: 0..255, set at link in variant link-time / pre-compile in variant pre-compile  # If this parameter is undefined for a channel, the corresponding bus does not belong to an NM coordination cluster.
      boolean NmPassiveModeEnabled: set at pre-compile  # Pre-processor switch for enabling support of Passive Mode of the <BusNm>s.
      float NmShutdownDelayTimer: 0..Inf, set at link in variant link-time / pre-compile in variant pre-compile  # This parameter defines the time in seconds which the NM Coordination algorithm shall delay the release of this channel with.
      boolean NmStateReportEnabled: set at pre-compile  # Specifies if the NMS shall be set for the corresponding network. | false: No NMS shall be set true: The NMS shall be set
      boolean NmSynchronizingNetwork: set at link in variant link-time / pre-compile in variant pre-compile  # If this parameter is true, then this network is a synchronizing network for the NM coordination cluster which it belongs to. The network is expected to call Nm_SynchronizationPoint() at regular intervals.
      symbolic name reference NmComMChannelRef: set at link in variant link-time / pre-compile in variant pre-compile, destination=ComMChannel  # Reference to the corresponding ComM Channel.
      symbolic name reference NmStateReportSignalRef [0..1]: set at pre-compile, destination=ComSignal  # Reference to the signal for setting the NMS by calling Com_SendSignal for the respective channel.
      choice container NmBusType
        container NmGenericBusNmConfig
          string NmGenericBusNmPrefix: set at link in variant link-time / pre-compile in variant pre-compile  # The prefix which identifies the generic <BusNm>. This will be used to determine the API name to be called by Nm for the provided interfaces of the <BusNm>. This string will used for the module prefix before the "_" character in the API call name.
        container NmStandardBusNmConfig
          enumeration NmStandardBusType: {NM_BUSNM_CANNM, NM_BUSNM_FRNM, NM_BUSNM_LINNM, NM_BUSNM_UDPNM}, set at link in variant link-time / pre-compile in variant pre-compile  # Identifies the bus type of the channel for standard AUTOSAR <BusNm>s and is used to determine which set of API calls to be called by Nm for the <BusNm>s. | Note: The Ethernet bus' NM is UdpNm !
    container NmGlobalConfig  # This container contains all global configuration parameters of the Nm Interface.
      container NmGlobalConstants
        integer NmNumberOfChannels: 1..255, set at pre-compile  # Number of NM channels allowed within one ECU.
      container NmGlobalFeatures
        boolean NmBusSynchronizationEnabled: set at pre-compile  # Pre-processor switch for enabling bus synchronization support of the <BusNm>s. This feature is required for NM Coordinator nodes only.
        function name NmCarWakeUpCallback [0..1]: set at link in variant link-time / pre-compile in variant pre-compile  # Name of the callback function to be called if Nm_CarWakeUpIndication() is called.
        boolean NmCarWakeUpRxEnabled: set at link in variant link-time / pre-compile in variant pre-compile, default-value=false  # Enables or disables CWU detection. | FALSE - CarWakeUp not supported TRUE - CarWakeUp supported
        boolean NmComControlEnabled: set at pre-compile  # Pre-processor switch for enabling the Communication Control support.
        boolean NmComUserDataSupport: set at pre-compile, default-value=false  # Enable/Disable setting of NMUserData via SW-C. If NmComUserDataSupport is enabled the API Nm_SetUserData shall not be available.
        boolean NmCoordinatorSupportEnabled: set at pre-compile, default-value=false  # Pre-processor switch for enabling NM Coordinator support.
        float NmGlobalCoordinatorTime [0..1]: 0..Inf, set at pre-compile  # This parameter defines the maximum shutdown time of a connected and coordinated NM-Cluster. | Note:This includes nested connections.
        boolean NmNodeDetectionEnabled: set at pre-compile  # Pre-processor switch for enabling the Node Detection feature.
        boolean NmNodeIdEnabled: set at pre-compile  # Pre-processor switch for enabling transmission of the source node identifier in NM messages.
        boolean NmPduRxIndicationEnabled: set at pre-compile  # Pre-processor switch for enabling the PDU Rx Indication.
        boolean NmRemoteSleepIndEnabled: set at pre-compile  # Pre-processor switch for enabling Remote Sleep Indication support. This feature is required for NM Coordinator nodes only.
        boolean NmRepeatMsgIndEnabled: set at pre-compile  # Pre-processor switch for enabling the Repeat Message Bit Indication.
        boolean NmStateChangeIndEnabled: set at pre-compile  # Pre-processor switch for enabling the Network Management state change notification.
        boolean NmUserDataEnabled: set at pre-compile  # Pre-processor switch for enabling User Data support.
      container NmGlobalProperties
        float NmCycletimeMainFunction: 0..Inf, set at link in variant link-time / pre-compile in variant pre-compile  # The period between successive calls to the Main Function of the NM Interface in seconds.
        boolean NmDevErrorDetect: set at pre-compile, default-value=false  # Pre-processor switch for enabling development error detection and notification.
        boolean NmVersionInfoApi: set at pre-compile  # Pre-processor switch for enabling Version Info API support.
  module definition NvM [0..1]: variants link-time/pre-compile  # Configuration of the NvM (NvRam Manager) module.
    container NvMBlockDescriptor [1..65536]  # Container for a management structure to configure the composition of a given NVRAM Block Management Type. Its multiplicity describes the number of configured NVRAM blocks, one block is required to be configured. The NVRAM block descriptors are condensed in the NVRAM block descriptor table.
      enumeration NvMBlockCrcType [0..1]: {NVM_CRC16, NVM_CRC32, NVM_CRC8}, set at link in variant link-time / pre-compile in variant pre-compile  # Defines CRC data width for the NVRAM block. Default: NVM_CRC16, i.e. CRC16 will be used if NVM_BLOCK_USE_CRC==true
      integer NvMBlockJobPriority: 0..255, set at link in variant link-time / pre-compile in variant pre-compile  # Defines the job priority for a NVRAM block (0 = Immediate priority).
      enumeration NvMBlockManagementType: {NVM_BLOCK_DATASET, NVM_BLOCK_NATIVE, NVM_BLOCK_REDUNDANT}, set at link in variant link-time / pre-compile in variant pre-compile  # Defines the block management type for the NVRAM block.[NVM137]
      boolean NvMBlockUseCrc: set at link in variant link-time / pre-compile in variant pre-compile  # Defines CRC usage for the NVRAM block, i.e. memory space for CRC is reserved in RAM and NV memory. | true: CRC will be used for this NVRAM block. false: CRC will not be used for this NVRAM block.
      boolean NvMBlockUseSyncMechanism: set at link in variant link-time / pre-compile in variant pre-compile, default-value=false  # Defines whether an explicit synchronization mechanism with a RAM mirror and callback routiness for transferring data to and from NvM module's RAM mirror is used for NV block. true if synchronization mechanism is used, false otherwise.
      boolean NvMBlockWriteProt: set at link in variant link-time / pre-compile in variant pre-compile  # Defines an initial write protection of the NV block | true: Initial block write protection is enabled. false: Initial block write protection is disabled.
      boolean NvMBswMBlockStatusInformation: set at link in variant link-time / pre-compile in variant pre-compile, default-value=false  # This parameter specifies whether BswM is informed about the current status of the specified block. | True: Call BswM_NvM_CurrentBlockMode on changes False: Don&rsquo;t inform BswM at all
      boolean NvMCalcRamBlockCrc [0..1]: set at link in variant link-time / pre-compile in variant pre-compile  # Defines CRC (re)calculation for the permanent RAM block | true: CRC will be (re)calculated for this permanent RAM block. false: CRC will not be (re)calculated for this permanent RAM block.
      function name NvMInitBlockCallback [0..1]: set at link in variant link-time / pre-compile in variant pre-compile  # Entry address of a block specific callback routine which shall be called if no ROM data is available for initialization of the NVRAM block. | If not configured, no specific callback routine shall be called for initialization of the NVRAM block with default data.
      integer NvMMaxNumOfReadRetries: 0..7, set at link in variant link-time / pre-compile in variant pre-compile, default-value=0  # Defines the maximum number of read retries.
      integer NvMMaxNumOfWriteRetries: 0..7, set at link in variant link-time / pre-compile in variant pre-compile  # Defines the maximum number of write retries for a NVRAM block with [NVM061_Conf]. Regardless of configuration a consistency check (and maybe write retries) are always forced for each block which is processed by the request NvM_WriteAll and NvM_WriteBlock.
      integer NvMNvBlockBaseNumber: 1..65534, set at link in variant link-time / pre-compile in variant pre-compile  # Configuration parameter to perform the link between the NVM_NVRAM_BLOCK_IDENTIFIER used by the SW-Cs and the FEE_BLOCK_NUMBER expected by the memory abstraction modules. The parameter value equals the FEE_BLOCK_NUMBER or EA_BLOCK_NUMBER shifted to the right by NvMDatasetSelectionBits bits. (ref. to chapter 7.1.2.1). | Calculation Formula: value = TargetBlockReference.[Ea/Fee]BlockConfiguration.[Ea/Fee]BlockNumber >> NvMDatasetSelectionBits
      integer NvMNvBlockLength: 1..65535, set at link in variant link-time / pre-compile in variant pre-compile  # Defines the NV block data length in bytes. | Note: The implementer can add the attribute 'withAuto' to the parameter definition which indicates that the length can be calculated by the generator automatically (e.g. by using the sizeof operator). When 'withAuto' is set to 'true' for this parameter definition the 'isAutoValue' can be set to 'true'. If 'isAutoValue' is set to 'true' the actual value will not be considered during ECU Configuration but will be (re-)calculated by the code generator and stored in the value attribute afterwards.
      integer NvMNvBlockNum: 1..255, set at link in variant link-time / pre-compile in variant pre-compile  # Defines the number of multiple NV blocks in a contiguous area according to the given block management type. | 1-255 For NVRAM blocks to be configured of block management type NVM_BLOCK_DATASET. The actual range is limited according to NVM444. 1 For NVRAM blocks to be configured of block management type NVM_BLOCK_NATIVE 2 For NVRAM blocks to be configured of block management type NVM_BLOCK_REDUNDANT
      integer NvMNvramBlockIdentifier: 2..65535, set at link in variant link-time / pre-compile in variant pre-compile, symbolic-name-value=true  # Identification of a NVRAM block via a unique block identifier. | Implementation Type: NvM_BlockIdType. min = 2 max = 2^(16- NVM_DATASET_SELECTION_BITS)-1 Reserved NVRAM block IDs: 0 -> to derive multi block request results via NvM_GetErrorStatus 1 -> redundant NVRAM block which holds the configuration ID
      integer NvMNvramDeviceId: 0..254, set at link in variant link-time / pre-compile in variant pre-compile  # Defines the NVRAM device ID where the NVRAM block is located. | Calculation Formula: value = TargetBlockReference.[Ea/Fee]BlockConfiguration.[Ea/Fee]DeviceIndex
      string NvMRamBlockDataAddress [0..1]: set at link in variant link-time / pre-compile in variant pre-compile  # Defines the start address of the RAM block data. | If this is not configured, no permanent RAM data block is available for the selected block management type.
      function name NvMReadRamBlockFromNvCallback [0..1]: set at link in variant link-time / pre-compile in variant pre-compile  # Entry address of a block specific callback routine which shall be called in order to let the application copy data from the NvM module's mirror to RAM block. | Implementation type: Std_ReturnType E_OK: copy was successful E_NOT_OK: copy was not successful, callback routine to be called again
      boolean NvMResistantToChangedSw: set at link in variant link-time / pre-compile in variant pre-compile  # Defines whether a NVRAM block shall be treated resistant to configuration changes or not. If there is no default data available at configuration time then the application shall be responsible for providing the default initialization data. In this case the application has to use NvM_GetErrorStatus()to be able to distinguish between first initialization and corrupted data. | true: NVRAM block is resistant to changed software. false: NVRAM block is not resistant to changed software.
      string NvMRomBlockDataAddress [0..1]: set at link in variant link-time / pre-compile in variant pre-compile  # Defines the start address of the ROM block data. | If not configured, no ROM block is available for the selected block management type.
      integer NvMRomBlockNum: 0..255, set at link in variant link-time / pre-compile in variant pre-compile  # Defines the number of multiple ROM blocks in a contiguous area according to the given block management type. | 0-255 For NVRAM blocks to be configured of block management type NVM_BLOCK_DATASET. The actual range is limited according to NVM444. 0-1 For NVRAM blocks to be configured of block management type NVM_BLOCK_NATIVE 0-1 For NVRAM blocks to be configured of block management type NVM_BLOCK_REDUNDANT
      boolean NvMSelectBlockForReadAll [0..1]: set at link in variant link-time / pre-compile in variant pre-compile  # NVM117: Defines whether a NVRAM block shall be processed during NvM_ReadAll or not. This configuration parameter has only influence on those NVRAM blocks which are configured to have a permanent RAM block. | true: NVRAM block shall be processed by NvM_ReadAll false: NVRAM block shall not be processed by NvM_ReadAll
      boolean NvMSelectBlockForWriteAll [0..1]: set at link in variant link-time / pre-compile in variant pre-compile  # Defines whether a NVRAM block shall be processed during NvM_WriteAll or not. This configuration parameter has only influence on those NVRAM blocks which are configured to have a permanent RAM block. | true: NVRAM block shall be processed by NvM_WriteAll false: NVRAM block shall not be processed by NvM_WriteAll
      function name NvMSingleBlockCallback [0..1]: set at link in variant link-time / pre-compile in variant pre-compile  # Entry address of the block specific callback routine which shall be invoked on termination of each asynchronous single block request [NVM113].
      boolean NvMStaticBlockIDCheck: set at link in variant link-time / pre-compile in variant pre-compile, default-value=false  # Defines if the Static Block ID check is enabled. | false: Static Block ID check is disabled. true: Static Block ID check is enabled.
      boolean NvMWriteBlockOnce: set at link in variant link-time / pre-compile in variant pre-compile  # Defines write protection after first write. The NVRAM manager sets the write protection bit after the NV block was written the first time. This means that some of the NV blocks in the NVRAM should never be erased nor be replaced with the default ROM data after first initialization. [NVM276]. | true: Defines write protection after first write is enabled. false: Defines write protection after first write is disabled.
      function name NvMWriteRamBlockToNvCallback [0..1]: set at link in variant link-time / pre-compile in variant pre-compile  # Entry address of a block specific callback routine which shall be called in order to let the application copy data from RAM block to NvM module's mirror. | Implementation type: Std_ReturnType E_OK: copy was successful E_NOT_OK: copy was not successful, callback routine to be called again
      boolean NvMWriteVerification: set at link in variant link-time / pre-compile in variant pre-compile, default-value=false  # Defines if Write Verification is enabled. | false: Write verification is disabled. true: Write Verification is enabled.
      integer NvMWriteVerificationDataSize: 1..65536, set at link in variant link-time / pre-compile in variant pre-compile, default-value=0  # Defines the number of bytes to compare in each step when comparing the content of a RAM Block and a block read back.
      choice container NvMTargetBlockReference  # This parameter is just a container for the parameters for EA and FEE
        container NvMEaRef [0..1]  # EEPROM Abstraction
          symbolic name reference NvMNameOfEaBlock: set at link in variant link-time / pre-compile in variant pre-compile, destination=EaBlockConfiguration  # reference to EaBlock
        container NvMFeeRef [0..1]  # Flash EEPROM Emulation
          symbolic name reference NvMNameOfFeeBlock: set at link in variant link-time / pre-compile in variant pre-compile, destination=FeeBlockConfiguration  # reference to FeeBlock
    container NvMCommon  # Container for common configuration options.
      enumeration NvMApiConfigClass: {NVM_API_CONFIG_CLASS_1, NVM_API_CONFIG_CLASS_2, NVM_API_CONFIG_CLASS_3}, set at pre-compile  # Preprocessor switch to enable some API calls which are related to NVM API configuration classes.
      boolean NvMBswMMultiBlockJobStatusInformation: set at link in variant link-time / pre-compile in variant pre-compile, default-value=true  # This parameter specifies whether BswM is informed about the current status of the multiblock job. | True: call BswM_NvM_CurrentJobMode if ReadAll and WriteAll are started, finished, canceled False: do not inform BswM at all
      integer NvMCompiledConfigId: 0..65535, set at pre-compile  # Configuration ID regarding the NV memory layout. This configuration ID shall be published as e.g. a SW-C shall have the possibility to write it to NV memory.
      integer NvMCrcNumOfBytes: 1..65535, set at link in variant link-time / pre-compile in variant pre-compile  # If CRC is configured for at least one NVRAM block, this parameter defines the maximum number of bytes which shall be processed within one cycle of job processing.
      integer NvMDatasetSelectionBits: 0..8, set at link in variant link-time / pre-compile in variant pre-compile  # Defines the number of least significant bits which shall be used to address a certain dataset of a NVRAM block within the interface to the memory hardware abstraction. | 0..8: Number of bits which are used for dataset or redundant block addressing. 0: No dataset or redundant NVRAM blocks are configured at all, no selection bits required. 1: In case of redundant NVRAM blocks are configured, but no dataset NVRAM blocks.
      boolean NvMDevErrorDetect: set at pre-compile  # Pre-processor switch to enable and disable development error detection. | true: Development error detection enabled. false: Development error detection disabled.
      boolean NvMDrvModeSwitch: set at link in variant link-time / pre-compile in variant pre-compile  # Preprocessor switch to enable switching memory drivers to fast mode during performing NvM_ReadAll and NvM_WriteAll | true: Fast mode enabled. false: Fast mode disabled.
      boolean NvMDynamicConfiguration: set at link in variant link-time / pre-compile in variant pre-compile  # Preprocessor switch to enable the dynamic configuration management handling by the NvM_ReadAll request. | true: Dynamic configuration management handling enabled. false: Dynamic configuration management handling disabled.
      boolean NvMJobPrioritization: set at link in variant link-time / pre-compile in variant pre-compile  # Preprocessor switch to enable job prioritization handling | true: Job prioritization handling enabled. false: Job prioritization handling disabled.
      function name NvMMultiBlockCallback [0..1]: set at link in variant link-time / pre-compile in variant pre-compile  # Entry address of the common callback routine which shall be invoked on termination of each asynchronous multi block request
      boolean NvMPollingMode: set at link in variant link-time / pre-compile in variant pre-compile  # Preprocessor switch to enable/disable the polling mode in the NVRAM Manager and at the same time disable/enable the callback functions useable by lower layers | true: Polling mode enabled, callback function usage disabled. false: Polling mode disabled, callback function usage enabled.
      integer NvMRepeatMirrorOperations: 0..7, set at link in variant link-time / pre-compile in variant pre-compile, default-value=0  # Defines the number of retries to let the application copy data to or from the NvM module's mirror before postponing the current job.
      boolean NvMSetRamBlockStatusApi: set at pre-compile  # Preprocessor switch to enable the API NvM_SetRamBlockStatus. | true: API NvM_SetRamBlockStatus enabled. false: API NvM_SetRamBlockStatus disabled.
      integer NvMSizeImmediateJobQueue [0..1]: 1..255, set at link in variant link-time / pre-compile in variant pre-compile  # Defines the number of queue entries for the immediate priority job queue. If NVM_JOB_PRIORITIZATION is switched OFF this parameter shall be out of scope.
      integer NvMSizeStandardJobQueue: 1..255, set at link in variant link-time / pre-compile in variant pre-compile  # Defines the number of queue entries for the standard job queue.
      boolean NvMVersionInfoApi: set at pre-compile  # Pre-processor switch to enable / disable the API to read out the modules version information [NVM285], [NVM286]. | true: Version info API enabled. false: Version info API disabled.
    container NvmDemEventParameterRefs [0..1]  # Container for the references to DemEventParameter elements which shall be invoked using the API Dem_ReportErrorStatus API in case the corresponding error occurs. The EventId is taken from the referenced DemEventParameter's DemEventId value. The standardized errors are provided in the container and can be extended by vendor specific error references.
      symbolic name reference NVM_E_INTEGRITY_FAILED [0..1]: set at pre-compile, destination=DemEventParameter  # Reference to the DemEventParameter which shall be issued when the error "API request integrity failed" has occured.
      symbolic name reference NVM_E_LOSS_OF_REDUNDANCY [0..1]: set at pre-compile, destination=DemEventParameter  # Reference to the DemEventParameter which shall be issued when the error "loss of redundancy" has occured.
      symbolic name reference NVM_E_QUEUE_OVERFLOW [0..1]: set at pre-compile, destination=DemEventParameter  # Reference to the DemEventParameter which shall be issued when the error "NVRAM Managers job queue overflow" has occured.
      symbolic name reference NVM_E_REQ_FAILED [0..1]: set at pre-compile, destination=DemEventParameter  # Reference to the DemEventParameter which shall be issued when the error "API request failed" has occured.
      symbolic name reference NVM_E_VERIFY_FAILED [0..1]: set at pre-compile, destination=DemEventParameter  # Reference to the DemEventParameter which shall be issued when the error "Write Verification failed" has occured.
      symbolic name reference NVM_E_WRITE_PROTECTED [0..1]: set at pre-compile, destination=DemEventParameter  # Reference to the DemEventParameter which shall be issued when the error "write attempt to NVRAM block with write protection" has occured.
      symbolic name reference NVM_E_WRONG_BLOCK_ID [0..1]: set at pre-compile, destination=DemEventParameter  # Reference to the DemEventParameter which shall be issued when the error "Static Block ID check failed" has occured.
  module definition Os [0..1]: variants pre-compile  # Configuration of the Os (Operating System) module.
    container OsAlarm [0..*]  # An OsAlarm may be used to asynchronously inform or activate a specific task. It is possible to start alarms automatically at system start-up depending on the application mode.
      reference OsAlarmAccessingApplication [0..*]: set at pre-compile, destination=OsApplication  # Reference to applications which have an access to this object.
      reference OsAlarmCounterRef: set at pre-compile, destination=OsCounter  # Reference to the assigned counter for that alarm
      choice container OsAlarmAction  # This container defines which type of notification is used when the alarm expires.
        container OsAlarmActivateTask [0..1]  # This container specifies the parameters to activate a task.
          reference OsAlarmActivateTaskRef: set at pre-compile, destination=OsTask  # Reference to the task that will be activated by that alarm action
        container OsAlarmCallback [0..1]  # This container specifies the parameters to call a callback OS alarm action.
          function name OsAlarmCallbackName: set at pre-compile  # Name of the function that is called when this alarm callback is triggered.
        container OsAlarmIncrementCounter [0..1]  # This container specifies the parameters to increment a counter.
          reference OsAlarmIncrementCounterRef: set at pre-compile, destination=OsCounter  # Reference to the counter that will be incremented by that alarm action
        container OsAlarmSetEvent [0..1]  # This container specifies the parameters to set an event
          reference OsAlarmSetEventRef: set at pre-compile, destination=OsEvent  # Reference to the event that will be set by that alarm action
          reference OsAlarmSetEventTaskRef: set at pre-compile, destination=OsTask  # Reference to the task that will be activated by that event
      container OsAlarmAutostart [0..1]  # If present this container defines if an alarm is started automatically at system start-up depending on the application mode.
        integer OsAlarmAlarmTime: 0..18446744073709551615, set at pre-compile  # The relative or absolute tick value when the alarm expires for the first time. Note that for an alarm which is RELATIVE the value must be at bigger than 0.
        enumeration OsAlarmAutostartType: {ABSOLUTE, RELATIVE}, set at pre-compile  # This specifies the type of autostart for the alarm..
        integer OsAlarmCycleTime: 0..18446744073709551615, set at pre-compile  # Cycle time of a cyclic alarm in ticks. If the value is 0 than the alarm is not cyclic.
        reference OsAlarmAppModeRef [1..*]: set at pre-compile, destination=OsAppMode  # Reference to the application modes for which the AUTOSTART shall be performed
    container OsAppMode [1..*]  # OsAppMode is the object used to define OSEK OS properties for an OSEK OS application mode. | No standard attributes are defined for AppMode. In a CPU, at least one AppMode object has to be defined. [source: OSEK OIL Spec. 2.5] An OsAppMode called OSDEFAULTAPPMODE must always be there for OSEK compatilbility.
    container OsApplication [0..*]  # An AUTOSAR OS must be capable of supporting a collection of OS objects (tasks, interrupts, alarms, hooks etc.) that form a cohesive functional unit. This collection of objects is termed an OS-Application. | All objects which belong to the same OS-Application have access to each other. Access means to allow to use these objects within API services. Access by other applications can be granted separately.
      integer OsApplicationCoreAssignment [0..1]: 0..65534, set at pre-compile  # ID of the core onto which the OsApplication is bound.
      boolean OsTrusted: set at pre-compile, default-value=false  # Parameter to specify if an OS-Application is trusted or not. | true: OS-Application is trusted false: OS-Application is not trusted (default)
      reference OsAppAlarmRef [0..*]: set at pre-compile, destination=OsAlarm  # Specifies the OsAlarms that belong to the OsApplication.
      reference OsAppCounterRef [0..*]: set at pre-compile, destination=OsCounter  # References the OsCounters that belong to the OsApplication.
      reference OsAppEcucPartitionRef [0..1]: set at pre-compile, destination=EcucPartition  # Denotes which "EcucPartition" is implemented by this "OSApplication".
      reference OsAppIsrRef [0..*]: set at pre-compile, destination=OsIsr  # references which OsIsrs belong to the OsApplication
      reference OsAppScheduleTableRef [0..*]: set at pre-compile, destination=OsScheduleTable  # References the OsScheduleTables that belong to the OsApplication.
      reference OsAppTaskRef [0..*]: set at pre-compile, destination=OsTask  # references which OsTasks belong to the OsApplication
      reference OsRestartTask [0..1]: set at pre-compile, destination=OsTask  # Optionally one task of an OS-Application may be defined as Restart Task. | Multiplicity = 1: Restart Task is activated by the Operating System if the protection hook requests it. Multiplicity = 0: No task is automatically started after a protection error happened.
      container OsApplicationHooks  # Container to structure the OS-Application-specific hooks
        boolean OsAppErrorHook: set at pre-compile  # Select the OS-Application error hook. | true: Hook is called false: Hook is not called
        boolean OsAppShutdownHook: set at pre-compile  # Select the OS-Application specific shutdown hook for the OS-Application. | true: Hook is called false: Hook is not called
        boolean OsAppStartupHook: set at pre-compile  # Select the OS-Application specific startup hook for the OS-Application. | true: Hook is called false: Hook is not called
      container OsApplicationTrustedFunction [0..*]  # Container to structure the configration parameters of trusted functions
        function name OsTrustedFunctionName: set at pre-compile  # Trusted function (as part of a trusted OS-Application) available to other OS-Applications. This also supersedes the OSEK OIL attribute TRUSTED in APPLICATION because the optionality of this parameter is describing that already.
    container OsCounter [0..*]  # Configuration information for the counters that belong to the OsApplication.
      integer OsCounterMaxAllowedValue: 1..18446744073709551615, set at pre-compile  # Maximum possible allowed value of the system counter in ticks.
      integer OsCounterMinCycle: 1..18446744073709551615, set at pre-compile  # The MINCYCLE attribute specifies the minimum allowed number of counter ticks for a cyclic alarm linked to the counter.
      integer OsCounterTicksPerBase: 1..4294967295, set at pre-compile  # The TICKSPERBASE attribute specifies the number of ticks required to reach a counterspecific unit. The interpretation is implementation-specific.
      enumeration OsCounterType: {HARDWARE, SOFTWARE}, set at pre-compile  # This parameter contains the natural type or unit of the counter.
      float OsSecondsPerTick [0..1]: 0..Inf, set at pre-compile  # Time of one counter tick in seconds.
      reference OsCounterAccessingApplication [0..*]: set at pre-compile, destination=OsApplication  # Reference to applications which have an access to this object.
      container OsDriver [0..1]  # This Container contains the information who will drive the counter. | This configuration is only valid if the counter has OsCounterType set to HARDWARE. If the container does not exist (multiplicity=0) the timer is managed by the OS internally (OSINTERNAL). If the container exists the OS can use the GPT interface to manage the timer. The user have to supply the GPT channel. If the counter is driven by some other (external to the OS) source (like a TPU for example) this must be described as a vendor specific extension.
        reference OsGptChannelRef [0..1]: set at pre-compile, destination=GptChannelConfiguration  # Reference to the GPT channel.
      container OsTimeConstant [0..*]  # Allows the user to define constants which can be e.g. used to compare time values with timer tick values. | A time value will be converted to a timer tick value during generation and can later on accessed via the OsConstName. The conversation is done by rounding time values to the nearest fitting tick value.
        float OsTimeValue: 0..Inf, set at pre-compile  # This parameter contains the value of the constant in seconds.
    container OsEvent [0..*]  # Representation of OS events in the configuration context. Adopted from the OSEK OIL specification.
      integer OsEventMask [0..1]: 0..18446744073709551615, set at pre-compile  # If event mask would be set to AUTO in OIL, this parameter should be omitted here.
    container OsIoc [0..1]  # Configuration of the IOC (Inter OS Application Communicator).
      container OsIocCommunication [0..*]  # Representation of a 1:1 or N:1 communication between software parts located in different OS-Applications that are bound to the same or to different cores. | The name shall begin with the name of the sending software service and be followed by a unique identifier delivered by the sending software service. In the case of RTE as user attention shall be paid on the fact that uniqueness for identifier names has to be reached over ports, data elements, object instances and maybe additional identification properties (E.g. Case 1:N mapping to 1:1). Example: - <NameSpace>_UniqueID
        integer OsIocBufferLength [0..1]: 0..4294967295, set at pre-compile  # This attribute defines the size of the IOC internal queue to be allocated for a queued communication. | This configuration information shall allow the optimization of the needed memory for communications requiring buffers within the RTE and within the IOC.
        container OsIocDataProperties [1..*]  # Data properties of the data to be transferred on the IOC communication channel.
          integer OsIocDataPropertyIndex [0..1]: 0..255, set at pre-compile  # This parameter is used to define in which order the data is send, e.g. whether IocSendGroup(A,B) or IocSendGroup(B,A) shall be used.
          string OsIocInitValue [0..1]: set at pre-compile  # Initial Value for the data to be transferred on the IOC communication channel.
          foreign reference OsIocDataTypeRef: set at pre-compile, destination-type=IMPLEMENTATION-DATA-TYPE  # This is the type of the data to be transferred on the IOC communication channel. This attribute is necessary to generate the parameter type of the Ioc functions. Additionally this information should be used to compute the data size for necessary data copy operations within the Ioc module. | If more than one attribute is defined, the IOC generator should generate an IocXxxGroup function (Xxx= CHOICE [Send, Receive, Write, Read]). N:1 communication (Multiplicity of OsIocSenderProperties > 1) is only allowed for multiplicity of OsIocDataRef = 1
        container OsIocReceiverProperties  # Representation of receiver properties for one communication. For each OsIocCommunication (1:1 or N:1) one receiver has to be defined. This container should be instanciated within an OsIocCommunication.
          enumeration OsIocFunctionImplementationKind [0..1]: {DO_NOT_CARE, FUNCTION, MACRO}, set at pre-compile, default-value=DO_NOT_CARE  # This parameter is used to select whether this communication is implemented as a macro or as a function.
          function name OsIocReceiverPullCB [0..1]: set at pre-compile  # This attribute defines the name of a callback function that the IOC shall call on the receiving core for each data reception. | In case of non existence of this attribute no ReceiverPullCB notification shall be applied by the IOC. The name of the function shall begin with the name of the receiving module, followed with a callback name and followed by the IocId. Example: void RTE_ReceiverPullCB_RTE25 (void). If this attribute does not exist, it means that no ReceiverPullCB shall be called (No notification from IOC is required). If this attribute exists the IOC shall call the callback function on the receiving core.
          reference OsIocReceivingOsApplicationRef: set at pre-compile, destination=OsApplication  # This attribute is a reference to the receiving OsApplication instance defined in the configuration file of the OS. | This information allows for the generator to get additional information necessary for the code generation like: * The protection properties of the communicating OsApplications to find out which protections have to be crossed * The core identifiers to find out if an intra or an inter core communication has to be realized * Interrupt details in case of cross core notification to realize over IRQs
        container OsIocSenderProperties [1..*]  # Representation of sender properties for one communication. For each OsIocCommunication one (1:1) or many senders (N:1) have to be defined. Multiplicity > 1 (N:1 communication) is only allowed for Multiplicity of OsIocDataTypeRef = 1. | This container should be instanciated within an OsIocCommunication.
          enumeration OsIocFunctionImplementationKind [0..1]: {DO_NOT_CARE, FUNCTION, MACRO}, set at pre-compile, default-value=DO_NOT_CARE  # This parameter is used to select whether this communication is implemented as a macro or as a function.
          integer OsIocSenderId [0..1]: 0..255, set at pre-compile  # Representation of a sender in a N:1 communication to distinguish between senders. | This parameter does not exist in 1:1 communication.
          reference OsIocSendingOsApplicationRef: set at pre-compile, destination=OsApplication  # This attribute is a reference to the sending OS-Application instance defined in the configuration file of the OS. | This information shall allows the generator to get additional information necessary for the code generation like: * The protection properties of the communicating OS-Applications to find out which protection boundaries have to be crossed. * The core identifiers to find out if an intra or an inter core communication has to be realized * Interrupt details in case of cross core notification to realize over IRQs
    container OsIsr [0..*]  # The OsIsr container represents an OSEK interrupt service routine.
      enumeration OsIsrCategory: {CATEGORY_1, CATEGORY_2}, set at pre-compile  # This attribute specifies the category of this ISR.
      reference OsIsrResourceRef [0..*]: set at pre-compile, destination=OsResource  # This reference defines the resources accessed by this ISR.
      container OsIsrTimingProtection [0..1]  # This container contains all parameters which are related to timing protection | If the container exists, the timing protection is used for this interrupt. If the container does not exist, the interrupt is not supervised regarding timing violations.
        float OsIsrAllInterruptLockBudget [0..1]: 0..Inf, set at pre-compile  # This parameter contains the maximum time for which the ISR is allowed to lock all interrupts (via SuspendAllInterrupts() or DisableAllInterrupts()) (in seconds).
        float OsIsrExecutionBudget [0..1]: 0..Inf, set at pre-compile  # The parameter contains the maximum allowed execution time of the interrupt (in seconds).
        float OsIsrOsInterruptLockBudget [0..1]: 0..Inf, set at pre-compile  # This parameter contains the maximum time for which the ISR is allowed to lock all Category 2 interrupts (via SuspendOSInterrupts()) (in seconds).
        float OsIsrTimeFrame [0..1]: 0..Inf, set at pre-compile  # This parameter contains the minimum inter-arrival time between successive interrupts (in seconds).
        container OsIsrResourceLock [0..*]  # This container contains a list of times the interrupt uses resources.
          float OsIsrResourceLockBudget: 0..Inf, set at pre-compile  # This parameter contains the maximum time the interrupt is allowed to hold the given resource (in seconds).
          reference OsIsrResourceLockResourceRef: set at pre-compile, destination=OsResource  # Reference to the resource the locking time is depending on
    container OsOS  # OS is the object used to define OSEK OS properties for an OSEK application. | Per CPU exactly one OS object has to be defined.
      integer OsNumberOfCores [0..1]: 1..65535, set at pre-compile  # Maximum number of cores that are controlled by the OS. | The OS uses the value internally. It depends on the ECU HW.
      enumeration OsScalabilityClass [0..1]: {SC1, SC2, SC3, SC4}, set at pre-compile  # A scalability class for each System Object "OS" has to be selected. In order to customize the operating system to the needs of the user and to take full advantage of the processor features the operating system can be scaled according to the scalability classes. | If the scalability class is omitted this translates to the OIL AUTO mechanism.
      boolean OsStackMonitoring: set at pre-compile  # Select stack monitoring of Tasks/Category 2 ISRs | true: Stacks are monitored false: Stacks are not monitored
      enumeration OsStatus: {EXTENDED, STANDARD}, set at pre-compile  # The Status attribute specifies whether a system with standard or extended status has to be used. Automatic assigment is not supported for this attribute.
      boolean OsUseGetServiceId: set at pre-compile  # As defined by OSEK
      boolean OsUseParameterAccess: set at pre-compile  # As defined by OSEK
      boolean OsUseResScheduler: set at pre-compile, default-value=true  # The OsUseResScheduler attribute defines whether the resource RES_SCHEDULER is used within the application.
      container OsHooks  # Container to structure all hooks belonging to the OS
        boolean OsErrorHook: set at pre-compile  # Error hook as defined by OSEK | true: Hook is called false: Hook is not called
        boolean OsPostTaskHook: set at pre-compile  # Post-task hook as defined by OSEK | true: Hook is called false: Hook is not called
        boolean OsPreTaskHook: set at pre-compile  # Pre-task hook as defined by OSEK | true: Hook is called false: Hook is not called
        boolean OsProtectionHook [0..1]: set at pre-compile  # Switch to enable/disable the call to the (user supplied) protection hook. | true: Protection hook is called on protection error false: Protection hook is not called
        boolean OsShutdownHook: set at pre-compile  # Shutdown hook as defined by OSEK | true: Hook is called false: Hook is not called
        boolean OsStartupHook: set at pre-compile  # Startup hook as defined by OSEK | true: Hook is called false: Hook is not called
    container OsResource [0..*]  # An OsResource object is used to co-ordinate the concurrent access by tasks and ISRs to a shared resource, e.g. the scheduler, any program sequence, memory or any hardware area.
      enumeration OsResourceProperty: {INTERNAL, LINKED, STANDARD}, set at pre-compile  # This specifies the type of the resource.
      reference OsResourceAccessingApplication [0..*]: set at pre-compile, destination=OsApplication  # Reference to applications which have an access to this object.
      reference OsResourceLinkedResourceRef [0..1]: set at pre-compile, destination=OsResource  # The link to the resource. Must be valid if OsResourceProperty is LINKED. If OsResourceProperty is not LINKED the value is ignored.
    container OsScheduleTable [0..*]  # An OsScheduleTable addresses the synchronization issue by providing an encapsulation of a statically defined set of alarms that cannot be modified at runtime.
      integer OsScheduleTableDuration: 0..18446744073709551615, set at pre-compile  # This parameter defines the modulus of the schedule table (in ticks).
      boolean OsScheduleTableRepeating: set at pre-compile  # true: first expiry point on the schedule table shall be processed at final expiry point delay ticks after the final expiry point is processed. | false: the schedule table processing stops when the final expiry point is processed.
      reference OsSchTblAccessingApplication [0..*]: set at pre-compile, destination=OsApplication  # Reference to applications which have an access to this object.
      reference OsScheduleTableCounterRef: set at pre-compile, destination=OsCounter  # This parameter contains a reference to the counter which drives the schedule table.
      container OsScheduleTableAutostart [0..1]  # This container specifies if and how the schedule table is started on startup of the Operating System. The options to start a schedule table correspond to the API calls to start schedule tables during runtime.
        enumeration OsScheduleTableAutostartType: {ABSOLUTE, RELATIVE, SYNCHRON}, set at pre-compile  # This specifies the type of the autostart for the schedule table.
        integer OsScheduleTableStartValue [0..1]: 0..18446744073709551615, set at pre-compile  # Absolute autostart tick value when the schedule table starts. Only used if the OsScheduleTableAutostartType is ABSOLUTE. | Relative offset in ticks when the schedule table starts. Only used if the OsScheduleTableAutostartType is RELATIVE.
        reference OsScheduleTableAppModeRef [1..*]: set at pre-compile, destination=OsAppMode  # Reference in which application modes the schedule table should be started during startup
      container OsScheduleTableExpiryPoint [1..*]  # The point on a Schedule Table at which the OS activates tasks and/or sets events
        integer OsScheduleTblExpPointOffset: 0..18446744073709551615, set at pre-compile  # The offset from zero (in ticks) at which the expiry point is to be processed.
        container OsScheduleTableEventSetting [0..*]  # Event that is triggered by that schedule table.
          reference OsScheduleTableSetEventRef: set at pre-compile, destination=OsEvent  # Reference to event that will be set by action
          reference OsScheduleTableSetEventTaskRef: set at pre-compile, destination=OsTask
        container OsScheduleTableTaskActivation [0..*]  # Task that is triggered by that schedule table.
          reference OsScheduleTableActivateTaskRef: set at pre-compile, destination=OsTask  # Reference to task that will be activated by action
        container OsScheduleTblAdjustableExpPoint [0..1]  # Adjustable expiry point
          integer OsScheduleTableMaxLengthen: 0..18446744073709551615, set at pre-compile  # The maximum positive adjustment that can be made to the expiry point offset (in ticks).
          integer OsScheduleTableMaxShorten: 0..18446744073709551615, set at pre-compile  # The maximum negative adjustment that can be made to the expiry point offset (in ticks).
      container OsScheduleTableSync [0..1]  # This container specifies the synchronization parameters of the schedule table.
        integer OsScheduleTblExplicitPrecision [0..1]: 0..18446744073709551615, set at pre-compile  # This configuration is only valid if the explicit synchronisation is used.
        enumeration OsScheduleTblSyncStrategy: {EXPLICIT, IMPLICIT, NONE}, set at pre-compile, origin=AUTOSAR ECUC, default-value=NONE  # AUTOSAR OS provides support for synchronisation in two ways: explicit and implicit.
    container OsSpinlock [0..*]  # An OsSpinlock object is used to co-ordinate concurrent access by TASKs/ISR2s on different cores to a shared resource.
      reference OsSpinlockAccessingApplication [1..*]: set at pre-compile, destination=OsApplication  # Reference to OsApplications that have an access to this object.
      reference OsSpinlockSuccessor [0..1]: set at pre-compile, destination=OsSpinlock  # Reference to OsApplications that have an access to this object. | To check whether a spinlock can be occupied (in a nested way) without any danger of deadlock, a linked list of spinlocks can be defined. A spinlock can only be occupied in the order of the linked list. It is allowed to skip a spinlock. If no linked list is specified, spinlocks cannot be nested.
    container OsTask [0..*]  # This container represents an OSEK task.
      integer OsTaskActivation: 1..4294967295, set at pre-compile  # This attribute defines the maximum number of queued activation requests for the task. A value equal to "1" means that at any time only a single activation is permitted for this task. Note that the value must be a natural number starting at 1.
      integer OsTaskPriority: 0..4294967295, set at pre-compile  # The priority of a task is defined by the value of this attribute. This value has to be understood as a relative value, i.e. the values show only the relative ordering of the tasks. | OSEK OS defines the lowest priority as zero (0); larger values correspond to higher priorities.
      enumeration OsTaskSchedule: {FULL, NON}, set at pre-compile  # The OsTaskSchedule attribute defines the preemptability of the task. | If this attribute is set to NON, no internal resources may be assigned to this task.
      reference OsTaskAccessingApplication [0..*]: set at pre-compile, destination=OsApplication  # Reference to applications which have an access to this object.
      reference OsTaskEventRef [0..*]: set at pre-compile, destination=OsEvent  # This reference defines the list of events the extended task may react on.
      reference OsTaskResourceRef [0..*]: set at pre-compile, destination=OsResource  # This reference defines a list of resources accessed by this task.
      container OsTaskAutostart [0..1]  # This container determines whether the task is activated during the system start-up procedure or not for some specific application modes. | If the task shall be activated during the system start-up, this container is present and holds the references to the application modes in which the task is auto-started.
        reference OsTaskAppModeRef [1..*]: set at pre-compile, destination=OsAppMode  # Reference to application modes in which that task is activated on startup of the OS
      container OsTaskTimingProtection [0..1]  # This container contains all parameters regarding timing protection of the task.
        float OsTaskAllInterruptLockBudget [0..1]: 0..Inf, set at pre-compile  # This parameter contains the maximum time for which the task is allowed to lock all interrupts (via SuspendAllInterrupts() or DisableAllInterrupts()) (in seconds).
        float OsTaskExecutionBudget [0..1]: 0..Inf, set at pre-compile  # This parameter contains the maximum allowed execution time of the task (in seconds).
        float OsTaskOsInterruptLockBudget [0..1]: 0..Inf, set at pre-compile  # This parameter contains the maximum time for which the task is allowed to lock all Category 2 interrupts (via SuspendOSInterrupts()) (in seconds).
        float OsTaskTimeFrame [0..1]: 0..Inf, set at pre-compile  # The minimum inter-arrival time between activations and/or releases of a task (in seconds).
        container OsTaskResourceLock [0..*]  # This container contains the worst case time between getting and releasing a given resource (in seconds).
          float OsTaskResourceLockBudget: 0..Inf, set at pre-compile  # This parameter contains the maximum time the task is allowed to lock the resource (in seconds)
          reference OsTaskResourceLockResourceRef: set at pre-compile, destination=OsResource  # Reference to the resource used by the task
