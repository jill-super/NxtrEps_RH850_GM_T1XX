[part 3 of 6: package /AUTOSAR/EcucDefs]
AUTOSAR XML (schema 4-0-3)
package /AUTOSAR/EcucDefs  (continued)
  module definition Dcm [0..1]: variants link-time/post-build/pre-compile  # Configuration of the Dcm (Diagnostic Communications Manager) module.
    container DcmConfigSet: multiple-configuration-container=true  # This container contains the configuration parameters and sub containers of the DCM module supporting multiple configuration sets. | This container is a MultipleConfigurationContainer, i.e. this container and its sub-containers exist once per configuration set.
      container DcmDsd  # These parameters apply to Diagnostic Service Dispatcher. All parameters for all service dispatchers are included in this one configuration container. | There must always be one service dispatcher in a DCM.
        container DcmDsdServiceTable [1..256]  # This container contains the configuration (DSD parameters) for Service Identifier Table.
          integer DcmDsdSidTabId: 0..255, set at link in variant link-time / pre-compile in variant post-build+pre-compile  # Due the fact of using one or more service tables the member of the Service Identifier Table includes a unique id for the Service Identifier Table.
          container DcmDsdService [1..*]  # This container contains the configuration (DSD parameters) for Service.
            function name DcmDsdSidTabFnc [0..1]: set at link in variant link-time / pre-compile in variant post-build+pre-compile  # Callback function of the ECU Supplier specific component for the particular DcmDsdSidTabServiceId. | This parameter is related to the interface <Module>_<DiagnosticService>. If it is not configured the service is handled Dcm-internally.
            integer DcmDsdSidTabServiceId: 0..255, set at link in variant link-time / pre-compile in variant post-build+pre-compile  # Id of the Service identifier. | The possible Service identifier are predefined in the ISO 14229-1 and ISO 15031-5 and in Table 4 and Table 5.
            boolean DcmDsdSidTabSubfuncAvail: set at link in variant link-time / pre-compile in variant post-build+pre-compile  # Information whether the DcmDsdSidTabServiceId includes Sub functions or not. Used for the Handling of "suppressPosRspMsgIndicationBit" ISO14229-1 can be referenced here, as this specification gives fix definition, if an SID includes Subfunction or not. | true = sub-function available false = sub-function not available
            reference DcmDsdSidTabModeRuleRef [0..1]: set at link in variant link-time / pre-compile in variant post-build+pre-compile, destination=DcmModeRule  # Reference to DcmDspModeRule | Mode rule which controls the execution of the DcmDsdService. If there is no reference, no check of the mode rule shall be done.
            reference DcmDsdSidTabSecurityLevelRef [0..*]: set at link in variant link-time / pre-compile in variant post-build+pre-compile, origin=AUTOSAR_ECUC V1.0.0, destination=DcmDspSecurityRow  # Link to the Security Access Levels needed for execution of the DcmDsdService. | Please refer to the ISO 14229-1, ISO 15031-5 and "Verification of the Security Access levels". Please note, that it shall be provided to configure several DcmDsdSidTabSecurityLevelRef per DcmDsdService. If there is no reference, no check of security level shall be done.
            reference DcmDsdSidTabSessionLevelRef [0..*]: set at link in variant link-time / pre-compile in variant post-build+pre-compile, origin=AUTOSAR_ECUC V1.0.0, destination=DcmDspSessionRow  # Link to the Session Control needed for execution of the DcmDsdService. Please refer to the ISO 14229-1, ISO 15031-5 and "Verification of the Diagnostic Session". Please note, that it shall be provided to configure several DcmDsdSidTabSessionLevelRef per DcmDsdService. If there is no reference, no check of session level shall be done.
            container DcmDsdSubService [0..*]  # This container contains the configuration (DSD parameters) for SubServices. This configuration is available only for services having Subfunction: this container exists only if parameter DcmDsdSidTabSubfuncAvail, of this service, is set to TRUE and the parameter DcmDsdSidTabFnc is not existing.
              function name DcmDsdSubServiceFnc [0..1]: set at link in variant link-time / pre-compile in variant post-build+pre-compile  # Callback function of the ECU Supplier specific component. This parameter is related to the interface <Module>_<DiagnosticService>_<SubService>. | If it is not configured the sub-service is handled Dcm-internally.
              integer DcmDsdSubServiceId: 0..255, set at link in variant link-time / pre-compile in variant post-build+pre-compile  # Id of the SubService identifier. The possible Subfunction parameter value are predefined in the ISO 14229-1 and ISO 15031-5.
              reference DcmDsdSubServiceModeRuleRef [0..1]: set at link in variant link-time / pre-compile in variant post-build+pre-compile, destination=DcmModeRule  # Reference to DcmDspModeRule | Mode rule which controls execution of this the DcmDsdSubService. If there is no reference, no check of the mode rule shall be done.
              reference DcmDsdSubServiceSecurityLevelRef [0..*]: set at link in variant link-time / pre-compile in variant post-build+pre-compile, destination=DcmDspSecurityRow  # Link to the Security Level needed for execution of the DcmDsdSubService. | Please refer to the ISO 14229-1, ISO 15031-5 and "Verification of the Diagnostic Session". Please note, that it shall be provided to configure several DcmDsdSubServiceSecurityLevelRef per DcmDsdSubService. If there is no reference, no check of security level shall be done.
              reference DcmDsdSubServiceSessionLevelRef [0..*]: set at link in variant link-time / pre-compile in variant post-build+pre-compile, destination=DcmDspSessionRow  # Link to the Session Control needed for execution of the DcmDsdSubService. | Please refer to the ISO 14229-1, ISO 15031-5 and "Verification of the Diagnostic Session". Please note, that it shall be provided to configure several DcmDsdSubServiceSessionLevelRef per DcmDsdSubService. If there is no reference, no check of session level shall be done.
      container DcmDsl  # These parameters apply to a Diagnostic Session Layer. There may be a parameter set (DSL Configuration) per protocol. | upperMultiplicity: Each DCM configuration must have exactly one DSL configuration. lowerMultiplicity: Each DCM configuration must have exactly one DSL configuration.
        container DcmDslBuffer [1..256]  # This container contains the configuration (parameters) for the diagnostic buffer.
          integer DcmDslBufferSize: 8..4294967294, set at pre-compile  # Size of Diagnostic Buffer (in Bytes) | For a linear buffer: size of the buffer shall be as large as the longest message (request or response) For a paged buffer (only Tx possible): size has impacts on the application performance Please note: max. range is the valid range for a CAN network. We assume a FlexRay (or other networks) implementation will work with this range (and the page buffer mechanism) without any problems.
        container DcmDslCallbackDCMRequestService [1..*]  # The name of this container is used to define the name of the R-Port through which the DCM access the interface CallbackDCMRequestServices. | The R-Port is named CallbackDCMRequestServices_<SWC> where _<SWC> is the name of the container DcmDslCallbackDCMRequestService.
        container DcmDslDiagResp  # This container contains the configuration (parameters) for the ResponsePending handling
          integer DcmDslDiagRespMaxNumRespPend: 0..255, set at link in variant link-time / post-build in variant post-build / pre-compile in variant pre-compile, origin=AUTOSAR_ECUC V1.0.0  # Maximum number of negative responses with response code 0x78 (requestCorrectlyReceived-ResponsePending) allowed per request. DCM will send a negative response with response code 0x10 (generalReject), in case the limit value gets reached. | Value 0xFF means that no limit number of NRC 0x78 response apply.
          boolean DcmDslDiagRespOnSecondDeclinedRequest: set at link in variant link-time / post-build in variant post-build / pre-compile in variant pre-compile, origin=AUTOSAR_ECUC V1.0.0  # Defines the reaction upon a second request (ClientB) that can not be processed (e.g. due to priority assessment). | TRUE: when the second request (Client B) can not be processed, it shall be answered with NRC21 BusyRepeatRequest. FALSE: when the second request (Client B) can not be processed, it shall not be responded.
        container DcmDslProtocol  # This container contains the configuration (parameters) for the protocol configuration (for each protocol) The following parameters needs to be configured per protocol.
          container DcmDslProtocolRow [1..*]  # Definition of a single Row of configuration for the protocol configuration (for each protocol)
            boolean DcmDslProtocolEndiannessConvEnabled: set at link in variant link-time / pre-compile in variant post-build+pre-compile, origin=AUTOSAR_ECUC V1.0.0  # Enables /disables the endianness conversion, per diagnostic | protocol.
            enumeration DcmDslProtocolID: {DCM_OBD_ON_CAN, DCM_OBD_ON_FLEXRAY, DCM_OBD_ON_IP, DCM_PERIODICTRANS_ON_IP, DCM_PERIODIC_ON_CAN, DCM_PERIODIC_ON_FLEXRAY, DCM_ROE_ON_CAN, DCM_ROE_ON_FLEXRAY, DCM_ROE_ON_IP, DCM_SUPPLIER_1, DCM_SUPPLIER_10, DCM_SUPPLIER_11, DCM_SUPPLIER_12, DCM_SUPPLIER_13, DCM_SUPPLIER_14, DCM_SUPPLIER_15, DCM_SUPPLIER_2, DCM_SUPPLIER_3, DCM_SUPPLIER_4, DCM_SUPPLIER_5, DCM_SUPPLIER_6, DCM_SUPPLIER_7, DCM_SUPPLIER_8, DCM_SUPPLIER_9, DCM_UDS_ON_CAN, DCM_UDS_ON_FLEXRAY, DCM_UDS_ON_IP}, set at link in variant link-time / post-build in variant post-build / pre-compile in variant pre-compile, symbolic-name-value=true  # The diagnostic protocol type for the DCM DSL protocol that is being configured. | Implementation Type: Dcm_ProtocolType
            boolean DcmDslProtocolIsParallelExecutab: set at link in variant link-time / pre-compile in variant post-build+pre-compile, origin=AUTOSAR_ECUC V1.0.0  # Enables the parallel processing of ROE or Periodic Transmission protocol. Only these both protocols are allowed to run in parallel to normal protocol (UDS, OBD).
            float DcmDslProtocolPreemptTimeout: 0..1000, set at link in variant link-time / post-build in variant post-build / pre-compile in variant pre-compile  # This is the value for the timeout (in milliseconds) of preempting protocol until protocol needs to be started. | This is defined in the AUTOSAR SWS for DCM as a uint16. The AUTOSAR configuration standard is to use SI units, so this parameter is defined as a float value in seconds. DCM configuration tools must convert this float value to the appropriate value format for the use in the software implementation of DCM. min: A negative value is not allowed. upperMultiplicity: Exactly one DcmDslProtocolPreemptTimeout value per DSL protocol timing structure. lowerMultiplicity: Exactly one DcmDslProtocolPreemptTimeout value per DSL timing structure. origin: Standard AUTOSAR configuration parameter.
            integer DcmDslProtocolPriority: 0..255, set at link in variant link-time / post-build in variant post-build / pre-compile in variant pre-compile  # The SWS for DCM defines this item as uint8. This is the protocol priority that is used during protocol preemption handling. | 0 = Highest priority (protocol may not be preempted by other protocols) 1, 2, 3... = Reducing priority. Protocol may be preempted by other protocols with lower priority value. upperMultiplicity: Exactly one priority must be provided per Tx Protocol. lowerMultiplicity: Exactly one priority must be provided per Tx Protocol. origin: Standard AUTOSAR configuration parameter.
            enumeration DcmDslProtocolTransType [0..1]: {TYPE1, TYPE2}, set at link in variant link-time / post-build in variant post-build / pre-compile in variant pre-compile, origin=AUTOSAR_ECUC V1.0.0  # Selects the transmission type for protocol.
            boolean DcmSendRespPendOnTransToBoot: set at link in variant link-time / post-build in variant post-build / pre-compile in variant pre-compile, default-value=true  # Parameter specifying if the ECU should send a NRC 0x78 (response pending) before transitioning to the bootloader (parameter set to TRUE) or if the transition shall be initiated without sending NRC 0x78 (parameter set to FALSE).
            float DcmTimStrP2ServerAdjust: 0..1000, set at link in variant link-time / post-build in variant post-build / pre-compile in variant pre-compile  # This parameter is used to gurantee that the DCM response is available on the bus before reaching P2.This parameter value in milliseconds has to be configured as a multiple of DcmTaskTime and is minimum in the timing handling of P2. | The AUTOSAR configuration standard is to use SI units, so this parameter is defined as a float value in seconds. DCM configuration tools must convert this float value to the appropriate value format for the use in the software implementation of DCM.
            float DcmTimStrP2StarServerAdjust: 0..5000, set at link in variant link-time / post-build in variant post-build / pre-compile in variant pre-compile  # This parameter is used to gurantee that the DCM response is available on the bus before reaching P2*.This parameter value in milliseconds has to be configured as multiple of DcmTaskTime and is minimum in the timing handling of P2*. | The AUTOSAR configuration standard is to use SI units, so this parameter is defined as a float value in seconds. DCM configuration tools must convert this float value to the appropriate value format for the use in the software implementation of DCM.
            reference DcmDslProtocolRxBufferID: set at link in variant link-time / post-build in variant post-build / pre-compile in variant pre-compile, destination=DcmDslBuffer  # Link to buffer configuration (DcmDslBuffer) for configuration of protocol buffer used for Rx actions. | upperMultiplicity / lowerMultiplicity:: Exactly one Rx buffer is required for protocol reception
            reference DcmDslProtocolSIDTable: set at link in variant link-time / post-build in variant post-build / pre-compile in variant pre-compile, destination=DcmDsdServiceTable  # Link to the used diagnostic service table for this protocol. | upperMultiplicity: Must have exactly one service table for the protocol. lowerMultiplicity: Must have exactly one service table for the protocol.
            reference DcmDslProtocolSessionRef [0..1]: set at link in variant link-time / pre-compile in variant post-build+pre-compile, destination=DcmDspSession  # Reference to the DcmDspSession table used for this protocol ConfigurationClass.
            reference DcmDslProtocolTxBufferID: set at link in variant link-time / post-build in variant post-build / pre-compile in variant pre-compile, destination=DcmDslBuffer  # Link to buffer configuration (DcmDslBuffer) for configuration of protocol buffer used for Tx actions. | upperMultiplicity / lowerMultiplicity:: Exactly one Tx buffer is required for protocol transmission.
            choice container DcmDslConnection [1..*]  # This container contains links between Diagnostic Protocol (=DcmDslProtocolRow) and the according Rx or Tx channel. | Because of the usecase to allow more then one diagnostic tester (using different CAN channels) it is necessary to allow configuration of multiple DcmDslConnections.
              container DcmDslMainConnection [0..1]  # This container contains configuration for Diagnostic Main Connection | (DcmDslProtocolTx, DcmDslProtocolRx). In addition it contains links to the ROE connection (DcmDslROEConnectionRef) and the Periodic Transmission Connection (DcmDslPeriodicTranmissionConRef) relevant for protocols with DcmDslProtocolTransType = TYPE2 or TYPE1.
                integer DcmDslProtocolRxTesterSourceAddr: 0..65535, set at link in variant link-time / post-build in variant post-build / pre-compile in variant pre-compile  # Tester source address uniquely describes a client and will be used e.g. within | the jump to Bootloader interfaces.
                reference DcmDslPeriodicTranmissionConRef [0..1]: set at link in variant link-time / post-build in variant post-build / pre-compile in variant pre-compile, origin=AUTOSAR_ECUC V1.0.0, destination=DcmDslPeriodicTransmission  # Configures the link to the connection of PeriodicTransmission protocol for the processing of the PeriodicTransmission events.
                reference DcmDslROEConnectionRef [0..1]: set at link in variant link-time / post-build in variant post-build / pre-compile in variant pre-compile, origin=AUTOSAR_ECUC V1.0.0, destination=DcmDslResponseOnEvent  # Configures the link to the connection of ROE protocol for processing of the ROE events.
                container DcmDslProtocolRx [1..*]  # This container contains the configuration (parameters) for the protocol configuration of RX channel (for each protocol) | The following parameters needs to be configured per protocol. Please keep in mind, that the parameter DcmDslProtocolRxPduId can be given several times per protocol and that the combination from DcmDslProtocolRxPduId and DcmDslProtocolRxAddrType is unique. Only one physical protocol is allowed per connection. upperMultiplicity: More than one receive PDU ID may be configured for reception (e.g. one for func requests, one for phys requests). lowerMultiplicity: At least one receive PDU ID configuration must be provided per protocol.
                  enumeration DcmDslProtocolRxAddrType: {DCM_FUNCTIONAL_TYPE, DCM_PHYSICAL_TYPE}, set at link in variant link-time / post-build in variant post-build / pre-compile in variant pre-compile  # Declares the communication type of this DCM_PROTOCOL_DCMRXPDUID. | PHYSICAL is used for 1 to 1 communication FUNCTIONAL is used for 1 to n communication
                  integer DcmDslProtocolRxChannelId: 0..255, set at link in variant link-time / post-build in variant post-build / pre-compile in variant pre-compile  # Channel Identifier associated to the received Pdu.
                  integer DcmDslProtocolRxPduId: 0..65535, set at link in variant link-time / post-build in variant post-build / pre-compile in variant pre-compile, symbolic-name-value=true  # DcmRxPduId value for reception of requests.
                  reference DcmDslProtocolRxPduRef: set at link in variant link-time / post-build in variant post-build / pre-compile in variant pre-compile, destination=Pdu  # DcmRxPduId reference for reception of requests / Multiple links shall be allowed. (e.g. one DcmRxPduId to receive func requests, one DcmRxPduId to receive phys requests)
                  symbolic name reference DcmDslProtocolRxComMChannelRef: set at link in variant link-time / post-build in variant post-build / pre-compile in variant pre-compile, destination=ComMChannel  # Reference to the ComMChannel on which the DcmDslProtocolRxPdu is received.
                container DcmDslProtocolTx  # This container contains the configuration (parameters) for the protocol configuration of TX channel (for each protocol) | The included parameters needs to be configured per protocol.
                  integer DcmDslTxConfirmationPduId: 0..65535, set at link in variant link-time / post-build in variant post-build / pre-compile in variant pre-compile, symbolic-name-value=true  # Handle Id to be used by the Lower Layer to confirm the transmission of the DcmDsProtocolTxPdu to the LowerLayer.
                  reference DcmDslProtocolTxPduRef: set at link in variant link-time / post-build in variant post-build / pre-compile in variant pre-compile, destination=Pdu  # DcmTxPduId reference for transmission of responses
              container DcmDslPeriodicTransmission [0..1]  # This container contains the configuration (parameters) for Periodic Transmission service. | Hint: Periodic Transmission request comes via DcmDslMainConnection and PeriodicTransmission Event response is given via DcmDslPeriodicTransmission.
                container DcmDslPeriodicConnection [0..*]  # Holding the TxPduId configuration for PeriodicTransmission.
                  integer DcmDslPeriodicTxConfirmationPduId: 0..65535, set at link in variant link-time / post-build in variant post-build / pre-compile in variant pre-compile, symbolic-name-value=true  # Handle Id to be used by the Lower Layer to confirm the transmission of the DcmDslPeriodicTxPdu to the LowerLayer.
                  reference DcmDslPeriodicTxPduRef: set at link in variant link-time / post-build in variant post-build / pre-compile in variant pre-compile, destination=Pdu  # This is the reference to the PDU ID to be used by this DCM when sending Periodic Transmissions. It is only needed for Type2 Periodic Transmissions configurations. | upperMultiplicity: one or several DcmDslPeriodicTxPduRef can be defined if Periodic Transmission is enabled and TYPE2 Periodic Transmissions is configured. lowerMultiplicity: DcmDslPeriodicTxPduRef does not need to be defined if Periodic Transmission is not enabled or TYPE1 Periodic Transmissions is configured..
              container DcmDslResponseOnEvent [0..1]  # This container contains the configuration (parameters) for ResponseOnEvent service. | Hint: ROE service request is recept via DcmDslMainConnection and that Event response is given via DcmDslResposeOnEvent
                integer DcmDslRoeTxConfirmationPduId [0..1]: 0..65535, set at link in variant link-time / post-build in variant post-build / pre-compile in variant pre-compile, symbolic-name-value=true  # Handle Id to be used by the Lower Layer to confirm the transmission of the DcmDslRoeTxPdu to the LowerLayer.
                reference DcmDslRoeTxPduRef [0..1]: set at link in variant link-time / post-build in variant post-build / pre-compile in variant pre-compile, destination=Pdu  # Reference to the PDU for transmission of ROE response (only needed for ROE Transmission Type is TYPE2) | upperMultiplicity: One PDU required if ROE Transmission Type is TYPE2. lowerMultiplicity: No PDU required if ROE Transmission Type is TYPE1.
        container DcmDslServiceRequestManufacturerNotification [0..*]  # The name of this container is used to define the name of the R-Port through which the DCM accesses the interface ServiceRequestNotification. | The R-Port is named ServiceRequestManufacturerNotification_<SWC>; where <SWC> is the name of the container DcmDslServiceRequestManufacturerNotification. The lowerMultiplicity is 0: If DcmRequestManufacturerNotificationEnabled = false the Indication API is not available.
        container DcmDslServiceRequestSupplierNotification [0..*]  # The name of this container is used to define the name of the R-Port through which the DCM accesses the interface ServiceRequestNotification. | The R-Port is named ServiceRequestSupplierNotification_<SWC> where <SWC> is the name of the container DcmDslServiceRequestSupplierNotification. The lowerMultiplicity is 0: If DcmRequestSupplierNotification = false the Indication API is not available.
      container DcmDsp [0..1]  # These parameters apply to Diagnostic Service Processing. There will always be one set of these parameters per DCM.
        integer DcmDspMaxDidToRead [0..1]: 0..65535, set at link in variant link-time / pre-compile in variant post-build+pre-compile  # Indicates the maximum allowed DIDs in a single "ReadDataByIdentifier" request. | If set to 0, then no limitation is applied.
        integer DcmDspPowerDownTime [0..1]: 0..255, set at link in variant link-time / pre-compile in variant post-build+pre-compile  # This parameter indicates to the client the minimum time of the stand-by sequence the server will remain in the power-down sequence. | The resolution of this parameter is one second per count. The following values are valid: 00 - FE hex: 0 - 254 s powerDownTime; FF hex: indicates a failure or time not available.
        container DcmDspComControl [0..1]
          container DcmDspComControlAllChannel [0..*]  # Collection of ComM channels which shall be controlled if all networks are addressed.
            symbolic name reference DcmDspAllComMChannelRef: set at link in variant link-time / post-build in variant post-build / pre-compile in variant pre-compile, destination=ComMChannel  # Reference to ComM channel.
          container DcmDspComControlSetting [0..1]  # Provide the configuration of the Communication control.
            reference DcmDspComControlCommunicationReEnableModeRuleRef [0..1]: set at link in variant link-time / pre-compile in variant post-build+pre-compile, destination=DcmModeRule  # Reference to DcmDspModeRule Mode rule which controls re-enabling | of communication by DCM. The DCM module shall call BswM_Dcm_CommunicationMode_CurrentState(DCM_ENABLE_RX_TX_NORM_NM)) in case that the referenced mode rule is not fulfilled anymore.
          container DcmDspComControlSpecificChannel [0..*]  # Assigns subnet number to ComM channel which will be controlled.
            integer DcmDspSubnetNumber: 1..14, set at pre-compile  # Subnet Number which controls the specific ComMChannel.
            symbolic name reference DcmDspSpecificComMChannelRef: set at link in variant link-time / post-build in variant post-build / pre-compile in variant pre-compile, destination=ComMChannel  # Reference to ComM channel.
        container DcmDspControlDTCSetting [0..1]  # Provide the configuration of the ControlDTCSetting mechanism.
          reference DcmDspControlDTCSettingReEnableModeRuleRef [0..1]: set at link in variant link-time / pre-compile in variant post-build+pre-compile, destination=DcmModeRule  # Reference to DcmDspModeRule | Mode rule which controls re-enabling of controlDTCsetting by DCM. The DCM module shall execute a ControlDTCSetting.Off (call Dem_EnableDTCSetting()) in case that the referenced mode rule is not fulfilled anymore.
        container DcmDspData [0..*]  # This container contains the configuration (parameters) of a Data belonging to a DID
          function name DcmDspDataConditionCheckReadFnc [0..1]: set at pre-compile  # Function name to demand application if the conditions (e.g. System state) to read the DID are correct. (ConditionCheckRead-function). | Multiplicity shall be equal to parameter DcmDspDataReadFnc. Only relevant if DcmDspDataUsePort=="USE_DATA_SYNCH_FNC or DcmDspDataUsePort==USE_DATA_ASYNCH_FNC". This parameter is related to the interface Xxx_ConditionCheckRead.
          function name DcmDspDataEcuSignal [0..1]: set at pre-compile  # Function name to control the access to a certain ECU Signal by the DCM. (IoHwAb_Dcm_<EcuSignalName>-function). | Only relevant if DcmDspDataUsePort==USE_ECU_SIGNAL.
          function name DcmDspDataFreezeCurrentStateFnc [0..1]: set at pre-compile  # Function name to request to application to freeze the current state of an IOControl. (FreezeCurrentState-function). | Only relevant if DcmDspDataUsePort=="USE_DATA_SYNCH_FNC or DcmDspDataUsePort==USE_DATA_ASYNCH_FNC". This parameter is related to the interface Xxx_FreezeCurrentState.
          function name DcmDspDataGetScalingInfoFnc [0..1]: set at pre-compile  # Function name to request to application the scaling information of the DID. (GetScalingInformation-function). | Only relevant if DcmDspDataUsePort=="USE_DATA_SYNCH_FNC or DcmDspDataUsePort==USE_DATA_ASYNCH_FNC". This parameter is related to the interface Xxxx_GetScalingInformation.
          function name DcmDspDataReadDataLengthFnc [0..1]: set at pre-compile  # Function name to request from application the data length of a DID. (ReadDataLength-function). | Only relevant if DcmDspDataUsePort=="USE_DATA_SYNCH_FNC or DcmDspDataUsePort==USE_DATA_ASYNCH_FNC". This parameter is related to the interface Xxx_ReadDataLength.
          function name DcmDspDataReadEcuSignal [0..1]: set at pre-compile  # Function name for read access to a certain ECU Signal by the DCM. (IoHwAb_Dcm_Read<EcuSignalName>-function). | Only relevant if DcmDspDataUsePort==USE_ECU_SIGNAL.
          function name DcmDspDataReadFnc [0..1]: set at pre-compile  # Function name to request from application the data value of a DID. (ReadData-function). | Multiplicity shall be equal to parameter DcmDspDataConditionCheckReadFnc. Only relevant if DcmDspDataUsePort=="USE_DATA_SYNCH_FNC or DcmDspDataUsePort==USE_DATA_ASYNCH_FNC". This parameter is related to the interface Xxx_ReadData.
          function name DcmDspDataResetToDefaultFnc [0..1]: set at pre-compile  # Function name to request to application to reset an IOControl to default value. (ResetToDefault-function). | Only relevant if DcmDspDataUsePort=="USE_DATA_SYNCH_FNC or DcmDspDataUsePort==USE_DATA_ASYNCH_FNC". This parameter is related to the interface Xxx_ResetToDefault.
          function name DcmDspDataReturnControlToEcuFnc [0..1]: set at pre-compile  # Function name to request to application to return control to ECU of an IOControl. (ReturnControlToECU-function). | Only relevant if DcmDspDataUsePort=="USE_DATA_SYNCH_FNC or DcmDspDataUsePort==USE_DATA_ASYNCH_FNC". This parameter is related to the interface Xxx_ReturnControlToECU.
          function name DcmDspDataShortTermAdjustmentFnc [0..1]: set at pre-compile  # Function name to request to application to adjuste the IO signal. (ShortTermAdjustment-function). | Only relevant if DcmDspDataUsePort=="USE_DATA_SYNCH_FNC or DcmDspDataUsePort==USE_DATA_ASYNCH_FNC". This parameter is related to the interface Xxx_ShortTermAdjustment.
          integer DcmDspDataSize: 0..65535, set at link in variant link-time / pre-compile in variant post-build+pre-compile  # Length of data in bits associated to the Data. If Data has variable datalength, that corresponds to the maximum datalength.
          enumeration DcmDspDataType [0..1]: {BOOLEAN, SINT16, SINT32, SINT8, UINT16, UINT32, UINT8}, set at link in variant link-time / pre-compile in variant post-build+pre-compile  # Provide the data type of Data belonging to a DID.
          enumeration DcmDspDataUsePort: {USE_BLOCK_ID, USE_DATA_ASYNCH_CLIENT_SERVER, USE_DATA_ASYNCH_FNC, USE_DATA_SENDER_RECEIVER, USE_DATA_SYNCH_CLIENT_SERVER, USE_DATA_SYNCH_FNC, USE_ECU_SIGNAL}, set at pre-compile  # Define wich interface shall be used to access the data.
          function name DcmDspDataWriteFnc [0..1]: set at pre-compile  # Function name to request application to write the data value of a DID. (WriteData-function). | Only relevant if DcmDspDataUsePort=="USE_DATA_SYNCH_FNC or DcmDspDataUsePort==USE_DATA_ASYNCH_FNC". This parameter is related to the interface Xxx_WriteData.
          reference DcmDspDataInfoRef: set at pre-compile, destination=DcmDspDataInfo  # Reference to 1 DcmDspDataInfo
          symbolic name reference DcmDspDataBlockIdRef [0..1]: set at pre-compile, origin=AUTOSAR_ECUC V1.0.0, destination=NvMBlockDescriptor  # NRAM blockId to access the data. | Only relevant if DcmDspDataUsePort==USE_BLOCK_ID.
        container DcmDspDataInfo [0..*]  # This container contains the configuration (parameters) of a Data
          boolean DcmDspDataFixedLength: set at link in variant link-time / pre-compile in variant post-build+pre-compile  # Indicates if the datalength of the Data is fixed | true = datalength of the Data is fixed false = datalength of the Data is variable
          integer DcmDspDataScalingInfoSize [0..1]: 0..4294967295, set at link in variant link-time / pre-compile in variant post-build+pre-compile  # If Scaling information service is available for this Data, it provides the size of the scaling information.
        container DcmDspDid [0..*]  # This container contains the configuration (parameters) of the DID.
          integer DcmDspDidIdentifier: 0..65535, set at link in variant link-time / pre-compile in variant post-build+pre-compile  # 2 byte Identifier of the DID
          boolean DcmDspDidRoeQueueEnabled [0..1]: set at link in variant link-time / pre-compile in variant post-build+pre-compile  # If set to TRUE, the ROE queue mechanism will be used in case of ROE OnChangeOfDataIdentifier on this DID. | If set to FALSE, the ROE event will be sent without queuing.
          boolean DcmDspDidUsed: set at link in variant link-time / post-build in variant post-build / pre-compile in variant pre-compile  # Allow to activate or deactivate the usage of a DID, for multi purpose ECUs | true = DID available false = DID not available
          reference DcmDspDidInfoRef: set at link in variant link-time / pre-compile in variant post-build+pre-compile, destination=DcmDspDidInfo  # Reference to DcmDspDidInfo containing information on this DID.
          reference DcmDspDidRef [0..*]: set at link in variant link-time / pre-compile in variant post-build+pre-compile, destination=DcmDspDid  # Reference to DcmDspDid in case this DID refer to one or serveral other DID's
          container DcmDspDidExtRoe [0..1]  # Provide information to manage a responseOnEvent request on this DID externally. If this container doesn't exist, an ROE event on this DID will be managed internally.
            function name DcmDspDidRoeActivateFnc [0..1]: set at link in variant link-time / pre-compile in variant post-build+pre-compile  # Function name to activate/deactivate an ROE event managed externally. Only relevant if DcmDspDataUsePort== USE_DATA_SYNCH_FNC or USE_DATA_ASYNCH_FNC. This parameter is related to the interface xxx_ActivateEvent.
            integer DcmDspDidRoeEventId: 0..255, set at link in variant link-time / pre-compile in variant post-build+pre-compile  # EventId to be used within Apis Dcm_TriggerOnEvent() and xxx_ActivateEvent()
          container DcmDspDidSignal [0..*]  # This container defines the reference to 1 DcmDspData container and position relevant for this DID.
            integer DcmDspDidDataPos: 0..65535, set at link in variant link-time / pre-compile in variant post-build+pre-compile  # Defines the position of the data defined by DcmDspDidDataRef reference to DcmDspData container in the DID. | The position is defined in bits.
            reference DcmDspDidDataRef: set at link in variant link-time / pre-compile in variant post-build+pre-compile, destination=DcmDspData  # Reference to 1 DcmDspData container relevant for this DID.
        container DcmDspDidInfo [0..*]  # This container contains the configuration (parameters) of the DID's Info
          boolean DcmDspDidDynamicallyDefined: set at link in variant link-time / pre-compile in variant post-build+pre-compile  # Indicates if this DID can be dynamically defined | true = DID can be dynamically defined false = DID can not be dynamically defined
          container DcmDspDidAccess  # This container contains the configuration (parameters) of the DID access
            container DcmDspDidControl [0..1]  # This container contains the configuration (parameters) of the DID control.
              boolean DcmDspDidFreezeCurrentState [0..1]: set at pre-compile  # This indicates the presence of "FreezeCurrentState".
              boolean DcmDspDidResetToDefault [0..1]: set at pre-compile  # This indicates the presence of "ResetToDefault".
              boolean DcmDspDidReturnControlToEcu [0..1]: set at pre-compile  # This indicates the presence of "ReturnControlToEcu".
              boolean DcmDspDidShortTermAdjustment [0..1]: set at pre-compile  # This indicates the presence of "ShortTermAdjustment".
              reference DcmDspDidControlModeRuleRef [0..1]: set at link in variant link-time / pre-compile in variant post-build+pre-compile, destination=DcmModeRule  # Reference to DcmDspModeRule | Mode rule which controls this DID. If there is no reference, no check of the mode rule shall be done.
              reference DcmDspDidControlSecurityLevelRef [0..*]: set at link in variant link-time / pre-compile in variant post-build+pre-compile, destination=DcmDspSecurityRow  # Reference to DcmDspSecurityRow | Security levels allowed to control this DID. If there is no reference, no check of security level shall be done.
              reference DcmDspDidControlSessionRef [0..*]: set at link in variant link-time / pre-compile in variant post-build+pre-compile, destination=DcmDspSessionRow  # Reference to DcmDspSessionRow | Sessions allowed to control this DID. If there is no reference, no check of session level shall be done.
            container DcmDspDidRead [0..1]  # This container contains the configuration (parameters) of the DID read.
              reference DcmDspDidReadModeRuleRef [0..1]: set at link in variant link-time / pre-compile in variant post-build+pre-compile, destination=DcmModeRule  # Reference to DcmDspModeRule | Mode rule which controls to read this DID. If there is no reference, no check of the mode rule shall be done.
              reference DcmDspDidReadSecurityLevelRef [0..*]: set at link in variant link-time / pre-compile in variant post-build+pre-compile, destination=DcmDspSecurityRow  # Reference to DcmDspSecurityRow | Security levels allowed to read this DID. If there is no reference, no check of security level shall be done.
              reference DcmDspDidReadSessionRef [0..*]: set at link in variant link-time / pre-compile in variant post-build+pre-compile, destination=DcmDspSessionRow  # Reference to DcmDspSessionRow | Sessions allowed to read this DID. If there is no reference, no check of session level shall be done.
            container DcmDspDidWrite [0..1]  # This container contains the configuration (parameters) of the DID write.
              reference DcmDspDidWriteModeRuleRef [0..1]: set at link in variant link-time / pre-compile in variant post-build+pre-compile, destination=DcmModeRule  # Reference to DcmDspModeRule | Mode rule which controls to write this DID. If there is no reference, no check of the mode rule shall be done.
              reference DcmDspDidWriteSecurityLevelRef [0..*]: set at link in variant link-time / pre-compile in variant post-build+pre-compile, destination=DcmDspSecurityRow  # Reference to DcmDspSecurityRow | Security levels allowed to write this DID. If there is no reference, no check of security level shall be done.
              reference DcmDspDidWriteSessionRef [0..*]: set at link in variant link-time / pre-compile in variant post-build+pre-compile, destination=DcmDspSessionRow  # Reference to DcmDspSessionRow | Sessions allowed to write this DID. If there is no reference, no check of session level shall be done.
        container DcmDspDidRange [0..*]  # This container defines the DID Range
          boolean DcmDspDidRangeHasGaps: set at link in variant link-time / pre-compile in variant post-build+pre-compile  # Parameter specifying if there are gaps in the DID range (parameter set to TRUE) or not (parameter set to FALSE)
          integer DcmDspDidRangeIdentifierLowerLimit: 0..65535, set at link in variant link-time / pre-compile in variant post-build+pre-compile  # Lower limit of DID range.
          integer DcmDspDidRangeIdentifierUpperLimit: 0..65535, set at link in variant link-time / pre-compile in variant post-build+pre-compile  # Upper limit of DID range.
          function name DcmDspDidRangeIsDidAvailableFnc [0..1]: set at pre-compile  # Function name to request from application if a specific DID is available within the range or not. | Only relevant if DcmDspDidRangeUsePort is set to false. This parameter is related to the interface Xxx_IsDidAvailable.
          integer DcmDspDidRangeMaxDataLength: 0..65535, set at link in variant link-time / pre-compile in variant post-build+pre-compile  # Maximum data length in bytes
          function name DcmDspDidRangeReadDidFnc [0..1]: set at pre-compile  # Function name to request from application the data range value of a DID.(ReadData-function). | Only relevant if DcmDspDidRangeUsePort is set to false. This parameter is related to the interface Xxx_ReadDidData.
          boolean DcmDspDidRangeUsePort: set at pre-compile  # When the parameter DcmDspDidRangeUsePort is set to true the DCM will access the Data using an R-Port requiring a PortInteface DataServices_DIDRange. In that case, DcmDspDidRangeIsDidAvailableFnc, DcmDspDidRangeReadDidFnc and DcmDspDidRangeWriteDidFnc are ignored and the RTE APIs are used. When the parameter DcmDspDidRangeUsePort is false, the DCM calls the functions defined in DcmDspDidRangeIsDidAvailableFnc, DcmDspDidRangeReadDidFnc and DcmDspDidRangeWriteDidFnc.
          function name DcmDspDidRangeWriteDidFnc [0..1]: set at pre-compile  # Function name to request application to write the data range value of a DID.(WriteData-function). | Only relevant if DcmDspDidRangeUsePort is set to false. This parameter is related to the interface Xxx_WriteDidData.
          reference DcmDspDidRangeInfoRef: set at link in variant link-time / pre-compile in variant post-build+pre-compile, destination=DcmDspDidInfo  # Reference to DcmDspDidInfo containing information on this DID Range.
        container DcmDspMemory [0..1]  # This container contains the configuration of the memory access.
          boolean DcmDspUseMemoryId: set at link in variant link-time / pre-compile in variant post-build+pre-compile  # If this parameter is set to false, the DCM will not use MemoryIdentifier parameter. | The Dcm_WriteMemory and Dcm_ReadMemory callouts shall be called without the MemoryIdentifier parameter. If this parameter is set to true, the DCM will use MemoryIdentifier parameter to select the memory device to use. The Dcm_WriteMemory and Dcm_ReadMemory callouts shall be called with the MemoryIdentifier parameter.
          container DcmDspMemoryIdInfo [1..*]  # Provides the value of memory identifier used to select the desired memory device | This container contains the configuration of the memory access requested through diagnostic services : ReadMemoryByAddress, WriteMemoryByAddress, RequestDownload, RequestUpload
            integer DcmDspMemoryIdValue [0..1]: 0..255, set at link in variant link-time / pre-compile in variant post-build+pre-compile  # Value of the memory device identifer used. This parameter is only relevant if the memory Id parameter use is enabled. (DcmDspUseMemoryId = TRUE)
            container DcmDspReadMemoryRangeInfo [0..*]  # Provides the range of memory address allowed for reading
              integer DcmDspReadMemoryRangeHigh: 0..4294967294, set at link in variant link-time / pre-compile in variant post-build+pre-compile  # High memory address of a range allowed for reading
              integer DcmDspReadMemoryRangeLow: 0..4294967294, set at link in variant link-time / pre-compile in variant post-build+pre-compile  # Low memory address of a range allowed for reading
              reference DcmDspReadMemoryRangeModeRuleRef [0..1]: set at link in variant link-time / pre-compile in variant post-build+pre-compile, destination=DcmModeRule  # Reference to DcmDspModeRule | Mode rule which controls read access on this memory address. If there is no reference, no check of the mode rule shall be done.
              reference DcmDspReadMemoryRangeSecurityLevelRef [0..*]: set at link in variant link-time / pre-compile in variant post-build+pre-compile, destination=DcmDspSecurityRow  # Link to the Security Access Levels needed for read access on this memory address. If there is no reference, no check of security level shall be done.
            container DcmDspWriteMemoryRangeInfo [0..*]  # Provides the range of memory address allowed for writting.
              integer DcmDspWriteMemoryRangeHigh: 0..4294967294, set at link in variant link-time / pre-compile in variant post-build+pre-compile  # High memory address of a range allowed for writting.
              integer DcmDspWriteMemoryRangeLow: 0..4294967294, set at link in variant link-time / pre-compile in variant post-build+pre-compile  # Low memory address of a range allowed for writting
              reference DcmDspWriteMemoryRangeModeRuleRef [0..1]: set at link in variant link-time / pre-compile in variant post-build+pre-compile, destination=DcmModeRule  # Reference to DcmDspModeRule | Mode rule which controls write access on this memory address. If there is no reference, no check of the mode rule shall be done.
              reference DcmDspWriteMemoryRangeSecurityLevelRef [0..*]: set at link in variant link-time / pre-compile in variant post-build+pre-compile, destination=DcmDspSecurityRow  # Link to the Security Access Levels needed for write access on this memory address. If there is no reference, no check of security level shall be done.
        container DcmDspPid [0..*]  # This container defines the availability of a PID to the DCM.
          integer DcmDspPidIdentifier: 0..255, set at link in variant link-time / pre-compile in variant post-build+pre-compile  # 1 byte Identifier of the PID
          enumeration DcmDspPidService: {DCM_SERVICE_01, DCM_SERVICE_01_02, DCM_SERVICE_02}, set at link in variant link-time / pre-compile in variant post-build+pre-compile  # Allow to indicate if this PID is used for service $01 or/and $02.
          integer DcmDspPidSize: 0..255, set at link in variant link-time / pre-compile in variant post-build+pre-compile  # Length of the PID in byte.
          boolean DcmDspPidUsed: set at link in variant link-time / post-build in variant post-build / pre-compile in variant pre-compile  # Allow to activate or deactivate the usage of a PID, for multi purpose ECUs | true = PID available false = PID not available
          container DcmDspPidData [1..*]  # This container defines the parameter for a Signal in the PID.
            integer DcmDspPidDataPos: 0..2040, set at link in variant link-time / pre-compile in variant post-build+pre-compile  # This is the position in bit of the PID structure and will not start at position 0 in case a support information is availabe (for bit-mapped PIDs).
            integer DcmDspPidDataSize: 0..2040, set at link in variant link-time / pre-compile in variant post-build+pre-compile  # Length of data associated to the PID in bit.
            container DcmDspPidDataSupportInfo [0..1]  # This container defines the supported information.
              integer DcmDspPidDataSupportInfoBit: 0..255, set at link in variant link-time / pre-compile in variant post-build+pre-compile  # referenced Bit of the SupportInfo
              reference DcmDspPidDataSupportInfoRef: set at link in variant link-time / pre-compile in variant post-build+pre-compile, destination=DcmDspPidSupportInfo  # Reference to DcmDspPidSupportInfo
            container DcmDspPidService01 [0..1]  # Contains specific configuration parameter of PID for service $01. This container exists only if DcmDspPidService is set to DCM_SERVICE_01 or DCM_SERVICE_01_02.
              function name DcmDspPidDataReadFnc [0..1]: set at pre-compile  # Function name for reading PID data value. | This is only relevant if DcmDspPidDataUsePort==USE_DATA_SYNCH_FNC. This parameter is related to the interface Xxx_ReadData.
              enumeration DcmDspPidDataUsePort: {USE_DATA_SENDER_RECEIVER, USE_DATA_SYNCH_CLIENT_SERVER, USE_DATA_SYNCH_FNC}, set at pre-compile  # If this parameter is set to USE_DATA_SYNCH_FNC, the DCM will use the function defined in DcmDspPidDataReadFnc to get the PID data value. | If this parameter is set to USE_DATA_SYNCH_CLIENT_SERVER, the DCM will have an R-Port requiring the interface DataServices_<Data>. If this parameter is set to USE_DATA_SENDER_RECEIVER, the DCM will have an R-Port requiring a SenderReceiverInterface The R-Port is named DataServices_<Data> where <Data> is the name of the container DcmDspPidData.
            container DcmDspPidService02 [0..1]  # Contains specific configuration parameter of PID for service $02. This container exists only if DcmDspPidService is set to DCM_SERVICE_02 or DCM_SERVICE_01_02.
              reference DcmDspPidDataDemRef [0..1]: set at link in variant link-time / pre-compile in variant post-build+pre-compile, destination=DemPidDataElement  # Reference to DemPidDataElement in DEM configuration. Allows to link the DCM PID and DEM PID configuration for Mode $02.
          container DcmDspPidSupportInfo [0..*]  # This container defines the support information (typically byte A) to declare the usability of the data bytes within the so-called bit-mapped PIDs (e.g. PID$68).
            integer DcmDspPidSupportInfoLen: 0..255, set at link in variant link-time / pre-compile in variant post-build+pre-compile  # Length of the supported information in bytes.
            integer DcmDspPidSupportInfoPos: 0..255, set at link in variant link-time / pre-compile in variant post-build+pre-compile  # Position of the supported information in bytes.
        container DcmDspRequestControl [0..*]  # This container contains the configuration (parameters) of the "Request control of on-board system, test or component" service (Service $08). | The DCM will request the control using an R-Port requiring a PortInteface RequestControlServices_<TID> The R-Port is named RequestControlServices_<TID> where <TID> is the name of the container DcmDspRequestControl.
          integer DcmDspRequestControlInBufferSize: 0..4294967295, set at link in variant link-time / pre-compile in variant post-build+pre-compile
          integer DcmDspRequestControlOutBufferSize: 0..4294967295, set at link in variant link-time / pre-compile in variant post-build+pre-compile
          integer DcmDspRequestControlTestId: 0..255, set at link in variant link-time / pre-compile in variant post-build+pre-compile  # Test Id for Service $08
        container DcmDspRoe [0..1]  # Provide the configuration of the ResponseOnEvent mechanism.
          integer DcmDspRoeBufSize [0..1]: 0..65535, set at link in variant link-time / pre-compile in variant post-build+pre-compile  # Size of the buffer used to managed internally the subservice OnChangeOfDataIdentifier of ResponseOnEvent Service.
          function name DcmDspRoeInitFnc [0..1]: set at link in variant link-time / pre-compile in variant post-build+pre-compile  # Function name to initialize an ROE event managed externally.
          boolean DcmDspRoeInitOnDSC: set at link in variant link-time / pre-compile in variant post-build+pre-compile  # If set to TRUE the ROE functionality is re-initialized on reception of service DiagnosticSessionControl.
          float DcmDspRoeInterMessageTime: 0..5000, set at link in variant link-time / pre-compile in variant post-build+pre-compile  # Provide the minimum time in ms between two transmissions of ROE event. It is used for the delay between two different consecutive Roe transmissions and between two transmissions of the retry mechanism. | The AUTOSAR configuration standard is to use SI units, so this parameter is defined as float value in seconds. DCM configuration tools must convert this float value to the appropriate value format for the use in the software implementation of DCM. min: A negative value is not allowed.
          integer DcmDspRoeMaxEventLength [0..1]: 1..65535, set at link in variant link-time / pre-compile in variant post-build+pre-compile  # Provide the max size in byte of an ROE message that will be stored in the ROE transmission queue.
          integer DcmDspRoeMaxNumberOfRetry: 0..255, set at link in variant link-time / pre-compile in variant post-build+pre-compile  # Provide the max number of re-transmission of an ROE event in case of transmission failure. | If set to 0, no retry mechanism will be managed
          integer DcmDspRoeMaxQueueLength [0..1]: 1..65535, set at link in variant link-time / pre-compile in variant post-build+pre-compile  # Provide the max number of element in the ROE transmission queue.
          boolean DcmDspRoeQueueEnabled: set at link in variant link-time / pre-compile in variant post-build+pre-compile  # If set to TRUE, the ROE queue mechanism is enabled on DCM. | If set to FALSE, the ROE event will be sent without queuing.
          function name DcmDspRoeStopFnc [0..1]: set at link in variant link-time / pre-compile in variant post-build+pre-compile  # Function name to stop an ROE event managed externally.
        container DcmDspRoutine [0..*]  # This container contains the configuration (parameters) for Routines
          function name DcmDspRequestResultsRoutineFnc [0..1]: set at pre-compile  # Function name for request to application the results of a routine. (Routine_RequestResults-function) | This parameter is related to the interface Xxx_RequestResults.
          boolean DcmDspRequestResultsRoutineSupported: set at link in variant link-time / pre-compile in variant post-build+pre-compile  # Indicates if the optional requestRoutineResults in the RoutineControl is supported | true = requestRoutineResults is supported false = requestRoutineResults is not supported
          boolean DcmDspRoutineFixedLength: set at link in variant link-time / pre-compile in variant post-build+pre-compile  # Indicates if the datalength of the optional record in the RoutineControl request and response is fixed. | true = datalength of the optional record is fixed false = datalength of the optional record is variable In case DcmDspRoutineFixedLength is set to FALSE, the DcmDspRoutineSignalLength for the last signal is the maximum length (in bits) of the optional record.
          integer DcmDspRoutineIdentifier: 0..65535, set at link in variant link-time / pre-compile in variant post-build+pre-compile  # 2 bytes Identifier of the RID
          boolean DcmDspRoutineUsePort: set at pre-compile  # If this parameter is set to true, the DCM uses a port requiring a PortInterface RoutineServices_<ROUTINENAME>. | The R-Port is named RoutineServices_<ROUTINENAME> where <ROUTINENAME> is the name of the container DcmDspRoutine In that case, the configuration must not provide function names in DcmDspStartRoutineFnc, DcmDspStopRoutineFnc or DcmDspRequestResultsRoutineFnc. If this is false, the DCM expects to find the names of the functions to be used in DcmDspStartRoutineFnc, DcmDspStopRoutineFnc or DcmDspRequestResultsRoutineFnc.
          boolean DcmDspRoutineUsed: set at link in variant link-time / post-build in variant post-build / pre-compile in variant pre-compile  # Allow to activate or deactivate the usage of a Routine, for multi purpose ECUs | true = Routine available false = Routine not available
          function name DcmDspStartRoutineFnc [0..1]: set at pre-compile  # Function name for request to application to start a routine. (Routine_Start-function) | This parameter is related to the interface Xxx_Start.
          function name DcmDspStopRoutineFnc [0..1]: set at pre-compile  # Function name for request to application to stop a routine. (Routine_Stop-function) | This parameter is related to the interface Xxx_Stop.
          boolean DcmDspStopRoutineSupported: set at link in variant link-time / pre-compile in variant post-build+pre-compile  # Indicates if the optional stopRoutine in the RoutineControl is supported | true = stopRoutine is supported false = stopRoutine is not supported
          reference DcmDspRoutineInfoRef: set at link in variant link-time / pre-compile in variant post-build+pre-compile, destination=DcmDspRoutineInfo  # Reference to DcmDspRoutineInfo containing information on this routine.
        container DcmDspRoutineInfo [0..*]  # This container contains the configuration (parameters) for Routine's Info.
          container DcmDspRoutineAuthorization  # This container contains the configuration (parameters) for the Routine Authorization.
            reference DcmDspRoutineModeRuleRef [0..1]: set at link in variant link-time / pre-compile in variant post-build+pre-compile, destination=DcmModeRule  # Reference to DcmDspModeRule | Mode rule which controls this RID. If there is no reference, no check of the mode rule shall be done.
            reference DcmDspRoutineSecurityLevelRef [0..*]: set at link in variant link-time / pre-compile in variant post-build+pre-compile, destination=DcmDspSecurityRow  # Reference to DcmDspSecurityRow | Security levels allowed to control this RID. If there is no reference, no check of security level shall be done.
            reference DcmDspRoutineSessionRef [0..*]: set at link in variant link-time / pre-compile in variant post-build+pre-compile, destination=DcmDspSessionRow  # Reference to DcmDspSessionRow | Sessions allowed to control this RID. If there is no reference, no check of session level shall be done.
          container DcmDspRoutineRequestResOut [0..1]  # Provide description of output parameter of RequestResult subservice for RoutineControl service.
            container DcmDspRoutineRequestResOutSignal [1..*]  # Provide description of a routine signal used in RoutineControl service.
              integer DcmDspRoutineSignalLength: 0..65535, set at link in variant link-time / pre-compile in variant post-build+pre-compile  # Provide the length in bits of the signal in the RoutineControl request/response
              integer DcmDspRoutineSignalPos: 0..65535, set at link in variant link-time / pre-compile in variant post-build+pre-compile  # Provide the position of the signal in the RoutineControl request/response. | The position is defined in bits.
              enumeration DcmDspRoutineSignalType: {BOOLEAN, SINT16, SINT32, SINT8, UINT16, UINT32, UINT8, VARIABLE_LENGTH}, set at link in variant link-time / pre-compile in variant post-build+pre-compile  # Provide the type of the signal in the RoutineControl request/response.
          container DcmDspRoutineStopIn [0..1]  # Provide description of input parameter of Stop subservice for RoutineControl service.
            container DcmDspRoutineStopInSignal [1..*]  # Provide description of a routine signal used in RoutineControl service.
              integer DcmDspRoutineSignalLength: 0..65535, set at link in variant link-time / pre-compile in variant post-build+pre-compile  # Provide the length in bits of the signal in the RoutineControl request/response
              integer DcmDspRoutineSignalPos: 0..65535, set at link in variant link-time / pre-compile in variant post-build+pre-compile  # Provide the position of the signal in the RoutineControl request/response. | The position is defined in bits.
              enumeration DcmDspRoutineSignalType: {BOOLEAN, SINT16, SINT32, SINT8, UINT16, UINT32, UINT8, VARIABLE_LENGTH}, set at link in variant link-time / pre-compile in variant post-build+pre-compile  # Provide the type of the signal in the RoutineControl request/response.
          container DcmDspRoutineStopOut [0..1]  # Provide description of output parameter of Stop subservice for RoutineControl service.
            container DcmDspRoutineStopOutSignal [1..*]  # Provide description of a routine signal used in RoutineControl service.
              integer DcmDspRoutineSignalLength: 0..65535, set at link in variant link-time / pre-compile in variant post-build+pre-compile  # Provide the length in bits of the signal in the RoutineControl request/response
              integer DcmDspRoutineSignalPos: 0..65535, set at link in variant link-time / pre-compile in variant post-build+pre-compile  # Provide the position of the signal in the RoutineControl request/response. | The position is defined in bits.
              enumeration DcmDspRoutineSignalType: {BOOLEAN, SINT16, SINT32, SINT8, UINT16, UINT32, UINT8, VARIABLE_LENGTH}, set at link in variant link-time / pre-compile in variant post-build+pre-compile  # Provide the type of the signal in the RoutineControl request/response.
          container DcmDspStartRoutineIn [0..1]  # Provide description of input parameter of Start subservice for RoutineControl service
            container DcmDspStartRoutineInSignal [1..*]  # Provide description of a routine signal used in RoutineControl service.
              integer DcmDspRoutineSignalLength: 0..65535, set at link in variant link-time / pre-compile in variant post-build+pre-compile  # Provide the length in bits of the signal in the RoutineControl request/response
              integer DcmDspRoutineSignalPos: 0..65535, set at link in variant link-time / pre-compile in variant post-build+pre-compile  # Provide the position of the signal in the RoutineControl request/response. | The position is defined in bits.
              enumeration DcmDspRoutineSignalType: {BOOLEAN, SINT16, SINT32, SINT8, UINT16, UINT32, UINT8, VARIABLE_LENGTH}, set at link in variant link-time / pre-compile in variant post-build+pre-compile  # Provide the type of the signal in the RoutineControl request/response.
          container DcmDspStartRoutineOut [0..1]  # Provide description of output parameter of Start subservice for RoutineControl service.
            container DcmDspStartRoutineOutSignal [1..*]  # Provide description of a routine signal used in RoutineControl service.
              integer DcmDspRoutineSignalLength: 0..65535, set at link in variant link-time / pre-compile in variant post-build+pre-compile  # Provide the length in bits of the signal in the RoutineControl request/response.
              integer DcmDspRoutineSignalPos: 0..65535, set at link in variant link-time / pre-compile in variant post-build+pre-compile  # Provide the position of the signal in the RoutineControl request/response. | The position is defined in bits.
              enumeration DcmDspRoutineSignalType: {BOOLEAN, SINT16, SINT32, SINT8, UINT16, UINT32, UINT8, VARIABLE_LENGTH}, set at link in variant link-time / pre-compile in variant post-build+pre-compile  # Provide the type of the signal in the RoutineControl request/response.
        container DcmDspSecurity  # This container contains the configuration ( DSP parameter) for security level configuration (per security level) | Description This container contains Rows of DcmDspSecurityRow
          container DcmDspSecurityRow [0..31]  # Definition of a single Row of configuration for security level configuration (per security level) | The name of this container is used to define the name of the R-Port through which the DCM accesses the interface SecurityAccess_<LEVEL>. The R-Port is named SecurityAccess_<LEVEL> where _<LEVEL> is the name of the container DcmDspSecurityRow. If there is no reference, no check of security level shall be done.
            integer DcmDspSecurityADRSize [0..1]: 1..4294967295, set at link in variant link-time / pre-compile in variant post-build+pre-compile  # Size of the AccessDataRecord used in GetSeed
            float DcmDspSecurityDelayTime: 0..20000, set at link in variant link-time / pre-compile in variant post-build+pre-compile  # Delay time after failed security access (in ms). This is started after DcmDspSecurityNumAttDelay number of failed security accesses. | The AUTOSAR configuration standard is to use SI units, so this parameter is defined as float value in seconds. DCM configuration tools must convert this float value to the appropriate value format for the use in the software implementation of DCM. min: A negative value is not allowed. upperMultiplicity: Exactly one delay time must be specified per security levbel configuration. lowerMultiplicity: Exactly one delay time must be specified per security levbel configuration. origin: Standard AUTOSAR configuration parameter.
            float DcmDspSecurityDelayTimeOnBoot: 0..20000, set at link in variant link-time / pre-compile in variant post-build+pre-compile, origin=AUTOSAR_ECUC V1.0.0  # Start delay timer on power on (in ms) | The AUTOSAR configuration standard is to use SI units, so this parameter is defined as float value in seconds. DCM configuration tools must convert this float value to the appropriate value format for the use in the software implementation of DCM. min: A negative value is not allowed. upperMultiplicity: Exactly one delay time must be specified per security level configuration. lowerMultiplicity: Exactly one delay time must be specified per security level configuration.
            integer DcmDspSecurityKeySize: 1..4294967295, set at link in variant link-time / pre-compile in variant post-build+pre-compile  # size of the security key (in Bytes).
            integer DcmDspSecurityLevel: 1..63, set at link in variant link-time / pre-compile in variant post-build+pre-compile, symbolic-name-value=true  # Value of Security level. | Level 1 is the highest security level. The locked state cannot be configured explicitly. 1,2,3...63: configuration dependent - Conversion formula to calculate SecurityLevel out of tester requested SecurityAccessType parameter: SecurityLevel = (SecurityAccessType + 1) / 2 Type: Dcm_SecLevelType
            integer DcmDspSecurityNumAttDelay: 1..255, set at link in variant link-time / pre-compile in variant post-build+pre-compile  # Number of failed security accesses after which the delay time is activated
            integer DcmDspSecuritySeedSize: 1..4294967295, set at link in variant link-time / pre-compile in variant post-build+pre-compile  # size of the security seed (in Bytes).
        container DcmDspSession [1..*]  # This container contains the configuration ( DSP parameter) session control configuration (per session control) | This container contains Rows of DcmDspSessionRow
          container DcmDspSessionRow [0..31]  # Definition of a single Row of session control configuration (per session control)
            enumeration DcmDspSessionForBoot: {DCM_NO_BOOT, DCM_OEM_BOOT, DCM_SYS_BOOT}, set at link in variant link-time / pre-compile in variant post-build+pre-compile, origin=AUTOSAR_ECUC V1.0.0  # This parameter defines whether this diagnostic session allows to jump to Bootloader (OEM Bootloader or System Supplier Bootloader). If this diagnostic session doesn't allow to jump to Bootloader the value DCM_NO_BOOT shall be chosen.
            integer DcmDspSessionLevel: 0..255, set at link in variant link-time / pre-compile in variant post-build+pre-compile, symbolic-name-value=true  # Value of the Session control. The symbolicName represents the Name of the Session | SWS defines the Dcm_SesCtrlType: 1 DEFAULT_SESSION 2 PROGRAMMING_SESSION 3 EXTENDED_DIAGNOSTIC_SESSION 4 SAFETY_SYSTEM_DIAGNOSTIC_SESSION 5...63 Reserved by Document 64...126 <configuration dependent (according "diagnosticSessionType" parameter DiagnosticSessionControl request> 127...254 Reserved by Document 255 ALL_SESSION_LEVEL
            float DcmDspSessionP2ServerMax: 0..1000, set at link in variant link-time / pre-compile in variant post-build+pre-compile  # This is the session value for P2ServerMax in milliseconds (per Session Control). | This is defined in the AUTOSAR SWS for DCM as a uint16. The AUTOSAR configuration standard is to use SI units, so this parameter is defined as a float value in seconds. DCM configuration tools must convert this float value to the appropriate value format for the use in the software implementation of DCM.
            float DcmDspSessionP2StarServerMax: 0..100000, set at link in variant link-time / pre-compile in variant post-build+pre-compile  # This is the session value for P2*ServerMax in milliseconds (per Session Control). | This is defined in the AUTOSAR SWS for DCM as a uint16. The AUTOSAR configuration standard is to use SI units, so this parameter is defined as a float value in seconds. DCM configuration tools must convert this float value to the appropriate value format for the use in the software implementation of DCM.
        container DcmDspTestResultByObdmid [0..1]  # This container contains the configuration (parameters) of the "Request on-board monitoring test results" service (Service $06).
          container DcmDspTestResultObdmidTid [1..*]  # This container contains the configuration (parameters) of a OBDMID and the assigned TIDs for the "Request on-board monitoring test results" service (Service $06).
            integer DcmDspTestResultObdmid: 0..255, set at link in variant link-time / pre-compile in variant post-build+pre-compile  # OBDMID for Service $06
            container DcmDspTestResultObdmidTids [1..*]  # This container contains the configuration (parameters) of the TIDs belonging to the OBDMID for the "Request on-board monitoring test results" service (Service $06).
              integer DcmDspTestResultObdmidTidUaSid: 0..255, set at link in variant link-time / pre-compile in variant post-build+pre-compile  # Unit And Scaling ID for Service $06
              reference DcmDspTestResultObdmidTidRef [1..*]: set at link in variant link-time / post-build in variant post-build / pre-compile in variant pre-compile, destination=DcmDspTestResultTid  # Link to reported TIDs of this OBDMID | upperMultiplicity / lowerMultiplicity:: At least one TID must be reported for an OBDMID
          container DcmDspTestResultTid [1..*]  # This container contains the configuration (parameters) of a single TID for the "Request on-board monitoring test results" service (Service $06). | The DCM will access the Data using an R-Port requiring a PortInterface DTRServices. The R-Port is named DtrServices_<OBDMID>_<TID> where <TID> is the name of the container DcmDspTestResultTid and <OBDMID> is the name of the container DcmDspTestResultObdmidTid.
            integer DcmDspTestResultTestId: 0..255, set at link in variant link-time / pre-compile in variant post-build+pre-compile  # Test Id for Service $06
        container DcmDspVehInfo [0..*]  # This container contains the configuration (parameters) of the "Request vehicle information service" (service $09).
          integer DcmDspVehInfoInfoType: 0..255, set at link in variant link-time / pre-compile in variant post-build+pre-compile  # value of InfoType.
          container DcmDspVehInfoData [1..*]  # Data Item of an InfoType; post-fix of the port interface name.
            integer DcmDspVehInfoDataOrder: 0..255, set at pre-compile  # Defines the order of the data item in the InfoType; values: 0..255; first data item having the order number 0; the next 1 and so on. | The configuration of order needs to be unique per InfoType.
            function name DcmDspVehInfoDataReadFnc [0..1]: set at pre-compile  # Function name for reading InfoType data item.
            integer DcmDspVehInfoDataSize: 0..255, set at pre-compile  # Size in bytes of the InfoType data item.
            boolean DcmDspVehInfoDataUsePort: set at pre-compile  # When the parameter DcmDspVehInfoUsePort is set to true the DCM will access the Data using an R-Port requiring a PortInteface InfotypeServices_<VEHINFODATA>. The R-Port is named | InfotypeServices_<VEHINFODATA>. where <VEHINFODATA> is the name of the container DcmDspVehInfoData. In that case, the DcmDspVehInfoDataReadFnc is ignored and the RTE APIs are used. When the parameter DcmDspVehInfoDataUsePort is false, the DCM calls the function defined in DcmDspVehInfoDataReadFnc.
      container DcmGeneral  # This container contains the configuration (parameters) for Component wide parameters
        boolean DcmDevErrorDetect: set at pre-compile  # Preprocessor switch to enable or disable the Development Error Detection (DET) mechanism.
        boolean DcmRequestManufacturerNotificationEnabled: set at pre-compile  # Allows to enable or disable the requested notification mechanism for the Manufacturer.
        boolean DcmRequestSupplierNotificationEnabled: set at pre-compile  # Allows to enable or disable the requested notification mechanism for the Supplier.
        boolean DcmRespondAllRequest: set at pre-compile  # If set to FALSE the DCM will not respond to diagnostic request that contains a service ID which is in the range from 0x40 to 0x7F or in the range from 0xC0 to 0xFF (Response IDs).
        float DcmTaskTime: 0..100, set at link in variant link-time / pre-compile in variant post-build+pre-compile  # Allow to configure the time for the periodic cyclic task. Please note: This configuration value shall be equal to the value in the ScheduleManager module. | The AUTOSAR configuration standard is to use SI units, so this parameter is defined as float value in seconds. DCM configuration tools must convert this float value to the appropriate value format for the use in the software implementation of DCM. min: A negative value is not allowed. upperMultiplicity: Exactly one TaskTime must be specified per configuration. lowerMultiplicity: Exactly one TaskTime must be specified per configuration.
        boolean DcmVersionInfoApi: set at pre-compile  # Preprocessor switch to enable or disable the output Version info of the functionality.
      container DcmPageBufferCfg  # This container contains the configuration (parameters) for Page Buffer handling
        boolean DcmPagedBufferEnabled: set at pre-compile  # Allow to enable or disable the Page buffer mechanism. | true = Page buffer handling enabled false = Page Buffer handling disabled
        float DcmPagedBufferTimeout [0..1]: 0..1000, set at link in variant link-time / pre-compile in variant post-build+pre-compile  # Allow to configure the Timeout (in ms) towards the application for filling the next page. | This parameter is only relevant if the Page Buffer handling is enabled. (DcmPagedBufferEnabled = TRUE) Defined in the DCM SWS as uint16, this parameter contains a value in milliseconds. The AUTOSAR configuration standard is to use SI units, so this parameter is defined as float value in seconds. DCM configuration tools must convert this float value to the appropriate value format for the use in the software implementation of DCM. min: A negative value is not allowed. upperMultiplicity: Exactly one Timeout must be specified per configuration. lowerMultiplicity: Exactly one Timeout must be specified per configuration.
      container DcmProcessingConditions [0..1]  # This container contains the configuration ( DSP parameter) for mode arbitration functionality of the Dcm
        container DcmModeCondition [1..*]  # This container contains the configuration of a mode condition which can be used as argument in DcmModeRules. | One DcmModeCondition shall contain either one DcmSwcModeRef or one DcmBswModeRef. Please note that the Dcm acts as well as mode manager. Therefore the references DcmSwcModeRef or one DcmBswModeRef. might point to provided ModeDeclarationGroupPrototypes of the Dcm itself as well as to provided ModeDeclarationGroupPrototypes of other Bsw Modules or software components.
          enumeration DcmConditionType: {DCM_EQUALS, DCM_EQUALS_NOT}, set at pre-compile  # This parameter specifies what kind of comparison that is made for the evaluation of the mode condition.
          instance reference DcmBswModeRef [0..1]: set at pre-compile, destination-context=MODE-DECLARATION-GROUP-PROTOTYPE, destination-type=MODE-DECLARATION  # This parameter references a mode of a ModeDeclarationGroupPrototype provided by a Basic Software Module used for the condition. | Please note that such ModeDeclarationGroupPrototype are owned by a Basic Software Module Description in the role providedModeGroup.
          instance reference DcmSwcModeRef [0..1]: set at pre-compile, destination-context=ROOT-SW-COMPOSITION-PROTOTYPE SW-COMPONENT-PROTOTYPE P-PORT-PROTOTYPE MODE-DECLARATION-GROUP-PROTOTYPE, destination-type=MODE-DECLARATION  # This parameter references a mode in a particular mode request port of a software component that is used for the condition.
        container DcmModeRule [1..*]  # This container contains the configuration of a mode rule which represents a logical expression with DcmModeCondistions or other DcmModeRules as arguments. | All arguments are processed with the operator defined by DcmLogicalOperator, for instance: Argument_A AND Argument_B AND Argument_C
          enumeration DcmLogicalOperator [0..1]: {DCM_AND, DCM_OR}, set at pre-compile  # This parameter specifies the logical operator to be used in the logical expression. If the expression only consists of a single condition this parameter shall not be used.
          integer DcmModeRuleNrcValue [0..1]: 0..255, set at link in variant link-time / pre-compile in variant pre-compile  # Optional parameter which defines the NRC to be sent in case the mode rule condition is not valid.
          choice reference DcmArgumentRef [1..*]: set at pre-compile, destination=[DcmModeCondition, DcmModeRule]  # This is a choice reference either to a mode condition or a an other mode rule serving as sub-expression.
  module definition Dem [0..1]: variants post-build/pre-compile  # Configuration of the Dem (Diagnostic Event Manager) module.
    container DemConfigSet: multiple-configuration-container=true  # This container contains the configuration parameters and sub containers of the Dem module supporting multiple configuration sets. This container is a MultipleConfigurationContainer, i.e. this container and its sub-containers exist once per configuration set.
      container DemDTCClass [0..65535]  # This container contains the configuration (parameters) for DTCClass.
        integer DemDTCFunctionalUnit: 0..255, set at pre-compile  # DTCFuncitonalUnit is a 1-byte value which identifies the corresponding basic vehicle / system function which reports the DTC. This parameter is necessary for the report of severity informations.
        enumeration DemDTCSeverity [0..1]: {DEM_DTC_SEV_CHECK_AT_NEXT_HALT, DEM_DTC_SEV_IMMEDIATELY, DEM_DTC_SEV_MAINTENANCE_ONLY, DEM_DTC_SEV_NO_SEVERITY}, set at pre-compile  # DTC severity | This parameter depends on automotive manufacturer and is optional.
        boolean DemImmediateNvStorage: set at pre-compile  # Switch to enable immediate storage triggering of an according event memory entriy persistently to NVRAM. | true: immediate non-volatile storage triggering enabled false: immediate non-volatile storage triggering disabled
        integer DemObdDTC [0..1]: 1..65535, set at post-build in variant post-build / pre-compile in variant pre-compile  # Unique Diagnostic Trouble Code value for OBD
        integer DemUdsDTC [0..1]: 1..16777214, set at post-build in variant post-build / pre-compile in variant pre-compile  # Unique Diagnostic Trouble Code value for UDS | (Range: 0x000000 and 0xFFFFFF are reserved for DTC groups by ISO 14229-1)
        container DemCallbackInitMForF [0..*]  # The presence of this container indicates, that the Dem has access to an "InitMonitorForFunction" callback, which the Dem will call to initialize a monitor. | In case the container has a DemCallbackInitMForFFnc, this parameter defines the name of the function that the Dem will call. In case there is no DemCallbackInitMForFFnc, the Dem will have an R-Port requiring the interface CallbackInitMonitorForFunction, whose name is generated by using the unique callback-prefix followed by the event name.
          function name DemCallbackInitMForFFnc [0..1]: set at pre-compile  # Function name of prototype "InitMonitorForFunction".
      container DemEventParameter [1..65535]  # This container contains the configuaration (parameters) for events. | Note that this container definition does not explicitly define a symbolic name parameter. Instead, the short name of the container will be used in the Ecu Configuration Description to specify the symbolic name of the diagonstic event.
        integer DemEventId: 1..65535, set at pre-compile, symbolic-name-value=true  # Unique identifier of a diagnostic event. | This parameter should not be changeable by user, because the Id should be generated by Dem itself to prevent gaps and multiple use of an Id. The events should be sequentially ordered beginning with 1 and no gaps in between.
        enumeration DemEventKind: {DEM_EVENT_KIND_BSW, DEM_EVENT_KIND_SWC}, set at pre-compile  # This parameter is used to distinguish between SW-C and BSW events. SW-C events are reported by Dem_SetEventStatus API and BSW events are reported by Dem_ReportErrorStatus API.
        integer DemMaxNumberFreezeFrameRecords: 0..255, set at pre-compile  # This parameter defines the number of according freeze frame records, which can maximal be stored for this event. Therefore all these freeze frame records have the same freeze frame class. | This parameter is only required for calculated record numeration (refer to DemTypeOfFreezeFrameRecordNumeration).
        reference DemDTCClassRef [0..1]: set at pre-compile, destination=DemDTCClass  # This parameter defines the DTC configuration associated with the diagnostic event. | It is allowed to have events without a DTC (e.g. for ECU-internal events triggering safety reactions without being reported via diagnostic communication). The same DemDTCClass can be used from several events, to combine these (refer to chapter "Combination of diagonstic event").
        reference DemExtendedDataClassRef [0..1]: set at pre-compile, destination=DemExtendedDataClass  # This reference defines the link to an extended data class sampler.
        reference DemFreezeFrameClassRef [0..1]: set at pre-compile, destination=DemFreezeFrameClass  # These references define the links to a freeze frame class sampler.
        reference DemFreezeFrameRecNumClassRef: set at pre-compile, destination=DemFreezeFrameRecNumClass  # This parameter defines the list of dedicated freeze frame record numbers associated with the diagnostic event. These record numbers are assigned to the freeze frame records (instead of calculated record numbers). | This parameter is only required for configured record numeration (refer to DemTypeOfFreezeFrameRecordNumeration).
        container DemCallbackClearEventAllowed [0..1]  # The presence of this container indicates that the Dem has access to a "ClearEventAllowed" callback. | In case there is a DemCallbackClearEventAllowedFnc, this parameter defines the name of the function that the Dem will call. In case there is no DemCallbackClearEventAllowedFnc, the Dem will have an R-Port requiring the interface CallbackClearEventAllowed whose name is generated by using the unique callback-prefix followed by the event name.
          function name DemCallbackClearEventAllowedFnc [0..1]: set at pre-compile  # Function name of prototype "ClearEventAllowed".
        container DemCallbackEventDataChanged [0..1]  # The presence of this container indicates that the Dem has access to an "EventDataChanged" callback. | In case there is a DemCallbackEventDataChangedFnc, this parameter defines the name of the function that the Dem will call. In case there is no DemCallbackEventDataChangedFnc, the Dem will have an R-Port requiring the interface CallbackEventDataChanged whose name is generated by using the unique callback-prefix followed by the event name.
          function name DemCallbackEventDataChangedFnc [0..1]: set at pre-compile  # Function name of prototype "EventDataChanged"
        container DemCallbackEventStatusChanged [0..*]  # The presence of this container indicates, that the Dem has access to an "EventStatusChanged" callback, which the Dem will call to notify other components about the change in the status of an event. | In case there is a DemCallbackEvenStatusChangedFnc, this parameter defines the name of the function that the Dem will call. In case there is no DemCallbackEvenStatusChangedFnc, the Dem will have an R-Port requiring the interface CallbackEventStatusChanged, whose name is generated by using the unique callback-prefix followed by the event name.
          function name DemCallbackEventStatusChangedFnc [0..1]: set at pre-compile  # Function name of prototype "EventStatusChanged"
        container DemCallbackInitMForE [0..1]  # The presence of this container indicates, that the Dem has access to an "InitMonitorForEvent" callback, which the Dem will call to initialize a monitor. | In case the container has a DemCallbackInitMForEFnc, this parameter defines the name of the function that the Dem will call. In case there is no DemCallbackInitMForEFnc, the Dem will have an R-Port requiring the interface CallbackInitMonitorForEvent, whose name is generated by using the unique callback-prefix followed by the event name.
          function name DemCallbackInitMForEFnc [0..1]: set at pre-compile  # Function name of prototype "InitMonitorForEvent".
        container DemEventClass  # This container contains the configuaration (parameters) for EventClass
          boolean DemAgingAllowed: set at pre-compile  # Switch to allow aging/unlearning of the event or not. | true: aging allowed false: aging not allowed
          integer DemAgingCycleCounterThreshold [0..1]: 1..256, set at pre-compile  # Number ot aging cycles needed to unlearn/delete the event.
          boolean DemConsiderPtoStatus: set at pre-compile  # This parameter is TRUE, when the event is affected by the Dem PTO handling.
          enumeration DemEventDestination [0..4]: {DEM_DTC_ORIGIN_MIRROR_MEMORY, DEM_DTC_ORIGIN_PRIMARY_MEMORY, DEM_DTC_ORIGIN_SECONDARY_MEMORY}, set at pre-compile  # The event destination assigns events to none, one or multiple origins. | If no event destination is assigned to a specific event, the event is handled internally and is not visible externally to the Dcm. If more than one event destination is assigned to a specific event, the event can be present in the corresponding origins.
          integer DemEventFailureCycleCounterThreshold [0..1]: 1..256, set at pre-compile  # Defines the number of failure cycles for the event based fault confirmation.
          enumeration DemEventOBDReadinessGroup: {DEM_OBD_RDY_AC, DEM_OBD_RDY_BOOSTPR, DEM_OBD_RDY_CAT, DEM_OBD_RDY_CMPRCMPT, DEM_OBD_RDY_EGSENS, DEM_OBD_RDY_ERG, DEM_OBD_RDY_EVAP, DEM_OBD_RDY_FLSYS, DEM_OBD_RDY_HCCAT, DEM_OBD_RDY_HTCAT, DEM_OBD_RDY_MISF, DEM_OBD_RDY_NONE, DEM_OBD_RDY_NOXCAT, DEM_OBD_RDY_O2SENS, DEM_OBD_RDY_O2SENSHT, DEM_OBD_RDY_PMFLT, DEM_OBD_RDY_SECAIR}, set at pre-compile  # This parameter specifies the Event OBD Readiness group for PID $01 and PID $41 computation. | This parameter is only applicable for emission-related ECUs.
          integer DemEventPriority: 1..256, set at pre-compile  # Priority of the event, in view of full event buffer.
          enumeration DemEventSignificance [0..1]: {DEM_EVENT_SIGNIFICANCE_FAULT, DEM_EVENT_SIGNIFICANCE_OCCURRENCE}, set at pre-compile  # Significance of the event, which indicates additional information concerning fault classification and resolution. | It can be mapped as Dem-internal data element. It shall be configured, if it is a part of event related data.
          boolean DemFFPrestorageSupported: set at pre-compile  # If this parameter is set to true, then the Prestorage of FreezeFrames is supported by the assigned event. This parameter is useful to calculate the buffer size.
          choice reference DemAgingCycleRef [0..1]: set at pre-compile, origin=AUTOSAR_ECUC V1.0.0, destination=[DemAgingCycle, DemOperationCycle]  # Reference to the cycle which is triggering the aging of the event. This can either be the same as the operation cycle of the event, or a separate aging cycle reported via API Dem_SetAgingCycleState. If external aging is configured (refer to DemAgingCycleCounterProcessing), this parameter is not used.
          reference DemEnableConditionGroupRef [0..1]: set at pre-compile, origin=AUTOSAR_ECUC V1.0.0, destination=DemEnableConditionGroup  # References an enable condition group.
          reference DemEventFailureCycleRef [0..1]: set at pre-compile, origin=AUTOSAR_ECUC V1.0.0, destination=DemOperationCycle  # Kind of failure cycle for the event based fault confirmation.
          reference DemOperationCycleRef: set at pre-compile, origin=AUTOSAR_ECUC V1.0.0, destination=DemOperationCycle  # Kind of operation cycle for the event (e.g. power cycle, driving cycle, ...)
          reference DemStorageConditionGroupRef [0..1]: set at pre-compile, origin=AUTOSAR_ECUC V1.0.0, destination=DemStorageConditionGroup  # References a storage condition group.
          choice container DemDebounceAlgorithmClass  # Debounce algorithm class: counter based, time based, or monitor internal.
            container DemDebounceCounterBased [0..1]  # This container contains the configuration (parameters) for counter based debouncing.
              integer DemDebounceCounterDecrementStepSize: 0..32768, set at pre-compile  # Defines the step size for decrementation of the internal fault detection counter (PREPASSED).
              integer DemDebounceCounterFailedThreshold: 0..32767, set at pre-compile  # Defines the value of the internal fault detection counter, which indicates the failed status.
              integer DemDebounceCounterIncrementStepSize: 0..32767, set at pre-compile  # Defines the step size for incrementation of the internal fault detection counter (PREFAILED).
              boolean DemDebounceCounterJumpDown: set at pre-compile  # Switch for the activation of Jump-Down. | true: Jump-Down activated false: Jump-Down deactivated
              integer DemDebounceCounterJumpDownValue: -32768..32767, set at pre-compile  # Jump-Down value of the internal fault detection counter.
              boolean DemDebounceCounterJumpUp: set at pre-compile  # Switch for the activation of Jump-Up. | true: Jump-Up activated false: Jump-Up deactivated
              integer DemDebounceCounterJumpUpValue: -32768..32767, set at pre-compile  # Jump-Up value of the internal fault detection counter.
              integer DemDebounceCounterPassedThreshold: -32768..0, set at pre-compile  # Defines the value of the internal fault detection counter, which indicates the passed status.
            container DemDebounceMonitorInternal [0..1]  # This container contains the configuration (parameters) for monitor internal debouncing.
              container DemCallbackGetFDC  # The presence of this container indicates, that the Dem has access to a "GetFaultDetectionCounter" callback, which the Dem will call to obtain the value of the fault detection counter. | In case the container has a DemCallbackGetFDCFnc, this parameter defines the name of the function that the Dem will call. In case there is no DemCallbackGetFDCFnc, the Dem will have a R-Port requiring the interface CallbackGetFaultDetectionCounter, whose name is generated by using the unique callback-prefix followed by the event name.
                function name DemCallbackGetFDCFnc [0..1]: set at pre-compile  # Function name of prototype "GetFaultDetectionCounter".
            container DemDebounceTimeBase [0..1]  # This container contains the configuration (parameters) for time based debouncing.
              float DemDebounceTimeFailedThreshold: 0..3600, set at pre-compile  # Defines the time out duration for "Event Failed" qualification. | The AUTOSAR configuration standard is to use SI units, so this parameter is defined as float value in seconds. Dem configuration tools must convert this float value to the appropriate value format for the use in the software implementation of Dem.
              float DemDebounceTimePassedThreshold: 0..3600, set at pre-compile  # Defines the time out duration for "Event Passed" qualification. | The AUTOSAR configuration standard is to use SI units, so this parameter is defined as float value in seconds. Dem configuration tools must convert this float value to the appropriate value format for the use in the software implementation of Dem.
          container DemIndicatorAttribute [0..255]  # This container contains the event specific configuration of Indicators.
            enumeration DemIndicatorBehaviour: {DEM_INDICATOR_BLINKING, DEM_INDICATOR_BLINK_CONT, DEM_INDICATOR_CONTINUOUS}, set at post-build in variant post-build / pre-compile in variant pre-compile  # Behaviour of the linked indicator
            integer DemIndicatorFailureCycleCounterThreshold [0..1]: 0..255, set at pre-compile  # Defines the number of failure cycles for the WarningIndicatorOnCriteria.
            enumeration DemIndicatorFailureCycleSource: {DEM_FAILURE_CYCLE_EVENT, DEM_FAILURE_CYCLE_INDICATOR}, set at pre-compile  # This parameter defines, which failure cycle is used for the WarningIndicatorOnCriteria handling.
            integer DemIndicatorHealingCycleCounterThreshold: 0..255, set at pre-compile  # Defines the number of healing cycles for the WarningIndicatorOffCriteria.
            reference DemIndicatorFailureCycleRef [0..1]: set at pre-compile, destination=DemOperationCycle  # Kind of failure cycle for the indicator controlled by the according event used for the WarningIndicatorOnCriteria.
            reference DemIndicatorHealingCycleRef: set at pre-compile, destination=DemOperationCycle  # Kind of healing cycle for the indicator controlled by the according event used for the WarningIndicatorOffCriteria.
            reference DemIndicatorRef: set at pre-compile, destination=DemIndicator  # Reference to the used indicator.
      container DemPidClass [0..255]  # This container contains the different PIDs for the single global OBD relevant freeze frame class. It is assembled out of one or several data elements.
        integer DemPidIdentifier: 0..255, set at post-build in variant post-build / pre-compile in variant pre-compile  # identifier of the PID
        container DemPidDataElement [1..255]  # This container contains the different data elements contained in the specific PID.
          choice reference DemPidDataElementClassRef: set at post-build in variant post-build / pre-compile in variant pre-compile, destination=[DemExternalCSDataElementClass, DemExternalSRDataElementClass, DemInternalDataElementClass]  # This reference contains the link to a data element class.
    container DemGeneral  # This container contains the configuration (parameters) of the BSW Dem
      enumeration DemAgingCycleCounterProcessing: {DEM_PROCESS_AGINGCTR_EXTERN, DEM_PROCESS_AGINGCTR_INTERN}, set at pre-compile  # This configuration switch defines, whether the aging counter is calculated Dem-internally or provided via Dem_SetAgingCycleCounterValue.
      integer DemBswErrorBufferSize: 0..255, set at pre-compile  # Maximum number of elements in buffer for handling of BSW errors (ref. to Dem107).
      enumeration DemClearDTCBehavior: {DEM_CLRRESP_NONVOLATILE_FINISH, DEM_CLRRESP_NONVOLATILE_TRIGGER, DEM_CLRRESP_VOLATILE}, set at pre-compile  # Defines the clearing process of diagnostic information for volatile and non-volatile memory and the positive response handling for the Dcm module.
      boolean DemDTCSuppressionSupport: set at pre-compile  # This configuration switch defines, whether support for DTC suppression is enabled or not. | true: DTC suppression support is enabled false: DTC suppression support is disabled
      boolean DemDebounceCounterBasedSupport: set at pre-compile  # This configuration switch defines, whether support for counter based debouncing is enabled or not. | true: counter based debouncing support is enabled false: counter based debouncing support is disabled
      boolean DemDebounceTimeBasedSupport: set at pre-compile  # This configuration switch defines, whether support for time based debouncing is enabled or not. | true: time based debouncing support is enabled false: time based debouncing support is disabled
      boolean DemDevErrorDetect: set at pre-compile  # Activate/Deactivate the Development Error Detection and Notification. | true: Development Error Detection and Notification activated false: Development Error Detection and Notification deactivated
      integer DemDtcStatusAvailabilityMask: 0..255, set at pre-compile  # Mask for the supported DTC status bits by the Dem. This mask is used by UDS service 0x19.
      boolean DemEnableConditionSupport: set at pre-compile  # This configuration switch defines, whether support for enable conditions is enabled or not. | true: support for enable conditions is enabled false: support for enable conditions is disabled
      enumeration DemEventCombinationSupport: {DEM_EVCOMB_DISABLED, DEM_EVCOMB_TYPE1, DEM_EVCOMB_TYPE2}, set at pre-compile  # This parameter defines the type of event combination supported by the Dem.
      boolean DemEventDisplacementSupport: set at pre-compile  # This configuration switch defines, whether support for event displacement is enabled or not. | true: event displacement support is enabled false: event displacement support is disabled
      enumeration DemExtendedDataCapture [0..1]: {DEM_TRIGGER_EVENT_MEMORY_STORAGE, DEM_TRIGGER_TESTFAILED}, set at pre-compile  # This parameter defines the point in time, when the extended data collection is done for the initial event memory entry.
      enumeration DemFreezeFrameCapture [0..1]: {DEM_TRIGGER_EVENT_MEMORY_STORAGE, DEM_TRIGGER_TESTFAILED}, set at pre-compile  # This parameter defines the point in time, when the freeze frame data collection is done for the initial event memory entry.
      string DemHeaderFileInclusion [0..*]: set at pre-compile, regular-expression=[a-zA-Z0-9_]([a-zA-Z0-9\._])*  # Name of the header file(s) to be included by the Dem module containing the used C-callback declarations.
      integer DemImmediateNvStorageLimit [0..1]: 1..255, set at pre-compile  # This parameter defines the maximum number of occurrences, a specific event memory entry is allowed, to be stored in NVRAM immediately (refer to DemImmediateNvStorage).
      integer DemMaxNumberEventEntryMirror: 0..255, set at pre-compile  # Maximum number of events which can be stored in the mirror memory
      integer DemMaxNumberEventEntryPermanent: 0..255, set at pre-compile  # Maximum number of events which can be stored in the permanent memory. | The assignment of an event to this memory type is dynamic and used for emission-related events only.
      integer DemMaxNumberEventEntryPrimary: 1..255, set at pre-compile  # Maximum number of events which can be stored in the primary memory
      integer DemMaxNumberEventEntrySecondary: 0..255, set at pre-compile  # Maximum number of events which can be stored in the secondary memory
      integer DemMaxNumberPrestoredFF: 0..255, set at pre-compile  # Defines the maximum number for prestored freeze frames. | If set to 0, then freeze frame prestorage is not supported by the ECU.
      boolean DemOBDSupport: set at pre-compile  # This configuration switch defines whether OBD is supported or not
      enumeration DemOccurrenceCounterProcessing: {DEM_PROCESS_OCCCTR_CDTC, DEM_PROCESS_OCCCTR_TF}, set at pre-compile  # This configuration switch defines the consideration of the fault confirmation process for the occurrence counter. For OBD and mixed systems (OBD/non OBD, refer to DemOBDSupport) the fault confirmation process must not be considered.
      enumeration DemOperationCycleProcessing: {DEM_PROCESS_OPCYC_COUNTER, DEM_PROCESS_OPCYC_STATE}, set at pre-compile  # This configuration switch defines, whether the operation cycles are triggered by DEM_CYCLE_STATE_START or collecting an external counter value, which results in respective state changes.
      boolean DemOperationCycleStatusStorage: set at pre-compile  # Defines if the operation cycle state is available over the power cycle (stored non-volatile) or not. | true: the operation cycle state is stored non-volatile false: the operation cycle state is only stored volatile
      boolean DemPTOSupport: set at pre-compile  # This configuration switch defines, whether PTO support (and therefore PID $1E support) is enabled or not.
      enumeration DemStatusBitHandlingTestFailedSinceLastClear: {DEM_STATUS_BIT_AGING_AND_DISPLACEMENT, DEM_STATUS_BIT_NORMAL}, set at pre-compile  # This configuration switch defines, whether the aging and displacement mechanism shall be applied to the "TestFailedSinceLastClear" status bits.
      boolean DemStatusBitStorageTestFailed: set at pre-compile  # Activate/Deactivate the permanent storage of the "TestFailed" status bits. | true: storage activated false: storage deactivated
      boolean DemStorageConditionSupport: set at pre-compile  # This configuration switch defines, whether support for storage conditions is enabled or not. | true: support for storage conditions is enabled false: support for storage conditions is disabled
      float DemTaskTime: 0..0.1, set at pre-compile, origin=AUTOSAR_ECUC V1.0.0  # Allow to configure the time for the periodic cyclic task. Please note: This configuration value shall be equal to the value in the Basic Software Scheduler configuration of the RTE module. | The AUTOSAR configuration standard is to use SI units, so this parameter is defined as float value in seconds. Dem configuration tools must convert this float value to the appropriate value format for the use in the software implementation of Dem. min: A negative value is not allowed. max: After event status was reported, processing shall be completed within 100ms in order to have the fault entry status information updated as soon as possible (e.g. for PID $01). upperMultiplicity: Exactly one TaskTime must be specified per configuration. lowerMultiplicity: Exactly one TaskTime must be specified per configuration.
      boolean DemTriggerDcmReports: set at pre-compile  # Activate/Deactivate the notification to the Diagnostic Communication Manager for ROE processing. | true: Dcm ROE notification activated false: Dcm ROE notification deactivated
      boolean DemTriggerDltReports: set at pre-compile  # Activate/Deactivate the notification to the Diagnostic Log and Trace. | true: Dlt notification activated false: Dlt notification deactivated
      boolean DemTriggerFiMReports: set at pre-compile  # Activate/Deactivate the notification to the Funciton Inhibition Manager. | true: FiM notification activated false: FiM notification deactivated
      boolean DemTriggerMonitorInitBeforeClearOk: set at pre-compile  # Defines if the monitor re-initialization has to be triggered before or after the Dem module returns DEM_CLEAR_OK. | true: trigger re-initialization before DEM_CLEAR_OK false: trigger re-initialization after DEM_CLEAR_OK
      enumeration DemTypeOfDTCSupported: {DEM_DTC_TRANSLATION_ISO11992_4, DEM_DTC_TRANSLATION_ISO14229_1, DEM_DTC_TRANSLATION_ISO15031_6, DEM_DTC_TRANSLATION_SAEJ1939_73}, set at pre-compile  # This parameter defines the format returned by Dem_GetTranslationType and does not relate to/influence the supported Dem functionality.
      enumeration DemTypeOfFreezeFrameRecordNumeration: {DEM_FF_RECNUM_CALCULATED, DEM_FF_RECNUM_CONFIGURED}, set at pre-compile  # This parameter defines the type of assigning freeze frame record numbers for event-specific freeze frame records.
      boolean DemVersionInfoApi: set at pre-compile  # Activate/Deactivate the version information API. | true: version information activated false: version information deactivated
      reference DemMILIndicatorRef [0..1]: set at pre-compile, destination=DemIndicator  # This parameter defines the indicator representing the MIL. | This paramteter is mandatory for ECUs supporting OBD (refer to DemOBDSupport).
      container DemAgingCycle [0..256]  # Note that this container definition does not explicitly define a symbolic name parameter. Instead, the short name of the container will be used in the Ecu Configuration Description to specify the symbolic name of the aging cycle name. These aging cycles are reported via API Dem_SetAgingCycleState only.
      container DemCallbackDTCStatusChanged [0..*]  # The presence of this container indicates, that the Dem has access to a "DTCStatusChanged" callback, which the Dem will call to notify other components about the change in the status of a DTC. | In case there is a DemCallbackDTCStatusChangedFnc, this parameter defines the name of the function that the Dem will call. In case there is no DemCallbackDTCStatusChangedFnc, the Dem will have an R-Port requiring the interface CallbackDTCStatusChanged whose name is generated by using the unique callback-prefix followed by the event name.
        function name DemCallbackDTCStatusChangedFnc [0..1]: set at pre-compile  # Function name of prototype "DTCStatusChanged". | Note: If the parameter DemTriggerDcmReports is enabled, this parameter shall not be "Dcm_DemTriggerOnDTCStatus".
      choice container DemDataElementClass [0..255]  # This container contains the configuration (parameters) for an internal/external data element class.
        container DemExternalCSDataElementClass [0..1]  # This container contains the configuration (parameters) for an external client/server based data element class. | It defines, how the Dem can obtain the value of the data element from either a SW-C or another BSW module. Whether a client/server port or a C function-call is used, is defined by DemDataElementUsePort.
          integer DemDataElementDataSize: 1..255, set at pre-compile  # Defines the size of the data element in bytes.
          function name DemDataElementReadFnc [0..1]: set at pre-compile  # In case of DemDataElementUsePort is false, this parameter defines the prototype of the C function "ReadDataElement" used to get the according value.
          boolean DemDataElementUsePort: set at pre-compile  # If the parameter is set to True, a R-Port is generated, to obtain the data element (interface DataServices_<SyncDataElement>). | If the parameter is set to False, the information is obtained by C function-call on another BSW module specified by the parameter DemDataElementReadFnc.
        container DemExternalSRDataElementClass [0..1]  # This container contains the configuration (parameters) for an external sender/receiver based data element class. It defines, how the Dem can obtain the value of the data element from a SW-C, by using a sender/receiver port.
          integer DemDataElementDataSize: 1..255, set at pre-compile  # Defines the size of the data element in bits.
          instance reference DemDataElementInstanceRef: set at pre-compile, destination-context=ROOT-SW-COMPOSITION-PROTOTYP SW-COMPONENT-PROTOTYPE+ PORT-PROTOTYPE, destination-type=VARIABLE-DATA-PROTOTYPE  # Instance Reference to the actual OperationPrototype which shall be traced.
        container DemInternalDataElementClass [0..1]  # This container contains the configuration (parameters) for an internal data element class.
          integer DemDataElementDataSize: 1..255, set at pre-compile  # Defines the size of the data element in bytes.
          enumeration DemInternalDataElement: {DEM_AGINGCTR, DEM_OCCCTR, DEM_OVFLIND, DEM_SIGNIFICANCE}, set at pre-compile  # This parameter defines the Dem-internal data value, which is mapped to the data element.
      container DemDidClass [0..255]  # This container contains the configuration (parameters) for a data Id class. It is assembled out of one or several data elements.
        integer DemDidIdentifier: 0..65535, set at pre-compile  # Identifier of the Data ID.
        choice reference DemDidDataElementClassRef [1..255]: set at pre-compile, destination=[DemExternalCSDataElementClass, DemExternalSRDataElementClass, DemInternalDataElementClass]  # This reference contains the link to a data element class.
      container DemEnableCondition [0..255]  # This container contains the configuration (parameters) for enable conditions.
        integer DemEnableConditionId: 0..255, set at pre-compile, symbolic-name-value=true  # Defines a unique enable condition Id. | This parameter should not be changeable by user, because the Id should be generated by Dem itself to prevent gaps and multiple use of an Id. The enable conditions should be sequentially ordered beginning with 0 and no gaps in between.
        boolean DemEnableConditionStatus: set at pre-compile  # Defines the inital status for enable or disable of acceptance of event reports of a diagnostic event. | The value is the initialization after power up (before this condition is reported the first time). true: acceptance of a diagnostic event enabled false: acceptance of a diagnostic event disabled
      container DemEnableConditionGroup [0..255]  # This container contains the configuration (parameters) for enable condition groups.
        reference DemEnableConditionRef [1..255]: set at pre-compile, origin=AUTOSAR_ECUC V1.0.0, destination=DemEnableCondition  # References an enable condition.
      container DemExtendedDataClass [0..*]  # This class contains the combinations of extended data records for an extended data class.
        reference DemExtendedDataRecordClassRef [1..253]: set at pre-compile, destination=DemExtendedDataRecordClass  # This reference contains the link to an extended data class record.
      container DemExtendedDataRecordClass [0..253]  # This container contains the configuration (parameters) for an extended data record class. | It is assembled out of one or several data elements.
        integer DemExtendedDataRecordNumber: 0..253, set at pre-compile  # This configuration parameter specifies an unique identifier for an extended data record. | One or more extended data records can be assigned to one diagnostic event/DTC. 0xFF and 0xFE are resereved by ISO (therefore the maximal value equals 253).
        enumeration DemExtendedDataRecordUpdate [0..1]: {DEM_UPDATE_RECORD_NO, DEM_UPDATE_RECORD_YES}, set at pre-compile  # This parameter defines the case, when the extended data record is stored/updated.
        choice reference DemDataElementClassRef [1..255]: set at pre-compile, destination=[DemExternalCSDataElementClass, DemExternalSRDataElementClass, DemInternalDataElementClass]  # This reference contains the link to a data element class.
      container DemFreezeFrameClass [0..255]  # This container contains the combinations of DIDs for a non OBD relevant freeze frame class.
        reference DemDidClassRef [1..255]: set at pre-compile, destination=DemDidClass  # For OBD relevant data | Multiple PIDs can be relevant per freeze frame.
      container DemFreezeFrameRecNumClass [0..255]  # This container contains a list of dedicated, different freeze frame record numbers assigned to an event. The order of record numbers in this list is assigned to the chronological order of the according freeze frame records. | dependency: DemTypeOfFreezeFrameRecordNumeration
        integer DemFreezeFrameRecordNumber [1..254]: 1..254, set at pre-compile  # This parameter defines a record number for a freeze frame record. This record number is unique per freeze frame record number class. | The range of this value is defined by ISO 14229-1 (0x01 .. 0xFE).
      container DemGeneralOBD [0..1]  # This container contains the general OBD-specific configuration (parameters) of the Dem module.
        choice reference DemOBDInputAcceleratorPaddleInformation: set at pre-compile, destination=[DemExternalCSDataElementClass, DemExternalSRDataElementClass]  # Input variable for the accelerator paddle information, which is assigned to a specific data element used as interface for the Dem-internal PID calculations.
        choice reference DemOBDInputAmbientPressure: set at pre-compile, destination=[DemExternalCSDataElementClass, DemExternalSRDataElementClass]  # Input variable for the ambient pressure, which is assigned to a specific data element used as interface for the Dem-internal PID calculations.
        choice reference DemOBDInputAmbientTemperature: set at pre-compile, destination=[DemExternalCSDataElementClass, DemExternalSRDataElementClass]  # Input variable for the ambient temperature, which is assigned to a specific data element used as interface for the Dem-internal PID calculations.
        choice reference DemOBDInputDistanceInformation: set at pre-compile, destination=[DemExternalCSDataElementClass, DemExternalSRDataElementClass]  # Input variable for the distance information, which is assigned to a specific data element used as interface for the Dem-internal PID calculations.
        choice reference DemOBDInputEngineSpeed: set at pre-compile, destination=[DemExternalCSDataElementClass, DemExternalSRDataElementClass]  # Input variable for the engine speed, which is assigned to a specific data element used as interface for the Dem-internal PID calculations.
        choice reference DemOBDInputEngineTemperature: set at pre-compile, destination=[DemExternalCSDataElementClass, DemExternalSRDataElementClass]  # Input variable for the engine temperature, which is assigned to a specific data element used as interface for the Dem-internal PID calculations.
        choice reference DemOBDInputProgrammingEvent: set at pre-compile, destination=[DemExternalCSDataElementClass, DemExternalSRDataElementClass]  # Input variable for the programming event, which is assigned to a specific data element used as interface for the Dem-internal PID calculations.
        choice reference DemOBDInputVehicleSpeed: set at pre-compile, destination=[DemExternalCSDataElementClass, DemExternalSRDataElementClass]  # Input variable for the vehicle speed, which is assigned to a specific data element used as interface for the Dem-internal PID calculations.
      container DemGroupOfDTC [0..255]  # This container contains the configuaration (parameters) for DTC groups.
        integer DemGroupDTCs: 0..16777214, set at pre-compile, symbolic-name-value=true  # DTC value of the selected group of DTC | (Range: 3 byte, 0x000000 is only available for the emission-related DTC group, 0xFFFFFF is reserved for 'all DTCs', according to ISO14229-1 Annex D.1,) The DTC group 'all DTCs' is always available and will not be configured.
      container DemIndicator [0..255]  # This container contains the configuration (parameters) for Indicators. | Note that this container definition does not explicitly define a symbolic name parameter. Instead, the short name of the container will be used in the Ecu Configuration Description to specify the symbolic name of the INDICATOR_NAME.
        integer DemIndicatorID: 0..255, set at pre-compile, symbolic-name-value=true  # Unique identifier of an indicator.
      container DemNvRamBlockId [0..*]  # This container contains the configuaration (parameters) for a non-volatile memory block, which is used from the Dem. If no permanent storage of event memory entries is required, no block needs to be configured. | The number of blocks which are necessary depends on the implementation and configuration (e.g. number of used event memories) of the Dem module.
        symbolic name reference DemNvRamBlockIdRef: set at pre-compile, origin=AUTOSAR_ECUC V1.0.0, destination=NvMBlockDescriptor  # This reference contains the link to a non-volatile memory block. For post build time configurations worst case szenario shall be used.
      container DemOperationCycle [1..256]  # Note that this container definition does not explicitly define a symbolic name parameter. Instead, the short name of the container will be used in the Ecu Configuration Description to specify the symbolic name of the operation cycle name.
        enumeration DemOperationCycleType: {DEM_OPCYC_IGNITION, DEM_OPCYC_OBD_DCY, DEM_OPCYC_OTHER, DEM_OPCYC_POWER, DEM_OPCYC_TIME, DEM_OPCYC_WARMUP}, set at pre-compile  # Operation cycles types for the Dem to be supported by cycle-state APIs. | Further cycle types can be specified as part of the Dem delivery.
      container DemRatioId [0..65535]  # This container contains the OBD specific ratio Id configuraiton. It is related to a specific event, a FID, and an IUMPR group. | Note that this container definition does not explicitly define a symbolic name parameter. Instead, the short name of the container will be used in the Ecu Configuration Description to specify the symbolic name of the ratio Id name.
        enumeration DemIUMPRGroup: {DEM_IUMPR_BOOSTPRS, DEM_IUMPR_CAT1, DEM_IUMPR_CAT2, DEM_IUMPR_EGR, DEM_IUMPR_EGSENSOR, DEM_IUMPR_EVAP, DEM_IUMPR_NMHCCAT, DEM_IUMPR_NOXADSORB, DEM_IUMPR_NOXCAT, DEM_IUMPR_OXS1, DEM_IUMPR_OXS2, DEM_IUMPR_PMFILTER, DEM_IUMPR_PRIVATE, DEM_IUMPR_SAIR, DEM_IUMPR_SECOXS1, DEM_IUMPR_SECOXS2}, set at pre-compile  # This parameter specifies the assigned IUMPR group of the ratio Id.
        enumeration DemRatioIdType: {DEM_RATIO_API, DEM_RATIO_OBSERVER}, set at pre-compile  # This parameter defines whether the ratio Id will be calculated API or observer based.
        reference DemDiagnosticEventRef: set at pre-compile, destination=DemEventParameter  # This reference contains the link to a diagnostic event.
        symbolic name reference DemFunctionIdRef: set at pre-compile, destination=FiMFID  # This reference contains the link to a function identifier within the FiM which is used as a primary FID.
        symbolic name reference DemSecondaryFunctionIdRef [0..*]: set at pre-compile, destination=FiMFID  # This reference contains the link to a function identifier within the FiM which is used as a secondary FID. | The "primary" and all "secondary" FID inhibitions are combined by "OR".
      container DemStorageCondition [0..255]  # This container contains the configuration (parameters) for storage conditions.
        integer DemStorageConditionId: 0..255, set at pre-compile, symbolic-name-value=true  # Defines a unique storage condition Id. This parameter should not be changeable by user, because the Id should be generated by Dem itself to prevent gaps and multiple use of an Id. The storage conditions should be sequentially ordered beginning with 0 and no gaps in between.
        boolean DemStorageConditionStatus: set at pre-compile  # Defines the initial status for enable or disable of storage of a diagnostic event. | The value is the initialization after power up (before this condition is reported the first time). true: storage of a diagnostic event enabled false: storage of a diagnostic event disabled
      container DemStorageConditionGroup [0..255]  # This container contains the configuration (parameters) for storage condition groups.
        reference DemStorageConditionRef [1..255]: set at pre-compile, origin=AUTOSAR_ECUC V1.0.0, destination=DemStorageCondition  # References an enable condition.
  module definition Det [0..1]: variants pre-compile  # Det configuration includes the functions to be called at notification. On one | side the application functions are specified and in general it can be decided whether Dlt shall be called at each call of Det.
    container DetGeneral  # Generic configuration parameters of the Det module.
      boolean DetForwardToDlt [0..1]: set at pre-compile  # Only if the parameter is present and set to true, the Det requires the Dlt interface and forwards it's call to the function Dlt_DetForwardErrorTrace. In this case the optional interface to Dlt_Det is required.
      boolean DetVersionInfoApi: set at pre-compile  # Pre-processor switch to enable / disable the API to read out the modules version information. | true: Version info API enabled. false: Version info API disabled.
    container DetNotification [0..1]  # Configuration of the notification functions.
      function name DetErrorHook [0..*]: set at pre-compile  # Optional list of functions to be called by the Development Error Tracer in context of each call of Det_ReportError. | The type of these functions shall be identical the type of Det_ReportError itself: Std_ReturnType (*f)(uint16, uint8, uint8, uint8).
  module definition Dio [0..1]: variants post-build/pre-compile  # Configuration of the Dio (Digital IO) module.
    container DioConfig: multiple-configuration-container=true  # This container contains the configuration parameters and sub containers of the AUTOSAR DIO module. This container is a MultipleConfigurationContainer, i.e. this container and its sub-containers exist once per configuration set.
      container DioPort [1..*]  # Configuration of individual DIO ports, consisting of channels and possible channel groups. | Note that this container definition does not explicitly define a symbolic name parameter. Instead, the container's short name will be used in the Ecu Configuration Description to specify the symbolic name of the port.
        integer DioPortId: 0..4294967295, set at post-build in variant post-build / pre-compile in variant pre-compile, symbolic-name-value=true  # Numeric identifier of the DIO port. Not all MCU ports may be used for DIO, thus there may be "gaps" in the list of all IDs. This value will be | assigned to the DIO port symbolic name (i.e. the SHORT-NAME of the DioPort container).
        container DioChannel [0..*]  # Configuration of an individual DIO channel. Besides a HW specific channel name which is typically fixed for a specific micro controller, additional symbolic names can be defined per channel. | Note hat this container definition does not explicitly define a symbolic name parameter. Instead, the container's short name will be used in the Ecu Configuration Description to specify the symbolic name of the channel.
          integer DioChannelId: 0..4294967295, set at post-build in variant post-build / pre-compile in variant pre-compile, symbolic-name-value=true  # Channel Id of the DIO channel. This value will be assigned to the symbolic names.
        container DioChannelGroup [0..*]  # Definition and configuration of DIO channel groups. A channel group represents several adjoining DIO channels represented by a logical group. | Note hat this container definition does not explicitly define a symbolic name parameter. Instead, the container's short name will be used in the Ecu Configuration Description to specify the symbolic name of the channel group.
          string DioChannelGroupIdentification: set at pre-compile, symbolic-name-value=true  # The DIO channel group is identified in DIO API by a pointer to a data structure (of type Dio_ChannelGroupType). That data structure contains the channel group information. | This parameter contains the code fragment that has to be inserted in the API call of the calling module to get the address of the variable in memory which holds the channel group information. Example values are "&MyDioGroup1" or "&MyDioGroupArray[0]"
          integer DioPortMask: 0..4294967295, set at post-build in variant post-build / pre-compile in variant pre-compile  # This shall be the mask which defines the positions of the channel | group. The channels shall consist of adjoining bits in the same port. The data type depends on the port width.
          integer DioPortOffset: 0..31, set at post-build in variant post-build / pre-compile in variant pre-compile  # The position of the Channel Group on the port, counted | from the LSB. This value can be derived from DioPortMask. calculationFormula = Position of the first bit of DioPortMask which is set to '1' counted from LSB
    container DioGeneral  # General DIO module configuration parameters.
      boolean DioDevErrorDetect: set at pre-compile  # Switches the Development Error Detection and Notification | ON or OFF
      boolean DioFlipChannelApi: set at pre-compile  # Adds / removes the service Dio_FlipChannel() from the code.
      boolean DioVersionInfoApi: set at pre-compile  # Adds / removes the service Dio_ GetVersionInfo() from the code.
  module definition Dlt [0..1]: variants link-time/post-build/pre-compile
    container DltGeneral  # Flags for adding removing functionality from code.
      boolean DltDevErrorDetect: set at pre-compile  # Enables/Disables development error detection.
      boolean DltImplementAppIdContextIdQuery: set at pre-compile  # If set the functionality for Verbose Mode shall be available.
      boolean DltImplementExtendedHeader: set at pre-compile  # If set the extended functionality for the header shall be available.
      boolean DltImplementFilterMessages: set at pre-compile  # This flag is for code generation of Dlt. If set the functionality for filtering messages shall be included in the code.
      boolean DltImplementNVRamStorage: set at pre-compile  # If set the functionality for storing and loading information in and from NVRam shall be availible.
      boolean DltImplementSWCInjection: set at pre-compile  # If the remote call from functions over the Dlt in SW-C shall be available.
      boolean DltImplementTimestamp: set at pre-compile  # If set the timestamp functionality for the header shall be available.
      boolean DltImplementVerboseMode: set at pre-compile  # If set the functionality for Verbose Mode shall be available.
      boolean DltImplementVfbTrace: set at pre-compile  # If set the the header files and the implementation of VFB-trace shall be generated.
      integer DltVfbTraceLogLevel: 0..6, set at link in variant link-time / pre-compile in variant post-build+pre-compile  # The log level of the log messages generated by the VFB-Trace. | ImplementationType: Dlt_MessageLogLevelType
      symbolic name reference DltGptChannel: set at pre-compile, destination=GptChannelConfiguration  # Reference to the hardware free running timer of the GPT module for time stamps (if no HWFRT is applied, calls to add timestamps are ignored).
    container DltMemory  # Configuration parameters for reserving memory for some internal storing and buffer.
      integer DltInitBufferSize: 0..4294967295, set at link in variant link-time / pre-compile in variant post-build+pre-compile  # Buffer size for the C-init buffer. This buffer is for storing messages from other BSW modules before Dlt is initialized. | Unit: byte
      integer DltMaxCountAppIds: 1..4294967295, set at link in variant link-time / pre-compile in variant post-build+pre-compile  # The maximum count of register able Application Ids. There shall be a table to manage registered Application IDs, this is the number of lines to hold in this table. | Unit: byte
      integer DltMaxCountContextIds: 1..4294967295, set at link in variant link-time / pre-compile in variant post-build+pre-compile  # The maximum count of registrable Context Ids. There shall be a table to manage registered Context IDs, this is the number of lines to hold in this table. | Unit: byte
      integer DltMaxCountContextIdsPerAppId: 1..4294967295, set at link in variant link-time / pre-compile in variant post-build+pre-compile  # Each Context ID belongs to a specific Application ID. Dlt shall handle the correlation between them. The table of the registered Application IDs shall hold for every Application ID several references to the proper Context IDs. This is the maximum count for Context IDs per Application ID. | Unit: byte
      integer DltMessageBufferSize: 0..4294967295, set at link in variant link-time / pre-compile in variant post-build+pre-compile  # Buffer size for storing Dlt messages for waiting to transmit over the Network (send buffer). | Unit: byte
    container DltMultipleConfigurationContainer: multiple-configuration-container=true  # Container holding the sub-structure for multiple configuration support.
      symbolic name reference DltNvRamBlockRef: set at post-build in variant post-build / pre-compile in variant pre-compile, destination=NvMBlockDescriptor  # Reference to the NvM Block which is used to store the Dlt parameters.
      container DltBandwidth  # Configuration parameters controlling network and diagnostic interfaces bandwidth. If DltImplementNVRamStorage is enabled this parameters are the initial values for the NVRam. If DltImplementNVRamStorage is not set, Link-Time or Post-Build configuration shall be uesd.
        integer DltBandwidthForComModule: 0..4294967295, set at link in variant link-time / post-build in variant post-build / pre-compile in variant pre-compile  # For communication over the Dlt Communication Module the maximum bandwidth shall be set. | Unit: kbit per second
        integer DltBandwidthForDiagChannel: 0..4294967295, set at link in variant link-time / post-build in variant post-build / pre-compile in variant pre-compile  # For communication over the DCM and as follows over the diagnostic interface the maximum bandwidth shall be set. | Unit: kbit per second
        float DltTimePeriodTrafficShaping: 0..Inf, set at link in variant link-time / post-build in variant post-build / pre-compile in variant pre-compile  # For implementing a traffic shaping, a time window for measuring shall be provided. | Unit: second
      container DltMessageFiltering  # Configuration parameters for setting message filtering properties in Dlt module.
        integer DltDefaultMaxLogLevel: 0..6, set at link in variant link-time / post-build in variant post-build / pre-compile in variant pre-compile  # The maximum log level a received message (from SW-C to Dlt) can have. This can also be modified at runtime and stored persistently in NVRAM. If DltImplementNVRamStorage is enabled this parameter is the initial value for the corospending NVRam entry. If DltImplementNVRamStorage is not set, Link-Time or Post-Build configuration shall be uesd. The value 0 means loging is disabled. | ImplementationType: Dlt_MessageLogLevelType
        boolean DltDefaultTraceStatus: set at link in variant link-time / post-build in variant post-build / pre-compile in variant pre-compile  # Tells if trace messages shall be forwarded by Dlt. This functionality can also be modified at runtime and changed can stored persistently in NVRAM. If DltImplementNVRamStorage is enabled this parameter is the initial value for the corresponding NVRam entry. If DltImplementNVRamStorage is not set, Link-Time or Post-Build configuration shall be used.
        integer DltFactoryDefaultMaxLogLevel: 0..6, set at link in variant link-time / post-build in variant post-build / pre-compile in variant pre-compile  # The maximum log level a received message (from SW-C to Dlt) can have. This is for setting DltDefaultMaxLogLevel to factory defaults. The value 0 means loging is disabled. | ImplementationType: Dlt_MessageLogLevelType
        boolean DltFilterMessages: set at link in variant link-time / pre-compile in variant post-build+pre-compile  # This flag gives the Dlt the instruction to filter or not to filter incoming log or trace messages. If it is not set all incoming messages are forwarded to the communication channel. So also the caller of the DltSendXXXMessage can leave the field trace_info or log_info empty. | If DltImplementNVRamStorage is enabled this parameter is the initial value for the corospending NVRam entry. If DltImplementNVRamStorage is not set, Link-Time or Post-Build configuration shall be uesd.
      container DltProtocol  # Configuration parameters for handling the specific protocol variants.
        string DltEcuId: set at link in variant link-time / post-build in variant post-build / pre-compile in variant pre-compile  # This is the name of the ECU for use within the Dlt protocol. The meaning is described in the document. This name is transimitted within the Dlt protocol. There this are 4 characters. If you want to use an number representation type this as character.
        enumeration DltHeaderPayloadEndianes: {BigEndian, LittleEndian}, set at pre-compile  # Determines the endianes of the CPU (Most Significant Byte).
        boolean DltHeaderUseEcuId: set at link in variant link-time / post-build in variant post-build / pre-compile in variant pre-compile  # Corresponds to field WEID (With ECU ID). If set ECU ID shall be placed in the header, else not. | If DltImplementNVRamStorage is enabled this parameter is the initial value for the corospending NVRam entry. If DltImplementNVRamStorage is not set, Link-Time or Post-Build configuration shall be uesd.
        boolean DltHeaderUseExtendedHeader: set at link in variant link-time / post-build in variant post-build / pre-compile in variant pre-compile  # Corresponds to field UEH (Use Extended Header). If set the Extended Header shall be attached, else not. | If DltImplementNVRamStorage is enabled this parameter is the initial value for the corospending NVRam entry. If DltImplementNVRamStorage is not set, Link-Time or Post-Build configuration shall be uesd.
        boolean DltHeaderUseSessionID: set at link in variant link-time / post-build in variant post-build / pre-compile in variant pre-compile  # Corresponds to field WSID (with Session ID). If set the Session ID shall be placed in the header, else not. | If DltImplementNVRamStorage is enabled this parameter is the initial value for the corospending NVRam entry. If DltImplementNVRamStorage is not set, Link-Time or Post-Build configuration shall be uesd.
        boolean DltHeaderUseTimestamp: set at link in variant link-time / post-build in variant post-build / pre-compile in variant pre-compile  # Corresponds to field WTMS (With Timestamp). If set the timestamp shall be placed in the header, else not. | If DltImplementNVRamStorage is enabled this parameter is the initial value for the corospending NVRam entry. If DltImplementNVRamStorage is not set, Link-Time or Post-Build configuration shall be uesd.
        integer DltMaxMessageLength: 8..65535, set at link in variant link-time / pre-compile in variant post-build+pre-compile  # The maximum length of a Dlt log or trace message.
        boolean DltUseVerboseMode: set at link in variant link-time / post-build in variant post-build / pre-compile in variant pre-compile  # If this flag is set Dlt shall use the Verbose Mode for generating the header of the transport protocol. Also it shall store the information provided by registering Context ID and Application ID (description) at runtime if flag is set. If it is not set, the Non Verbose Mode shall be used. | If DltImplementNVRamStorage is enabled this parameter is the initial value for the corospending NVRam entry. If DltImplementNVRamStorage is not set, Link-Time or Post-Build configuration shall be uesd.
    container DltVfbTrace [0..*]  # All functions to trace from the VFB by the Dlt.
      function name DltVfbTraceFunction: set at pre-compile  # The Dlt generator shall enable VFB tracing for a given hook function when there is a #define in the Dlt-VFB configuration header file for the hook function name and tracing is globally enabled. | Example: #define Dlt_Rte WriteHook i1 p1 a Start. Also the corresponding function shall be generated. The exact argument description for the function is to take from the provieded BSWModudulDescription from the RTE module.
      foreign reference DltBswModuleEntryRef: set at pre-compile, destination-type=BSW-MODULE-ENTRY  # Foreign reference to the BSWModuleEntry describing the trace function implementation.
  module definition DoIP [0..1]: variants link-time/post-build/pre-compile  # Configuration of the DoIP (Diagnostic over IP) module.
    container DoIPConfigSet: multiple-configuration-container=true  # This container contains the configuration parameters and sub containers of the AUTOSAR DoIP module. This container is a MultipleConfigurationContainer, i.e. this container and its sub-containers exist once per configuration set.
      integer DoIPEid [0..1]: 1..281474976710656, set at link in variant link-time / post-build in variant post-build / pre-compile in variant pre-compile  # Configured EID (Entity ID of) for vehicle identification/vehicle announcement. Only necessary if DoIPUseMacAddressForIdentification is set to FALSE.
      integer DoIPGid [0..1]: 1..281474976710656, set at link in variant link-time / post-build in variant post-build / pre-compile in variant pre-compile  # Configured GID (Group ID of) for vehicle identification/vehicle announcement.
      integer DoIPLogicalAddress: 1..65535, set at link in variant link-time / post-build in variant post-build / pre-compile in variant pre-compile  # Describes the logical address of the DoIP entity, i.e. the SA that will route diagnostic requests to the Dcm of the DoIP entity.
      container DoIPChannel [1..65536]  # Configuration of one DoIPChannel.
        reference DoIPChannelSARef: destination=DoIPTester  # Reference to the DoIPTester.
        reference DoIPChannelTARef: destination=DoIPTargetAddress  # Reference to the target address.
        container DoIPPduRRxPdu  # This container contains the Rx Pdus to connect with the Rx Pdus of the PduR.
          integer DoIPPduRRxPduId: 1..65535, set at link in variant link-time / post-build in variant post-build / pre-compile in variant pre-compile, symbolic-name-value=true  # The DoIPPduRRxPduId is required by the API call DoIP_CancelReceive.
          reference DoIPPduRRxPduRef: set at link in variant link-time / post-build in variant post-build / pre-compile in variant pre-compile, destination=Pdu  # Reference to the "global" Pdu structure to allow harmonization of handle IDs in the COM-Stack.
        container DoIPPduRTxPdu  # This container contains the Tx Pdus to connect with the Tx Pdus of the PduR.
          integer DoIPPduRTxPduId: 1..65535, set at link in variant link-time / post-build in variant post-build / pre-compile in variant pre-compile, symbolic-name-value=true  # The DoIPPduRTxPduId is required by DoIP_Transmit and DoIP_CancelTransmit.
          reference DoIPPduRTxPduRef: set at link in variant link-time / post-build in variant post-build / pre-compile in variant pre-compile, destination=Pdu  # Reference to the "global" Pdu structure to allow harmonization of handle IDs in the COM-Stack.
      container DoIPConnections  # Container contains all lower layer connection specific information, i.e. the single Pdu References and Handle IDs to the SoAd.
        container DoIPTargetAddress [1..255]  # This container describes a possible TargetAddress that is supported by DoIP.
          integer DoIPTargetAddressValue: 1..65535, set at link in variant link-time / post-build in variant post-build / pre-compile in variant pre-compile  # Valid Target Address of a DoIP target address.
        container DoIPTcpConnection [1..255]  # Each container describes a tcp connection to the lower layer SoAd module.
          container DoIPSoAdRxPdu  # This container contains the Rx Pdus received by DoIP
            integer DoIPSoAdRxPduId: 1..65535, set at link in variant link-time / post-build in variant post-build / pre-compile in variant pre-compile, symbolic-name-value=true  # The DoIPSoAdRxPduId is required by the API call DoIP_SoAdTpRxIndication to receive I-PDUs from the SoAd.
            reference DoIPSoAdRxPduRef: set at link in variant link-time / post-build in variant post-build / pre-compile in variant pre-compile, destination=Pdu  # Reference to the "global" Pdu structure to allow harmonization of handle IDs in the COM-Stack.
          container DoIPSoAdTxPdu  # This container describes the TxPdu sent via the SoAd
            integer DoIPSoAdTxPduId: 1..65535, set at link in variant link-time / post-build in variant post-build / pre-compile in variant pre-compile, symbolic-name-value=true  # The DoIPSoAdTxPduId is required by the API call DoIP_SoAdTpTxConfirmation that is called by the SoAd to confirm that the IPdu has been transmitted successfully.
            reference DoIPSoAdTxPduRef: set at link in variant link-time / post-build in variant post-build / pre-compile in variant pre-compile, destination=Pdu  # Reference to the "global" Pdu structure to allow harmonization of handle IDs in the COM-Stack.
        container DoIPUdpConnection [1..255]  # This Container describes the udp connection to the lower layer SoAd module.
          container DoIPSoAdRxPdu  # This container contains the Rx Pdus received by DoIP
            integer DoIPSoAdRxPduId: 1..65535, set at link in variant link-time / post-build in variant post-build / pre-compile in variant pre-compile, symbolic-name-value=true  # The DoIPSoAdRxPduId is required by the API call DoIP_SoAdTpRxIndication to receive I-PDUs from the SoAd.
            reference DoIPSoAdRxPduRef: set at link in variant link-time / post-build in variant post-build / pre-compile in variant pre-compile, destination=Pdu  # Reference to the "global" Pdu structure to allow harmonization of handle IDs in the COM-Stack.
          container DoIPSoAdTxPdu  # This container describes the TxPdu sent via the SoAd
            integer DoIPSoAdTxPduId: 1..65535, set at link in variant link-time / post-build in variant post-build / pre-compile in variant pre-compile, symbolic-name-value=true  # The DoIPSoAdTxPduId is required by the API call DoIP_SoAdTpTxConfirmation that is called by the SoAd to confirm that the IPdu has been transmitted successfully.
            reference DoIPSoAdTxPduRef: set at link in variant link-time / post-build in variant post-build / pre-compile in variant pre-compile, destination=Pdu  # Reference to the "global" Pdu structure to allow harmonization of handle IDs in the COM-Stack.
      container DoIPRoutingActivation [0..255]: post-build-changeable=true  # This container describes the routing activation possibilities by representing for each container a possible routing activation request message to the DoIP entity and the according references to the activated diagnostic messages.
        integer DoIPRoutingActivationNumber: 0..255, set at link in variant link-time / post-build in variant post-build / pre-compile in variant pre-compile  # Identifies the Routing activation Number which is received for a DoIP routing activation request message.
        reference DoIPTargetAddressRef [1..255]: set at link in variant link-time / post-build in variant post-build / pre-compile in variant pre-compile, destination=DoIPTargetAddress  # Reference to all DoIPTargetAddress which are activated on this Routing activation.
        container DoIPRoutingActivationAuthenticationCallback [0..1]  # Container describes the Callbackfunction to call on a Routing Activation Request for Authentication. If this container is configured but the DoIPRoutingAcivationAuthenticationFunc parameter is not present, the DoIP module will use an RPort of ServiceInterface <RoutingActivation>_RoutingActivation with the name "CB<RoutingActivation>RoutingActivation". <RoutingActivation> is the ShortName of the DoIPRoutingActiviation container.
          function name DoIPRoutingAcivationAuthenticationFunc [0..1]: set at link in variant link-time+post-build / pre-compile in variant pre-compile  # Direct C Callback function to trigger the authentication function for routing activation. If the DoIPRoutingAcivationAuthenticationFunc parameter is present, the DoIP module will not use an RPort of ServiceInterface <RoutingActivation>_RoutingActivation but call the configured function.
          integer DoIPRoutingActivationAuthenticationReqLength: 0..4, set at link in variant link-time+post-build / pre-compile in variant pre-compile  # Describes the amount of bytes used to handle to the authentication function on routing activation. If 0 is configured as length the parameter AuthenticationReqData will not be handled to the API.
          integer DoIPRoutingActivationAuthenticationResLength: 0..4, set at link in variant link-time+post-build / pre-compile in variant pre-compile  # Describes the amount of bytes used to read by the authentication function on routing activation. If 0 is configured as length the parameter AuthenticationResData will not be fetched via the API.
        container DoIPRoutingActivationConfirmationCallback [0..1]  # Container describes the Callbackfunction to call on a Routing Activation Request for Confirmation. If this container is configured but the DoIPRoutingAcivationConfirmationFunc parameter is not present the DoIP module will use an RPort of ServiceInterface <RoutingActivation>_RoutingActivation with the name "CB<RoutingActivation>RoutingActivation". <RoutingActivation> is the ShortName of the DoIPRoutingActiviation container.
          function name DoIPRoutingAcivationConfirmationFunc [0..1]: set at link in variant link-time+post-build / pre-compile in variant pre-compile  # Direct C Callback function to trigger the confirmation function for routing activation. If the DoIPRoutingAcivationConfirmationFunc parameter is present the DoIP module will not use an RPort of ServiceInterface <RoutingActivation>_RoutingActivation but call the configured function.
          integer DoIPRoutingActivationConfirmationReqLength: 0..4, set at link in variant link-time+post-build / pre-compile in variant pre-compile  # Describes the amount of bytes used to handle to the confirmation function on routing activation. If 0 is configured as length the parameter ConfirmedReqData will not be handled to the API.
          integer DoIPRoutingActivationConfirmationResLength: 0..4, set at link in variant link-time+post-build / pre-compile in variant pre-compile  # Describes the amount of bytes used to read by the confirmation function on routing activation. If 0 is configured as length the parameter ConfirmedResData will not be fetched via the API.
      container DoIPTester [0..255]: post-build-changeable=true  # This container describes the properties of the possible connectable Tester for the DoIP entity.
        integer DoIPNumByteDiagAckNack: 1..18446744073709551611, set at link in variant link-time / post-build in variant post-build / pre-compile in variant pre-compile  # Specifies the number of original Diagnostic request bytes the DoIP entity responses on a NACK of a diagnostic response message to the Tester.
        integer DoIPTesterSA: 1..65535, set at link in variant link-time / post-build in variant post-build / pre-compile in variant pre-compile  # Source Address of the Tester sent via routing activation or diagnostic message.
        reference DoIPRoutingActivationRef [1..255]: set at link in variant link-time / post-build in variant post-build / pre-compile in variant pre-compile, destination=DoIPRoutingActivation  # Reference to a DoIPRoutingActivation describing the possible routing activations of the DoIPTester
    container DoIPGeneral  # This container specifies the general configuration parameters of the DoIP module.
      float DoIPAliveCheckResponseTimeout: 0..Inf, set at pre-compile  # Timeout in [s] for waiting for a response to an Alive Check request before the connection is considered to be disconnected. Represents parameter T_TCP_AliveCheck of ISO 13400-2:2012.
      boolean DoIPDevelopmentErrorDetect: set at pre-compile  # Pre-processor switch for enabling development error detection support.
      boolean DoIPDhcpOptionVinUse: set at pre-compile  # If DoIPDhcpOptionVinUse is set to true the DoIP module will add the VIN to the Dhcp host name if no valid Dhcp host name is already set.
      boolean DoIPEntityStatusMaxByteFieldUse: set at pre-compile  # This parameter is used to distinguish the optional support of the Max data size element of a diagnostic entity status response.
      integer DoIPGIDInvalidityPattern: 0..255, set at pre-compile  # Specifies the Byte pattern that is used for response messages if no valid GID could be retrieved.
      float DoIPGeneralInactivityTime: 0..Inf, set at pre-compile  # Timeout in [s] for maximum inactivity of a TCP socket connection before the DoIP module will close the according socket connection. Represents parameter T_TCP_General_Inactivity of ISO 13400-2:2012
      string DoIPHeaderFileInclusion [0..*]: set at pre-compile  # Name of the header file(s) to be included by the DoIP module containing the used C-callback declarations.
      float DoIPInitialInactivityTime: 0..Inf, set at pre-compile  # Timeout in [s] used for initial inactivity of a connected TCP socket connection directly after socket connection. Represents parameter T_TCP_Initial_Inactivity of ISO 13400-2:2012
      float DoIPInitialVehicleAnnouncementTime: 0..Inf, set at pre-compile  # Time to wait in [s] for sending first vehicle anouncement message after IP address assignment. Represents parameter A_DoIP_Announce_Wait of ISO 13400-2:2012
      float DoIPMainFunctionPeriod: 0..Inf, set at pre-compile  # Determines the frequency at which the DoIP_MainFunction() is called in [s].
      integer DoIPMaxRequestBytes: 1..18446744073709551615, set at pre-compile  # Specifies the maximum allowed bytes of a DoIP message request without the DoIP header.
      integer DoIPMaxTesterConnections: 1..255, set at pre-compile  # Maximum ammount of tester connections that shall be maintained at one time before alive check is performed.
      enumeration DoIPNodeType: {DOIP_GATEWAY, DOIP_NODE}, set at pre-compile  # Describes the Type of the DoIP node.
      boolean DoIPUseEIDasGID: set at pre-compile  # Specifies if the DoIP entity shall use its EID if it is the Master for vehicle identification gid on the vehicle identification/vehicle announcement.
      boolean DoIPUseMacAddressForIdentification: set at pre-compile  # Provided the information if a configured EID at vehicle identification response/vehicle announment is used or the MAC address. | TRUE: Use MAC Address instead of EID for Vehicle identification/announcement. FALSE: Use configured EID for vehicle identification/announcement. Dependencies: DoIPEID
      boolean DoIPUseVehicleIdentificationSyncStatus: set at pre-compile  # Defines if the optional VIN/GID synchronization status is used additionally in the vehicle identification/announcement.
      float DoIPVehicleAnnouncementInterval: 0..Inf, set at pre-compile  # Time to wait in [s] for sending subsequent vehicle anouncement messages. Represents parameter A_DoIP_Announce_Interval of ISO 13400-2:2012
      integer DoIPVehicleAnnouncementRepetition: 1..255, set at pre-compile  # Amount of repetitions of the vehicle announcement message on IP address assignment. Represents parameter A_DoIP_Annunce_Num of ISO 13400-2:2012
      boolean DoIPVersionInfoApi: set at pre-compile  # Activates the DoIP_GetVersionInfo() API. | TRUE: Enables the DoIP_GetVersionInfo() API. FALSE: DoIP_GetVersionInfo() API is not included.
      boolean DoIPVinGidMaster: set at pre-compile  # Specifies if the DoIP entity is the Vehicle identification Master for the GID (Group ID).
      integer DoIPVinInvalidityPattern: 0..255, set at pre-compile  # Specifies the Byte pattern that is used for response messages if no valid VIN could be retrieved.
      container DoIPGetGid [0..1]  # This container describes the Callbackfunction to get the GID. | If this container is not configured no Callbackfunction will be used. If this container is configured but the DoIPGetGID parameter is not present, the DoIP module will use an RPort of ServiceInterface CallbackGetGID with the name "CBGetGID".
        function name DoIPGetGID [0..1]: set at link in variant link-time+post-build / pre-compile in variant pre-compile  # Direct C Callback function to get the GID of the DoIP entity. If the DoIPGetGID parameter is present, the DoIP module will not use an RPort of ServiceInterface CallbackGetGID but call the configured function.
      container DoIPPowerModeCallback  # This container describes the Callbackfunction to get the Power Mode. This container shall always be present. | If the DoIPPowerMode parameter is not present, the DoIP module will use an RPort of ServiceInterface CallbackGetPowerMode with the name "CBGetPowerMode".
        function name DoIPPowerMode [0..1]: set at link in variant link-time+post-build / pre-compile in variant pre-compile  # Direct C Callback function to get the Power Mode of the DoIP entity. If the DoIPPowerMode parameter is present, the DoIP module will not use an RPort of ServiceInterface CallbackGetPowerMode but will call the configured function.
      container DoIPTriggerGidSynchronization [0..1]  # This container describes the Callbackfunction to trigger the GID synchronisation. | If this container is not configured no Callbackfunction will be used. If this container is configured but the DoIPTriggerGIDSynchronzation parameter is not present, the DoIP module will use an RPort of ServiceInterface CallbackTriggerGIDSynchronization with the name "CBTriggerGIDSynchronization".
        function name DoIPTriggerGIDSynchronzation [0..1]: set at link in variant link-time+post-build / pre-compile in variant pre-compile  # Direct C Callback function to trigger the synchronization of the GID. If the DoIPTriggerGIDSynchronzation parameter is present, the DoIP module will not use an RPort of ServiceInterface CallbackTriggerGIDSynchronization but call the configured function.
  module definition Ea [0..1]: variants pre-compile  # Configuration of the Ea (EEPROM Abstraction) module. | The module shall abstract from the device specific addressing scheme and segmentation and provide the upper layers with a virtual addressing scheme and segmentation as well as a 'virtually' unlimited number of erase cycles.
    container EaBlockConfiguration [1..*]  # Configuration of block specific parameters for the EEPROM abstraction module.
      integer EaBlockNumber: 1..65534, set at pre-compile, symbolic-name-value=true  # Block identifier (handle). | 0x0000 and 0xFFFF shall not be used for block numbers (see EA006). Range: min = 2^NVM_DATASET_SELECTION_BITS max = 0xFFFF -2^NVM_DATASET_SELECTION_BITS Note: Depending on the number of bits set aside for dataset selection several other block numbers shall also be left out to ease implementation.
      integer EaBlockSize: 1..65535, set at pre-compile  # Size of a logical block in bytes.
      boolean EaImmediateData: set at pre-compile  # Marker for high priority data. | true: Block contains immediate data. false: Block does not contain immediate data.
      integer EaNumberOfWriteCycles: 0..4294967295, set at pre-compile  # Number of write cycles required for this block.
      symbolic name reference EaDeviceIndex: set at pre-compile, destination=EepGeneral  # Device index (handle). | Range: 0 .. 254 (0xFF reserved for broadcast call to GetStatus function).
    container EaGeneral  # General configuration of the EEPROM abstraction module. This container lists block independent configuration parameters.
      boolean EaDevErrorDetect: set at pre-compile  # Pre-processor switch to enable and disable development error detection. | true: Development error detection enabled. false: Development error detection disabled.
      integer EaIndex: 0..254, set at pre-compile  # Specifies the InstanceId of this module instance. If only one instance is present it shall have the Id 0.
      function name EaNvmJobEndNotification [0..1]: set at pre-compile  # Mapped to the job end notification routine provided by the upper layer module (NvM_JobEndNotification).
      function name EaNvmJobErrorNotification [0..1]: set at pre-compile  # Mapped to the job error notification routine provided by the upper layer module (NvM_JobErrorNotification).
      boolean EaPollingMode: set at pre-compile  # Pre-processor switch to enable and disable the polling mode for this module. | true: Polling mode enabled, callback functions (provided to EEP module) disabled. false: Polling mode disabled, callback functions (provided to EEP module) enabled.
      boolean EaSetModeSupported: set at pre-compile, default-value=true  # Compile switch to enable / disable the function Ea_SetMode.
      boolean EaVersionInfoApi: set at pre-compile  # Pre-processor switch to enable / disable the API to read out the modules version information. | true: Version info API enabled. false: Version info API disabled.
      integer EaVirtualPageSize: 0..65535, set at pre-compile  # The size in bytes to which logical blocks shall be aligned.
    container EaPublishedInformation  # Additional published parameters not covered by CommonPublishedInformation container. | Note that these parameters do not have any configuration class setting, since they are published information.
      integer EaBlockOverhead: 0..65535, set at published-information  # Management overhead per logical block in bytes. | Note: If the management overhead depends on the block size or block location a formula has to be provided that allows the configurator to calculate the management overhead correctly.
      float EaMaximumBlockingTime: 0..Inf, set at published-information  # The maximum time the EA module's API routines shall be blocked (delayed) by internal operations. (EA070) | Note: Internal operations in that case means operations that are not explicitly invoked from the upper layer module but need to be handled for proper operation of this module or the underlying memory driver.
      integer EaPageOverhead: 0..65535, set at published-information  # Management overhead per page in bytes. | Note: If the management overhead depends on the block size or block location a formula has to be provided that allows the configurator to calculate the management overhead correctly.
  module definition EcuC [0..1]: variants post-build/pre-compile  # Virtual module to collect ECU Configuration specific / global configuration information.
    container EcucPartitionCollection [0..1]  # Collection of Partitions defined for this ECU.
      container EcucPartition [0..*]  # Definition of one Partition on this ECU. | One Partition will be implemented using one Os-Application.
        boolean EcucPartitionBswModuleExecution: set at pre-compile  # Denotes that this partition will execute all BSW Modules. BSW Modules can only be executed in one partition.
        boolean PartitionCanBeRestarted: set at pre-compile  # Specifies the requirement whether the Partition can be restarted. If set to true all software executing in this partition shall be capable of handling a restart.
        instance reference EcucPartitionSoftwareComponentInstanceRef [0..*]: set at pre-compile, destination-context=ROOT-SW-COMPOSITION-PROTOTYPE, destination-type=SW-COMPONENT-PROTOTYPE  # References the SW Component instances from the Ecu Extract that shall be executed in this partition.
    container EcucPduCollection [0..1]  # Collection of all Pdu objects flowing through the Com-Stack.
      enumeration PduIdTypeEnum: {UINT16, UINT8}  # The PduIdType is used within the entire AUTOSAR Com Stack except for bus drivers. The size of this global type depends on the maximum number of PDUs used within one software module. If no software module deals with more PDUs that 256, this type can be set to uint8. If at least one software module handles more than 256 PDUs, this type must be set to uint16. See AUTOSAR_SWS_CommunicationStackTypes for more details.
      enumeration PduLengthTypeEnum: {UINT16, UINT32, UINT8}  # The PduLengthType is used within the entire AUTOSAR Com Stack except for bus drivers. The size of this global type depends on the maximum length of PDUs to be sent by an ECU. If no segmentation is used the length depends on the maximum payload size of a frame of the underlying communication system (for FlexRay maximum size is 255 bytes, therefore uint8). If segementation is used it depends on the maximum length of a segmeneted N-PDU (in general uint16 is used). See AUTOSAR_SWS_CommunicationStackTypes for more details.
      container Pdu [0..*]  # One Pdu flowing through the COM-Stack. | This Pdu is used by all Com-Stack modules to agree on referencing the same Pdu.
        integer PduLength: 0..4095, set at post-build in variant post-build / pre-compile in variant pre-compile  # Length of the Pdu in bytes. It should be noted that in former AUTOSAR releases (Rel 2.1, Rel 3.0, Rel 3.1, Rel 4.0 Rev. 1) this parameter was defined in bits.
        foreign reference SysTPduToFrameMappingRef [0..1]: set at pre-compile, destination-type=PDU-TO-FRAME-MAPPING  # Optional reference to the PduToFrameMapping from the SystemTemplate which this Pdu represents.
    container EcucVariationResolver [0..1]  # Collection of PredefinedVariant elements containing definition of values for SwSystemconst which shall be applied when resolving the variability during ECU Configuration.
      foreign reference PredefinedVariantRef [1..*]: set at pre-compile, destination-type=PREDEFINED-VARIANT
