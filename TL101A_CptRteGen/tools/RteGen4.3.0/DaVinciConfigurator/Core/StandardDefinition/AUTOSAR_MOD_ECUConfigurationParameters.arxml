[part 2 of 6: package /AUTOSAR/EcucDefs]
AUTOSAR XML (schema 4-0-3)
# The material contained in this specification is protected by copyright and
# other types of Intellectual Property Rights. The commercial exploitation of
# the material contained in this specification requires a license to such
# Intellectual Property Rights.
# This specification may be utilized or reproduced without any modification, in
# any form or by any means, for informational purposes only.
# For any other purpose, no part of the specification may be utilized or
# reproduced, in any form or by any means, without permission in writing from
# the publisher.
# licensed under the same rules as applicable to the AUTOSAR Standard.
package /AUTOSAR/EcucDefs  (continued)
  module definition CanTrcv [0..*]: variants post-build/pre-compile  # Configuration of the CanTrcv (CAN Transceiver driver) module.
    container CanTrcvConfigSet: multiple-configuration-container=true  # This is the multiple configuration set container for CAN Transceiver.
      integer CanTrcvSPICommRetries: 0..255, set at post-build in variant post-build / pre-compile in variant pre-compile, default-value=0  # Indicates the maximum number of communication retries in case of a failed SPI communication (applies both to timed out communication and to errors/NACK in the response data). | If configured value is '0', no retry is allowed (communication is expected to succeed at first try).
      integer CanTrcvSPICommTimeout: 0..100, set at post-build in variant post-build / pre-compile in variant pre-compile, default-value=0  # Indicates the maximum time allowed to the CanTrcv for replying (either positively or negatively) to a SPI command. | Timeout is configured in milliseconds. Timeout value of '0' means that no specific timeout is to be used by CanTrcv and the communication is executed at the best of the SPI HW capacity.
      container CanTrcvChannel [1..*]  # Container gives CAN transceiver driver information about a single CAN | transceiver (channel).
        integer CanTrcvChannelId: 0..255, set at pre-compile, symbolic-name-value=true  # Unique identifier of the CAN Transceiver Channel.
        boolean CanTrcvChannelUsed: set at pre-compile, default-value=true  # Shall the related CAN transceiver channel be used?
        boolean CanTrcvControlsPowerSupply: set at pre-compile, default-value=false  # Is ECU power supply controlled by this transceiver? | TRUE = Controlled by transceiver. FALSE = Not controlled by transceiver.
        boolean CanTrcvHwPnSupport: set at pre-compile, default-value=false  # Indicates whether the HW supports the selective wake-up function | TRUE = Selective wakeup feature is supported by the transceiver FALSE = Selective wakeup functionality is not available in transceiver
        enumeration CanTrcvInitState: {CANTRCV_OP_MODE_NORMAL, CANTRCV_OP_MODE_SLEEP, CANTRCV_OP_MODE_STANDBY}, set at pre-compile, default-value=CANTRCV_OP_MODE_NORMAL  # State of CAN transceiver after call to CanTrcv_Init.
        integer CanTrcvMaxBaudrate: 0..1000, set at pre-compile  # Max baudrate for transceiver hardware type. Only used for validation purposes. Value shall be configured by configuration tool based on | transceiver hardware type.
        boolean CanTrcvWakeupByBusUsed [0..1]: set at pre-compile, default-value=false  # Is wake up by bus supported? If CAN transceiver hardware does not support wake up by bus value is always FALSE. If CAN transceiver hardware supports wake up by bus value is TRUE or FALSE depending whether it is used or not. | TRUE = Is used. FALSE = Is not used.
        reference CanTrcvWakeupSourceRef [0..1]: set at pre-compile, destination=EcuMWakeupSource  # Reference to a wakeup source in the EcuM configuration. | This reference is only needed if CanTrcvWakeupByBusUsed is true.
        choice container CanTrcvAccess  # Container gives CanTrcv Driver information about access to a single CAN transceiver.
          container CanTrcvDioAccess [0..1]  # Container gives CAN transceiver driver information about accessing ports and port pins. In addition relation between CAN transceiver hardware pin names and Dio port access information is given. | If a CAN transceiver hardware has no Dio interface, there is no instance of this container.
            container CanTrcvDioChannelAccess [1..*]  # Container gives DIO channel access by single Can transceiver channel.
              string CanTrcvHardwareInterfaceName: set at pre-compile  # CAN transceiver hardware interface name. It is typically the name of a pin. From a Dio point of view it is either a port, a single channel or a channel group. Depending on this fact either | CANTRCV_DIO_PORT_SYMBOLIC_NAME or CANTRCV_DIO_CHANNEL_SYMBOLIC_NAME or CANTRCV_DIO_CHANNEL_GROUP_SYMBOLIC_NAME shall reference a Dio configuration. The CAN transceiver driver implementation description shall list up this name for the appropriate CAN transceiver hardware.
              choice reference CanTrcvDioSymNameRef: set at pre-compile, destination=[DioChannel, DioChannelGroup, DioPort]  # Choice Reference to a DIO Port, DIO Channel or DIO Channel Group. This reference replaces the CANTRCV_DIO_PORT_SYM_NAME, CANTRCV_DIO_CHANNEL_SYM_NAME and CANTRCV_DIO_GROUP_SYM_NAME references in the Can Trcv SWS.
          container CanTrcvSpiSequence [0..*]  # Container gives CAN transceiver driver information about one SPI sequence. | One SPI sequence used by CAN transceiver driver is in exclusive use for it. No other driver is allowed to access this sequence. CAN transceiver driver may use one sequence to access n CAN transceiver hardwares chips of the same type or n sequences are used to access one single CAN transceiver hardware chip. If a CAN transceiver hardware has no SPI interface, there is no instance of this container.
            boolean CanTrcvSpiAccessSynchronous [0..1]: set at pre-compile, default-value=false  # This parameter is used to define whether the access to the Spi sequence is synchronous or asynchronous. | true: SPI access is synchronous. false: SPI access is asynchronous.
            symbolic name reference CanTrcvSpiSequenceName [0..*]: set at pre-compile, destination=SpiSequence  # Reference to a Spi sequence configuration container.
        container CanTrcvPartialNetwork [0..1]  # Container gives CAN transceiver driver information about the configuration of Partial Networking functionality.
          integer CanTrcvBaudRate: 0..1000, set at post-build in variant post-build / pre-compile in variant pre-compile  # Indicates the CAN Bus communication baud rate in kbps.
          boolean CanTrcvBusErrFlag: set at post-build in variant post-build / pre-compile in variant pre-compile, default-value=false  # Indicates if the Bus Error (BUSERR) flag is managed by the BSW. This flag is set if a bus failure is detected by the transceiver. | TRUE = Supported by transceiver and managed by BSW. FALSE = Not managed by BSW.
          boolean CanTrcvPnCanIdIsExtended: set at post-build in variant post-build / pre-compile in variant pre-compile, default-value=false  # Indicates whether extended or standard ID is used. | TRUE = Extended Can identifier is used. FALSE = Standard Can identifier is used
          boolean CanTrcvPnEnabled: set at post-build in variant post-build / pre-compile in variant pre-compile, default-value=false  # Indicates whether the selective wake-up function is enabled or disabled in HW. | TRUE = Selective wakeup feature is enabled in the transceiver hardware FALSE = Selective wakeup feature is disabled in the transceiver hardware
          integer CanTrcvPnFrameCanId: 0..4294967295, set at post-build in variant post-build / pre-compile in variant pre-compile  # CAN ID of the Wake-up Frame (WUF).
          integer CanTrcvPnFrameCanIdMask: 0..4294967295, set at post-build in variant post-build / pre-compile in variant pre-compile  # ID Mask for the selective activation of the transceiver. It is used to enableFrame Wake-up (WUF) on a group of IDs.
          integer CanTrcvPnFrameDlc: 0..8, set at post-build in variant post-build / pre-compile in variant pre-compile  # Data Length of the Wake-up Frame (WUF).
          boolean CanTrcvPowerOnFlag: set at post-build in variant post-build / pre-compile in variant pre-compile, default-value=false  # Description: Indicates if the Power On Reset (POR) flag is available and is managed by the transceiver. | TRUE = Supported by Hardware. FALSE = Not supported by Hardware
          container CanTrcvPnFrameDataMaskSpec [0..8]  # Defines data payload mask to be used on the received payload in order to determine if the transceiver must be woken up by the received Wake-up Frame (WUF).
            integer CanTrcvPnFrameDataMask: 0..255, set at post-build in variant post-build / pre-compile in variant pre-compile  # Defines the n byte (Byte0 = LSB) of the data payload mask to be used on the received payload in order to determine if the transceiver must be woken up by the received Wake-up Frame (WUF).
            integer CanTrcvPnFrameDataMaskIndex: 0..7, set at post-build in variant post-build / pre-compile in variant pre-compile  # holds the position n in frame of the mask-part
    container CanTrcvGeneral  # Container gives CAN transceiver driver basic information.
      boolean CanTrcvDevErrorDetect: set at pre-compile  # Switches development error detection and notification on and off. | If switched on, #define CANTRCV_DEV _ERROR_DETECT ON shall be generated. If switched off, #define CANTRCV_DEV_ERROR _DETECT OFF shall be generated. Define shall be part of file CanTrcv_Cfg.h.
      boolean CanTrcvGetVersionInfo: set at pre-compile, default-value=false  # Switches version information API on and off. If switched off, function need not be present in compiled code.
      integer CanTrcvSPICommRetries: 0..255, set at pre-compile, default-value=0  # Indicates the maximal number of communication retries in case of failed SPI communication (applies both to timed out communication and to errors/NACK in the response data). | (0 ... 255 times, 0 means no retry allowed, communication must succeed at first try)
      integer CanTrcvSPICommTimeout: 0..100, set at pre-compile, default-value=0  # Indicates the maximal time allowed to the Transceiver in order to reply | (either positively or negatively) to a SPI command. (value in ms, 0ms means no specific timeout is to be used, communication is executed at the best of the SPI HW capacity)
      integer CanTrcvWaitCount: 0..4294967295, set at pre-compile, default-value=0  # Indicates the number of wait states to change the transceiver operation mode. Transceiver hardware may need wait states for some transitions.
      enumeration CanTrcvWakeUpSupport: {CANTRCV_WAKEUP_BY_POLLING, CANTRCV_WAKEUP_NOT_SUPPORTED}, set at pre-compile  # Informs whether wake up is supported by polling or not supported. In case no | wake up is supported by the hardware, setting has to be NOT_SUPPORTED. Only in the case of wake up supported by polling, function CanTrcv_MainFunction has to be present and to be invoked by the scheduler.
  module definition Cdd [0..*]  # The CDD module describes the minimal requirements that are necessary for the configuration of a CDD with respect to the surrounding standardized BSW modules.
    container CddComStackContribution [0..1]  # Contribution of COM Stack modules.
      container CddComIfUpperLayerContribution [0..1]  # Parameters that are necessary for the configuration of a Complex Device Driver that serves as the UpperLayer of the Com Interface module.
        container CddComIfUpperLayerRxPdu [1..*]  # This container specifies Rx PDUs that are exchanged between the CDD and the standardized BSW module.
          integer CddComIfHandleId [0..1]: 0..65535, symbolic-name-value=true  # ECU wide unique, symbolic handle for the Pdu.
          reference CddComIfPduRef: destination=Pdu  # Reference to the "global" Pdu structure to allow harmonization of handle IDs in the COM-Stack.
        container CddComIfUpperLayerTxPdu [1..*]  # This container specifies Tx PDUs that are exchanged between the CDD and the standardized BSW module.
          integer CddComIfHandleId [0..1]: 0..65535, symbolic-name-value=true  # ECU wide unique, symbolic handle for the Pdu.
          reference CddComIfPduRef: destination=Pdu  # Reference to the "global" Pdu structure to allow harmonization of handle IDs in the COM-Stack.
      container CddComMLowerLayerContribution [0..1]  # Parameters that are necessary for the configuration of a Complex Device Driver that serves as the LowerLayer of the Communication Manager module.
        container CddComMLowerLayerChannel [1..*]  # This container contains the network specific parameters.
          reference CddComMLowerLayerChannelRef: destination=ComMChannel  # Unique handle to identify one certain network. Reference to one of the network handles configured for the ComM.
      container CddGenericNmLowerLayerContribution [0..1]  # Parameters that are necessary for the configuration of a Complex Device Driver that serves as the LowerLayer of the Generic NM module.
        container CddGenericNmLowerLayerChannel [1..*]  # NM Channel specific configuration parameters.
          reference CddGenericNmComMNetworkHandleRef: destination=ComMChannel  # This reference points to the unique channel defined by the ComMChannel and provides access to the unique channel index value in ComMChannelId.
      container CddPduRLowerLayerContribution [0..1]  # Parameters that are necessary for the configuration of a Complex Device Driver that serves as the LowerLayer of the Pdu Router module.
        container CddPduRLowerLayerRxPdu [1..*]  # This container specifies Rx PDUs that are exchanged between the CDD and the standardized BSW module.
          integer CddPduRLowerLayerHandleId [0..1]: 0..65535, symbolic-name-value=true  # ECU wide unique, symbolic handle for the Pdu.
          reference CddPduRLowerLayerPduRef: destination=Pdu  # Reference to the "global" Pdu structure to allow harmonization of handle IDs in the COM-Stack.
        container CddPduRLowerLayerTxPdu [1..*]  # This container specifies Tx PDUs that are exchanged between the CDD and the standardized BSW module.
          integer CddPduRLowerLayerHandleId [0..1]: 0..65535, symbolic-name-value=true  # ECU wide unique, symbolic handle for the Pdu.
          reference CddPduRLowerLayerPduRef: destination=Pdu  # Reference to the "global" Pdu structure to allow harmonization of handle IDs in the COM-Stack.
      container CddPduRUpperLayerContribution [0..1]  # Parameters that are necessary for the configuration of a Complex Device Driver that serves as the UpperLayer of the Pdu Router module.
        container CddPduRUpperLayerRxPdu [1..*]  # This container specifies Rx PDUs that are exchanged between the CDD and the standardized BSW module.
          integer CddPduRUpperLayerHandleId [0..1]: 0..65535, symbolic-name-value=true  # ECU wide unique, symbolic handle for the Pdu.
          reference CddPduRUpperLayerPduRef: destination=Pdu  # Reference to the "global" Pdu structure to allow harmonization of handle IDs in the COM-Stack.
        container CddPduRUpperLayerTxPdu [1..*]  # This container specifies Tx PDUs that are exchanged between the CDD and the standardized BSW module.
          integer CddPduRUpperLayerHandleId [0..1]: 0..65535, symbolic-name-value=true  # ECU wide unique, symbolic handle for the Pdu.
          reference CddPduRUpperLayerPduRef: destination=Pdu  # Reference to the "global" Pdu structure to allow harmonization of handle IDs in the COM-Stack.
    container CddEcucPartitionInteraction [0..1]  # This optional container holds the partition interaction configuration.
      function name CddPartitionStoppedFunctionName  # Function name to be called when the partition which is triggering the complex driver is stopped.
      reference CddEcucPartitionRef: destination=EcucPartition  # Reference to the "EcucPartition" which executes the software which triggers the CDD.
  module definition Com [0..1]: variants link-time/post-build/pre-compile  # Configuration of the AUTOSAR COM module.
    container ComConfig: multiple-configuration-container=true  # This container contains the configuration parameters and sub containers of the AUTOSAR COM module. This container is a MultipleConfigurationContainer, i.e. this container and its sub-containers exist once per configuration set.
      integer ComConfigurationId: 0..4294967295, set at link in variant link-time / post-build in variant post-build / pre-compile in variant pre-compile  # This ID is returned by a call to Com_GetConfigurationId.
      container ComGwMapping [0..*]
        choice container ComGwDestination [1..*]  # Each instance of this choice container allows to define one routing destination either by reference to an already configured COM signal / signal group or by a destination description container.
          container ComGwDestinationDescription [0..1]  # Description of a gateway destination. This container allows defining a gateway destination without the configuration of a complete COM signal. This allows adding / changing gateway relations post build without the configuration of new signals.
            integer ComBitPosition: 0..2031, set at link in variant link-time / post-build in variant post-build / pre-compile in variant pre-compile  # Starting position within the I-PDU. This parameter refers to the position in the I-PDU and not in the shadow buffer. If the endianness conversion is configured to Opaque the parameter ComBitPosition shall define the bit0 of the first byte like in little endian byte order
            enumeration ComSignalEndianness: {BIG_ENDIAN, LITTLE_ENDIAN, OPAQUE}, set at link in variant link-time / post-build in variant post-build / pre-compile in variant pre-compile  # Defines the endianness of the signal's network representation.
            string ComSignalInitValue [0..1]: set at link in variant link-time / post-build in variant post-build / pre-compile in variant pre-compile, default-value=0  # Initial value for this signal. The default value is 0. | In case the ComSignalType is UINT8, UINT16, UINT32, SINT8, SINT16, SINT32 the string shall be interpreted as defined in the chapter Integer Type in the AUTOSAR EcuC specification. In case the ComSignalType is FLOAT32, FLOAT64 the string shall be interpreted as defined in the chapter Float Type in the AUTOSAR EcuC specification. In case the ComSignalType is BOOLEAN the string shall be interpreted as defined in the chapter Boolean Type in the AUTOSAR EcuC specification. In case the ComSignal is a UINT8_N, UINT6_DYN the string shall be interpreted as a decimal representation of the characters separated by blanks, e.g. "97 98 100" means a string "abd", where the char "a" is in byte 0(lowest address), "b" is in byte 1, and "d" is in byte 2 and (highest address).
            enumeration ComTransferProperty [0..1]: {PENDING, TRIGGERED, TRIGGERED_ON_CHANGE, TRIGGERED_ON_CHANGE_WITHOUT_REPETITION, TRIGGERED_WITHOUT_REPETITION}, set at link in variant link-time / post-build in variant post-build / pre-compile in variant pre-compile  # Defines if a write access to this signal can trigger the transmission of the corresponding I-PDU. If the I-PDU is triggered, depends also on the transmission mode of the corresponding I-PDU.
            integer ComUpdateBitPosition [0..1]: 0..2031, set at link in variant link-time / post-build in variant post-build / pre-compile in variant pre-compile  # Bit position of update-bit inside I-PDU. | If this attribute is omitted then there is no update-bit. This setting must be consistently on sender and on receiver side. Range: 0..63 for CAN and LIN 0..2031 for FlexRay
            reference ComGwIPduRef: set at link in variant link-time / post-build in variant post-build / pre-compile in variant pre-compile, destination=ComIPdu  # Reference to an I-PDU of a Signal Gateway source or destination description.
            container ComFilter [0..1]  # This container contains the configuration parameters of the AUTOSAR COM module's Filters. | Note: On sender side the container is used to specify the transmission mode conditions.
              enumeration ComFilterAlgorithm: {ALWAYS, MASKED_NEW_DIFFERS_MASKED_OLD, MASKED_NEW_DIFFERS_X, MASKED_NEW_EQUALS_X, NEVER, NEW_IS_OUTSIDE, NEW_IS_WITHIN, ONE_EVERY_N}, set at link in variant link-time+post-build / pre-compile in variant pre-compile  # The range of values is specified in the [17] specification, chapter 2.2.2, Reception Filtering.
              integer ComFilterMask [0..1]: 0..18446744073709551615, set at link in variant link-time+post-build / pre-compile in variant pre-compile  # The name of this attribute corresponds to the parameter name in the [17] specification of Reception Filtering.
              integer ComFilterMax [0..1]: 0..18446744073709551615, set at link in variant link-time+post-build / pre-compile in variant pre-compile  # The name of this attribute corresponds to the parameter name in the [17] specification of Reception Filtering.
              integer ComFilterMin [0..1]: 0..18446744073709551615, set at link in variant link-time+post-build / pre-compile in variant pre-compile  # The name of this attribute corresponds to the parameter name in the [17] specification of Reception Filtering.
              integer ComFilterOffset [0..1]: 0..18446744073709551615, set at link in variant link-time+post-build / pre-compile in variant pre-compile  # The name of this attribute corresponds to the parameter name in the [17] specification of Reception Filtering. | Range = 0..(ComFilterPeriod-1)
              integer ComFilterPeriod [0..1]: 0..18446744073709551615, set at link in variant link-time / post-build in variant post-build / pre-compile in variant pre-compile  # This parameter defines the period of the ComFilterAlgorithm ONE_EVERY_N.
              integer ComFilterX [0..1]: 0..18446744073709551615, set at link in variant link-time+post-build / pre-compile in variant pre-compile  # The name of this attribute corresponds to the parameter name in the [17] specification of Reception Filtering.
          container ComGwSignal [0..1]  # This container allows specifying a gateway source or destination respectively with a reference to a ComSignal, a ComGroupSignal or a ComSignalGroup.
            choice reference ComGwSignalRef: set at link in variant link-time / post-build in variant post-build / pre-compile in variant pre-compile, destination=[ComGroupSignal, ComSignal, ComSignalGroup]  # Reference to an object of a gateway relation. Either to a ComSignal, ComGroupSignal or to a SignalGroup.
        choice container ComGwSource  # This choice container allows the definition of the gateway source signal either by reference to an already configured COM signal / signal group or by a source description container.
          container ComGwSignal [0..1]  # This container allows specifying a gateway source or destination respectively with a reference to a ComSignal, a ComGroupSignal or a ComSignalGroup.
            choice reference ComGwSignalRef: set at link in variant link-time / post-build in variant post-build / pre-compile in variant pre-compile, destination=[ComGroupSignal, ComSignal, ComSignalGroup]  # Reference to an object of a gateway relation. Either to a ComSignal, ComGroupSignal or to a SignalGroup.
          container ComGwSourceDescription [0..1]  # Description of a gateway source. This container allows defining a gateway source without the configuration of a complete COM signal. This allows adding / changing gateway relations post build without the configuration of new signals.
            integer ComBitPosition: 0..2031, set at link in variant link-time / post-build in variant post-build / pre-compile in variant pre-compile  # Starting position within the I-PDU. This parameter refers to the position in the I-PDU and not in the shadow buffer. If the endianness conversion is configured to Opaque the parameter ComBitPosition shall define the bit0 of the first byte like in little endian byte order
            integer ComBitSize [0..1]: 0..64, set at link in variant link-time / post-build in variant post-build / pre-compile in variant pre-compile  # Size in bits, for non-array signal types. | For ComSignalType UINT8_N and UINT8_DYN this size shall be configured by ComSignalLength.
            enumeration ComSignalEndianness: {BIG_ENDIAN, LITTLE_ENDIAN, OPAQUE}, set at link in variant link-time / post-build in variant post-build / pre-compile in variant pre-compile  # Defines the endianness of the signal's network representation.
            integer ComSignalLength [0..1]: 0..4095, set at link in variant link-time+post-build / pre-compile in variant pre-compile  # Description: | For ComSignalType UINT8_N this parameter specifies the length n in bytes. For ComSignalType UINT8_DYN it specifies the maximum length in bytes. For all other types this parameter shall be ignored. Range: 0..8 for normal CAN/ LIN I-PDUs, 0..254 for normal FlexRay I-PDUs, and 0..4095 for I-PDUs with ComIPduType TP.
            enumeration ComSignalType: {BOOLEAN, FLOAT32, FLOAT64, SINT16, SINT32, SINT8, UINT16, UINT32, UINT8, UINT8_DYN, UINT8_N}, set at link in variant link-time / post-build in variant post-build / pre-compile in variant pre-compile  # The AUTOSAR type of the signal. Whether or not the signal is signed or unsigned can be found by examining the value of this attribute. | This type could also be used to reserved appropriate storage in AUTOSAR COM.
            integer ComUpdateBitPosition [0..1]: 0..2031, set at link in variant link-time / post-build in variant post-build / pre-compile in variant pre-compile  # Bit position of update-bit inside I-PDU. | If this attribute is omitted then there is no update-bit. This setting must be consistently on sender and on receiver side. Range: 0..63 for CAN and LIN 0..2031 for FlexRay
            reference ComGwIPduRef: set at link in variant link-time / post-build in variant post-build / pre-compile in variant pre-compile, destination=ComIPdu  # Reference to an I-PDU of a Signal Gateway source or destination description.
      container ComIPdu [0..*]  # Contains the configuration parameters of the AUTOSAR COM module's I-PDUs.
        function name ComIPduCallout [0..1]: set at pre-compile  # This parameter defines the existence and the name of a callout function for the corresponding I-PDU. If this parameter is omitted no I-PDU callout shall take place for the corresponding I-PDU.
        boolean ComIPduCancellationSupport [0..1]: set at pre-compile, default-value=false  # Defines for I-PDUs with ComIPduType NORMAL: | If the underlying IF-modul supports cancellation of transmit requests. Defines for I-PDUs with ComIPduType TP: If the underlying TP-module supports RX and TX cancellation of ongoing requests.
        enumeration ComIPduDirection: {RECEIVE, SEND}, set at link in variant link-time / post-build in variant post-build / pre-compile in variant pre-compile  # The direction defines if this I-PDU, and therefore the contributing signals and signal groups, shall be sent or received.
        integer ComIPduHandleId [0..1]: 0..65535, set at link in variant link-time+post-build / pre-compile in variant pre-compile, symbolic-name-value=true  # The numerical value used as the ID of this I-PDU. The ComIPduHandleId is required by the API calls to receive I-PDUs from the PduR (ComIP-duDirection: Receive). For Tx-I-PDUs (ComIPduDirection: Send) this handle Id is used by the PduR to confirm the transmission of the ComIPdu. In case no Tx-Confirmation is configured for a Tx-I-PDU, the ComIPduHandleId is not used.
        enumeration ComIPduSignalProcessing: {DEFERRED, IMMEDIATE}, set at link in variant link-time / post-build in variant post-build / pre-compile in variant pre-compile  # For the definition of the two modes Immediate and Deferred.
        function name ComIPduTriggerTransmitCallout: set at pre-compile  # If there is a trigger transmit callout defined for this I-PDU this parameter contains the name of the callout function.
        enumeration ComIPduType: {NORMAL, TP}, set at link in variant link-time / post-build in variant post-build / pre-compile in variant pre-compile  # Defines if this I-PDU is a normal I-PDU that can be sent unfragmented or if this is a large I-PDU that shall be sent via the Transport Protocol of the underlying bus.
        reference ComIPduGroupRef [0..*]: set at link in variant link-time / post-build in variant post-build / pre-compile in variant pre-compile, destination=ComIPduGroup  # Reference to the I-PDU groups this I-PDU belongs to.
        reference ComIPduSignalGroupRef [0..*]: set at link in variant link-time / post-build in variant post-build / pre-compile in variant pre-compile, destination=ComSignalGroup  # References to all signal groups contained in this I-Pdu
        reference ComIPduSignalRef [0..*]: set at link in variant link-time / post-build in variant post-build / pre-compile in variant pre-compile, destination=ComSignal  # References to all signals contained in this I-PDU.
        reference ComPduIdRef: set at link in variant link-time+post-build / pre-compile in variant pre-compile, destination=Pdu  # Reference to the "global" Pdu structure to allow harmonization of handle IDs in the COM-Stack.
        container ComIPduCounter [0..1]  # This optional container contains the configuration parameters of PDU Counter.
          function name ComIPduCounterErrorNotification [0..1]: set at link in variant link-time+post-build / pre-compile in variant pre-compile  # Name of Com_CbkCounterErr callback function to be called. If this | parameter is omitted no I-PDU counter mismatch notification shall take place.
          integer ComIPduCounterSize: 1..8, set at pre-compile  # Size of PDU Counter expressed in bits
          integer ComIPduCounterStartPosition: 0..2031, set at pre-compile  # Position of PDU counter expressed in bits from start position of data content | of I-PDU (SDU). Note that PDU counter is not allowed to cross a byte border. The parameter ComIPduCounterStartPosition shall define the bit0 of the first byte like in little endian byte order.
          integer ComIPduCounterThreshold [0..1]: 0..255, set at pre-compile, default-value=0  # Threshold value of I-PDU counter algorithm, see COM590.
        container ComIPduReplication [0..1]  # This optional container contains the information needed for each I-PDU replicated.
          integer ComIPduReplicationQuorum: 1..3, set at pre-compile  # The number of identical I-PDUs needed for successful voting.
          reference ComIPduReplicaRef [1..2]: set at pre-compile, destination=Pdu  # Reference to replicas PduR PDUs of this IPDU.
        container ComTxIPdu [0..1]  # This container contains additional transmission related configuration parameters of the AUTOSAR COM module's I-PDUs.
          float ComMinimumDelayTime [0..1]: 0..3600, set at link in variant link-time / post-build in variant post-build / pre-compile in variant pre-compile, origin=AUTOSAR_ECUC V3.0  # Defines the Minimum Delay Time (MDT) between successive transmissions of this I-PDU in seconds. The MDT is independent of the possible different transmission modes. There is only one minimum delay time parameter for one I-PDU. The minimum delay timer is not reset by changing the transmission mode. Hence, it is not allowed to violate the minimum delay time by transmission mode changes. It is not possible to monitor the minimum delay time for I-PDUs that are requested using the Com_TriggerTransmit API.
          enumeration ComTxIPduClearUpdateBit [0..1]: {Confirmation, Transmit, TriggerTransmit}, set at link in variant link-time / post-build in variant post-build / pre-compile in variant pre-compile  # Defines when the update-bits of signals or signal groups, contained in this I-PDU, will be cleared.
          integer ComTxIPduUnusedAreasDefault: 0..255, set at link in variant link-time+post-build / pre-compile in variant pre-compile  # The AUTOSAR COM module fills not used areas of an I-PDU with this byte pattern. This attribute is mandatory to avoid undefined behaviour. This byte-pattern will be repeated throughout the I-PDU before any init-values or update-bits were set.
          container ComTxModeFalse [0..1]  # This container contains the configuration parameters of the AUTOSAR COM module's transmission modes in the case the ComFilter evaluates to false.
            container ComTxMode  # This container contains the configuration parameters of the AUTOSAR COM module's transmission modes.
              enumeration ComTxModeMode: {DIRECT, MIXED, NONE, PERIODIC}, set at link in variant link-time / post-build in variant post-build / pre-compile in variant pre-compile  # The available transmission modes described in [18] shall be extended by the additional mode None. | The transmission mode None shall not have any further sub-attributes in the ComTxMode object.
              integer ComTxModeNumberOfRepetitions [0..1]: 0..255, set at link in variant link-time / post-build in variant post-build / pre-compile in variant pre-compile  # Defines the number of repetitions for the transmission mode DIRECT and the event driven part of transmission mode MIXED.
              float ComTxModeRepetitionPeriod [0..1]: 0..3600, set at link in variant link-time / post-build in variant post-build / pre-compile in variant pre-compile  # Defines the repetition period in seconds of the multiple transmissions in case ComTxModeNumberOfRepetitions is configured greater than 1 and ComTxModeMode is configured to DIRECT or MIXED. In case of the mixed transmission mode only the event driven part is affected.
              float ComTxModeTimeOffset [0..1]: 0..3600, set at link in variant link-time / post-build in variant post-build / pre-compile in variant pre-compile  # Defines the period in seconds between the start of the I-PDU by Com_IpduGroupControl and the first transmission request in case ComTxModeMode is configured to PERIODIC or MIXED. In case of the mixed transmission mode only the periodic part is affected.
              float ComTxModeTimePeriod [0..1]: 0..3600, set at link in variant link-time / post-build in variant post-build / pre-compile in variant pre-compile  # Defines the repetition period in seconds of the periodic transmission requests in case ComTxModeMode is configured to PERIODIC or MIXED. In case of the mixed transmission mode only the periodic part is affected.
          container ComTxModeTrue [0..1]  # This container contains the configuration parameters of the AUTOSAR COM module's transmission modes in the case the ComFilter evaluates to true.
            container ComTxMode  # This container contains the configuration parameters of the AUTOSAR COM module's transmission modes.
              enumeration ComTxModeMode: {DIRECT, MIXED, NONE, PERIODIC}, set at link in variant link-time / post-build in variant post-build / pre-compile in variant pre-compile  # The available transmission modes described in [18] shall be extended by the additional mode None. | The transmission mode None shall not have any further sub-attributes in the ComTxMode object.
              integer ComTxModeNumberOfRepetitions [0..1]: 0..255, set at link in variant link-time / post-build in variant post-build / pre-compile in variant pre-compile  # Defines the number of repetitions for the transmission mode DIRECT and the event driven part of transmission mode MIXED.
              float ComTxModeRepetitionPeriod [0..1]: 0..3600, set at link in variant link-time / post-build in variant post-build / pre-compile in variant pre-compile  # Defines the repetition period in seconds of the multiple transmissions in case ComTxModeNumberOfRepetitions is configured greater than 1 and ComTxModeMode is configured to DIRECT or MIXED. In case of the mixed transmission mode only the event driven part is affected.
              float ComTxModeTimeOffset [0..1]: 0..3600, set at link in variant link-time / post-build in variant post-build / pre-compile in variant pre-compile  # Defines the period in seconds between the start of the I-PDU by Com_IpduGroupControl and the first transmission request in case ComTxModeMode is configured to PERIODIC or MIXED. In case of the mixed transmission mode only the periodic part is affected.
              float ComTxModeTimePeriod [0..1]: 0..3600, set at link in variant link-time / post-build in variant post-build / pre-compile in variant pre-compile  # Defines the repetition period in seconds of the periodic transmission requests in case ComTxModeMode is configured to PERIODIC or MIXED. In case of the mixed transmission mode only the periodic part is affected.
      container ComIPduGroup [0..*]  # Contains the configuration parameters of the AUTOSAR COM module's I-PDU groups.
        integer ComIPduGroupHandleId: 0..65535, set at link in variant link-time+post-build / pre-compile in variant pre-compile, symbolic-name-value=true  # The numerical value used as the ID of this I-PDU Group . | The ComIPduGroupHandleId is required by the API calls to start and stop I-PDU Groups. Range: 0 .. (ComSupportedIPduGroups-1)
        reference ComIPduGroupGroupRef [0..*]: set at link in variant link-time / post-build in variant post-build / pre-compile in variant pre-compile, destination=ComIPduGroup  # References to all I-PDU groups that includes this I-PDU group. If this reference is omitted this I-PDU group does not belong to another I-PDU group.
      container ComSignal [0..*]  # Contains the configuration parameters of the AUTOSAR COM module's signals.
        integer ComBitPosition: 0..2031, set at link in variant link-time / post-build in variant post-build / pre-compile in variant pre-compile  # Starting position within the I-PDU. This parameter refers to the position in the I-PDU and not in the shadow buffer. If the endianness conversion is configured to Opaque the parameter ComBitPosition shall define the bit0 of the first byte like in little endian byte order
        integer ComBitSize [0..1]: 0..64, set at link in variant link-time / post-build in variant post-build / pre-compile in variant pre-compile  # Size in bits, for non-array signal types. | For ComSignalType UINT8_N and UINT8_DYN this size shall be configured by ComSignalLength.
        enumeration ComDataInvalidAction [0..1]: {NOTIFY, REPLACE}, set at link in variant link-time+post-build / pre-compile in variant pre-compile  # This parameter defines the action performed upon reception of an invalid signal. | Relating to signal groups the action in case if one of the included signals is an invalid signal. If Replace is used the ComSignalInitValue will be used for the replacement.
        function name ComErrorNotification [0..1]: set at link in variant link-time+post-build / pre-compile in variant pre-compile  # Only valid on sender side: Name of Com_CbkTxErr callback function to be called. | If this parameter is omitted no error notification shall take place.
        float ComFirstTimeout [0..1]: 0..3600, set at link in variant link-time+post-build / pre-compile in variant pre-compile  # Defines the length of the first deadline monitoring timeout period in seconds. This timeout is used immediately after start (or restart) of the deadline monitoring service. The timeout period of the successive periods is configured by COM263_Conf.
        integer ComHandleId: 0..65535, set at link in variant link-time+post-build / pre-compile in variant pre-compile, symbolic-name-value=true  # The numerical value used as the ID. | For signals it is required by the API calls Com_UpdateShadowSignal, Com_ReceiveShadowSignal and Com_InvalidateShadowSignal. For signals groups it is required by the Com_SendSignalGroup and Com_ReceiveSignalGroup calls.
        function name ComInvalidNotification [0..1]: set at link in variant link-time+post-build / pre-compile in variant pre-compile  # Only valid on receiver side: Name of Com_CbkInv callback function to be called. Name of the function which notifies the RTE about the reception of an invalidated signal/ signal group. Only applicable if ComDataInvalidAction is configured to NOTIFY.
        function name ComNotification [0..1]: set at link in variant link-time+post-build / pre-compile in variant pre-compile  # On sender side: Name of Com_CbkTxAck callback function to be called. | On receiver side: Name of Com_CbkRxAck callback function to be called. If this parameter is omitted no notification shall take place.
        enumeration ComRxDataTimeoutAction [0..1]: {NONE, REPLACE}, set at link in variant link-time+post-build / pre-compile in variant pre-compile  # This parameter defines the action performed upon expiration of the reception deadline monitoring timer.
        string ComSignalDataInvalidValue [0..1]: set at link in variant link-time+post-build / pre-compile in variant pre-compile  # Defines the data invalid value of the signal. | In case the ComSignalType is UINT8, UINT16, UINT32, SINT8, SINT16, SINT32 the string shall be interpreted as defined in the chapter Integer Type in the AUTOSAR EcuC specification. In case the ComSignalType is FLOAT32, FLOAT64 the string shall be interpreted as defined in the chapter Float Type in the AUTOSAR EcuC specification. In case the ComSignalType is BOOLEAN the string shall be interpreted as defined in the chapter Boolean Type in the AUTOSAR EcuC specification. In case the ComSignal is a UINT8_N, UINT6_DYN the string shall be interpreted as a decimal representation of the characters separated by blanks, e.g. "97 98 100" means a string "abd", where the char "a" is in byte 0(lowest address), "b" is in byte 1, and "d" is in byte 2 and (highest address).
        enumeration ComSignalEndianness: {BIG_ENDIAN, LITTLE_ENDIAN, OPAQUE}, set at link in variant link-time / post-build in variant post-build / pre-compile in variant pre-compile  # Defines the endianness of the signal's network representation.
        string ComSignalInitValue [0..1]: set at link in variant link-time / post-build in variant post-build / pre-compile in variant pre-compile, default-value=0  # Initial value for this signal. The default value is 0. | In case the ComSignalType is UINT8, UINT16, UINT32, SINT8, SINT16, SINT32 the string shall be interpreted as defined in the chapter Integer Type in the AUTOSAR EcuC specification. In case the ComSignalType is FLOAT32, FLOAT64 the string shall be interpreted as defined in the chapter Float Type in the AUTOSAR EcuC specification. In case the ComSignalType is BOOLEAN the string shall be interpreted as defined in the chapter Boolean Type in the AUTOSAR EcuC specification. In case the ComSignal is a UINT8_N, UINT6_DYN the string shall be interpreted as a decimal representation of the characters separated by blanks, e.g. "97 98 100" means a string "abd", where the char "a" is in byte 0(lowest address), "b" is in byte 1, and "d" is in byte 2 and (highest address).
        integer ComSignalLength [0..1]: 0..4095, set at link in variant link-time+post-build / pre-compile in variant pre-compile  # Description: | For ComSignalType UINT8_N this parameter specifies the length n in bytes. For ComSignalType UINT8_DYN it specifies the maximum length in bytes. For all other types this parameter shall be ignored. Range: 0..8 for normal CAN/ LIN I-PDUs, 0..254 for normal FlexRay I-PDUs, and 0..4095 for I-PDUs with ComIPduType TP.
        enumeration ComSignalType: {BOOLEAN, FLOAT32, FLOAT64, SINT16, SINT32, SINT8, UINT16, UINT32, UINT8, UINT8_DYN, UINT8_N}, set at link in variant link-time / post-build in variant post-build / pre-compile in variant pre-compile  # The AUTOSAR type of the signal. Whether or not the signal is signed or unsigned can be found by examining the value of this attribute. | This type could also be used to reserved appropriate storage in AUTOSAR COM.
        float ComTimeout [0..1]: 0..3600, set at link in variant link-time / post-build in variant post-build / pre-compile in variant pre-compile  # Defines the length of the deadline monitoring timeout period in seconds. The period for the first timeout period can be configured separately by COM183_Conf.
        function name ComTimeoutNotification [0..1]: set at link in variant link-time+post-build / pre-compile in variant pre-compile  # On sender side: Name of Com_CbkTxTOut callback function to be called. | On receiver side: Name of Com_CbkRxTOut callback function to be called.
        enumeration ComTransferProperty [0..1]: {PENDING, TRIGGERED, TRIGGERED_ON_CHANGE, TRIGGERED_ON_CHANGE_WITHOUT_REPETITION, TRIGGERED_WITHOUT_REPETITION}, set at link in variant link-time / post-build in variant post-build / pre-compile in variant pre-compile  # Defines if a write access to this signal can trigger the transmission of the corresponding I-PDU. If the I-PDU is triggered, depends also on the transmission mode of the corresponding I-PDU.
        integer ComUpdateBitPosition [0..1]: 0..2031, set at link in variant link-time / post-build in variant post-build / pre-compile in variant pre-compile  # Bit position of update-bit inside I-PDU. | If this attribute is omitted then there is no update-bit. This setting must be consistently on sender and on receiver side. Range: 0..63 for CAN and LIN 0..2031 for FlexRay
        foreign reference ComSystemTemplateSystemSignalRef [0..1]: set at link in variant link-time / post-build in variant post-build / pre-compile in variant pre-compile, destination-type=I-SIGNAL-TO-I-PDU-MAPPING  # Reference to the ISignalToIPduMapping that contains a reference to the ISignal (System Template) which this ComSignal (or ComGroupSignal) represents.
        container ComFilter [0..1]  # This container contains the configuration parameters of the AUTOSAR COM module's Filters. | Note: On sender side the container is used to specify the transmission mode conditions.
          enumeration ComFilterAlgorithm: {ALWAYS, MASKED_NEW_DIFFERS_MASKED_OLD, MASKED_NEW_DIFFERS_X, MASKED_NEW_EQUALS_X, NEVER, NEW_IS_OUTSIDE, NEW_IS_WITHIN, ONE_EVERY_N}, set at link in variant link-time+post-build / pre-compile in variant pre-compile  # The range of values is specified in the [17] specification, chapter 2.2.2, Reception Filtering.
          integer ComFilterMask [0..1]: 0..18446744073709551615, set at link in variant link-time+post-build / pre-compile in variant pre-compile  # The name of this attribute corresponds to the parameter name in the [17] specification of Reception Filtering.
          integer ComFilterMax [0..1]: 0..18446744073709551615, set at link in variant link-time+post-build / pre-compile in variant pre-compile  # The name of this attribute corresponds to the parameter name in the [17] specification of Reception Filtering.
          integer ComFilterMin [0..1]: 0..18446744073709551615, set at link in variant link-time+post-build / pre-compile in variant pre-compile  # The name of this attribute corresponds to the parameter name in the [17] specification of Reception Filtering.
          integer ComFilterOffset [0..1]: 0..18446744073709551615, set at link in variant link-time+post-build / pre-compile in variant pre-compile  # The name of this attribute corresponds to the parameter name in the [17] specification of Reception Filtering. | Range = 0..(ComFilterPeriod-1)
          integer ComFilterPeriod [0..1]: 0..18446744073709551615, set at link in variant link-time / post-build in variant post-build / pre-compile in variant pre-compile  # This parameter defines the period of the ComFilterAlgorithm ONE_EVERY_N.
          integer ComFilterX [0..1]: 0..18446744073709551615, set at link in variant link-time+post-build / pre-compile in variant pre-compile  # The name of this attribute corresponds to the parameter name in the [17] specification of Reception Filtering.
      container ComSignalGroup [0..*]  # Contains the configuration parameters of the AUTOSAR COM module's signal groups.
        enumeration ComDataInvalidAction [0..1]: {NOTIFY, REPLACE}, set at link in variant link-time+post-build / pre-compile in variant pre-compile  # This parameter defines the action performed upon reception of an invalid signal. | Relating to signal groups the action in case if one of the included signals is an invalid signal. If Replace is used the ComSignalInitValue will be used for the replacement.
        function name ComErrorNotification [0..1]: set at link in variant link-time+post-build / pre-compile in variant pre-compile  # Only valid on sender side: Name of Com_CbkTxErr callback function to be called. | If this parameter is omitted no error notification shall take place.
        float ComFirstTimeout [0..1]: 0..3600, set at link in variant link-time+post-build / pre-compile in variant pre-compile  # Defines the length of the first deadline monitoring timeout period in seconds. This timeout is used immediately after start (or restart) of the deadline monitoring service. The timeout period of the successive periods is configured by COM263_Conf.
        integer ComHandleId: 0..65535, set at link in variant link-time+post-build / pre-compile in variant pre-compile, symbolic-name-value=true  # The numerical value used as the ID. | For signals it is required by the API calls Com_UpdateShadowSignal, Com_ReceiveShadowSignal and Com_InvalidateShadowSignal. For signals groups it is required by the Com_SendSignalGroup and Com_ReceiveSignalGroup calls.
        function name ComInvalidNotification [0..1]: set at link in variant link-time+post-build / pre-compile in variant pre-compile  # Only valid on receiver side: Name of Com_CbkInv callback function to be called. Name of the function which notifies the RTE about the reception of an invalidated signal/ signal group. Only applicable if ComDataInvalidAction is configured to NOTIFY.
        function name ComNotification [0..1]: set at link in variant link-time+post-build / pre-compile in variant pre-compile  # On sender side: Name of Com_CbkTxAck callback function to be called. | On receiver side: Name of Com_CbkRxAck callback function to be called. If this parameter is omitted no notification shall take place.
        enumeration ComRxDataTimeoutAction [0..1]: {NONE, REPLACE}, set at link in variant link-time+post-build / pre-compile in variant pre-compile  # This parameter defines the action performed upon expiration of the reception deadline monitoring timer.
        float ComTimeout [0..1]: 0..3600, set at link in variant link-time / post-build in variant post-build / pre-compile in variant pre-compile  # Defines the length of the deadline monitoring timeout period in seconds. The period for the first timeout period can be configured separately by COM183_Conf.
        function name ComTimeoutNotification [0..1]: set at link in variant link-time+post-build / pre-compile in variant pre-compile  # On sender side: Name of Com_CbkTxTOut callback function to be called. | On receiver side: Name of Com_CbkRxTOut callback function to be called.
        enumeration ComTransferProperty [0..1]: {PENDING, TRIGGERED, TRIGGERED_ON_CHANGE, TRIGGERED_ON_CHANGE_WITHOUT_REPETITION, TRIGGERED_WITHOUT_REPETITION}, set at link in variant link-time / post-build in variant post-build / pre-compile in variant pre-compile  # Defines if a write access to this signal can trigger the transmission of the corresponding I-PDU. If the I-PDU is triggered, depends also on the transmission mode of the corresponding I-PDU.
        integer ComUpdateBitPosition [0..1]: 0..2031, set at link in variant link-time / post-build in variant post-build / pre-compile in variant pre-compile  # Bit position of update-bit inside I-PDU. | If this attribute is omitted then there is no update-bit. This setting must be consistently on sender and on receiver side. Range: 0..63 for CAN and LIN 0..2031 for FlexRay
        foreign reference ComSystemTemplateSignalGroupRef [0..1]: set at link in variant link-time / post-build in variant post-build / pre-compile in variant pre-compile, destination-type=I-SIGNAL-TO-I-PDU-MAPPING  # Reference to the ISignalToIPduMapping that contains a reference to the ISignalGroup (SystemTemplate) which this ComSignalGroup represents.
        container ComGroupSignal [0..*]  # This container contains the configuration parameters of group signals. I.e. signals that are included within a signal group.
          integer ComBitPosition: 0..2031, set at link in variant link-time / post-build in variant post-build / pre-compile in variant pre-compile  # Starting position within the I-PDU. This parameter refers to the position in the I-PDU and not in the shadow buffer. If the endianness conversion is configured to Opaque the parameter ComBitPosition shall define the bit0 of the first byte like in little endian byte order
          integer ComBitSize [0..1]: 0..64, set at link in variant link-time / post-build in variant post-build / pre-compile in variant pre-compile  # Size in bits, for non-array signal types. | For ComSignalType UINT8_N and UINT8_DYN this size shall be configured by ComSignalLength.
          integer ComHandleId: 0..65535, set at link in variant link-time+post-build / pre-compile in variant pre-compile, symbolic-name-value=true  # The numerical value used as the ID. | For signals it is required by the API calls Com_UpdateShadowSignal, Com_ReceiveShadowSignal and Com_InvalidateShadowSignal. For signals groups it is required by the Com_SendSignalGroup and Com_ReceiveSignalGroup calls.
          string ComSignalDataInvalidValue [0..1]: set at link in variant link-time+post-build / pre-compile in variant pre-compile  # Defines the data invalid value of the signal. | In case the ComSignalType is UINT8, UINT16, UINT32, SINT8, SINT16, SINT32 the string shall be interpreted as defined in the chapter Integer Type in the AUTOSAR EcuC specification. In case the ComSignalType is FLOAT32, FLOAT64 the string shall be interpreted as defined in the chapter Float Type in the AUTOSAR EcuC specification. In case the ComSignalType is BOOLEAN the string shall be interpreted as defined in the chapter Boolean Type in the AUTOSAR EcuC specification. In case the ComSignal is a UINT8_N, UINT6_DYN the string shall be interpreted as a decimal representation of the characters separated by blanks, e.g. "97 98 100" means a string "abd", where the char "a" is in byte 0(lowest address), "b" is in byte 1, and "d" is in byte 2 and (highest address).
          enumeration ComSignalEndianness: {BIG_ENDIAN, LITTLE_ENDIAN, OPAQUE}, set at link in variant link-time / post-build in variant post-build / pre-compile in variant pre-compile  # Defines the endianness of the signal's network representation.
          string ComSignalInitValue [0..1]: set at link in variant link-time / post-build in variant post-build / pre-compile in variant pre-compile, default-value=0  # Initial value for this signal. The default value is 0. | In case the ComSignalType is UINT8, UINT16, UINT32, SINT8, SINT16, SINT32 the string shall be interpreted as defined in the chapter Integer Type in the AUTOSAR EcuC specification. In case the ComSignalType is FLOAT32, FLOAT64 the string shall be interpreted as defined in the chapter Float Type in the AUTOSAR EcuC specification. In case the ComSignalType is BOOLEAN the string shall be interpreted as defined in the chapter Boolean Type in the AUTOSAR EcuC specification. In case the ComSignal is a UINT8_N, UINT6_DYN the string shall be interpreted as a decimal representation of the characters separated by blanks, e.g. "97 98 100" means a string "abd", where the char "a" is in byte 0(lowest address), "b" is in byte 1, and "d" is in byte 2 and (highest address).
          integer ComSignalLength [0..1]: 0..4095, set at link in variant link-time+post-build / pre-compile in variant pre-compile  # Description: | For ComSignalType UINT8_N this parameter specifies the length n in bytes. For ComSignalType UINT8_DYN it specifies the maximum length in bytes. For all other types this parameter shall be ignored. Range: 0..8 for normal CAN/ LIN I-PDUs, 0..254 for normal FlexRay I-PDUs, and 0..4095 for I-PDUs with ComIPduType TP.
          enumeration ComSignalType: {BOOLEAN, FLOAT32, FLOAT64, SINT16, SINT32, SINT8, UINT16, UINT32, UINT8, UINT8_DYN, UINT8_N}, set at link in variant link-time / post-build in variant post-build / pre-compile in variant pre-compile  # The AUTOSAR type of the signal. Whether or not the signal is signed or unsigned can be found by examining the value of this attribute. | This type could also be used to reserved appropriate storage in AUTOSAR COM.
          enumeration ComTransferProperty: {PENDING, TRIGGERED_ON_CHANGE}, set at link in variant link-time / post-build in variant post-build / pre-compile in variant pre-compile  # Optionally defines whether this group signal shall contribute to the TRIGGERED_ON_CHANGE transfer property of the signal group. If at least one group signal of a signal group has the "ComTransferProperty" configured all other group signals of that signal group shall have the attribute configured as well.
          foreign reference ComSystemTemplateSystemSignalRef [0..1]: set at link in variant link-time / post-build in variant post-build / pre-compile in variant pre-compile, destination-type=I-SIGNAL-TO-I-PDU-MAPPING  # Reference to the ISignalToIPduMapping that contains a reference to the ISignal (System Template) which this ComSignal (or ComGroupSignal) represents.
          container ComFilter [0..1]  # This container contains the configuration parameters of the AUTOSAR COM module's Filters. | Note: On sender side the container is used to specify the transmission mode conditions.
            enumeration ComFilterAlgorithm: {ALWAYS, MASKED_NEW_DIFFERS_MASKED_OLD, MASKED_NEW_DIFFERS_X, MASKED_NEW_EQUALS_X, NEVER, NEW_IS_OUTSIDE, NEW_IS_WITHIN, ONE_EVERY_N}, set at link in variant link-time+post-build / pre-compile in variant pre-compile  # The range of values is specified in the [17] specification, chapter 2.2.2, Reception Filtering.
            integer ComFilterMask [0..1]: 0..18446744073709551615, set at link in variant link-time+post-build / pre-compile in variant pre-compile  # The name of this attribute corresponds to the parameter name in the [17] specification of Reception Filtering.
            integer ComFilterMax [0..1]: 0..18446744073709551615, set at link in variant link-time+post-build / pre-compile in variant pre-compile  # The name of this attribute corresponds to the parameter name in the [17] specification of Reception Filtering.
            integer ComFilterMin [0..1]: 0..18446744073709551615, set at link in variant link-time+post-build / pre-compile in variant pre-compile  # The name of this attribute corresponds to the parameter name in the [17] specification of Reception Filtering.
            integer ComFilterOffset [0..1]: 0..18446744073709551615, set at link in variant link-time+post-build / pre-compile in variant pre-compile  # The name of this attribute corresponds to the parameter name in the [17] specification of Reception Filtering. | Range = 0..(ComFilterPeriod-1)
            integer ComFilterPeriod [0..1]: 0..18446744073709551615, set at link in variant link-time / post-build in variant post-build / pre-compile in variant pre-compile  # This parameter defines the period of the ComFilterAlgorithm ONE_EVERY_N.
            integer ComFilterX [0..1]: 0..18446744073709551615, set at link in variant link-time+post-build / pre-compile in variant pre-compile  # The name of this attribute corresponds to the parameter name in the [17] specification of Reception Filtering.
      container ComTimeBase  # Contains the timebase parameters for Tx, Rx and routing.
        float ComGwTimeBase [0..1]: 0..3600, set at link in variant link-time / post-build in variant post-build / pre-compile in variant pre-compile  # The period between successive calls to Com_MainFunctionRouteSignals in seconds. This parameter may be used by the COM generator to transform the values of the signal gateway related timing configuration parameters of the COM module to internal implementation specific counter or tick values. The COM module's internal timing handling is implementation specific. | The COM module (generator) might rely on the fact that Com_MainFunctionRouteSignals is scheduled according to the value configured here.
        float ComRxTimeBase [0..1]: 0..3600, set at link in variant link-time / post-build in variant post-build / pre-compile in variant pre-compile  # The period between successive calls to Com_MainFunctionRx in seconds. This parameter may be used by the COM generator to transform the values of the reception related timing configuration parameters of the COM module to internal implementation specific counter or tick values. The COM module's internal timing handling is implementation specific. | The COM module (generator) may rely on the fact that Com_MainFunctionRx is scheduled according to the value configured here.
        float ComTxTimeBase [0..1]: 0..3600, set at link in variant link-time / post-build in variant post-build / pre-compile in variant pre-compile  # The period between successive calls to Com_MainFunctionTx in seconds. This parameter may be used by the COM generator to transform the values of the transmission related timing configuration parameters of the COM module to internal implementation specific counter or tick values. The COM module's internal timing handling is implementation specific. | The COM module (generator) may rely on the fact that Com_MainFunctionTx is scheduled according to the value configured here.
    container ComGeneral  # Contains the general configuration parameters of the module.
      boolean ComConfigurationUseDet [0..1]: set at pre-compile  # The error hook shall contain code to call the Det. | If this parameter is configured COM_DEV_ERROR_DETECT shall be set to ON as output of the configuration tool. (as input for the source code), see COM028.
      boolean ComEnableMDTForCyclicTransmission [0..1]: set at pre-compile, default-value=true  # Enables globally for the whole Com module the minimum delay time monitoring for cyclic and repeated transmissions (ComTxModeMode=PERIODIC or ComTxModeMode=MIXED for the cyclic transmissions, ComTxModeNumberOfRepetitions > 0 for repeated transmissions).
      boolean ComRetryFailedTransmitRequests [0..1]: set at pre-compile, default-value=true  # If this Parameter is set to true, retry of failed transmission requests is enabled. If this Parameter is not present, the default value is assumed.
      integer ComSupportedIPduGroups: 0..65535, set at pre-compile  # Defines the maximum number of supported I-PDU groups.
      boolean ComVersionInfoApi: set at pre-compile  # Activate/Deactivate the version information API (Com_GetVersionInfo). | True: version information API activated False: version information API deactivated
  module definition ComM [0..1]: variants post-build/pre-compile  # Configuration of the ComM (Communications Manager) module.
    container ComMConfigSet: multiple-configuration-container=true  # This container is the base for a multiple configuration set.
      boolean ComMPncEnabled [0..1]: set at post-build in variant post-build / pre-compile in variant pre-compile, default-value=false  # Defines whether in this configuration set the partial networking is enabled. | true: Enabled false: Disabled
      container ComMChannel [1..*]  # This container contains the configuration (parameters) of the bus channel(s). The channel parameters shall be harmonized within the whole communication stack.
        enumeration ComMBusType: {COMM_BUS_TYPE_CAN, COMM_BUS_TYPE_ETH, COMM_BUS_TYPE_FR, COMM_BUS_TYPE_INTERNAL, COMM_BUS_TYPE_LIN}, set at pre-compile  # Identifies the bus type of the channel.
        integer ComMChannelId: 0..255, set at pre-compile, symbolic-name-value=true  # Channel identification number of the corresponding channel.
        boolean ComMFullCommRequestNotificationEnabled: set at pre-compile, default-value=false  # Defines if the optional SenderReceiver Port of Interface ComM_CurrentChannelRequest will be provided for this channel. | True means enabled. False means disabled
        boolean ComMGlobalNvmBlockDescriptor: set at pre-compile  # If this parameter is set to "true", the NoWakeUp inhibition state of the channel shall be stored (in some implementation specific way) in the block pointed to by ComMGlobalNvmBlockDescriptor.
        float ComMMainFunctionPeriod: 0.001..0.1, set at pre-compile, default-value=0.02  # Specifies the period in seconds that the MainFunction has to be triggered with. | Comment: ComM scheduling shall be at least as fast as the communication stack and a schedule longer than 100ms makes no sense for communication.
        boolean ComMNoCom: set at pre-compile, default-value=false  # Not allowed to change state of ComM channel to COMM_SILENT_COMMUNICATION or COMM_FULL_COMMUNICATION. | true: Enabled - Not allowed to switch to Communication Modes above. false: Disabled - Allowed to switch Communication Modes above. Shall be possible to change parameter during runtime with ComM API's. ECU/All channels: ComM_LimitECUToNoComMode(). Separate channels: ComM_LimitChannelToNoComMode().
        boolean ComMNoWakeup: set at pre-compile, default-value=false  # Defines if an ECU is not allowed to wake-up the channel. | true: Enabled (not allowed to wake-up)) false: Disabled This is the default/init value of a runtime variable that can be changed during runtime using ComM_PreventWakeUp().
        enumeration ComMPncGatewayType [0..1]: {COMM_GATEWAY_TYPE_ACTIVE, COMM_GATEWAY_TYPE_PASSIVE}, set at pre-compile  # Identifies the Partial Network Gateway behaviour of a ComMChannel.
        container ComMNetworkManagement  # This container contains the configuration parameters of the networkmanagement.
          float ComMNmLightTimeout [0..1]: 0..255, set at pre-compile, default-value=10  # Defines the timeout (in seconds) after COMM_FULL_COMMUNICATION sub-state COMM_FULL_COM_READY_SLEEP is left. | The range shall be greater than 0.0 and less or equal to 255.0.
          enumeration ComMNmVariant: {FULL, LIGHT, NONE, PASSIVE}, set at pre-compile, default-value=FULL  # Defines the functionality of the networkmanagement. | Shall be harmonized with NM configuration.
          boolean ComMPncNmRequest: set at pre-compile, default-value=false  # If this parameter equals true then every time a FULL Communication is requested due to a change in the PNC state machine to PNC_REQUESTED Nm shall be called using the API Nm_NetworkRequest.
        container ComMUserPerChannel [0..*]  # This container contains a list of identifiers that are needed to refer to a user in the system which is linked to a channel.
          reference ComMUserChannel: set at pre-compile, destination=ComMUser  # Reference to the ComMUser that corresponds to this channel user. | ImplementationType: COMM_UserHandleType
      container ComMPnc [0..*]  # This container contains the configuration of the partial network cluster (PNC).
        integer ComMPncId: 0..47, set at pre-compile, symbolic-name-value=true  # Partial network cluster identification number.
        reference ComMChannelPerPnc [1..*]: set at pre-compile, destination=ComMChannel  # Reference to the ComMChannel that is required for this PNC. | ImplementationType: COMM_ChannelType
        reference ComMUserPerPnc [0..*]: set at pre-compile, destination=ComMUser  # Reference to the ComMUsers that correspond to this PNC. | ImplementationType: COMM_UserHandleType
        container ComMPncComSignal [0..*]  # Represents the PncComSignals which are used to communicate the EIRA and ERA status of this PNC.
          enumeration ComMPncComSignalDirection: {RX, TX}, set at pre-compile  # Indicates the communication direction of this PncComSignal.
          enumeration ComMPncComSignalKind: {EIRA, ERA}, set at pre-compile  # Indicates whether this PncComSignal represents EIRA or ERA PNC information.
          reference ComMPncComSignalChannelRef [0..1]: set at pre-compile, destination=ComMChannel  # Reference to the ComMChannel which is used to determine whether this PncComSignal shall participate in the active or passive role (via the parameter ComMPncGatewayType of the ComMChannel). | Not applicable if ComMPncComSignalKind is EIRA.
          symbolic name reference ComMPncComSignalRef: set at pre-compile, destination=ComSignal  # Reference to the ComSignal which is used to transport the partial network channel request information.
      container ComMUser [1..*]  # This container contains a list of identifiers that are needed to refer to a user in the system which is designated to request Communication modes.
        integer ComMUserIdentifier: 0..255, set at pre-compile, symbolic-name-value=true  # An identifier that is needed to refer to a user in the system which is designated to request Communication Modes. | ImplementationType: ComM_UserHandleType
        reference ComMUserEcucPartitionRef [0..1]: set at pre-compile, destination=EcucPartition  # Denotes in which "EcucPartition" the requester is executed. When the | partition is stopped, the communication request shall be cancelled in the ComM to avoid a stay-awake situation of the bus due to a stopped partition.
    container ComMGeneral  # General configuration parameters of the Communication Manager.
      boolean ComMDevErrorDetect: set at pre-compile, default-value=false  # Switches the Development Error Detection and Notification ON or OFF. | true: Enabled false: Disabled
      boolean ComMDirectUserMapping [0..1]: set at pre-compile, default-value=false  # If this parameter is set to true the configuration tool shall automatically create a ComMUser per ComMPnc and a ComMUser per ComMChannel. | The shortName of the generated ComMUsers shall follow the following naming convention: PNCUser_ComMPncId, e.g. PNCUser_13 ChannelUser_ComMChannelId, e.g. ChannelUser_25 Restriction: ComMUser, which are created due to this configuration parameter, shall not be used by SWCs (only available for BswM).
      integer ComMEcuGroupClassification: 0..255, set at pre-compile, default-value=3  # Defines whether a mode inhibition affects the ECU or not. | Examples: 000: No mode inhibition can be activated 001: Wake up inhibition can be enabled Forcing into COMM_NO_COMMUNICATION mode shall be switched on if ComMNmVariant=PASSIVE.
      boolean ComMModeLimitationEnabled: set at pre-compile, default-value=false  # true if mode limitation functionality shall be enabled. | true: Enabled false: Disabled
      boolean ComMPncGatewayEnabled [0..1]: set at pre-compile, default-value=false  # Enables or disables support of Partial Network Gateway. | False: Partial Networking Gateway is disabled True: Partial Networking Gateway is enabled
      float ComMPncPrepareSleepTimer [0..1]: 0..63, set at pre-compile  # Time in seconds the PNC state machine shall wait in PNC_PREPARE_SLEEP.
      boolean ComMPncSupport: set at pre-compile, default-value=false  # Enables or disables support of partial networking. | False: Partial Networking is disabled True: Partial Networking is enabled
      boolean ComMSynchronousWakeUp: set at pre-compile, default-value=true  # Wake up of one channel shall lead to a wake up of all channels if true. | true: Enabled false: Disabled
      float ComMTMinFullComModeDuration: 0.001..65, set at pre-compile, default-value=5  # Minimum time duration in seconds, spent in the COMM_FULL_COMMUNICATION sub-state COMM_FULL_COM_NETWORK_REQUESTED.
      boolean ComMVersionInfoApi: set at pre-compile, default-value=true  # Switches the possibility to read the published information with the service ComM_GetPublishedInformation(). | true: Enabled false: Disabled
      boolean ComMWakeupInhibitionEnabled: set at pre-compile, default-value=false  # true if wake up inhibition functionality enabled. | true: Enabled false: Disabled
      symbolic name reference ComMGlobalNvMBlockDescriptor [0..1]: set at pre-compile, destination=NvMBlockDescriptor  # Reference to NVRAM block containing the none volatile data. If this parameter is not configured it means that no NVRam is used at all.
  module definition CorTst [0..1]: variants link-time/pre-compile  # Configuration of the CorTst module.
    container CorTstBackgroundConfigSet [0..*]  # Multiple Configuration Set Container, defines background mode.
      container CorTstSelect  # This container specifies configuration parameters to select individual tests for foreground mode and background mode. The availability is hardware and implementation specific.
        boolean CorTstAddress: set at link in variant link-time / pre-compile in variant pre-compile, default-value=false  # Enable/Disables core address test.
        boolean CorTstAlu: set at link in variant link-time / pre-compile in variant pre-compile, default-value=false  # Enable/Disables core ALU test.
        boolean CorTstCache: set at link in variant link-time / pre-compile in variant pre-compile, default-value=false  # Enable/Disables core cache test.
        boolean CorTstInterrupt: set at link in variant link-time / pre-compile in variant pre-compile, default-value=false  # Enable/Disables core interrupt test
        boolean CorTstMemoryIf: set at link in variant link-time / pre-compile in variant pre-compile, default-value=false  # Enable/Disables core memory interface test
        boolean CorTstMpu: set at link in variant link-time / pre-compile in variant pre-compile, default-value=false  # Enable/Disables core MPU test
        boolean CorTstRegister: set at link in variant link-time / pre-compile in variant pre-compile, default-value=false  # Enable/Disables core register test
    container CorTstConfigApiServices
      boolean CorTstAbortApi: set at pre-compile, default-value=false  # Adds / removes the service CorTst_Abort() from the code.
      boolean CorTstGetCurrentStatus: set at pre-compile, default-value=false  # Adds / removes the service CorTst_GetCurrentStatus() from the code.
      boolean CorTstGetFgndSignature: set at pre-compile, default-value=false  # Adds / removes the service CorTst_GetFgndSignature() from the code.
      boolean CorTstGetSignature: set at pre-compile, default-value=false  # Adds / removes the service CorTst_GetSignature() from the code.
      boolean CorTstGetStateApi: set at pre-compile, default-value=false  # Adds / removes the service CorTst_GetState() from the code.
      boolean CorTstStartApi: set at pre-compile, default-value=false  # Adds / removes the service CorTst_Start() from the code.
      boolean CorTstVersionInfoApi: set at pre-compile, default-value=false  # Adds / removes the service CorTst_GetVersionInfo() from the code.
    container CorTstDemEventParameterRefs [0..1]  # Container for the references to DemEventParameter elements which shall be invoked using the API Dem_ReportErrorStatus in case the corresponding error occurs. The EventId is taken from the referenced DemEventParameter's DemEventId value. The standardized errors are provided in the container and can be extended by vendor specific error references.
      symbolic name reference CORTST_E_CORE_FAILURE [0..1]: set at pre-compile, destination=DemEventParameter  # Reference to the DemEventParameter which shall be issued when the error "CORE failure" has occured.
    container CorTstForegroundConfigSet [1..*]  # Multiple Configuration Set Container , defines foreground mode.
      integer CorTstTestIdFgnd: 0..4294967295, set at pre-compile  # This is the Id of this specific foreground test configuration. The value shall be used in the call to the API CorTst_Start(CorTst_TestIdFgndType TestId).
      container CorTstSelect  # This container specifies configuration parameters to select individual tests for foreground mode and background mode. The availability is hardware and implementation specific.
        boolean CorTstAddress: set at link in variant link-time / pre-compile in variant pre-compile, default-value=false  # Enable/Disables core address test.
        boolean CorTstAlu: set at link in variant link-time / pre-compile in variant pre-compile, default-value=false  # Enable/Disables core ALU test.
        boolean CorTstCache: set at link in variant link-time / pre-compile in variant pre-compile, default-value=false  # Enable/Disables core cache test.
        boolean CorTstInterrupt: set at link in variant link-time / pre-compile in variant pre-compile, default-value=false  # Enable/Disables core interrupt test
        boolean CorTstMemoryIf: set at link in variant link-time / pre-compile in variant pre-compile, default-value=false  # Enable/Disables core memory interface test
        boolean CorTstMpu: set at link in variant link-time / pre-compile in variant pre-compile, default-value=false  # Enable/Disables core MPU test
        boolean CorTstRegister: set at link in variant link-time / pre-compile in variant pre-compile, default-value=false  # Enable/Disables core register test
    container CorTstGeneral
      boolean CorTstDevErrorDetect: set at pre-compile, default-value=false  # Switch for enabling the development error detection.
      integer CorTstFgndTestNumber: 1..4294967295, set at pre-compile  # This parameter holds the number of test configurations available for the foreground tests as defined in this configuration.
      boolean CorTstNotificationSupported: set at pre-compile, default-value=true  # Switch to indicate that the notification is supported.
      integer CorTstTestIntervalIdEndValue [0..1]: 0..4294967295, set at pre-compile  # Defines the end value of the Test Interval Id.
      boolean CorTstTestResultMode: set at pre-compile, default-value=false  # Switch for enabling test result comparison within the Core test driver. In this mode a core test result OK or NOTOK shall not be calculated from the core test driver. Within core test driver no comparison against the reference value is processed.
  module definition Crc [0..1]: variants pre-compile  # Configuration of the Crc (Crc routines) module.
    container CrcGeneral  # General configuration of CRC module
      enumeration Crc16Mode [0..1]: {CRC_16_HARDWARE, CRC_16_RUNTIME, CRC_16_TABLE}, set at pre-compile  # Switch to select one of the available CRC 16-bit (CCITT) calculation methods
      enumeration Crc32Mode [0..1]: {CRC_32_HARDWARE, CRC_32_RUNTIME, CRC_32_TABLE}, set at pre-compile  # Switch to select one of the available CRC 32-bit (IEEE-802.3 CRC32 Ethernet Standard) calculation methods
      enumeration Crc8H2FMode [0..1]: {CRC_8H2F_HARDWARE, CRC_8H2F_RUNTIME, CRC_8H2F_TABLE}, set at pre-compile  # Switch to select one of the available CRC 8-bit (2Fh polynomial) calculation methods
      enumeration Crc8Mode [0..1]: {CRC_8_HARDWARE, CRC_8_RUNTIME, CRC_8_TABLE}, set at pre-compile  # Switch to select one of the available CRC 8-bit (SAE J1850) calculation methods
  module definition Csm [0..1]: variants pre-compile  # Configuration of the Csm (CryptoServiceManager) module.
    container CsmAsymDecrypt [0..1]  # Container for incorporation of AsymDecrypt primitives.
      integer CsmAsymDecryptMaxKeySize: 1..4294967295, set at pre-compile  # The maximum, in bytes, of all key lengths used in all CRY primitives which implement an asymmetrical decryption.
      container CsmAsymDecryptConfig [0..32]  # Container for configuration of service AsymDecrypt. The container name serves as a symbolic name for the identifier of a service configuration.
        string CsmAsymDecryptInitConfiguration: set at pre-compile  # Name of a C symbol which contains the configuration of the underlying cryptographic primitive.
        string CsmAsymDecryptPrimitiveName: set at pre-compile  # Name of the cryptographic primitive to use.
        function name CsmCallbackAsymDecrypt: set at pre-compile  # Callback function to be called if service has finished.
    container CsmAsymEncrypt [0..1]  # Container for incorporation of AsymEncrypt primitives.
      integer CsmAsymEncryptMaxKeySize: 1..4294967295, set at pre-compile  # The maximum, in bytes, of all key lengths used in all CRY primitives which implement an asymmetrical encryption.
      container CsmAsymEncryptConfig [0..32]  # Container for configuration of service AsymEncrypt. The container name serves as a symbolic name for the identifier of a service configuration.
        string CsmAsymEncryptInitConfiguration: set at pre-compile  # Name of a C symbol which contains the configuration of the underlying cryptographic primitive.
        string CsmAsymEncryptPrimitiveName: set at pre-compile  # Name of the cryptographic primitive to use.
        function name CsmCallbackAsymEncrypt: set at pre-compile  # Callback function to be called if service has finished.
    container CsmAsymPrivateKeyExtract [0..1]  # Container for incorporation of AsymPrivateKeyExtract primitives.
      integer CsmAsymPrivateKeyExtractMaxKeySize: 1..4294967295, set at pre-compile  # The maximum, in bytes, of all key lengths used in all CRY primitives which implement an asymmetrical private key extraction.
      container CsmAsymPrivateKeyExtractConfig [0..32]  # Container for configuration of service AsymPrivateKeyExtract. | The container name serves as a symbolic name for the identifier of a service configuration.
        string CsmAsymPrivateKeyExtractInitConfiguration: set at pre-compile  # Name of a C symbol which contains the configuration of the underlying cryptographic primitive.
        string CsmAsymPrivateKeyExtractPrimitiveName: set at pre-compile  # Name of the cryptographic primitive to use.
        function name CsmCallbackAsymPrivateKeyExtract: set at pre-compile  # Callback function to be called if service has finished.
    container CsmAsymPrivateKeyWrapAsym [0..1]  # Container for incorporation of AsymPrivateKeyWrapSym primitives.
      integer CsmAsymPrivateKeyWrapAsymMaxPrivKeySize: 1..4294967295, set at pre-compile  # The maximum length, in bytes, of all private key types used in all CRY primitives which implement an asymmetrical private key wrapping.
      integer CsmAsymPrivateKeyWrapAsymMaxPubKeySize: 1..4294967295, set at pre-compile  # The maximum length, in bytes, of all public key types used in all CRY primitives which implement an asymmetrical private key wrapping.
      container CsmAsymPrivateKeyWrapAsymConfig [0..32]  # Container for configuration of service SymKeyWrapAsym. The container name serves as a symbolic name for the identifier of a service configuration.
        string CsmAsymPrivateKeyWrapAsymInitConfiguration: set at pre-compile  # Name of a C symbol which contains the configuration of the underlying cryptographic primitive.
        string CsmAsymPrivateKeyWrapAsymPrimitiveName: set at pre-compile  # Name of the cryptographic primitive to use.
        function name CsmCallbackAsymPrivateKeyWrapAsym: set at pre-compile  # Callback function to be called if service has finished.
    container CsmAsymPrivateKeyWrapSym [0..1]  # Container for incorporation of AsymPrivateKeyWrapSym primitives.
      integer CsmAsymPrivateKeyWrapSymMaxPrivKeySize: 1..4294967295, set at pre-compile  # The maximum length, in bytes, of all private information types used in all CRY primitives which implement an asymetric private key wrapping.
      integer CsmAsymPrivateKeyWrapSymMaxSymKeySize: 1..4294967295, set at pre-compile  # The maximum, in bytes, of all key lengths used in all CRY primitives which implement an asymetrical private key wrapping.
      container CsmAsymPrivateKeyWrapSymConfig [0..32]  # Container for configuration of service AsymPrivateKeyWrapSym. The container name serves as a symbolic name for the identifier of a service configuration.
        string CsmAsymPrivateKeyWrapSymInitConfiguration: set at pre-compile  # Name of a C symbol which contains the configuration of the underlying cryptographic primitive.
        string CsmAsymPrivateKeyWrapSymPrimitiveName: set at pre-compile  # Name of the cryptographic primitive to use.
        function name CsmCallbackAsymPrivateKeyWrapSym: set at pre-compile  # Callback function to be called if service has finished.
    container CsmAsymPublicKeyExtract [0..1]  # Container for incorporation of AsymPublicKeyExtract primitives.
      integer CsmAsymPublicKeyExtractMaxKeySize: 1..4294967295, set at pre-compile  # The maximum, in bytes, of all key lengths used in all CRY primitives which implement an asymmetrical public key extraction.
      container CsmAsymPublicKeyExtractConfig [0..32]  # Container for configuration of service AsymPublicKeyExtract. | The container name serves as a symbolic name for the identifier of a service configuration.
        string CsmAsymPublicKeyExtractInitConfiguration: set at pre-compile  # Name of a C symbol which contains the configuration of the underlying cryptographic primitive.
        string CsmAsymPublicKeyExtractPrimitiveName: set at pre-compile  # Name of the cryptographic primitive to use.
        function name CsmCallbackAsymPublicKeyExtract: set at pre-compile  # Callback function to be called if service has finished.
    container CsmChecksum [0..1]  # Container for incorporation of Checksum primitives.
      container CsmChecksumConfig [0..32]  # Container for configuration of service Checksum. The container name serves as a symbolic name for the identifier of a service configuration.
        function name CsmCallbackChecksum: set at pre-compile  # Callback function to be called if service has finished.
        string CsmChecksumInitConfiguration: set at pre-compile  # Name of a C symbol which contains the configuration of the underlying cryptographic primitive.
        string CsmChecksumPrimitiveName: set at pre-compile  # Name of the cryptographic primitive to use.
    container CsmDemEventParameterRefs [0..1]  # Container for the references to DemEventParameter elements which shall be invoked using the API Dem_ReportErrorStatus API in case the corresponding error occurs. The EventId is taken from the referenced DemEventParameter's DemEventId value. The standardized errors are provided in the container and can be extended by vendor specific error references.
      symbolic name reference CSM_E_INIT_FAILED [0..1]: set at pre-compile, destination=DemEventParameter  # Reference to the DemEventParameter which shall be issued when the error "Initialization of CSM module failed" has occured.
    container CsmGeneral  # Container for common configuration options.
      boolean CsmDevErrorDetect: set at pre-compile  # Pre-processor switch to enable and disable development error detection. | True: Development error detection enabled. False: Development error detection disabled
      string CsmMaxAlignScalarType: set at pre-compile  # The scalar type which has the maximum alignment restrictions on the given platform. | This type can be e.g. uint8, uint16 or uint32.
      integer CsmMaximumBlockingTime: 1..4294967295, set at pre-compile  # If interruption is turned on with the configuration option CsmUseInterruption, this option configures the maximum time in microseconds the main function shall be allowed to run before it must interrupt itself. The lowest allowed value for the option is implementation dependent.
      boolean CsmUseInterruption: set at pre-compile  # Pre-processor switch to enable and disable interruption of job processing. | True: Interruption of job processing enabled False: Interruption of job processing disabled
      boolean CsmUseSyncJobProcessing: set at pre-compile  # Pre-processor switch to enable and disable synchronous job processing. | True: synchronous job processing enabled False: synchronous job processing disabled
      boolean CsmVersionInfoApi: set at pre-compile  # Pre-processor switch to enable and disable availability of the API Csm_GetVersionInfo(). True: API Csm_GetVersionInfo() is available. False: API Csm_GetVersionInfo() is not available.
    container CsmHash [0..1]  # Container for incorporation of Hash primitives.
      container CsmHashConfig [0..32]  # Configurations for the Hash service. The container name serves as a symbolic name for the identifier of a service configuration.
        function name CsmCallbackHash: set at pre-compile  # Callback function to be called if service has finished.
        string CsmHashInitConfiguration: set at pre-compile  # Name of a C symbol which contains the configuration of the underlying cryptographic primitive.
        string CsmHashPrimitiveName: set at pre-compile  # Name of the cryptographic primitive to use.
    container CsmKeyDerive [0..1]  # Container for incorporation of KeyDerive primitives.
      integer CsmKeyDeriveMaxKeySize: 1..4294967295, set at pre-compile  # The maximum, in bytes, of all key lengths used in all CRY primitives which implement a key derivation.
      container CsmKeyDeriveConfig [0..32]  # Container for configuration of service KeyDerive. The container name serves as a symbolic name for the identifier of a service configuration.
        function name CsmCallbackKeyDerive: set at pre-compile  # Callback function to be called if service has finished.
        string CsmKeyDeriveInitConfiguration: set at pre-compile  # Name of a C symbol which contains the configuration of the underlying cryptographic primitive.
        string CsmKeyDerivePrimitiveName: set at pre-compile  # Name of the cryptographic primitive to use.
    container CsmKeyDeriveSymKey [0..1]  # Container for incorporation of CsmKeyDeriveSymKey primitives.
      integer CsmKeyDeriveSymKeyMaxSymKeySize: 1..4294967295, set at pre-compile  # The maximum, in bytes, of all key lengths used in all CRY primitives which implement a key derivation.
      container CsmKeyDeriveSymKeyConfig [0..32]  # Container for configuration of service CsmKeyDeriveSymKey. The container name serves as a symbolic name for the identifier of a service configuration.
        function name CsmCallbackKeyDeriveSymKey: set at pre-compile  # Callback function to be called if service has finished.
        string CsmKeyDeriveSymKeyInitConfiguration: set at pre-compile  # Name of a C symbol which contains the configuration of the underlying cryptographic primitive.
        string CsmKeyDeriveSymKeyPrimitiveName: set at pre-compile  # Name of the cryptographic primitive to use.
    container CsmKeyExchangeCalcPubVal [0..1]  # Container for incorporation of KeyExchangeCalcPubVal primitives.
      integer CsmKeyExchangeCalcPubValMaxBaseTypeSize: 1..4294967295, set at pre-compile  # The maximum length, in bytes, of all base types used in all CRY primitives which implement a public value calculation.
      integer CsmKeyExchangeCalcPubValMaxPrivateTypeSize: 1..4294967295, set at pre-compile  # The maximum length, in bytes, of all private information types used in all CRY primitives which implement a public value calculation.
      container CsmKeyExchangeCalcPubValConfig [0..32]  # Container for configuration of service KeyExchangeCalcPubVal. The container name serves as a symbolic name for the identifier of a service configuration.
        function name CsmCallbackKeyExchangeCalcPubVal: set at pre-compile  # Callback function to be called if service has finished.
        string CsmKeyExchangeCalcPubValInitConfiguration: set at pre-compile  # Name of a C symbol which contains the configuration of the underlying cryptographic primitive.
        string CsmKeyExchangeCalcPubValPrimitiveName: set at pre-compile  # Name of the cryptographic primitive to use.
    container CsmKeyExchangeCalcSecret [0..1]  # Container for incorporation of KeyExchangeCalcSecret primitives.
      integer CsmKeyExchangeCalcSecretMaxBaseTypeSize: 1..4294967295, set at pre-compile  # The maximum length, in bytes, of all base types used in all CRY primitives which implement a shared secret calculation.
      integer CsmKeyExchangeCalcSecretMaxPrivateTypeSize: 1..4294967295, set at pre-compile  # The maximum length, in bytes, of all private information types used in all CRY primitives which implement a shared secret calculation.
      container CsmKeyExchangeCalcSecretConfig [0..32]  # Container for configuration of service KeyExchangeCalcSecret. The container name serves as a symbolic name for the identifier of a service configuration.
        function name CsmCallbackKeyExchangeCalcSecret: set at pre-compile  # Callback function to be called if service has finished.
        string CsmKeyExchangeCalcSecretInitConfiguration: set at pre-compile  # Name of a C symbol which contains the configuration of the underlying cryptographic primitive.
        string CsmKeyExchangeCalcSecretPrimitiveName: set at pre-compile  # Name of the cryptographic primitive to use.
    container CsmKeyExchangeCalcSymKey [0..1]  # Container for incorporation of KeyExchangeCalcSymKey primitives.
      integer CsmKeyExchangeCalcSymKeyMaxBaseTypeSize: 1..4294967295, set at pre-compile  # The maximum length, in bytes, of all base types used in all CRY primitives which implement a symmetrical key calculation.
      integer CsmKeyExchangeCalcSymKeyMaxPrivateTypeSize: 1..4294967295, set at pre-compile  # The maximum length, in bytes, of all private information types used in all CRY primitives which implement a symmetrical key calculation.
      integer CsmKeyExchangeCalcSymKeyMaxSymKeySize: 1..4294967295, set at pre-compile  # The maximum, in bytes, of all key lengths used in all CRY primitives which implement a symmetrical key calculation.
      container CsmKeyExchangeCalcSymKeyConfig [0..32]  # Container for configuration of service KeyExchangeCalcSymKey. The container name serves as a symbolic name for the identifier of a service configuration.
        function name CsmCallbackKeyExchangeCalcSymKey: set at pre-compile  # Callback function to be called if service has finished.
        string CsmKeyExchangeCalcSymKeyInitConfiguration: set at pre-compile  # Name of a C symbol which contains the configuration of the underlying cryptographic primitive.
        string CsmKeyExchangeCalcSymKeyPrimitiveName: set at pre-compile  # Name of the cryptographic primitive to use.
    container CsmMacGenerate [0..1]  # Container for incorporation of MacGenerate primitives.
      integer CsmMacGenerateMaxKeySize: 1..4294967295, set at pre-compile  # The maximum, in bytes, of all key lengths used in all CRY primitives which implement a MAC generation.
      container CsmMacGenerateConfig [0..32]  # Configurations for the MacGenerate service. The container name serves as a symbolic name for the identifier of a service configuration.
        function name CsmCallbackMacGenerate: set at pre-compile  # Callback function to be called if service has finished.
        string CsmMacGenerateInitConfiguration: set at pre-compile  # Name of a C symbol which contains the configuration of the underlying cryptographic primitive.
        string CsmMacGeneratePrimitiveName: set at pre-compile  # Name of the cryptographic primitive to use.
    container CsmMacVerify [0..1]  # Container for incorporation of MacVerify primitives.
      integer CsmMacVerifyMaxKeySize: 1..4294967295, set at pre-compile  # The maximum, in bytes, of all key lengths used in all CRY primitives which implement a MAC verification.
      container CsmMacVerifyConfig [0..32]  # Container for configuration of service MacVerify. The container name serves as a symbolic name for the identifier of a service configuration.
        function name CsmCallbackMacVerify: set at pre-compile  # Callback function to be called if service has finished.
        string CsmMacVerifyInitConfiguration: set at pre-compile  # Name of a C symbol which contains the configuration of the underlying cryptographic primitive.
        string CsmMacVerifyPrimitiveName: set at pre-compile  # Name of the cryptographic primitive to use.
    container CsmRandomGenerate [0..1]  # Container for incorporation of RandomGenerate primitives.
      container CsmRandomGenerateConfig [0..32]  # Container for configuration of service RandomGenerate. The container name serves as a symbolic name for the identifier of a service configuration.
        function name CsmCallbackRandomGenerate: set at pre-compile  # Callback function to be called if service has finished.
        string CsmRandomGenerateInitConfiguration: set at pre-compile  # Name of a C symbol which contains the configuration of the underlying cryptographic primitive.
        string CsmRandomGeneratePrimitiveName: set at pre-compile  # Name of the cryptographic primitive to use.
    container CsmRandomSeed [0..1]  # Container for incorporation of RandomSeed primitives.
      container CsmRandomSeedConfig [0..32]  # Container for configuration of service RandomSeed. The container name serves as a symbolic name for the identifier of a service configuration.
        function name CsmCallbackRandomSeed: set at pre-compile  # Callback function to be called if service has finished.
        string CsmRandomSeedInitConfiguration: set at pre-compile  # Name of a C symbol which contains the configuration of the underlying cryptographic primitive.
        string CsmRandomSeedPrimitiveName: set at pre-compile  # Name of the cryptographic primitive to use.
    container CsmSignatureGenerate [0..1]  # Container for incorporation of SignatureGenerate primitives
      integer CsmSignatureGenerateMaxKeySize: 1..4294967295, set at pre-compile  # The maximum, in bytes, of all key lengths used in all CRY primitives which implement a signature generation.
      container CsmSignatureGenerateConfig [0..32]  # Container for configuration of service SignatureGenerate. The container name serves as a symbolic name for the identifier of a service configuration.
        function name CsmCallbackSignatureGenerate: set at pre-compile  # Callback function to be called if service has finished.
        string CsmSignatureGenerateInitConfiguration: set at pre-compile  # Name of a C symbol which contains the configuration of the underlying cryptographic primitive.
        string CsmSignatureGeneratePrimitiveName: set at pre-compile  # Name of the cryptographic primitive to use.
    container CsmSignatureVerify [0..1]  # Container for incorporation of SignatureVerify primitives.
      integer CsmSignatureVerifyMaxKeySize: 1..4294967295, set at pre-compile  # The maximum, in bytes, of all key lengths used in all CRY primitives which implement a signature verification.
      container CsmSignatureVerifyConfig [0..32]  # Container for configuration of service SignatureVerify. The container name serves as a symbolic name for the identifier of a service configuration.
        function name CsmCallbackSignatureVerify: set at pre-compile  # Callback function to be called if service has finished.
        string CsmSignatureVerifyInitConfiguration: set at pre-compile  # Name of a C symbol which contains the configuration of the underlying cryptographic primitive.
        string CsmSignatureVerifyPrimitiveName: set at pre-compile  # Name of the cryptographic primitive to use.
    container CsmSymBlockDecrypt [0..1]  # Container for incorporation of SymBlockDecrypt primitives.
      integer CsmSymBlockDecryptMaxKeySize: 1..4294967295, set at pre-compile  # The maximum, in bytes, of all key lengths used in all CRY primitives which implement a symmetrical block decryption.
      container CsmSymBlockDecryptConfig [0..32]  # Container for configuration of service SymBlockDecrypt. The container name serves as a symbolic name for the identifier of a service configuration.
        function name CsmCallbackSymBlockDecrypt: set at pre-compile  # Callback function to be called if service has finished.
        string CsmSymBlockDecryptInitConfiguration: set at pre-compile  # Name of a C symbol which contains the configuration of the underlying cryptographic primitive.
        string CsmSymBlockDecryptPrimitiveName: set at pre-compile  # Name of the cryptographic primitive to use.
    container CsmSymBlockEncrypt [0..1]  # Container for incorporation of SymBlockEncrypt primitives.
      integer CsmSymBlockEncryptMaxKeySize: 1..4294967295, set at pre-compile  # The maximum, in bytes, of all key lengths used in all CRY primitives which implement a symmetrical block encryption.
      container CsmSymBlockEncryptConfig [0..32]  # Container for configuration of service SymBlockEncrypt. The container name serves as a symbolic name for the identifier of a service configuration.
        function name CsmCallbackSymBlockEncrypt: set at pre-compile  # Callback function to be called if service has finished.
        string CsmSymBlockEncryptInitConfiguration: set at pre-compile  # Name of a C symbol which contains the configuration of the underlying cryptographic primitive.
        string CsmSymBlockEncryptPrimitiveName: set at pre-compile  # Name of the cryptographic primitive to use.
    container CsmSymDecrypt [0..1]  # Container for incorporation of SymDecrypt primitives
      integer CsmSymDecryptMaxKeySize: 1..4294967295, set at pre-compile  # The maximum, in bytes, of all key lengths used in all CRY primitives which implement a symmetrical decryption.
      container CsmSymDecryptConfig [0..32]  # Container for configuration of service SymDecrypt. | The container name serves as a symbolic name for the identifier of a service configuration.
        function name CsmCallbackSymDecrypt: set at pre-compile  # Callback function to be called if service has finished.
        string CsmSymDecryptInitConfiguration: set at pre-compile  # Name of a C symbol which contains the configuration of the underlying cryptographic primitive.
        string CsmSymDecryptPrimitiveName: set at pre-compile  # Name of the cryptographic primitive to use.
    container CsmSymEncrypt [0..1]  # Container for incorporation of SymEncrypt primitives.
      integer CsmSymEncryptMaxKeySize: 1..4294967295, set at pre-compile  # The maximum, in bytes, of all key lengths used in all CRY primitives which implement a symmetrical encryption.
      container CsmSymEncryptConfig [0..32]  # Container for configuration of service SymEncrypt. The container name serves as a symbolic name for the identifier of a service configuration.
        function name CsmCallbackSymEncrypt: set at pre-compile  # Callback function to be called if service has finished.
        string CsmSymBlockEncryptInitConfiguration: set at pre-compile  # Name of a C symbol which contains the configuration of the underlying cryptographic primitive.
        string CsmSymEncryptPrimitiveName: set at pre-compile  # Name of the cryptographic primitive to use.
    container CsmSymKeyExtract [0..1]  # Container for incorporation of SymKeyExtract primitives.
      integer CsmSymKeyExtractMaxKeySize: 1..4294967295, set at pre-compile  # The maximum, in bytes, of all key lengths used in all CRY primitives which implement a symmetrical key extraction.
      container CsmSymKeyExtractConfig [0..32]  # Container for configuration of service SymKeyExtract. The container name serves as a symbolic name for the identifier of a service configuration.
        function name CsmCallbackSymKeyExtract: set at pre-compile  # Callback function to be called if service has finished.
        string CsmSymKeyExtractInitConfiguration: set at pre-compile  # Name of a C symbol which contains the configuration of the underlying cryptographic primitive.
        string CsmSymKeyExtractPrimitiveName: set at pre-compile  # Name of the cryptographic primitive to use.
    container CsmSymKeyWrapAsym [0..1]  # Container for incorporation of SymKeyWrapSym primitives.
      integer CsmSymKeyWrapAsymMaxPubKeySize: 1..4294967295, set at pre-compile  # The maximum length, in bytes, of all public key types used in all CRY primitives which implement an asymmetrical key wrapping.
      integer CsmSymKeyWrapAsymMaxSymKeySize: 1..4294967295, set at pre-compile  # The maximum, in bytes, of all key lengths used in all CRY primitives which implement an asymmetrical key wrapping.
      container CsmSymKeyWrapAsymConfig [0..32]  # Container for configuration of service SymKeyWrapAsym. The container name serves as a symbolic name for the identifier of a service configuration.
        function name CsmCallbackSymKeyWrapAsym: set at pre-compile  # Callback function to be called if service has finished.
        string CsmSymKeyWrapAsymInitConfiguration: set at pre-compile  # Name of a C symbol which contains the configuration of the underlying cryptographic primitive.
        string CsmSymKeyWrapAsymPrimitiveName: set at pre-compile  # Name of the cryptographic primitive to use.
    container CsmSymKeyWrapSym [0..1]  # Container for incorporation of SymKeyWrapSym primitives.
      integer CsmSymKeyWrapSymMaxSymKeySize: 1..4294967295, set at pre-compile  # The maximum, in bytes, of all key lengths used in all CRY primitives which implement an symmetrical key wrapping.
      container CsmSymKeyWrapSymConfig [0..32]  # Container for configuration of service SymKeyWrapSym. The container name serves as a symbolic name for the identifier of a service configuration.
        function name CsmCallbackSymKeyWrapSym: set at pre-compile  # Callback function to be called if service has finished.
        string CsmSymKeyWrapSymInitConfiguration: set at pre-compile  # Name of a C symbol which contains the configuration of the underlying cryptographic primitive.
        string CsmSymKeyWrapSymPrimitiveName: set at pre-compile  # Name of the cryptographic primitive to use.
  module definition Dbg [0..1]: variants post-build/pre-compile  # Configuration of the debugging module.
    container DbgBuffering [0..1]  # This container holds the parameters to manage the storage of debugging data in RAM.
      integer DbgBufferSize: 0..65535, set at pre-compile  # Size in bytes of the RAM for the ring buffer. A size of 0 means that no buffer exists. All data records are directly transferred.
      enumeration DbgBufferStrategy: {OverwriteOldestEntries, StopStorage}, set at pre-compile, default-value=StopStorage  # Strategy of buffer operations when it is full: overwrite oldest entries or stop the storage.
      enumeration DbgBufferTransmission: {StartAfterInitialization, StartOnHostRequest}, set at pre-compile, default-value=StartOnHostRequest  # Automatic or requested transmission of the buffer.
    container DbgCommunication [0..1]  # This container holds all configuration parameters for communication.
      container DbgRxPdu  # This container holds configuration parameters for the receive-pdu.
        integer DbgRxPduId: 0..65535, set at published-information, symbolic-name-value=true, default-value=0  # Handle Id to be used by the PduR to indicate the reception of the DbgRxPdu to the Dbg module. The actual value of this parameter is fixed to 0 since there is only one RxPdu for the Dbg module. | The existence of this parameter is essential for the PduR generation tool to actually find a symbolicNameValue for the RxPdu.
        reference DbgReceiveIPduRef: set at pre-compile, destination=Pdu  # Reference to the receive I-PDU.
      container DbgTxPdu  # This container holds configuration parameters for the transmit-pdu.
        integer DbgTxConfirmationPduId: 0..65535, set at published-information, symbolic-name-value=true, default-value=0  # Handle Id to be used by the PduR to confirm the transmission of the DbgTxPdu to the Dbg module. The actual value of this parameter is fixed to 0 since there is only one TxPdu for the Dbg module. | The existence of this parameter is essential for the PduR generation tool to actually find a symbolicNameValue for the TxPdu.
        reference DbgSendIPduRef: set at pre-compile, destination=Pdu  # Reference to the send I-PDU.
    container DbgGeneral  # This container holds the general parameters of the debugging module.
      boolean DbgDevErrorDetect: set at pre-compile  # Enables/Disables development error detection.
      string DbgHeaderFileInclusion [0..*]: set at pre-compile, regular-expression=[a-zA-Z0-9_]([a-zA-Z0-9\._])*  # Name of the header file(s) to be included by the Dbg module.
      boolean DbgVersionInfoApi: set at pre-compile  # Activate/Deactivate the version information API (Dbg_GetVersionInfo). True: version information API activated False: version information API deactivated.
    container DbgMultipleConfigurationContainer: multiple-configuration-container=true
      integer DbgMaxDynamicDID [0..1]: 0..200, set at post-build in variant post-build / pre-compile in variant pre-compile  # Maximum number of dynamic DIDs. This value is only needed to reserve memory for dynamic DIDs added by the host at runtime. If this parameter is not supplied it is automatically set to the configured number of static DIDs. | The sum of MaxStaticDID and MaxDynamicDID must not exceed 200. Dynamic DIDs are MaxStaticDID based and consecutive.
      integer DbgMaxStaticDID [0..1]: 0..200, set at post-build in variant post-build / pre-compile in variant pre-compile  # Maximum number of static DIDs. This value is only needed to reserve memory for static DIDs added at post-build time. If this parameter is not supplied it is automatically set to the configured number of static DIDs. Static DIDs are zero based and consecutive.
      container DbgPredefinedDID [0..16]  # This container holds all configuration parameters for predefined DIDs. For predefined DIDs, only certain values can be changed.
        boolean DbgPredefinedDIDActivation: set at post-build in variant post-build / pre-compile in variant pre-compile, default-value=false  # Activation or not of the DID for debugging. | true: DIDOn. false: DIDOff.
        boolean DbgPredefinedDIDBuffering: set at post-build in variant post-build / pre-compile in variant pre-compile, default-value=false  # Buffer the data or transmit directly. | true: BufferingOn. false: BufferingOff.
        enumeration DbgPredefinedDIDName: {Dbg_PostTaskHook, Dbg_PreTaskHook, Dbg_TraceDetCall, Dbg_TraceFunctionEntry, Dbg_TraceFunctionExit, Dbg_TraceRTECall, Dbg_TraceRTEComCallback, Dbg_TraceRTEComSignalIv, Dbg_TraceRTEComSignalRx, Dbg_TraceRTEComSignalTx, Dbg_TraceRTEVfbSignalReceive, Dbg_TraceRTEVfbSignalSend, Dbg_TraceRunnableStart, Dbg_TraceRunnableTermination, Dbg_TraceTimestamps}, set at pre-compile  # List of possible names for predefined DIDs.
        boolean DbgPredefinedDIDTimeStampActivation: set at post-build in variant post-build / pre-compile in variant pre-compile, default-value=false  # Using or not of time stamp. | true: TimeStampOn. false: TimeStampOff.
        choice container DbgPredefinedDIDAddInfo [0..*]  # Additional information in case the Predefined DID needs further configuration parameters.
          container DbgAddInfoComSignal [0..*]  # Additional information for DIDs with the DbgPredefinedDIDName set to: | - Dbg_TraceRTEComSignalTx - Dbg_TraceRTEComSignalRx - Dbg_TraceRTEComSignalIv - Dbg_TraceRTEComCallback The actual SignalId used in the debugging trace APIs is taken from the ComHandleId availabe at the ComSignal configuration of the Com module.
            string DbgComSignalName [0..1]: set at pre-compile  # Optional name of the traced signal. If present it shall be used in the display of the debugging tool.
            foreign reference DbgBswModuleEntryRef: set at pre-compile, destination-type=BSW-MODULE-ENTRY  # Foreign reference to the BSWModuleEntry describing the trace function implementation.
            reference DbgComSignalRef: set at pre-compile, destination=ComSignal  # Reference to the ComSignal which shall be traced.
          container DbgAddInfoRteCall [0..*]  # Additional information for DIDs with the DbgPredefinedDIDName set to: | - Dbg_TraceRTECall
            integer DbgCallComponentId: 0..65535, set at pre-compile  # Id used to identify the SW-Component Type.
            integer DbgCallInstanceId: 0..255, set at pre-compile  # Id used to identify the SW-Component Instance.
            integer DbgCallPortId: 0..65535, set at pre-compile  # Id used to identify the Port.
            integer DbgCallServiceId: 0..255, set at pre-compile  # Id used to identify the OperationProtoype.
            foreign reference DbgBswModuleEntryRef: set at pre-compile, destination-type=BSW-MODULE-ENTRY  # Foreign reference to the BSWModuleEntry describing the trace function implementation.
            instance reference DbgServiceInstanceRef: set at pre-compile, destination-context=SW-COMPONENT-PROTOTYPE PORT-PROTOTYPE, destination-type=CLIENT-SERVER-OPERATION  # Reference to the actual OperationPrototype which shall be traced.
          container DbgAddInfoRunnable [0..*]  # Additional information for DIDs with the DbgPredefinedDIDName set to: | - Dbg_TraceRunnableStart - Dbg_TraceRunnableTermination
            integer DbgRunnableComponentId: 0..65535, set at pre-compile  # Id used to identify the SW-Component Type.
            integer DbgRunnableId: 0..255, set at pre-compile  # Id used to identify the RunnableEntity.
            integer DbgRunnableInstanceId: 0..255, set at pre-compile  # Id used to identify the SW-Component Instance.
            foreign reference DbgBswModuleEntryRef: set at pre-compile, destination-type=BSW-MODULE-ENTRY  # Foreign reference to the BSWModuleEntry describing the trace function implementation.
            foreign reference DbgRunnableEntityRef: set at pre-compile, destination-type=RUNNABLE-ENTITY  # Reference to the actual RunnableEntity which shall be traced.
            foreign reference DbgSoftwareComponentInstanceRef: set at pre-compile, destination-type=SW-COMPONENT-PROTOTYPE  # Reference to the SW-ComponentProtoype which shall be traced.
          container DbgAddInfoVfbSignal [0..*]  # Additional information for DIDs with the DbgPredefinedDIDName set to: | - Dbg_TraceRTEVfbSignalSend - Dbg_TraceRTEVfbSignalReceive
            integer DbgVfbComponentId: 0..65535, set at pre-compile  # Id used to identify the SW-Component Type.
            integer DbgVfbDataElementId: 0..255, set at pre-compile  # Id used to identify the DataElementPrototype.
            integer DbgVfbInstanceId: 0..255, set at pre-compile  # Id used to identify the SW-Component Instance.
            integer DbgVfbPortId: 0..65535, set at pre-compile  # Id used to identify the Port.
            foreign reference DbgBswModuleEntryRef: set at pre-compile, destination-type=BSW-MODULE-ENTRY  # Foreign reference to the BSWModuleEntry describing the trace function implementation.
            instance reference DbgDataElementInstanceRef: set at pre-compile, destination-context=SW-COMPONENT-PROTOTYPE PORT-PROTOTYPE, destination-type=VARIABLE-DATA-PROTOTYPE  # Reference to the actual DataElementPrototype which shall be traced.
      container DbgStaticDID [0..200]  # This container holds all configuration parameters for static DIDs. For predefined DIDs, only certain values can be changed.
        integer DbgAutomaticCollectionFrequency: 0..65535, set at post-build in variant post-build / pre-compile in variant pre-compile, default-value=0  # Cycle time of collection in DataCollectionTicks. A value of "0" indicates that the collection takes place only on request.
        boolean DbgStaticDIDActivation: set at post-build in variant post-build / pre-compile in variant pre-compile, default-value=false  # Activation or not of the DID for debugging. | true: DIDOn. false: DIDOff.
        boolean DbgStaticDIDBuffering: set at post-build in variant post-build / pre-compile in variant pre-compile, default-value=false  # Buffer the data or transmit directly. | true: BufferingOn. false: BufferingOff.
        string DbgStaticDIDNameRef: set at post-build in variant post-build / pre-compile in variant pre-compile  # Name of the DID, translated by the configuration/generation tool into consecutive DID numbers starting from 0.
        boolean DbgStaticTimeStampActivation: set at post-build in variant post-build / pre-compile in variant pre-compile, default-value=false  # Using or not of time stamp. | true: TimeStampOn. false: TimeStampOff.
        choice container DbgStaticDIDData [1..65535]  # Choice how the DID is to be configured.
          container DbgAddressSizePair [0..1]  # This container describes address/size pairs. It is used for static DIDs and dynamic DIDs.
            integer DbgASAbsoluteAddress [0..1]: 0..4294967295, set at pre-compile  # Absolute address of memory location to be debugged. | max = (2**32)-1
            linker symbol DbgASNameRef [0..1]: set at pre-compile  # Symbolic name of the variable, translated by the configuration/generation tool into the address and size of the variable.
            integer DbgASSize [0..1]: 0..255, set at pre-compile  # Absolute size in Bytes of memory location to be debugged.
          container DbgDebugData [0..1]  # Reference to staticMemory used for Debug Data.
            foreign reference DbgDebugDataRef: set at pre-compile, destination-type=VARIABLE-DATA-PROTOTYPE  # Reference to staticMemory used for Debug Data.
          container DbgLocalDebugData [0..1]  # Reference to a localDebugData.
            foreign reference DbgLocalDebugDataRef: set at pre-compile, destination-type=IMPLEMENTATION-DATA-TYPE-ELEMENT  # Reference to a localDebugData.
    container DbgPeriodicDataCollection [0..1]  # This container holds the parameters to manage the time base of the debugging module.
      integer DbgDataCollectionTick: 0..4294967295, set at pre-compile  # Number of OS counter ticks to be used as data collection tick. The OS alarm used for periodic collection of DIDs is set with this value.
      reference DbgAlarmReference: set at pre-compile, destination=OsAlarm  # Reference to the OS alarm used for periodic collection of DIDs.
    container DbgTimestampConfiguration [0..1]  # This container holds the parameters to manage the time stamps of the debugging module.
      enumeration DbgGlobalTimestampActivation: {TimestampOff, TimestampOn}, set at pre-compile, default-value=TimestampOff  # Initial value for timestamp collection.
      enumeration DbgTimeStampSize: {TimeStampSize_16Bit, TimeStampSize_32Bit}, set at pre-compile, default-value=TimeStampSize_16Bit  # Memory size used for the time stamps of all DIDs.
      symbolic name reference DbgGptChannel: set at pre-compile, destination=GptChannelConfiguration  # Reference to the hardware free running timer of the GPT module for time stamps (if no HWFRT is applied, calls to add timestamps are ignored)
