[part 6 of 6: package /AUTOSAR/EcucDefs]
AUTOSAR XML (schema 4-0-3)
package /AUTOSAR/EcucDefs  (continued)
  module definition PduR [0..1]: variants post-build/pre-compile  # Configuration of the PduR (PDU Router) module.
    container PduRBswModules [0..*]  # Each container describes a specific BSW module (upper/CDD/lower/IpduM) that the PDU Router shall interface to. | The reason to have it as own configuration container instead of implication of the routing path is to be able to configure CDD:s properly and to force module's to be used in a post-build situation even though no routing is made to/from this module (future configurations may include these modules).
      boolean PduRCancelReceive: set at pre-compile  # Specifies if the Transport protocol module supports the CancelReceive API or not. Value true the API is supported.
      boolean PduRCancelTransmit: set at pre-compile  # Specifies if the BSW module supports the CancelTransmit API or not. Value true the API is supported.
      boolean PduRChangeParameterRequestApi: set at pre-compile  # This parameter, if set to true, enables the PduR_<Up>ChangeParameterRequest Api for this Module.
      boolean PduRCommunicationInterface: set at pre-compile  # Specifies if the BSW module supports the Communication Interface APIs or not. Value true the APIs are supported. | A module can have both Communication Interface APIs and Transport Protocol APIs (e.g. the COM module).
      boolean PduRLowerModule: set at pre-compile  # The PduRLowerModule will decide who will call the APIs and who will implement the APIs. | For example, if the CanIf module is referenced then the PDU Router module will implement the PduR_CanIfRxIndication API. And the PDUR module will call the CanIf_Transmit API. Other APIs are of course also covered. An upper module can also be an lower module (e.g. the IpduM module).
      boolean PduRRetransmission: set at pre-compile  # If set to true this means that the destination transport protocol module will use the retransmission feature. This parameter might be set to false if the retransmission feature is not used, even though the destination transport protocol is supporting it. | This parameter is only valid for transport protocol modules and gateway operations. If transmission from a local upper layer module this module will handle the retransmission.
      boolean PduRTransportProtocol: set at pre-compile  # The PDU Router module shall use the API parameters specified for transport protocol interface.
      boolean PduRTriggertransmit: set at pre-compile  # Specifies if the BSW module supports the TriggerTransmit API or not. Value true the API is supported.
      boolean PduRTxConfirmation: set at pre-compile  # Specifies if the BSW module supports the TxConfirmation API or not. Value true the API is supported.
      boolean PduRUpperModule: set at pre-compile  # The PduRUpperModule will decide who will call the APIs and who will implement the APIs. | For example, if the COM module is referenced then the PDU Router module will implement the PduR_Transmit API. And the PDUR module will call the Com_RxIndication API. Other APIs are of course also covered. An upper module can also be an lower module (e.g. the IpduM module).
      boolean PduRUseTag: set at pre-compile  # This parameter, if set to true, enables the usage of the tag (<up>) in the following API calls: | * PduR_<Up>CancelReceiveRequest * PduR_<Up>CancelTransmitRequest * PduR_<Up>ChangeParameterRequest Example: If used by COM and the parameter is enabled the PduR_ComCancelTransmitRequest is used. The background is that upper layer modules differ in usage of this tag (e.g. COM is using the tag, DCM is not).
      foreign reference PduRBswModuleRef: set at pre-compile, destination-type=ECUC-MODULE-CONFIGURATION-VALUES  # This is a reference to one BSW module's configuration (i.e. not the ECUC parameter definition template). | Example, there could be several configurations of LinIf and this reference selects one of them.
    container PduRGeneral  # This container is a subcontainer of PduR and specifies the general configuration parameters of the PDU Router.
      boolean PduRDevErrorDetect: set at pre-compile  # If true then PDU Router will enable the error-reporting to the Development Error Tracer (DET).
      boolean PduRVersionInfoApi: set at pre-compile  # If true the PduR_GetVersionInfo API is available.
      boolean PduRZeroCostOperation: set at pre-compile  # If set the PduR configuration generator will report an error if zero-cost-operation cannot be fulfilled. | This parameter shall be seen as an input requirement to the configuration generator.
    container PduRRoutingTables: multiple-configuration-container=true  # Represents one table of routing paths. | This routing table allows multiple configurations that can be used to create several routing tables in the same configuration. This is mainly used for post-build (e.g. post-build selectable) but can be used by pre-compile and link-time for variant handling.
      integer PduRConfigurationId: 0..65535, set at pre-compile  # Identification of the configuration of the PduR configuration. This identification can be read using the PduR API.
      container PduRRoutingPathGroup [0..*]  # This container groups routing path destinations. Destinations are used instead of routing paths since a routing path can be 1:n. It is desirable to be able to enable/disable a specific bus (i.e. a destination) rather than a routing path. Of course it is possible to create groups that covers specific routing paths as well. | Enabling and disabling of routing path groups are made using the PduR API
        boolean PduRIsEnabledAtInit: set at pre-compile  # If set to true this routing path group will be enabled after initializing the PDU Router module (i.e. enabled in the PduR_Init function).
        integer PduRRoutingPathGroupId: 0..65535, set at post-build in variant post-build / pre-compile in variant pre-compile, symbolic-name-value=true  # Identification of the routing group. | The identification will be used by the disable/enable API in the PDU Router module API.
        reference PduRDestPduRef [1..*]: set at post-build in variant post-build / pre-compile in variant pre-compile, destination=PduRDestPdu  # This reference selects one destination of the routing path.
      container PduRRoutingTable [0..*]  # Represents one container of routing paths. Each container is either minimum routing or not.
        boolean PduRIsMinimumRouting: set at pre-compile  # Specifies if the container contains routing paths that are of the type minimum routing or not.
        container PduRRoutingPath [0..*]  # This container is a subcontainer of PduRRoutingTable and specifies the routing path of a PDU.
          container PduRDestPdu [1..*]  # This container is a subcontainer of PduRRoutingPath and specifies one destination for the PDU to be routed.
            enumeration PduRDestPduDataProvision [0..1]: {PDUR_DIRECT, PDUR_TRIGGERTRANSMIT}, set at post-build in variant post-build / pre-compile in variant pre-compile  # Specifies how data are provided: direct (as part of the Transmit call) or via the TriggerTransmit callback function. Only required for non-TP I-PDUs (local and gatewayed).
            integer PduRDestPduHandleId [0..1]: 0..65535, set at post-build in variant post-build / pre-compile in variant pre-compile, symbolic-name-value=true  # PDU identifier assigned by PDU Router. Used by communication interface and transport protocol modules for confirmation.
            integer PduRTpThreshold [0..1]: 1..65535, set at pre-compile  # Defines the number of bytes which shall be received before transmission on the destination bus may start. Only required for routing-on-the-fly TP gateway PDUs. The threshold shall not be larger than the length of the related TP Buffer.
            boolean PduRTransmissionConfirmation [0..1]: set at pre-compile  # This parameter is only for communication interfaces. Transport protocol modules will always call the TxConfirmation function. | If set the destination communication interface module will call the TxConfirmation. However the TxConfirmation may be not called due to error. So the PduR shall not block until the TxConfirmation is called. One background for this parameter is for the PduR to know when all modules have confirmed a multicast operation.
            reference PduRDestPduRef: set at post-build in variant post-build / pre-compile in variant pre-compile, destination=Pdu  # Destination PDU reference; reference to unique PDU identifier which shall be used by the PDU Router instead of the source PDU ID when calling the related function of the destination module.
            reference PduRDestTxBufferRef [0..1]: set at post-build in variant post-build / pre-compile in variant pre-compile, destination=PduRTxBuffer  # Reference to a buffer that is allocated in the PduRTxBuffer. Having a global (for PduR) list of buffers allows reusage and hence less memory consumption.
            container PduRDefaultValue [0..1]  # Specifies the default value of the I-PDU. Only required for gateway operation and if at least one PDU specified by PduRDestPdu uses TriggerTransmit Data provision. | Represented as an array of IntegerParamDef.
              container PduRDefaultValueElement [0..*]  # Each value element is represented by the element and the position in an array.
                integer PduRDefaultValueElement: 0..255, set at post-build in variant post-build / pre-compile in variant pre-compile  # The default value consists of a number of elements. Each element is one byte long and the number of elements is specified by SduLength. The position of this parameter in the container is specified by the PduRElementBytePosition parameter.
                integer PduRDefaultValueElementBytePosition: 0..255, set at post-build in variant post-build / pre-compile in variant pre-compile  # This parameter specifies the byte position of the element within the default value
          container PduRSrcPdu  # This container is a subcontainer of PduRRoutingPath and specifies the source of the PDU to be routed.
            integer PduRSourcePduHandleId: 0..65535, set at post-build in variant post-build / pre-compile in variant pre-compile, symbolic-name-value=true  # PDU identifier assigned by PDU Router.
            reference PduRSrcPduRef: set at post-build in variant post-build / pre-compile in variant pre-compile, destination=Pdu  # Source PDU reference; reference to unique PDU identifier which shall be used for the requested PDU Router operation.
      container PduRTpBufferTable [0..1]  # This container will specify the needed buffers for gatewaying using TP. It is not connected to the specific routing path destination to allow a more efficient buffer handling.
        integer PduRMaxTpBufferNumber: 0..65535, set at pre-compile  # maximum number of TP buffers.
        container PduRTpBuffer [0..*]  # Specifies a buffer used for gatwaying through TP.
          integer PduRTpBufferLength: 1..65535, set at pre-compile  # Length of the TP buffer in number of bytes
      container PduRTxBufferTable [0..1]  # This container will specify the needed buffers for gatewaying using communication interface. It not defined per routing path to allow reusage of buffers.
        integer PduRMaxTxBufferNumber: 0..65535, set at pre-compile  # maximum number of Tx buffers.
        container PduRTxBuffer [0..*]  # Specifies a buffer used for gatwaying through communication interface.
          integer PduRPduMaxLength: 1..255, set at pre-compile  # Length of the Tx buffer in number of bytes.
          integer PduRTxBufferDepth: 1..255, set at pre-compile  # Number of Pdus that can be stored in the buffer. If value is 1 then the buffer semantic is "last is best". If the value is greater then 1 then the buffer semnatic is a FiFo.
  module definition Port [0..1]: variants post-build/pre-compile  # Configuration of the Port module.
    container PortConfigSet: multiple-configuration-container=true  # This container is the base of a multiple configuration set
      container PortContainer [1..*]  # Container collecting the PortPins.
        integer PortNumberOfPortPins: 1..65535, set at pre-compile  # The number of specified PortPins in this PortContainer.
        container PortPin [1..*]  # Configuration of the individual port pins.
          enumeration PortPinDirection: {PORT_PIN_IN, PORT_PIN_OUT}, set at post-build in variant post-build / pre-compile in variant pre-compile  # The initial direction of the pin (IN or OUT). If the direction is not changeable, the value configured here is fixed. | The direction must match the pin mode. E.g. a pin used for an ADC must be configured to be an in port. Implementation Type: Port_PinDirectionType
          boolean PortPinDirectionChangeable: set at post-build in variant post-build / pre-compile in variant pre-compile  # Parameter to indicate if the direction is changeable on a port pin during runtime. | true: Port Pin direction changeable enabled. false: Port Pin direction changeable disabled.
          integer PortPinId: 1..65535, set at pre-compile, symbolic-name-value=true  # Pin Id of the port pin. This value will be assigned to the symbolic name derived from the port pin container short name.
          enumeration PortPinInitialMode: {PORT_PIN_MODE_ADC, PORT_PIN_MODE_CAN, PORT_PIN_MODE_DIO, PORT_PIN_MODE_DIO_GPT, PORT_PIN_MODE_DIO_WDG, PORT_PIN_MODE_FLEXRAY, PORT_PIN_MODE_ICU, PORT_PIN_MODE_LIN, PORT_PIN_MODE_MEM, PORT_PIN_MODE_PWM, PORT_PIN_MODE_SPI}, set at post-build in variant post-build / pre-compile in variant pre-compile  # Port pin mode from mode list for use with Port_Init() function.
          enumeration PortPinLevelValue: {PORT_PIN_LEVEL_HIGH, PORT_PIN_LEVEL_LOW}, set at post-build in variant post-build / pre-compile in variant pre-compile  # Port Pin Level value from Port pin list.
          enumeration PortPinMode [1..*]: {PORT_PIN_MODE_ADC, PORT_PIN_MODE_CAN, PORT_PIN_MODE_DIO, PORT_PIN_MODE_DIO_GPT, PORT_PIN_MODE_DIO_WDG, PORT_PIN_MODE_FLEXRAY, PORT_PIN_MODE_ICU, PORT_PIN_MODE_LIN, PORT_PIN_MODE_MEM, PORT_PIN_MODE_PWM, PORT_PIN_MODE_SPI}, set at post-build in variant post-build / pre-compile in variant pre-compile  # Port pin mode from mode list. | Note that more than one mode is allowed by default. That way it is e.g. possible to combine DIO with another mode such as ICU.
          boolean PortPinModeChangeable: set at post-build in variant post-build / pre-compile in variant pre-compile  # Parameter to indicate if the mode is changeable on a port pin during runtime. True: Port Pin mode changeable allowed. False: Port Pin mode changeable not permitted.
    container PortGeneral  # Module wide configuration parameters of the PORT driver.
      boolean PortDevErrorDetect: set at pre-compile  # Switches the Development Error Detection and Notification on or off. | true: Enabled. false: Disabled.
      boolean PortSetPinDirectionApi: set at pre-compile  # Pre-processor switch to enable / disable the use of the function Port_SetPinDirection(). | TRUE: Enabled - Function Port_SetPinDirection() is available. FALSE: Disabled - Function Port_SetPinDirection() is not available.
      boolean PortSetPinModeApi: set at pre-compile  # Pre-processor switch to enable / disable the use of the function Port_SetPinMode(). | true: Enabled - Function Port_SetPinMode() is available. false: Disabled - Function Port_SetPinMode() is not available.
      boolean PortVersionInfoApi: set at pre-compile  # Pre-processor switch to enable / disable the API to read out the modules version information. | true: Version info API enabled. false: Version info API disabled.
  module definition Pwm [0..*]: variants post-build/pre-compile  # Configuration of Pwm (Pulse Width Modulation) module.
    container PwmChannelConfigSet: multiple-configuration-container=true  # Multiple Configuration Set Container
      container PwmChannel [1..*]  # Configuration of an individual PWM channel.
        enumeration PwmChannelClass [0..1]: {PWM_FIXED_PERIOD, PWM_FIXED_PERIOD_SHIFTED, PWM_VARIABLE_PERIOD}, set at post-build in variant post-build / pre-compile in variant pre-compile  # Class of PWM Channel. | ImplementationType: Pwm_ChannelClassType
        integer PwmChannelId: 0..4294967295, set at pre-compile, symbolic-name-value=true  # Channel Id of the PWM channel. This value will be assigned to the symbolic name derived of the PwmChannel container short name.
        integer PwmDutycycleDefault: 0..32768, set at post-build in variant post-build / pre-compile in variant pre-compile  # Value of duty cycle used for Initialization | 0, represents 0% 0x8000 represents 100%
        enumeration PwmIdleState: {PWM_HIGH, PWM_LOW}, set at post-build in variant post-build / pre-compile in variant pre-compile  # The parameter PWM_IDLE_STATE represents the output state of the PWM after the signal is stopped (e.g. call of Pwm_SetOutputToIdle).
        function name PwmNotification [0..1]: set at post-build in variant post-build / pre-compile in variant pre-compile, default-value="NULL"  # Definition of the Callback function.
        float PwmPeriodDefault: 0..Inf, set at post-build in variant post-build / pre-compile in variant pre-compile  # Value of period used for Initialization.(in seconds).
        enumeration PwmPolarity: {PWM_HIGH, PWM_LOW}, set at post-build in variant post-build / pre-compile in variant pre-compile  # Defines the starting polarity of each PWM channel.
    container PwmConfigurationOfOptApiServices
      boolean PwmDeInitApi: set at pre-compile  # Adds / removes the service Pwm_DeInit() from the code.
      boolean PwmGetOutputState: set at pre-compile
      boolean PwmSetDutyCycle: set at pre-compile
      boolean PwmSetOutputToIdle: set at pre-compile
      boolean PwmSetPeriodAndDuty: set at pre-compile
      boolean PwmVersionInfoApi: set at pre-compile  # Switch to indicate that the Pwm_ GetVersionInfo is supported
    container PwmGeneral
      boolean PwmDevErorDetect: set at pre-compile  # Switch for enabling the development error detection.
      boolean PwmDutycycleUpdatedEndperiod: set at pre-compile  # Switch for enabling the update of the duty cycle parameter at the end of the current period. | TRUE: update of duty cycle is done at the end of period of currently generated waveform (current waveform is finished). FALSE: update of duty cycle is done immediately (just after service call, current waveform is cut).
      integer PwmIndex: 0..4294967295, set at pre-compile  # Specifies the InstanceId of this module instance. If only one instance is present it shall have the Id 0.
      boolean PwmNotificationSupported: set at pre-compile  # Switch to indicate that the notifications are supported
      boolean PwmPeriodUpdatedEndperiod: set at pre-compile  # Switch for enabling the update of the period parameter at the end of the current period. | TRUE: update of period/duty cycle is done at the end of period of currently generated waveform (current waveform is finished). FALSE: update of period/duty cycle is done immediately (just after service call, current waveform is cut).
  module definition RamTst [0..1]: variants link-time/pre-compile  # Configuration of the RamTst module.
    container RamTstCommon  # This container holds a list of all available functions in the RamTst module. Each function is turned ON or OFF before compiling so that only the desired functions and test algorithms are in the compiled code.
      boolean RamTstAllowApi: set at pre-compile  # Preprocessor switch to disable / enable the function "RamTst_Allow".
      boolean RamTstChangeNumOfTestedCellsApi: set at pre-compile  # Preprocessor switch to disable / enable the function "RamTst_ChangeNumberOfTestedCells".
      boolean RamTstDevErrorDetect: set at pre-compile  # Preprocessor switch to select the development error tracer (DET) | ON or OFF
      boolean RamTstGetAlgParamsApi: set at pre-compile  # Preprocessor switch to disable / enable the function "RamTst_GetAlgParams".
      boolean RamTstGetExecutionStatusApi: set at pre-compile  # Preprocessor switch to disable / enable the function | "RamTst_GetExecutionStatus"
      boolean RamTstGetNumberOfTestedCellsApi: set at pre-compile  # Preprocessor switch to disable / enable the function "RamTst_GetNumberOfTestedCells".
      boolean RamTstGetTestAlgorithmApi: set at pre-compile  # Preprocessor switch to disable / enable the function | "RamTst_GetTestAlgorithm"
      boolean RamTstGetTestResultApi: set at pre-compile  # Preprocessor switch to disable / enable the function | "RamTst_GetTestResult"
      boolean RamTstGetTestResultPerBlockApi: set at pre-compile  # Preprocessor switch to disable / enable the function | "RamTst_GetTestResultPerBlock"
      boolean RamTstGetVersionInfoApi: set at pre-compile  # Preprocessor switch to disable / enable the function | "RamTst_GetVersionInfo"
      boolean RamTstResumeApi: set at pre-compile  # Preprocessor switch to disable / enable the function "RamTst_Resume".
      boolean RamTstRunFullTestApi: set at pre-compile  # Preprocessor switch to disable / enable the function | "RamTst_RunFullTest"
      boolean RamTstRunPartialTestApi: set at pre-compile  # Preprocessor switch to disable / enable the function | "RamTst_RunPartialTest"
      boolean RamTstSelectAlgParamsApi: set at pre-compile  # Preprocessor switch to disable / enable the function "RamTst_SelectAlgParams".
      boolean RamTstStopApi: set at pre-compile  # Preprocessor switch to disable / enable the function | "RamTst_Stop"
      boolean RamTstSuspendApi: set at pre-compile  # Preprocessor switch to disable / enable the function "RamTst_Suspend".
      container RamTstAlgorithms  # This container holds all of the available test algorithms for the specific microcontroller. Each test algorithm is selected ON or OFF before compiling so that only the desired test algorithms are in the compiled code.
        boolean RamTstAbrahamTestSelected: set at pre-compile  # Preprocessor switch to select the Abraham Test ON or OFF
        boolean RamTstCheckerboardTestSelected: set at pre-compile  # Preprocessor switch to select the Checkerboard Test ON or OFF
        boolean RamTstGalpatTestSelected: set at pre-compile  # Preprocessor switch to select the Galpat Test ON or OFF
        boolean RamTstMarchTestSelected: set at pre-compile  # Preprocessor switch to select the March Test ON or OFF
        boolean RamTstTranspGalpatTestSelected: set at pre-compile  # Preprocessor switch to select the Transparent Galpat Test ON or OFF
        boolean RamTstWalkPathTestSelected: set at pre-compile  # Preprocessor switch to select the Walking Path Test ON or OFF
      container RamTstConfigParams  # This container specifies configuration parameters which are set at pre-compile or link time.
        integer RamTstDefaultAlgParamsId: 1..255, set at link in variant link-time / pre-compile in variant pre-compile  # This is the identifier for the default "RamTstAlgParams" valid after the "RamTst_Init(..)" function. It is the initial value for a RAM variable which could be changed by the function "RamTst_SelectAlgParams".
        integer RamTstMinNumberOfTestedCells: 1..4294967295, set at link in variant link-time / pre-compile in variant pre-compile  # Minimum number of tested cells for one cyle of a background test, as defined by implementer.
        integer RamTstNumberOfAlgParamSets: 1..255, set at link in variant link-time / pre-compile in variant pre-compile  # Number of configured parameter sets for the available test algorithms. | calculationFormula = count of the container RamTst_AlgParams
        function name RamTstTestCompletedNotification: set at link in variant link-time / pre-compile in variant pre-compile  # This function will be called from abackground test after finishing the RAM test without an error.
        function name RamTstTestErrorNotification: set at link in variant link-time / pre-compile in variant pre-compile  # This function will be called from a background test if an error occurs during the RAM test.
        container RamTstAlgParams [1..255]  # This container holds parameters for configuring an algorithm. For each algorithm selected in the RamTst_Algorithms container there can be one or more RamTstAlgParams containers. The multiplicity of the included container RamTstBlockParams depends on the number of separate blocks of RAM which are defined for the particular test configuration.
          integer RamTstAlgParamsId: 1..255, set at link in variant link-time / pre-compile in variant pre-compile  # This is the identifier by which this RamTstAlgParams set can be selected.
          enumeration RamTstAlgorithm: {RAMTST_ABRAHAM_TEST, RAMTST_CHECKERBOARD_TEST, RAMTST_GALPAT_TEST, RAMTST_MARCH_TEST, RAMTST_TRANSP_GALPAT_TEST, RAMTST_WALK_PATH_TEST}, set at link in variant link-time / pre-compile in variant pre-compile  # This is the algorithm for which this RamTstAlgParams set is defined. Note that the same algorithm can be used in more than one RamTstAlgParams. | Constraint: Only the algorithms selected by RamTstCommon/ RamTstAlgorithms can be used.
          integer RamTstExtNumberOfTestedCells: 1..4294967295, set at link in variant link-time / pre-compile in variant pre-compile  # This is the absolute maximum value for the number of cells that NUMBER_OF_TESTED_CELLS and MAX_NUMBER_OF_TESTED_CELLS can be.
          integer RamTstMaxNumberOfTestedCells: 1..4294967295, set at link in variant link-time / pre-compile in variant pre-compile  # This is the maximum value for the number of cells that can be tested in one cycle of a background test.
          integer RamTstNumberOfBlocks: 1..65535, set at link in variant link-time / pre-compile in variant pre-compile  # Number of RAM blocks configured using the container | "RamTst_BlockParams" calculationFormula = Count of RamTstBlockParams contained in this RamTstAlgParams.
          integer RamTstNumberOfTestedCells: 1..4294967295, set at link in variant link-time / pre-compile in variant pre-compile  # This is the initial value for a RAM variable, which can be changed by the function "RamTst_ChangeNumberOfTestedCells"
          container RamTstBlockParams [1..65535]  # This container holds the description for one block of RAM. For each RAM block to be tested by a given algorithm, there is one container which describes the block. Multiple instances of this container are included in each container RamTst_AlgParams.
            integer RamTstBlockId: 1..65535, set at link in variant link-time / pre-compile in variant pre-compile  # ID of the RAM block
            integer RamTstEndAddress: 1..4294967295, set at link in variant link-time / pre-compile in variant pre-compile  # End Address of the RAM block. | Constraint: It must be larger than the RamTstStartAddress.
            integer RamTstFillPattern: 0..4294967295, set at link in variant link-time / pre-compile in variant pre-compile  # Pattern to be filled into each memory cell after destructive test of this block.
            integer RamTstStartAddress: 0..4294967295, set at link in variant link-time / pre-compile in variant pre-compile  # Start Address of the RAM block. | Constraint: It must be smaller than the RamTstEndAddress.
            enumeration RamTstTestPolicy: {RAMTEST_DESTRUCTIVE, RAMTEST_NON_DESTRUCTIVE}, set at link in variant link-time / pre-compile in variant pre-compile  # Policy regading destruction or non-destruction of memory content.
    container RamTstDemEventParameterRefs [0..1]  # Container for the references to DemEventParameter elements which shall be invoked using the API Dem_ReportErrorStatus in case the corresponding error occurs. The EventId is taken from the referenced DemEventParameter's DemEventId value. | The standardized errors are provided in the container and can be extended by vendor-specific error references.
      symbolic name reference RAMTST_E_RAM_FAILURE [0..1]: set at pre-compile, destination=DemEventParameter  # Reference to the DemEventParameter which shall be issued when the error "RAM failure" has occurred.
    container RamTstPublishedInformation  # Container holding all RamTst specific published information parameter.
      integer RamTstCellSize: 1..64, set at published-information  # Size of RAM cells (in bits) which can be tested individually by the given implementation.
  module definition Rte [0..1]: variants post-build/pre-compile  # Configuration of the Rte (Runtime Environment) module.
    container RteBswGeneral  # General configuration parameters of the Bsw Scheduler section.
      boolean RteSchMVersionInfoApi: set at pre-compile  # Enables the generation of the SchM_GetVersionInfo() API.
      boolean RteUseComShadowSignalApi: set at pre-compile, default-value=false  # This parameter defines whether the ComShadowSignalAPIs ((Com_UpdateShadowSignal, Com_InvalidateShadowSignal, Com_ReceiveShadowSignal) are used or not. | If this parameter is set to true the ShadowSignal APIs and Signal APIs (Com_SendSignal, Com_InvalidateSignal, Com_ReceiveSignal) are used. If this parameter is set to false only the Signal APIs (Com_SendSignal, Com_InvalidateSignal, Com_ReceiveSignal) are used.
    container RteBswModuleInstance [0..*]  # Represents one instance of a Bsw-Module configured on one ECU.
      foreign reference RteBswImplementationRef: set at pre-compile, destination-type=BSW-IMPLEMENTATION  # Reference to the BswImplementation for which the Rte /SchM is configured.
      foreign reference RteBswModuleConfigurationRef [0..1]: set at pre-compile, destination-type=MODULE-CONFIGURATION  # Reference to the ECU Configuration Values provided for this BswImplementation.
      container RteBswEventToTaskMapping [0..*]  # Maps a BswSchedulableEntity onto one OsTask based on the activating BswEvent.
        float RteBswActivationOffset [0..1]: 0..Inf, set at pre-compile  # Activation offset in seconds.
        boolean RteBswImmediateRestart: set at pre-compile, default-value=false  # When RteBswImmediateRestart is set to true the BswSchedulableEntitiy shall be immediately re-started after termination if it was activated by this BswEvent while it was already started. | This parameter shall not be set to true when the mapped BswEvent refers to a BswSchedulableEntitiy which minimumStartInterval attribute is > 0.
        integer RteBswPositionInTask [0..1]: 0..65535, set at pre-compile  # Each BswSchedulableEntity activation mapped to an OsTask has a specific position within the task execution. | For periodic activation this is the order of execution. For event driver activation this is the order of evaluation which actual BswSchedulableEntity has to be executed.
        enumeration RteOsSchedulePoint [0..1]: {CONDITIONAL, NONE, UNCONDITIONAL}, set at pre-compile  # Introduce a schedule point by explicitly calling Os Schedule service after the execution of the ExecutableEntity. The Rte generator is allowed to optimize several consecutive calls to Os schedule into one single call if the ExecutableEntity executions in between have been skipped. | The absence of this parameter is interpreted as "NONE". It shall be considered an invalid configuration if the task is preemptable and the value of this parameter is not set to "NONE" or the parameter is absent.
        foreign reference RteBswEventRef: set at pre-compile, destination-type=BSW-EVENT  # Reference to the BswEvent which is pointing to the BswSchedulableEntity being mapped. This allows a fine grained mapping of BswSchedulableEntites based on the activating BswEvent.
        reference RteBswMappedToTaskRef [0..1]: set at pre-compile, destination=OsTask  # Reference to the OsTask the BswSchedulableEntity activated by the RteBswEventRef is mapped to. | If no reference to the OsTask is specified the BswSchedulableEntity activated by this BswEvent is executed in the context of the caller.
        reference RteBswUsedOsAlarmRef [0..1]: set at pre-compile, destination=OsAlarm  # If an OsAlarm is used to activate the OsTask this BswEvent is mapped to it shall be referenced here.
        reference RteBswUsedOsEventRef [0..1]: set at pre-compile, destination=OsEvent  # If an OsEvent is used to activate the OsTask this BswEvent is mapped to it shall be referenced here.
        reference RteBswUsedOsSchTblExpiryPointRef [0..1]: set at pre-compile, destination=OsScheduleTableExpiryPoint  # If an OsScheduleTableExpiryPoint is used to activate the OsTask this BswEvent is mapped to it shall be referenced here.
      container RteBswExclusiveAreaImpl [0..*]  # Represents one ExclusiveArea of one BswImplementation. Used to specify the implementation means of this ExclusiveArea.
        enumeration RteExclusiveAreaImplMechanism: {ALL_INTERRUPT_BLOCKING, COOPERATIVE_RUNNABLE_PLACEMENT, OS_INTERRUPT_BLOCKING, OS_RESOURCE}, set at pre-compile  # To be used implementation mechanism for the specified ExclusiveArea.
        foreign reference RteBswExclusiveAreaRef: set at pre-compile, destination-type=EXCLUSIVE-AREA  # Reference to the ExclusiveArea for which the implementation mechanism shall be specified.
        reference RteBswExclusiveAreaOsResourceRef [0..1]: set at pre-compile, destination=OsResource  # Optional reference to an OsResource in case RteExclusiveAreaImplMechanism is configured to OS_RESOURCE for this ExclusiveArea.
      container RteBswExternalTriggerConfig [0..*]  # Defines the configuration of Inter Basic Software Module Entity Triggering
        integer RteBswTriggerSourceQueueLength: 0..4294967295, set at pre-compile, default-value=0  # Length of trigger queue on the trigger source side. | The queue is implemented by the RTE. A value greater or equal to 1 requests an queued behavior. Setting the value of RteTriggerSourceQueueLength to 0 requests an none queued implementation of the trigger communication. If there is no RteBswTriggerSourceQueueLength configured for a Trigger Emitter the default value of 0 applies as well.
        foreign reference RteBswTriggerSourceRef: set at pre-compile, destination-type=TRIGGER  # Reference to a Trigger instance in the role releasedTrigger of the related BSW Module instance. | The referenced Trigger has to belong to the same BSW Module instance as the RteBswModuleInstance owning this parameter configures.
      container RteBswInternalTriggerConfig [0..*]  # Defines the configuration of internal Basic Software Module Entity Triggering
        integer RteBswTriggerSourceQueueLength: 0..4294967295, set at pre-compile, default-value=0  # Length of trigger queue on the trigger source side. | The queue is implemented by the RTE. A value greater or equal to 1 requests an queued behavior. Setting the value of RteTriggerSourceQueueLength to 0 requests an none queued implementation of the trigger communication. If there is no RteBswTriggerSourceQueueLength configured for a Trigger Emitter the default value of 0 applies as well.
        foreign reference RteBswTriggerSourceRef: set at pre-compile, destination-type=BSW-INTERNAL-TRIGGERING-POINT  # Reference to a BswInternalTriggeringPoint of the related BSW Module instance. | The referenced BswInternalTriggeringPoint has to belong to the same BSW Module instance as the RteBswModuleInstance owning this parameter configures.
      container RteBswRequiredModeGroupConnection [0..*]  # Defines the connection between one requiredModeGroup of this BSW Module instance and one providedModeGroup instance.
        foreign reference RteBswProvidedModeGroupRef: set at pre-compile, destination-type=MODE-DECLARATION-GROUP-PROTOTYPE  # References the providedModeGroupPrototype to which this requiredModeGroup shall be connected.
        foreign reference RteBswRequiredModeGroupRef: set at pre-compile, destination-type=MODE-DECLARATION-GROUP-PROTOTYPE  # References requiredModeGroupPrototype which shall be connected to the providedModeGroupPrototype.
        reference RteBswProvidedModeGrpModInstRef: set at pre-compile, destination=RteBswModuleInstance  # Reference to the RteBswModuleInstance configuration container which identifies the instance of the BSW Module. | Used with the RteBswProvidedModeGroupRef to unambiguously identify the ModeDeclarationGroupPrototype instance.
      container RteBswRequiredTriggerConnection [0..*]  # Defines the connection between one requiredTrigger of this BSW Module instance and one releasedTrigger instance.
        foreign reference RteBswReleasedTriggerRef: set at pre-compile, destination-type=TRIGGER  # References the releasedTrigger to which this requiredTrigger shall be connected.
        foreign reference RteBswRequiredTriggerRef: set at pre-compile, destination-type=TRIGGER  # References one requiredTrigger which shall be connected to the releasedTrigger.
        reference RteBswReleasedTriggerModInstRef: set at pre-compile, destination=RteBswModuleInstance  # Reference to the RteBswModuleInstance configuration container which identifies the instance of the BSW Module. | Used with the RteBswReleasedTriggerRef to unambiguously identify the Trigger instance.
    container RteGeneration  # This container holds the parameters for the configuration of the RTE Generation.
      enumeration RteCalibrationSupport: {DOUBLE_POINTERED, INITIALIZED_RAM, NONE, SINGLE_POINTERED}, set at pre-compile, default-value=NONE  # The RTE generator shall have the option to switch off support for calibration for generated RTE code. This option shall influence complete RTE code at once.
      integer RteCodeVendorId: 0..65535, set at pre-compile  # Holds the vendor ID of the generated Rte code.
      boolean RteDevErrorDetect: set at pre-compile, default-value=false  # The Rte shall log development errors to the Det module.
      boolean RteDevErrorDetectUninit: set at pre-compile, default-value=false  # The Rte shall detect if it is started when its APIs are called, and the BSW Scheduler shall check if it is initialized when its APIs are called.
      enumeration RteGenerationMode: {COMPATIBILITY_MODE, VENDOR_MODE}, set at pre-compile, default-value=COMPATIBILITY_MODE  # Switch between the two available generation modes of the RTE generator.
      enumeration RteIocInteractionReturnValue: {RTE_COM, RTE_IOC}, set at pre-compile, default-value=RTE_IOC  # Defines whether the return value of RTE APIs is based on RTE-IOC interaction or RTE-COM interaction.
      boolean RteMeasurementSupport: set at pre-compile, default-value=false  # The RTE generator shall have the option to switch off support for measurement for generated RTE code. This option shall influence complete RTE code at once.
      enumeration RteOptimizationMode: {MEMORY, RUNTIME}, set at pre-compile, default-value=RUNTIME  # Switch between the two available optimization modes of the RTE generator.
      integer RteToolChainSignificantCharacters [0..1]: 0..65535, set at pre-compile, default-value=31  # If present, the RTE generator shall provide the list of C RTE identifiers whose name is not unique when only the first RteToolChainSignificantCharacters characters are considered.
      boolean RteValueRangeCheckEnabled: set at pre-compile, default-value=false  # If set to true the RTE generator shall enable the value range checking for the specified VariableDataPrototypes.
      linker symbol RteVfbTraceClientPrefix [0..*]: set at pre-compile  # Defines an additional prefix for all VFB trace functions to be generated. With this approach it is possible to have debugging and DLT trace functions at the same time.
      boolean RteVfbTraceEnabled: set at pre-compile, default-value=false  # The RTE generator shall globally enable VFB tracing when RteVfbTrace is set to "true".
      function name RteVfbTraceFunction [0..*]: set at pre-compile  # The RTE generator shall enable VFB tracing for a given hook function when there is a #define in the RTE configuration header file for the hook function name and tracing is globally enabled. | Example: #define Rte_WriteHook_i1_p1_a_Start This also applies to VFB trace functions with a RteVfbTraceClientPrefix, e.g. Rte_Dbg_WriteHook_I1_P1_a_Start.
    container RteImplicitCommunication [0..*]  # Configuration of the Implicit Communication behavior to be generated.
      boolean RteCoherentAccess: set at pre-compile, default-value=false  # If set to true the referenced VariableAccess'es of this RteImplicitCommunication container are in one CoherencyGroup. | Data values for Coherent Implicit Read Access'es are read before the first reading RunnbaleEntity starts and are stable during the execution of all the reading RunnableEntitys; except Coherent Implicit Write Access'es belongs to the same Coherency Group. Data values written by Coherent Implicit Write Access'es are available for readers not belonging to the Coherency Group after the last writing RunnableEntity has terminated. Please note that a Coherent Implicit Data Access can be defined for VariableAccess'es to same and different VariableDataElements. Nevertheless all Coherent Implicit Data Access'es of one Coherency Group have to be executed in the same task.
      boolean RteImmediateBufferUpdate: set at pre-compile, default-value=false  # If set to true the RTE will perform preemption area specific buffer update immediately before (for VariableAccess in the role dataReadAccess) resp. after (for VariableAccess in the role dataWriteAccess) Runnable execution.
      foreign reference RteVariableReadAccessRef [0..*]: set at pre-compile, destination-type=VARIABLE-ACCESS  # Reference to the VariableAccess in the dataReadAccess role.
      foreign reference RteVariableWriteAccessRef [0..*]: set at pre-compile, destination-type=VARIABLE-ACCESS  # Reference to the VariableAccess in the dataWriteAccess role.
      instance reference RteSoftwareComponentInstanceRef [1..*]: set at pre-compile, destination-context=ROOT-SW-COMPOSITION-PROTOTYPE, destination-type=SW-COMPONENT-PROTOTYPE  # Reference to a SwComponentPrototype. | This denotes the instances of the VariableAccess belonging to the RteImplicitCommunication.
    container RteInitializationBehavior [1..*]  # Specifies the initialization strategy for variables allocated by RTE with the purpose to implement VariableDataPrototypes. | The container defines a set of RteSectionInitializationPolicys and one RteInitializationStrategy which is applicable for this set.
      enumeration RteInitializationStrategy: {RTE_INITIALIZATION_STRATEGY_AT_DATA_DECLARATION, RTE_INITIALIZATION_STRATEGY_AT_DATA_DECLARATION_AND_PARTITION_RESTART, RTE_INITIALIZATION_STRATEGY_AT_RTE_START_AND_PARTITION_RESTART, RTE_INITIALIZATION_STRATEGY_NONE}, set at pre-compile  # Definition of the initialization strategy applicable for the SectionInitializationPolicys selected by RteSectionInitializationPolicy.
      string RteSectionInitializationPolicy [1..*]: set at pre-compile  # This parameter describes the SectionInitializationPolicys for which a particular RTE initialization strategy applies. | The SectionInitializationPolicy describes the intended initialization of MemorySections. The following values are standardized in AUTOSAR Methodology: * '''NO-INIT''': No initialization and no clearing is performed. Such data elements must not be read before one has written a value into it. * '''INIT''': To be used for data that are initialized by every reset to the specified value (initValue). * '''POWER-ON-INIT''': To be used for data that are initialized by "Power On" to the specified value (initValue). Note: there might be several resets between power on resets. * '''CLEARED''': To be used for data that are initialized by every reset to zero. * '''POWER-ON-CLEARED''': To be used for data that are initialized by "Power On" to zero. Note: there might be several resets between power on resets.
    container RteOsInteraction [1..*]  # Interaction of the Rte with the Os.
      container RteModeToScheduleTableMapping [0..*]  # Provides configuration input in which Modes of a ModeDeclarionGroupPrototype of a Mode Manager a OsScheudleTable shall be active. | The Mode Manager is either specified as a SwComponentPrototype (RteModeSchtblMapSwc) or as a BSW-Module (RteModeSchtblMapBsw).
        foreign reference RteModeSchtblMapModeDeclarationRef [1..*]: set at pre-compile, destination-type=MODE-DECLARATION  # Reference to the ModeDeclarations.
        reference RteModeScheduleTableRef: set at pre-compile, destination=OsScheduleTable  # Reference to the OsScheduleTable which shall be active in the specified RteModeSchblMapModeDeclarationRefs.
        container RteModeSchtblMapBsw [0..1]  # Specifies an instance of a ModeDeclarationGroupPrototype of a Bsw-Module.
          foreign reference RteModeSchtblMapBswProvidedModeGroupRef: set at pre-compile, destination-type=MODE-DECLARATION-GROUP-PROTOTYPE  # Reference to an instance of a ModeDeclarationGroupPrototype of a Bsw-Module.
          reference RteModeSchtblMapBswInstanceRef: set at pre-compile, destination=RteBswModuleInstance  # Reference to an instance specification of a Bsw-Module.
        container RteModeSchtblMapSwc [0..1]  # Specifies an instance of a ModeDeclarationGroupPrototype of a SwComponentPrototype.
          foreign reference RteModeSchtblMapSwcPortRef: set at pre-compile, destination-type=P-PORT-PROTOTYPE  # Reference to the PPortPrototype of a SwComponentPrototype.
          reference RteModeSchtblMapSwcInstanceRef: set at pre-compile, destination=RteSwComponentInstance  # Reference to an instance specification of a SwComponentPrototype.
      container RteUsedOsActivation [0..*]  # Attributes used in the activation of OsTasks and Runnable Entities.
        float RteExpectedActivationOffset: 0..Inf, set at pre-compile  # Activation offset in seconds. | Important: This is a requirement from the Rte towards the Os/Mcu setup. The Rte Generator shall assume this activation offset to be fulfilled.
        float RteExpectedTickDuration: 0..Inf, set at pre-compile  # The expected tick duration in seconds which shall be configured to drive the OsScheduleTables or OsAlarm. | Important: This is a requirement from the Rte towards the Os/Mcu setup. The Rte Generator shall assume this tick duration to be fulfilled.
        reference RteActivationOsAlarmRef [0..1]: set at pre-compile, destination=OsAlarm  # Reference to an OsAlarm.
        reference RteActivationOsSchTblRef [0..1]: set at pre-compile, destination=OsScheduleTable  # Reference to an OsScheduleTable.
        reference RteActivationOsTaskRef [0..1]: set at pre-compile, destination=OsTask  # Reference to an OsTask.
    container RtePostBuildVariantConfiguration: multiple-configuration-container=true  # Specifies the PostbuildVariantSets for each of the PostBuild configurations of the RTE. | The shortName of this container defines the name of the RtePostBuildVariant.
      foreign reference RtePostBuildUsedPredefinedVariant [1..*]: set at pre-compile, destination-type=PREDEFINED-VARIANT  # Reference to the PredefinedVariant element which defines the values for PostBuildVariationCriterion elements.
    container RteSwComponentInstance [0..*]  # Representation of one SwComponentPrototype located on the to be configured ECU. All subcontainer configuration aspects are in relation to this SwComponentPrototype. | The RteSwComponentInstance can be associated with either a AtomicSwComponentType or ParameterSwComponentType.
      foreign reference RteSoftwareComponentInstanceRef [0..1]: set at pre-compile, destination-type=SW-COMPONENT-PROTOTYPE  # Reference to a SwComponentPrototype.
      container RteEventToTaskMapping [0..*]  # Maps a RunnableEntity onto one OsTask based on the activating RTEEvent. | Even if a RunnableEntity shall be executed via a direct function call this RteEventToTaskMapping shall be specified, but no RteMappedToTask and RtePositionInTask elements given.
        float RteActivationOffset [0..1]: 0..Inf, set at pre-compile  # Activation offset in seconds.
        boolean RteImmediateRestart: set at pre-compile, default-value=false  # When RteImmediateRestart is set to true the RunnableEntitiy shall be immediately re-started after termination if it was activated by this RTEEvent while it was already started. | This parameter shall not be set to true when the mapped RTEEvent refers to a RunnableEntity which minimumStartInterval attribute is > 0.
        enumeration RteOsSchedulePoint [0..1]: {CONDITIONAL, NONE, UNCONDITIONAL}, set at pre-compile  # Introduce a schedule point by explicitly calling Os Schedule service after the execution of the ExecutableEntity. The Rte generator is allowed to optimize several consecutive calls to Os schedule into one single call if the ExecutableEntity executions in between have been skipped. | The absence of this parameter is interpreted as "NONE". It shall be considered an invalid configuration if the task is preemptable and the value of this parameter is not set to "NONE" or the parameter is absent.
        integer RtePositionInTask [0..1]: 0..65535, set at pre-compile  # Each RunnableEntity mapped to an OsTask has a specific position within the task execution. | For periodic activation this is the order of execution. For event driver activation this is the order of evaluation which actual RunnableEntity has to be executed.
        foreign reference RteEventRef: set at pre-compile, destination-type=RTE-EVENT  # Reference to the description of the RTEEvent which is pointing to the RunnableEntity being mapped. This allows a fine grained mapping of RunnableEntites based on the activating RTEEvent.
        reference RteMappedToTaskRef [0..1]: set at pre-compile, destination=OsTask  # Reference to the OsTask the RunnableEntity activated by the RteEventRef is mapped to. | If no reference to the OsTask is specified the RunnableEntity shall be executed via a direct function call.
        reference RteUsedOsAlarmRef [0..1]: set at pre-compile, destination=OsAlarm  # If an OsAlarm is used to activate the OsTask this RteEvent is mapped to it shall be referenced here.
        reference RteUsedOsEventRef [0..1]: set at pre-compile, destination=OsEvent  # If an OsEvent is used to activate the OsTask this RteEvent is mapped to it shall be referenced here.
        reference RteUsedOsSchTblExpiryPointRef [0..1]: set at pre-compile, destination=OsScheduleTableExpiryPoint  # If an OsScheduleTableExpiryPoint is used to activate the OsTask this RteEvent is mapped to it shall be referenced here.
        reference RteVirtuallyMappedToTaskRef [0..1]: set at pre-compile, destination=OsTask  # Optional reference to an OsTask where the activation of this RteEvent shall be evaluated. The actual execution of the Runnable Entity shall happen in the OsTask referenced by RteMappedToTaskRef.
      container RteExclusiveAreaImplementation [0..*]  # Specifies the implementation to be used for the data consistency of this ExclusiveArea.
        enumeration RteExclusiveAreaImplMechanism: {ALL_INTERRUPT_BLOCKING, COOPERATIVE_RUNNABLE_PLACEMENT, OS_INTERRUPT_BLOCKING, OS_RESOURCE}, set at pre-compile  # To be used implementation mechanism for the specified ExclusiveArea.
        foreign reference RteExclusiveAreaRef: set at pre-compile, destination-type=EXCLUSIVE-AREA  # Reference to the ExclusiveArea.
        reference RteExclusiveAreaOsResourceRef [0..1]: set at pre-compile, destination=OsResource  # Optional reference to an OsResource in case RteExclusiveAreaImplMechanism is configured to OS_RESOURCE for this ExclusiveArea.
      container RteExternalTriggerConfig [0..*]  # Defines the configuration of External Trigger Event Communication for Software Components
        integer RteTriggerSourceQueueLength: 0..4294967295, set at pre-compile, default-value=0  # Length of trigger queue on the trigger source side. | The queue is implemented by the RTE. A value greater or equal to 1 requests an queued behavior. Setting the value of RteTriggerSourceQueueLength to 0 requests an none queued implementation of the trigger communication. If there is no RteTriggerSourceQueueLength configured for a Trigger Emitter the default value of 0 applies as well.
        instance reference RteSwcTriggerSourceRef: set at pre-compile, destination-context=P-PORT-PROTOTYPE, destination-type=TRIGGER  # Reference to a Trigger instance in the pPortPrototype of the related component instance. | The referenced Trigger instance has to belong to the same software component instance as the RteSwComponentInstance owning this parameter configures.
      container RteInternalTriggerConfig [0..*]  # Defines the configuration of Inter Runnable Triggering for Software Components
        integer RteTriggerSourceQueueLength: 0..4294967295, set at pre-compile, default-value=0  # Length of trigger queue on the trigger source side. | The queue is implemented by the RTE. A value greater or equal to 1 requests an queued behavior. Setting the value of RteTriggerSourceQueueLength to 0 requests an none queued implementation of the trigger communication. If there is no RteTriggerSourceQueueLength configured for a Trigger Emitter the default value of 0 applies as well.
        foreign reference RteSwcTriggerSourceRef: set at pre-compile, destination-type=INTERNAL-TRIGGERING-POINT  # Reference to an InternalTriggeringPoint of the related component instance. | The referenced InternalTriggeringPoint has to belong to the same software component instance as the RteSwComponentInstance owning this parameter configures.
      container RteNvRamAllocation [0..*]  # Specifies the relationship between the AtomicSwComponentType's NVRAMMapping / NVRAM needs and the NvM module configuration.
        linker symbol RteNvmRamBlockLocationSymbol [0..1]: set at pre-compile  # This is the name of the linker object name where the NVRam Block will be mirrored by the Nvm. | This symbol will be resolved into the parameter "NvmRamBlockDataAddress" from the "NvmBlockDescriptor".
        linker symbol RteNvmRomBlockLocationSymbol [0..1]: set at pre-compile  # This is the name of the linker object name where the NVRom Block will be accessed by the Nvm. | This symbol will be resolved into the parameter "NvmRomBlockDataAddress" from the "NvmBlockDescriptor".
        foreign reference RteSwNvRamMappingRef: set at pre-compile, destination-type=SWC-SERVICE-DEPENDENCY  # Reference to the SwSeriveDependency which is used to specify the NvBlockNeeds.
        symbolic name reference RteNvmBlockRef: set at pre-compile, destination=NvMBlockDescriptor  # Reference to the used NvM block for storage of the NVRAMMapping information.
    container RteSwComponentType [0..*]  # Representation of one SwComponentType for the base of all configuration parameter which are affecting the whole type and not a specific instance.
      foreign reference RteComponentTypeRef: set at pre-compile, destination-type=SW-COMPONENT-TYPE  # Reference to either AtomicSwComponentType or ParameterSwComponentType.
      foreign reference RteImplementationRef [0..1]: set at pre-compile, destination-type=SWC-IMPLEMENTATION  # The Implementation which shall be assiged to the SwComponentType.
      container RteComponentTypeCalibration [0..1]  # Specifies for each ParameterSwComponentType or AtomicSwComponentType whether calibration is enabled. | If references to SwAddrMethod are provided in RteCalibrationSwAddrMethodRef only ParameterDataPrototypes with the referenced SwAddrMethod shall have software calibration support enabled.
        boolean RteCalibrationSupportEnabled: set at pre-compile  # Enables calibration support for the specified ParameterSwComponentType or AtomicSwComponentType.
        foreign reference RteCalibrationSwAddrMethodRef [0..*]: set at pre-compile, destination-type=SW-ADDR-METHOD  # Reference to the SwAddrMethod for which software calibration support shall be enabled.
  module definition SoAd [0..1]: variants link-time/post-build/pre-compile  # Configuration of the SoAd (Socket Adaptor) module.
    container SoAdDemEventParameterRefs [0..1]  # Container for the references to DemEventParameter elements which shall be invoked using the API Dem_ReportErrorStatus API in case the corresponding error occurs. The EventId is taken from the referenced DemEventParameter's DemEventId value. The standardized errors are provided in the container and can be extended by vendor specific error references.
      symbolic name reference SOAD_E_INTR [0..1]: set at pre-compile, destination=DemEventParameter  # Reference to the DemEventParameter which shall be issued when the error "Interrupted system call" has occured.
      symbolic name reference SOAD_E_IO [0..1]: set at pre-compile, destination=DemEventParameter  # Reference to the DemEventParameter which shall be issued when the error "Input/output error" has occured.
      symbolic name reference SOAD_E_UPPERBUFF [0..1]: set at pre-compile, destination=DemEventParameter  # Reference to the DemEventParameter which shall be issued when the error "No buffer available in upper layer" has occured.
    container SoAdDoIpConfig: multiple-configuration-container=true  # This container contains all global configuration parameters of the DoIP plug-in.
      float SoAdDoIpAliveCheckResponseTime: 0..Inf, set at pre-compile  # This parameter specifies the maximum time that a DoIP entity shall wait for an Alive Check Response after sending an Alive Check Request.
      float SoAdDoIpControlTimeout: 0..Inf, set at pre-compile  # This parameter specifies the maximum time that the test equipment waits for a response to a previously sent control command.
      float SoAdDoIpGenericInactiveTime: 0..Inf, set at pre-compile  # This parameter specifies the maximum time of inactivity on a TCP_DATA socket before it is closed.
      string SoAdDoIpHostNameOpt: set at post-build in variant post-build / pre-compile in variant link-time+pre-compile  # Defines the <manufacturer specific> part of the "host name option". | Note: WD ISO 13400 implicitly shows 3 parts to the Host Name Option: 1) It is required to start with "DoIP_" 2) There may be a static OEM specific part 3) There may be a dynamic vehicle specific part, e.g. VIN SoAdDoIpHostNameOpt contains parts 1) and 2) only.
      float SoAdDoIpInitialInactiveTime: 0..Inf, set at pre-compile  # This parameter specifies the maximum time of inactivity directly after a TCP_DATA socket was established. After the specified time without Routing Activation, the TCP_DATA socket is closed.
      float SoAdDoIpResponseTimeout: 0..Inf, set at pre-compile  # This parameter specifies the maximum time after which a DoIP information request must have been processed and the corresponding response must have been sent by the DoIP entity, otherwise the request or the response must be considered lost.
      float SoAdDoIpVidAnnounceInterval: 0..Inf, set at pre-compile  # This timing parameter specifies the time between the Vehicle Announcement Messages that are sent by DoIP entities after a valid IP address was configured.
      float SoAdDoIpVidAnnounceMaxWait: 0..Inf, set at pre-compile  # Describes the maximum time a DoIP entity shall wait before sending an Vehicle Identification Response.
      float SoAdDoIpVidAnnounceMinWait: 0..Inf, set at pre-compile  # Describes the minimum time a DoIP entity shall wait before sending an Vehicle Identification Response.
      integer SoAdDoIpVidAnnounceNum: 0..255, set at pre-compile  # Specifies the number of Vehicle Announcement messages, which the DoIP entity sends after a valid IP address has been configured.
      container SoAdDoIpEid  # A unique 6-byte DoIp Entity Identification (EID)
        container SoAdDoIpEidByte [6..6]  # One byte of the DoIp Entity Identification (EID).
          integer SoAdDoIpEidByteIndex: 0..5, set at link in variant link-time / post-build in variant post-build / pre-compile in variant pre-compile  # Index of the Eid byte array.
          integer SoAdDoIpEidByteValue: 0..255, set at link in variant link-time / post-build in variant post-build / pre-compile in variant pre-compile  # Byte Value at the SoAdDoIpEidByteIndex position in the Eid byte array.
    container SoAdDoIpRoute  # A SoAd_DoIP_Route allocates a PDU ID to a combination of a DoIP source and a DoIP target address.
      integer SoAdDoIpSourceAddress: 0..65535, set at link in variant link-time+post-build / pre-compile in variant pre-compile  # The logical DoIP address of the source entitiy.
      integer SoAdDoIpTargetAddress: 0..65535, set at link in variant link-time+post-build / pre-compile in variant pre-compile  # The logical DoIP address of the target entity.
      reference SoAdDoIpSocketConnectionRef: set at link in variant link-time+post-build / pre-compile in variant pre-compile, destination=SoAdSocketConnection  # Reference to the used socket connection.
    container SoAdGeneral  # This container contains all global configuration parameters of SoAd configured from the Pdu Router Module perspective.
      integer SoAdBufferMemorySize: 0..65535, set at pre-compile  # Memory size reserved for SoAd buffers.
      boolean SoAdCallbackApi: set at pre-compile  # True if the TCP/IP stack supports the AUTOSAR Call-back API in addition to the Berkeley Socket API. | TRUE: TCP/IP Stack supports AUTOSAR callback API FALSE: TCP/IP Stack supports only BSD Sockets.
      boolean SoAdDevErrorDetect: set at pre-compile  # Pre-processor switch for enabling development error detection support.
      boolean SoAdDoIpActive: set at pre-compile  # True if a DoIP protocol plug-in is available.
      boolean SoAdDoIpVersionInfoApi: set at pre-compile  # Switches the DoIP_GetVersionInfo() API ON or OFF.
      boolean SoAdIPv6AddressEnabled: set at pre-compile  # Allows for increased memory allocation to store IPv6 addresses. | TRUE: Enables support for IPv6 addresses FALSE: Only IPv4 addresses are supported
      float SoAdMainFunctionPeriod: 0..Inf, set at pre-compile  # Determines the frequency at which the SoAd_MainFunction() is called in [s].
      integer SoAdMaxOpenSockets: 0..65535, set at pre-compile  # Specifies the number of sockets that will be open at any one time.
      float SoAdPollingInterval: 0..Inf, set at pre-compile  # Specifies the interval at which the SoAd shall poll the TCP/IP stack for new information in [s].
      integer SoAdSocketCount: 1..255, set at pre-compile  # Number of entries in the Socket connection table.
      float SoAdTcpIpMainFunctionPeriod: 0..Inf, set at pre-compile  # Determines the frequency at which the TcpIp_MainFunctionCyclic() is called in [s].
      boolean SoAdTcpIpVersionInfoApi: set at pre-compile  # Activates the TCPIP_GetVersionInfo API. | TRUE: Enables the TCPIP_GetVersionInfo API. FALSE: TCPIP_GetVersionInfo API is not included.
      boolean SoAdUdpNmApiEnabled: set at link in variant link-time+post-build / pre-compile in variant pre-compile  # Activates the configurable interfaces to be used by UdpNm. | TRUE: Enables support for the UdpNm API. FALSE: UdpNm API is not included.
      boolean SoAdVersionInfoApi: set at pre-compile  # Activates the SoAd_GetVersionInfo() API. | TRUE: Enables the SoAd_GetVersionInfo() API. FALSE: SoAd_GetVersionInfo() API is not included.
      boolean SoAdXcpApiEnabled: set at link in variant link-time+post-build / pre-compile in variant pre-compile  # Activates the configurable interfaces to be used by Xcp. | TRUE: Enables support for the Xcp API. FALSE: Xcp API is not included.
    container SoAdPduRoute [1..*]  # Describes the path of a PDU from the PDU Router to the socket in the TCP/IP stack for transmission.
      integer SoAdDestinationId: 0..4294967296, set at link in variant link-time+post-build / pre-compile in variant pre-compile  # ID to be sent on the TCP/IP connection if the PDU header option is enabled.
      integer SoAdSourcePduId: 0..65535, set at link in variant link-time+post-build / pre-compile in variant pre-compile, symbolic-name-value=true  # PDU ID of the PDU coming from the PDU Router.
      integer SoAdSourceSduLength: 0..65535, set at link in variant link-time+post-build / pre-compile in variant pre-compile  # Length in bytes of the SDU to be sent over the TCP/IP stack.
      function name SoAdTxConfirmationUL [0..1]: set at link in variant link-time+post-build / pre-compile in variant pre-compile  # This optional parameter defines the name of the <User_TxConfirmation> in case that SoAdUserTxConfirmationUL is configured to Cdd. If SoAdUserTxConfirmationUL equals PduR, Xcp or UdpNm, the name of the <User_TxConfirmation> is fixed and this parameter is skipped. If SoAdUserTxConfirmationUL equals Cdd, the name of the <User_TxConfirmation> is selectable.
      enumeration SoAdUserTxConfirmationUL: {Cdd, PduR, UdpNm, Xcp}, set at link in variant link-time+post-build / pre-compile in variant pre-compile  # This parameter defines the upper layer (UL) module to which the confirmation of the successfully transmitted SoAdSourcePduId has to be routed via the <User_SoAdTxConfirmation>. | This <User_SoAdTxConfirmation> has to be invoked when the confirmation of the configured SoAdSourcePduId will be received by a Tx confirmation event from the EthIf module.
      reference SoAdDestinationSocketRef: set at link in variant link-time+post-build / pre-compile in variant pre-compile, destination=SoAdSocketConnection  # Connection on which the PDU is to be sent on, references the appropriate entry in the Socket Connection Table.
      reference SoAdSourcePduRef: set at link in variant link-time+post-build / pre-compile in variant pre-compile, destination=Pdu  # Reference to the global PDU structure
    container SoAdSocketConnection [1..*]  # Information required to receive and transmit data via the TCP/IP stack on a particular connection.
      enumeration SoAdAutosarConnector: {Cdd, DoIP, PduR, Xcp}, set at link in variant link-time+post-build / pre-compile in variant pre-compile  # Connection point within the AUTOSAR stack for this socket connection | Availability of protocol plug-ins. Entries in the Socket and PDU Routing Tables.
      boolean SoAdPduHeaderEnable: set at link in variant link-time+post-build / pre-compile in variant pre-compile  # Enables the transmission of the PDU header (ID, length) on this TCP/IP connection. | TRUE: Send PDU header before data FALSE: Send data only
      boolean SoAdPduProvideBufferEnable: set at link in variant link-time+post-build / pre-compile in variant pre-compile  # Enables the use of TP style API towards the PDU Router for this PDU. Will trigger the calls to ProvideRxBuffer and ProvideTxBuffer respectively. | TRUE: The TP stype API is to be used towards the PDU Router. FALSE: The IF style API is to be used towards the PDU Router.
      boolean SoAdResourceManagementEnable: set at link in variant link-time+post-build / pre-compile in variant pre-compile  # Enables the resource management option for this socket. | May not be activated for UDP sockets in receive and not for DoIP sockets. TRUE: resource management option enabled FALSE: resource management option disabled
      boolean SoAdSocketAutosarApi: set at link in variant link-time+post-build / pre-compile in variant pre-compile  # Enables the use of the AUTOSAR call-back API for this connection. | TRUE: Use AUTOSAR call-back API FALSE: Use BSD Socket API Availability of the AUTOSAR Call-back API in the TCP/IP stack.
      integer SoAdSocketId: 0..65535, set at link in variant link-time+post-build / pre-compile in variant pre-compile, symbolic-name-value=true  # The Socket ID is used as a reference to a particular connection when transferring data to and from the PDU Router.
      string SoAdSocketLocalIpAddress: set at link in variant link-time+post-build / pre-compile in variant pre-compile  # Local IP address used for this connection. | Network configuration. Local and Remote Address need to be in the same subnet.
      integer SoAdSocketLocalPort [0..1]: 0..65535, set at link in variant link-time+post-build / pre-compile in variant pre-compile  # Local UDP or TCP port used for this connection.
      enumeration SoAdSocketProtocol: {TCP, UDP}, set at pre-compile  # Specifies the transport protocol (UDP or TCP).
      string SoAdSocketRemoteIpAddress: set at link in variant link-time+post-build / pre-compile in variant pre-compile  # IP address where NM packets are being sent to.
      integer SoAdSocketRemotePort [0..1]: 0..65535, set at link in variant link-time+post-build / pre-compile in variant pre-compile  # Remote UDP or TCP port used for this connection.
      boolean SoAdSocketTcpInitiate [0..1]: set at link in variant link-time+post-build / pre-compile in variant pre-compile  # Specifies the initiator for this TCP connection. | This parameter is only relevant for TCP connections. It will not be defined for UDP sockets. TRUE: This TCP connection is initiated by this module. FALSE: This TCP connection is to be initiated in the listen mode.
      boolean SoAdSocketTcpNoDelay [0..1]: set at link in variant link-time+post-build / pre-compile in variant pre-compile  # Specifies not to use the congestion control mechanism for this connection. This parameter is only relevant for TCP connections. It will not be defined for UDP sockets. | TRUE: This TCP connection will NOT use congestion control. FALSE: This TCP connection will use congestion control.
      boolean SoAdSocketUdpListenOnly [0..1]: set at link in variant link-time+post-build / pre-compile in variant pre-compile  # Used to disable the transmit functionality on this UDP port. This parameter is only relevant for UDP connections. | TRUE: This UDP port cannot transmit data FALSE: This UDP port can send and receive data
      container SoAdDemEventConnectionParameterRefs [0..1]  # Container for the references to DemEventParameter elements which shall be invoked using the API Dem_ReportErrorStatus API in case the corresponding error occurs. The EventId is taken from the referenced DemEventParameter's DemEventId value. The standardized errors are provided in the container and can be extended by vendor specific error references.
        symbolic name reference SOAD_E_AGAIN [0..1]: set at pre-compile, destination=DemEventParameter  # Reference to the DemEventParameter which shall be issued when the error "Resource temporarily unavailable" has occured.
        symbolic name reference SOAD_E_CONNABORTED [0..1]: set at pre-compile, destination=DemEventParameter  # Reference to the DemEventParameter which shall be issued when the error "Software caused connection abort" has occured.
        symbolic name reference SOAD_E_CONNREFUSED [0..1]: set at pre-compile, destination=DemEventParameter  # Reference to the DemEventParameter which shall be issued when the error "Connection refused" has occured.
        symbolic name reference SOAD_E_CONNRESET [0..1]: set at pre-compile, destination=DemEventParameter  # Reference to the DemEventParameter which shall be issued when the error "Connection reset by peer" has occured.
        symbolic name reference SOAD_E_HOSTDOWN [0..1]: set at pre-compile, destination=DemEventParameter  # Reference to the DemEventParameter which shall be issued when the error "Host is down" has occured.
        symbolic name reference SOAD_E_HOSTUNREACH [0..1]: set at pre-compile, destination=DemEventParameter  # Reference to the DemEventParameter which shall be issued when the error "Host is down" has occured.
        symbolic name reference SOAD_E_NETDOWN [0..1]: set at pre-compile, destination=DemEventParameter  # Reference to the DemEventParameter which shall be issued when the error "Network is down" has occured.
        symbolic name reference SOAD_E_NETRESET [0..1]: set at pre-compile, destination=DemEventParameter  # Reference to the DemEventParameter which shall be issued when the error "Network dropped connection on reset" has occured.
        symbolic name reference SOAD_E_NETUNREACH [0..1]: set at pre-compile, destination=DemEventParameter  # Reference to the DemEventParameter which shall be issued when the error "Network is unreachable" has occured.
        symbolic name reference SOAD_E_NOTCONN [0..1]: set at pre-compile, destination=DemEventParameter  # Reference to the DemEventParameter which shall be issued when the error "Socket is not connected" has occured.
        symbolic name reference SOAD_E_PIPE [0..1]: set at pre-compile, destination=DemEventParameter  # Reference to the DemEventParameter which shall be issued when the error "Broken pipe" has occured.
        symbolic name reference SOAD_E_SDULENGTH [0..1]: set at pre-compile, destination=DemEventParameter  # Reference to the DemEventParameter which shall be issued when the error "SDU length mismatch" has occured.
        symbolic name reference SOAD_E_TIMEDOUT [0..1]: set at pre-compile, destination=DemEventParameter  # Reference to the DemEventParameter which shall be issued when the error "Operation timed out" has occured.
    container SoAdSocketRoute [1..*]  # Describes the path of a PDU from a socket in the TCP/IP stack to the PDU Router after reception in the TCP/IP Stack.
      integer SoAdDestinationSduLength: 0..65535, set at link in variant link-time+post-build / pre-compile in variant pre-compile  # Length in bytes of the data contained in the PDU.
      function name SoAdRxIndicationUL [0..1]: set at link in variant link-time+post-build / pre-compile in variant pre-compile  # This parameter defines the name of the <User_RxIndication> in case that SoAdUserRxIndicationUL is configured to Cdd. If SoAdUserRxIndicationUL equals PduR, Xcp or UdpNm, the name of the <User_RxIndication> is fixed and this parameter is skipped. If SoAdUserRxIndicationUL equals CDD the name of the <User_RxIndication> is selectable.
      integer SoAdSourceId: 0..4294967296, set at link in variant link-time+post-build / pre-compile in variant pre-compile  # ID contained in the packet received on the TCP/IP connection if the PDU header option is enabled.
      enumeration SoAdUserRxIndicationUL: {Cdd, PduR, UdpNm, Xcp}, set at link in variant link-time+post-build / pre-compile in variant pre-compile  # This parameter defines the upper layer (UL) module to which the indication of the successfully received SoAd PDU has to be routed via <User_SoAdRxIndication>. This <User_SoAdRxIndication> has to be invoked when the RX indication is received by the EthIf module.
      reference SoAdDestinationPduRef: set at link in variant link-time+post-build / pre-compile in variant pre-compile, destination=Pdu  # Reference to the global PDU structure
      reference SoAdSourceSocketRef: set at link in variant link-time+post-build / pre-compile in variant pre-compile, destination=SoAdSocketConnection  # Connection on which the PDU was received. This references an entry in the Socket Connection Table.
  module definition Sd [0..1]: variants link-time/post-build/pre-compile  # Configuration of the Service Discovery module.
    container SdConfig: multiple-configuration-container=true  # This container contains the configuration parameters and sub containers of the AUTOSAR Service Discovery module. This container is a MultipleConfigurationContainer, i.e. this container and its sub-containers exist once per configuration set.
      container SdInstance [0..*]  # This container represents an instance of the SD; i.e. the SD configuration for a certain link.
        string SdInstanceHostname [0..1]: set at link in variant link-time / post-build in variant post-build / pre-compile in variant pre-compile  # Configuration parameter to specify the Hostname.
        container SdClientService [0..*]  # This container specifies all parameters used by Client services.
          boolean SdClientServiceAutoRequire: set at link in variant link-time / post-build in variant post-build / pre-compile in variant pre-compile, default-value=false  # If existing and set to true, this Service will be set to "required" on start.
          integer SdClientServiceHandleId: 0..65535, set at link in variant link-time / post-build in variant post-build / pre-compile in variant pre-compile, symbolic-name-value=true  # The HandleId by which the BswM can identify this Client Service Instance.
          integer SdClientServiceId: 0..65534, set at link in variant link-time / post-build in variant post-build / pre-compile in variant pre-compile  # Id to identify the service. This is unique for the service interface.
          integer SdClientServiceInstanceId: 0..65534, set at link in variant link-time / post-build in variant post-build / pre-compile in variant pre-compile  # Configuration parameter to specify Instance Id of the service as used in SD entries.
          integer SdClientServiceMajorVersion: 0..254, set at link in variant link-time / post-build in variant post-build / pre-compile in variant pre-compile  # Major version number of the Service as used in the SD entries.
          integer SdClientServiceMinorVersion: 0..4294967295, set at link in variant link-time / post-build in variant post-build / pre-compile in variant pre-compile  # Minor version number of the Service as used in the SD Service Entries.
          reference SdClientServiceTimerRef: set at link in variant link-time / post-build in variant post-build / pre-compile in variant pre-compile, destination=SdClientTimer  # The reference of the SdClientTimer container for this service.
          container SdClientCapabilityRecord [0..*]  # Sd uses capability records to store arbitrary name/value pairs conveying additional information about the named service. | The following use cases are supported: 1) Key present, with no value (e.g. "passreq" -- password required for this service) 2) Key present, with empty value (e.g. "PlugIns=" server supports plugins, but none are presently installed) 3) Key present, with non-empty value (e.g. "PlugIns=JPEG,MPEG2,MPEG4")
            string SdClientServiceCapabilityRecordKey: set at pre-compile  # Defines a CapabilityRecord key.
            string SdClientServiceCapabilityRecordValue [0..1]: set at pre-compile  # Defines the corresponding CapabilityRecord value.
          container SdConsumedEventGroup [0..*]  # A Service may have event groups which can be consumed. A service consumer has to subscribe to the corresponding event-group. After the subscription the event consumer takes the role of a server and the event provider that of a client.
            boolean SdConsumedEventGroupAutoRequire: set at link in variant link-time / post-build in variant post-build / pre-compile in variant pre-compile, default-value=false  # If existing and set to true, this EventGroup will be set to "required" on start.
            integer SdConsumedEventGroupHandleId: 0..65535, set at link in variant link-time / post-build in variant post-build / pre-compile in variant pre-compile, symbolic-name-value=true  # The HandleId by which the BswM can identify this EventGroup.
            integer SdConsumedEventGroupId: 0..65534, set at pre-compile  # The Eventgroup Id of this eventGroup as a unique identifier of the eventgroup in this service. This identifier is used for EventGroup entries as well.
            reference SdConsumedEventGroupTimerRef: set at link in variant link-time / post-build in variant post-build / pre-compile in variant pre-compile, destination=SdClientTimer  # The reference of the SdClientTimer container for this eventGroup.
            symbolic name reference SdConsumedEventGroupMulticastActivationRef [0..1]: set at link in variant link-time / post-build in variant post-build / pre-compile in variant pre-compile, destination=SoAdRoutingGroup  # The reference of a Routing Group in order to activate and setup the Socket Connection for Multicast Events of this EventGroup. The multicast address from the received Multicast option is setup by SoAd_RequestIpAddrAssignment. | The local address is the same as for the unicast events; thus, it was sent in the UDP Endpoint option of the Subscribe EventGroup entry.
            symbolic name reference SdConsumedEventGroupTcpActivationRef [0..1]: set at link in variant link-time / post-build in variant post-build / pre-compile in variant pre-compile, destination=SoAdRoutingGroup  # The reference of the Routing Group for activation of the data path for receiving TCP events. | This element is also being used for getting the IP address and port number for building the TCP endpoint option for the Subscribe EventGroup entry. If no TCP methods are used in the service, this element is also being used for setting the remote address (TCP Endpoint option referenced by the Offer Service entry) and opening the TCP connection to the server before sending the Subscribe EventGroup entry. If multiple EventGroups of the same Service Instance are subscribed the TCP connection will be shared and must be opened only once.
            symbolic name reference SdConsumedEventGroupUdpActivationRef [0..1]: set at link in variant link-time / post-build in variant post-build / pre-compile in variant pre-compile, destination=SoAdRoutingGroup  # The reference of the Routing Group for activation of the data path for receiving UDP events. | This element is also being used for getting the IP address and port number for building the UDP endpoint option for the Subscribe EventGroup entry. If no UDP methods are used in the service, this element is also being used for setting the remote address (UDP Endpoint option referenced by the Offer Service entry). If multiple EventGroups of the same Service Instance are subscribed the UDP Socket Connection will be shared and must be set only once.
            container SdClientCapabilityRecord [0..*]  # Sd uses capability records to store arbitrary name/value pairs conveying additional information about the named service. | The following use cases are supported: 1) Key present, with no value (e.g. "passreq" -- password required for this service) 2) Key present, with empty value (e.g. "PlugIns=" server supports plugins, but none are presently installed) 3) Key present, with non-empty value (e.g. "PlugIns=JPEG,MPEG2,MPEG4")
              string SdClientServiceCapabilityRecordKey: set at pre-compile  # Defines a CapabilityRecord key.
              string SdClientServiceCapabilityRecordValue [0..1]: set at pre-compile  # Defines the corresponding CapabilityRecord value.
          container SdConsumedMethods [0..1]  # Container element for representing the data path for accessing the server methods.
            symbolic name reference SdClientServiceActivationRef [0..1]: set at link in variant link-time / post-build in variant post-build / pre-compile in variant pre-compile, destination=SoAdRoutingGroup  # Reference to a SoAdRoutingGroupRef to activate/deactivate the data path for the methods.
            symbolic name reference SdClientServiceTcpRef [0..1]: set at link in variant link-time / post-build in variant post-build / pre-compile in variant pre-compile, destination=SoAdSocketConnection  # Reference to the SoAdSocketConnection representing the data path (TCP) for communication with methods. | This element is also used to set the remote address of the server and to open the TCP connection.
            symbolic name reference SdClientServiceUdpRef [0..1]: set at link in variant link-time / post-build in variant post-build / pre-compile in variant pre-compile, destination=SoAdSocketConnection  # Reference to the SoAdSocketConnection representing the data path (UDP) for communication with methods. | This element is also used to set the remote address of the server.
        container SdClientTimer [0..*]  # This container specifies all timers used by the Service Discovery module for Client Services.
          float SdClientTimerInitialFindDelayMax [0..1]: 0..Inf, set at link in variant link-time / post-build in variant post-build / pre-compile in variant pre-compile  # Max value in [s] to delay randomly the transmission of a find message. This parameter is mandatory for ClientService.
          float SdClientTimerInitialFindDelayMin [0..1]: 0..Inf, set at link in variant link-time / post-build in variant post-build / pre-compile in variant pre-compile  # Min value in [s] to delay randomly the transmission of a find message. This parameter is mandatory for ClientService.
          float SdClientTimerInitialFindRepetitionsBaseDelay [0..1]: 0..Inf, set at link in variant link-time / post-build in variant post-build / pre-compile in variant pre-compile  # The base delay in [s] for find repetitions. Successive finds have an exponential back off delay (1x base delay, 2x base delay, 4x base delay, ...). This parameter is mandatory for ClientService.
          integer SdClientTimerInitialFindRepetitionsMax [0..1]: 0..10, set at link in variant link-time / post-build in variant post-build / pre-compile in variant pre-compile  # Configuration for the maximum number of find repetitions. This parameter is mandatory for ClientService.
          float SdClientTimerRequestResponseMaxDelay [0..1]: 0..Inf, set at link in variant link-time / post-build in variant post-build / pre-compile in variant pre-compile  # Maximum allowable response delay to entries received by multicast in seconds. This parameter is mandatory for ConsumedEventGroups.
          float SdClientTimerRequestResponseMinDelay [0..1]: 0..Inf, set at link in variant link-time / post-build in variant post-build / pre-compile in variant pre-compile  # Minimum allowable response delay to the find message in seconds. This parameter is mandatory for ConsumedEventGroups.
          integer SdClientTimerTTL: 1..16777215, set at link in variant link-time / post-build in variant post-build / pre-compile in variant pre-compile  # Time to live for find and subscribe messages.
        container SdInstanceMulticastRxPdu  # This container specifies the received PDU.
          integer SdRxPduId: 0..65535, set at link in variant link-time / post-build in variant post-build / pre-compile in variant pre-compile  # ID of the PDU that will be received via the API Sd_SoAdIfRxIndication().
          reference SdRxPduRef: set at link in variant link-time / post-build in variant post-build / pre-compile in variant pre-compile, destination=Pdu  # Reference to the "global" Pdu structure to allow harmonization of handle IDs in the COM-Stack.
        container SdInstanceTxPdu  # This container specifies the transmitted PDU.
          reference SdTxPduRef: set at link in variant link-time / post-build in variant post-build / pre-compile in variant pre-compile, destination=Pdu  # Reference to the "global" Pdu structure to allow harmonization of handle IDs in the COM-Stack.
        container SdInstanceUnicastRxPdu  # This container specifies the received PDU.
          integer SdRxPduId: 0..65535, set at link in variant link-time / post-build in variant post-build / pre-compile in variant pre-compile  # ID of the PDU that will be received via the API Sd_SoAdIfRxIndication().
          reference SdRxPduRef: set at link in variant link-time / post-build in variant post-build / pre-compile in variant pre-compile, destination=Pdu  # Reference to the "global" Pdu structure to allow harmonization of handle IDs in the COM-Stack.
        container SdServerService [0..*]  # This container specifies all parameters used by Server services.
          boolean SdServerServiceAutoAvailable: set at link in variant link-time / post-build in variant post-build / pre-compile in variant pre-compile, default-value=false  # If existing and set to true, this Service will be set to "Available" on start.
          integer SdServerServiceHandleId: 0..65535, set at link in variant link-time / post-build in variant post-build / pre-compile in variant pre-compile, symbolic-name-value=true  # The HandleId by which the BswM can identify this Server Service Instance.
          integer SdServerServiceId: 0..65534, set at link in variant link-time / post-build in variant post-build / pre-compile in variant pre-compile  # Id to identify the service. This is unique for the service interface.
          integer SdServerServiceInstanceId: 0..65534, set at link in variant link-time / post-build in variant post-build / pre-compile in variant pre-compile  # Configuration parameter to specify Instance Id of the Service implemented by the Server Service.
          integer SdServerServiceMajorVersion: 0..254, set at link in variant link-time / post-build in variant post-build / pre-compile in variant pre-compile  # Major version number of the Service as used in SD Entries.
          integer SdServerServiceMinorVersion: 0..4294967294, set at link in variant link-time / post-build in variant post-build / pre-compile in variant pre-compile  # Minor version number of the Service as used e.g. in Offer Service entries.
          reference SdServerServiceTimerRef: set at link in variant link-time / post-build in variant post-build / pre-compile in variant pre-compile, destination=SdServerTimer  # The reference of the SdServerTimer container for this service.
          container SdEventHandler [0..*]  # Container Element for representing an EventGroup as part of the Service Instance.
            boolean SdEventHandlerAutoAvailable: set at link in variant link-time / post-build in variant post-build / pre-compile in variant pre-compile, default-value=false  # If existing and set to true, this EventGroup will be set to "available" on start.
            integer SdEventHandlerEventGroupId: 0..65534, set at pre-compile  # The EventGroup Id of this EventGroup as a unique identifier of the EventGroup in this service. This identifier is used for EventGroup entries as well.
            integer SdEventHandlerHandleId: 0..65535, set at link in variant link-time / post-build in variant post-build / pre-compile in variant pre-compile, symbolic-name-value=true  # The HandleId by which the BswM can identify this EventGroup.
            integer SdEventHandlerMulticastThreshold: 0..65535, set at link in variant link-time / post-build in variant post-build / pre-compile in variant pre-compile  # Specifies the number of subscribed clients that trigger the Server to change the transmission of events to Multicast. | If configured to 0 only unicast will be used. If configured to 1 the first client will be already served by multicast. If configured to 2 the first client will be served with unicast and as soon as the second client arrives both will be served by multicast. This does not influence the handling of initial events, which are served using unicast only.
            reference SdEventHandlerTimerRef: set at link in variant link-time / post-build in variant post-build / pre-compile in variant pre-compile, destination=SdServerTimer  # The reference of the SdServerTimer container for this EventGroup.
            container SdEventHandlerMulticast [0..1]  # The subcontainer including the Routing Group for Activation of Events sent over Multicast. | The activation ref is also being used for identification of the related Socket Connection in order to find the Multicast Address used in the Multicast Option referenced by the Subscribe EventGroup Ack entry.
              symbolic name reference SdEventActivationRef [0..1]: set at link in variant link-time / post-build in variant post-build / pre-compile in variant pre-compile, destination=SoAdRoutingGroup  # Reference to a SoAdRoutingGroup for activation of the data path for a subscribed client (start sending events after subscribe).
            container SdEventHandlerTcp [0..*]  # The subcontainer including the Routing Groups for Activation and Trigger Transmit for Events sent over TCP. | The activation ref (or triggering ref if no activation ref exists) is also being used for identification of the related socket connections in order to find the related client by iterating the SdEventHandlerTcp elements (remote address statically configured or automatically set by opening TCP connection before subscription).
              symbolic name reference SdEventActivationRef [0..1]: set at link in variant link-time / post-build in variant post-build / pre-compile in variant pre-compile, destination=SoAdRoutingGroup  # Reference to a SoAdRoutingGroup for activation of the data path for a subscribed client (start sending events after subscribe).
              symbolic name reference SdEventTriggeringRef [0..1]: set at link in variant link-time / post-build in variant post-build / pre-compile in variant pre-compile, destination=SoAdRoutingGroup  # Reference to a SoAdRoutingGroup that is used for triggered transmit. Triggering is needed to sent out initial events on the server side after a client got subscribed.
            container SdEventHandlerUdp [0..*]  # The subcontainer including the Routing Groups for Activation and Trigger Transmit for Events sent over UDP. | The activation ref (or triggering ref if no activation ref exists) is also being used for identification of the related socket connections in order to set the remote address of the client or find the related client by iterating the SdEventHandlerUdp elements (remote address statically configured or automatically set by method call before subscription).
              symbolic name reference SdEventActivationRef [0..1]: set at link in variant link-time / post-build in variant post-build / pre-compile in variant pre-compile, destination=SoAdRoutingGroup  # Reference to a SoAdRoutingGroup for activation of the data path for a subscribed client (start sending events after subscribe).
              symbolic name reference SdEventTriggeringRef [0..1]: set at link in variant link-time / post-build in variant post-build / pre-compile in variant pre-compile, destination=SoAdRoutingGroup  # Reference to a SoAdRoutingGroup that is used for triggered transmit. Triggering is needed to sent out initial events on the server side after a client got subscribed.
            container SdServerCapabilityRecord [0..*]  # Sd uses capability records to store arbitrary name/value pairs conveying additional information about the named service. | The following use cases are supported: 1) Key present, with no value (e.g. "passreq" -- password required for this service) 2) Key present, with empty value (e.g. "PlugIns=" server supports plugins, but none are presently installed) 3) Key present, with non-empty value (e.g. "PlugIns=JPEG,MPEG2,MPEG4")
              string SdServerCapabilityRecordKey: set at pre-compile  # Defines a CapabilityRecord key.
              string SdServerCapabilityRecordValue [0..1]: set at pre-compile  # Defines the corresponding CapabilityRecord value.
          container SdProvidedMethods [0..1]  # Container element for representing the needed elements of the data path for the methods provided by the service.
            reference SdServerServiceTcpRef [0..1]: set at link in variant link-time / post-build in variant post-build / pre-compile in variant pre-compile, destination=SoAdSocketConnectionGroup  # Reference to SoAdSocketConnectionGroup used for methods. | This is used to access the local IP address and port for building the endpoint option for offers of this service.
            reference SdServerServiceUdpRef [0..1]: set at link in variant link-time / post-build in variant post-build / pre-compile in variant pre-compile, destination=SoAdSocketConnectionGroup  # Reference to SoAdSocketConnectionGroup used for methods. | This is used to access the local IP address and port for building the endpoint option for offers of this service.
            symbolic name reference SdServerServiceActivationRef [0..1]: set at link in variant link-time / post-build in variant post-build / pre-compile in variant pre-compile, destination=SoAdRoutingGroup  # Reference to a SoAdRoutingGroup to activated and deactivate the data path for methods of the service.
          container SdServerCapabilityRecord [0..*]  # Sd uses capability records to store arbitrary name/value pairs conveying additional information about the named service. | The following use cases are supported: 1) Key present, with no value (e.g. "passreq" -- password required for this service) 2) Key present, with empty value (e.g. "PlugIns=" server supports plugins, but none are presently installed) 3) Key present, with non-empty value (e.g. "PlugIns=JPEG,MPEG2,MPEG4")
            string SdServerCapabilityRecordKey: set at pre-compile  # Defines a CapabilityRecord key.
            string SdServerCapabilityRecordValue [0..1]: set at pre-compile  # Defines the corresponding CapabilityRecord value.
        container SdServerTimer [0..*]  # This container specifies all timers used by the Service Discovery module for Server Services.
          float SdServerTimerInitialOfferDelayMax [0..1]: 0..Inf, set at link in variant link-time / post-build in variant post-build / pre-compile in variant pre-compile  # Max value in [s] to delay randomly the first offer. This parameter is mandatory for ServerService.
          float SdServerTimerInitialOfferDelayMin [0..1]: 0..Inf, set at link in variant link-time / post-build in variant post-build / pre-compile in variant pre-compile  # Min value in [s] to delay randomly the first offer. This parameter is mandatory for ServerService.
          float SdServerTimerInitialOfferRepetitionBaseDelay [0..1]: 0..Inf, set at link in variant link-time / post-build in variant post-build / pre-compile in variant pre-compile  # The base delay in [s] for offer repetitions. Successive offers have an exponential back off delay (1x base delay, 2x base delay, 4x base delay, ...). This parameter is mandatory for ServerService.
          integer SdServerTimerInitialOfferRepetitionsMax [0..1]: 0..10, set at link in variant link-time / post-build in variant post-build / pre-compile in variant pre-compile  # Configure the maximum amount of offer repetition. This parameter is mandatory for ServerService.
          float SdServerTimerOfferCyclicDelay [0..1]: 0..Inf, set at link in variant link-time / post-build in variant post-build / pre-compile in variant pre-compile  # Interval between cyclic offers in the main phase. This parameter is mandatory for ServerService.
          float SdServerTimerRequestResponseMaxDelay: 0..Inf, set at link in variant link-time / post-build in variant post-build / pre-compile in variant pre-compile  # Maximum allowable response delay to entries received by multicast in seconds.
          float SdServerTimerRequestResponseMinDelay: 0..Inf, set at link in variant link-time / post-build in variant post-build / pre-compile in variant pre-compile  # Minimum allowable response delay to entries received by multicast in seconds.
          integer SdServerTimerTTL: 1..16777215, set at link in variant link-time / post-build in variant post-build / pre-compile in variant pre-compile  # Time to live for offer service or subscribe EventGroup ack.
    container SdGeneral  # This container lists the general configuration parameters for the Service Discovery module.
      boolean SdDevErrorDetect: set at pre-compile  # Enables and disables the development error detection and notification mechanism.
      float SdMainFunctionCycleTime: 1E-4..1, set at pre-compile  # This parameter defines the cycle time in seconds of the periodic calling of Sd main function.
      boolean SdVersionInfoApi: set at pre-compile  # Enables and disables the version info API.
  module definition Spi [0..1]: variants link-time/post-build/pre-compile  # Configuration of the Spi (Serial Peripheral Interface) module.
    container SpiDriver: multiple-configuration-container=true  # Configuration of one instance (if multiplicity is 1, it is the sole configuration) of an SPI driver.
      integer SpiMaxChannel [0..1]: 0..255, set at link in variant link-time / post-build in variant post-build / pre-compile in variant pre-compile  # This parameter contains the number of Channels configured. It will be gathered by tools during the configuration stage.
      integer SpiMaxJob [0..1]: 0..65535, set at link in variant link-time / post-build in variant post-build / pre-compile in variant pre-compile  # Total number of Jobs configured.
      integer SpiMaxSequence [0..1]: 0..255, set at link in variant link-time / post-build in variant post-build / pre-compile in variant pre-compile  # Total number of Sequences configured.
      container SpiChannel [1..*]  # All data needed to configure one SPI-channel
        integer SpiChannelId: 0..255, set at pre-compile, symbolic-name-value=true  # SPI Channel ID, used as parameter in SPI API functions.
        enumeration SpiChannelType: {EB, IB}, set at link in variant link-time / post-build in variant post-build / pre-compile in variant pre-compile  # Buffer usage with EB/IB channel.
        integer SpiDataWidth: 1..32, set at link in variant link-time / post-build in variant post-build / pre-compile in variant pre-compile  # This parameter is the width of a transmitted data unit.
        integer SpiDefaultData [0..1]: 0..4294967295, set at link in variant link-time / post-build in variant post-build / pre-compile in variant pre-compile  # The default data to be transmitted when (for internal buffer or external buffer) the pointer passed to Spi_WriteIB (for internal buffer) or to Spi_SetupEB (for external buffer) is NULL.
        integer SpiEbMaxLength: 0..65535, set at link in variant link-time / post-build in variant post-build / pre-compile in variant pre-compile  # This parameter contains the maximum size (in bytes) of data buffers in case of EB Channels and only.
        integer SpiIbNBuffers: 0..65535, set at link in variant link-time / post-build in variant post-build / pre-compile in variant pre-compile  # This parameter contains the maximum number of data buffers in case of IB Channels and only.
        enumeration SpiTransferStart: {LSB, MSB}, set at link in variant link-time / post-build in variant post-build / pre-compile in variant pre-compile  # This parameter defines the first starting bit for transmission.
      container SpiDemEventParameterRefs [0..1]  # Container for the references to DemEventParameter elements which shall be invoked using the API Dem_ReportErrorStatus API in case the corresponding error occurs. The EventId is taken from the referenced DemEventParameter's DemEventId value. The standardized errors are provided in the container and can be extended by vendor specific error references.
        symbolic name reference SPI_E_HARDWARE_ERROR [0..1]: set at link in variant link-time / post-build in variant post-build / pre-compile in variant pre-compile, destination=DemEventParameter  # Reference to the DemEventParameter which shall be issued when a hardware error was detected. If the reference is not configured the error shall not be reported.
      container SpiExternalDevice [1..*]  # The communication settings of an external device. Closely linked to SpiJob.
        float SpiBaudrate: 0..Inf, set at link in variant link-time / post-build in variant post-build / pre-compile in variant pre-compile  # This parameter is the communication baudrate - This parameter allows | using a range of values, from the point of view of configuration tools, from Hz up to MHz.
        string SpiCsIdentifier: set at link in variant link-time / post-build in variant post-build / pre-compile in variant pre-compile, symbolic-name-value=true  # This parameter is the symbolic name to identify the Chip Select (CS) allocated to this Job.
        enumeration SpiCsPolarity: {HIGH, LOW}, set at link in variant link-time / post-build in variant post-build / pre-compile in variant pre-compile  # This parameter defines the active polarity of Chip Select.
        enumeration SpiCsSelection [0..1]: {CS_VIA_GPIO, CS_VIA_PERIPHERAL_ENGINE}, set at link in variant link-time / post-build in variant post-build / pre-compile in variant pre-compile, default-value=CS_VIA_PERIPHERAL_ENGINE  # When the Chip select handling is enabled (see SpiEnableCs), then this parameter specifies if the chip select is handled automatically by Peripheral HW engine or via general purpose IO by Spi driver.
        enumeration SpiDataShiftEdge: {LEADING, TRAILING}, set at link in variant link-time / post-build in variant post-build / pre-compile in variant pre-compile  # This parameter defines the SPI data shift edge.
        boolean SpiEnableCs: set at link in variant link-time / post-build in variant post-build / pre-compile in variant pre-compile  # This parameter enables or not the Chip Select handling functions. If this parameter is enabled then parameter SpiCsSelection further details the type of chip selection.
        enumeration SpiHwUnit: {CSIB0, CSIB1, CSIB2, CSIB3}, set at link in variant link-time / post-build in variant post-build / pre-compile in variant pre-compile  # This parameter is the symbolic name to identify the HW SPI Hardware | microcontroller peripheral allocated to this Job.
        enumeration SpiShiftClockIdleLevel: {HIGH, LOW}, set at link in variant link-time / post-build in variant post-build / pre-compile in variant pre-compile  # This parameter defines the SPI shift clock idle level.
        float SpiTimeClk2Cs: 0..1E-4, set at link in variant link-time / post-build in variant post-build / pre-compile in variant pre-compile  # Timing between clock and chip select (in seconds) - This parameter allows to use a range of values from 0 up to 0.0001 seconds. | The real configuration-value used in software BSW-SPI is calculated out of this by the generator-tools
      container SpiJob [1..*]  # All data needed to configure one SPI-Job, amongst others the connection between the internal SPI unit and the special settings for an external device is done.
        enumeration SpiHwUnitSynchronous [0..1]: {ASYNCHRONOUS, SYNCHRONOUS}, set at link in variant link-time / post-build in variant post-build / pre-compile in variant pre-compile  # If SpiHwUnitSynchronous is set to "SYNCHRONOUS", the SpiJob uses its containing SpiDriver in a synchronous manner. If it is set to "ASYNCHRONOUS", it uses the driver in an asynchronous way. If the parameter is not set, the SpiChannel uses the driver also in an asynchronous way.
        function name SpiJobEndNotification [0..1]: set at link in variant link-time / post-build in variant post-build / pre-compile in variant pre-compile  # This parameter is a reference to a notification function.
        integer SpiJobId: 0..65535, set at pre-compile, symbolic-name-value=true  # SPI Job ID, used as parameter in SPI API functions.
        integer SpiJobPriority: 0..3, set at link in variant link-time / post-build in variant post-build / pre-compile in variant pre-compile  # Priority set accordingly to SPI093: 0, lowest, 3, highest priority
        reference SpiDeviceAssignment: set at pre-compile, destination=SpiExternalDevice  # Reference to the external device used by this job
        container SpiChannelList [1..*]  # References to SPI channels and their order within the Job.
          integer SpiChannelIndex: 0..255, set at link in variant link-time / post-build in variant post-build / pre-compile in variant pre-compile  # This parameter specifies the order of Channels within the Job.
          reference SpiChannelAssignment: set at link in variant link-time / post-build in variant post-build / pre-compile in variant pre-compile, destination=SpiChannel  # A job reference to a SPI channel.
      container SpiSequence [1..*]  # All data needed to configure one SPI-sequence
        boolean SpiInterruptibleSequence: set at link in variant link-time / post-build in variant post-build / pre-compile in variant pre-compile  # This parameter allows or not this Sequence to be suspended by another one.
        function name SpiSeqEndNotification [0..1]: set at link in variant link-time / post-build in variant post-build / pre-compile in variant pre-compile  # This parameter is a reference to a notification function.
        integer SpiSequenceId: 0..255, set at pre-compile, symbolic-name-value=true  # SPI Sequence ID, used as parameter in SPI API functions.
        reference SpiJobAssignment [1..*]: set at link in variant link-time / post-build in variant post-build / pre-compile in variant pre-compile, destination=SpiJob  # A sequence references several jobs, which are executed during a communication sequence
    container SpiGeneral  # General configuration settings for SPI-Handler
      boolean SpiCancelApi: set at pre-compile  # Switches the Spi_Cancel function ON or OFF.
      integer SpiChannelBuffersAllowed: 0..2, set at pre-compile  # Selects the SPI Handler/Driver Channel Buffers usage allowed and | delivered. IB = 0; EB = 1; IB/EB = 2;
      boolean SpiDevErrorDetect: set at pre-compile  # Switches the Development Error Detection and Notification ON or OFF.
      boolean SpiHwStatusApi: set at pre-compile  # Switches the Spi_GetHWUnitStatus function ON or OFF.
      boolean SpiInterruptibleSeqAllowed: set at pre-compile  # Switches the Interruptible Sequences handling functionality ON or OFF.
      integer SpiLevelDelivered: 0..2, set at pre-compile  # Selects the SPI Handler/Driver level of scalable functionality that is | available and delivered.
      boolean SpiSupportConcurrentSyncTransmit: set at pre-compile  # Specifies whether concurrent Spi_SyncTransmit() calls for different sequences shall be configurable.
      boolean SpiVersionInfoApi: set at pre-compile  # Switches the Spi_GetVersionInfo function ON or OFF.
    container SpiPublishedInformation  # Container holding all SPI specific published information parameters
      integer SpiMaxHwUnit: 0..18446744073709551615, set at published-information  # Number of different SPI hardware microcontroller peripherals (units/busses) available and handled by this SPI Handler/Driver module.
  module definition StbM [0..1]: variants pre-compile  # Configuration of the Synchronized Time-base Manager (StbM) module.
    container StbMDemEventParameterRefs [0..1]  # Container for the references to DemEventParameter elements which shall be invoked using the API Dem_ReportErrorStatus API in case the corresponding error occurs. The EventId is taken from the referenced DemEventParameter's DemEventId value. The standardized errors are provided in the container and can be extended by vendor specific error references.
      symbolic name reference STBM_E_INIT_FAILED [0..1]: set at pre-compile, destination=DemEventParameter  # Reference to the DemEventParameter which shall be issued when the error "StbM initialization failed" has occured.
      symbolic name reference STBM_E_INTEGRITY_FAILED [0..1]: set at pre-compile, destination=DemEventParameter  # Reference to the DemEventParameter which shall be issued when the error "API request integrity failed" has occured.
      symbolic name reference STBM_E_REQ_FAILED [0..1]: set at pre-compile, destination=DemEventParameter  # Reference to the DemEventParameter which shall be issued when the error "API request failed" has occured.
    container StbMGeneral  # This container holds the general parameters of the Synchronized Time-base Manager
      boolean StbMAbsoluteTimeApi: set at pre-compile  # Enables/Disables the StbM_GetAbsoluteTime API.
      boolean StbMDevErrorDetect: set at pre-compile  # Switch for enabling the development error detection.
      integer StbMTickTypeRange: 0..65535, set at pre-compile  # Defines the upper range of the type "StbM_TickType".
      boolean StbMVersionInfo: set at pre-compile  # Activate/Deactivate the version information API (StbM_GetVersionInfo). True: version information API activated False: version information API deactivated.
    container StbMSynchronizedTimeBase [1..*]  # Synchronized time.base collects the information about a specific time-base provider within the system.
      function name StbMGlobalTimeProviderCallout [0..1]: set at pre-compile  # Entry address of the time-base specific callout routine which shall be invoked by the StbM for gathering the current time-base value. | In case the synchronized time-base is derived from the local time, this container can be omitted. For this case, the StbM achieves the current time-base value by calling the OS interface "GetCounterValue" with the respective OSCounter configured via the ECUC param "StbMLocalTimeRef".
      function name StbMSyncStateProviderCallout [0..1]: set at pre-compile  # Entry address of the time-base specific callout routine which shall be invoked by the StbM for gathering the current time-base status. | In case the synchronized time-base is derived from the local time, this container can be omitted. For this case, the state is always "STBM_STATE_SYNC".
      integer StbMSynchronizedTimeBaseIdentifier: 0..65535, set at pre-compile, symbolic-name-value=true  # Identification of a synchronized time-base via a unique identifier.
      function name StbMTickDurationProviderCallout [0..1]: set at pre-compile  # Entry address of the time-base specific callout routine which shall be invoked by the StbM for gathering the current time-base tick duration. | In case the synchronized time-base is derived from the local time, this container can be omitted. For this case, the StbM achieves the tick duration by configuring an alarm which uses the HW counter configured via the ECUC param "StbMLocalTimeRef". Note: The tick duration of the local time will not change during runtime.
      foreign reference StbMFlexRayClusterRef [0..1]: set at pre-compile, destination-type=FLEXRAY-CLUSTER  # Optional reference to the FlexRay cluster.
      foreign reference StbMTtcanClusterRef [0..1]: set at pre-compile, destination-type=TTCAN-CLUSTER  # Optional reference to the Ttcan cluster.
      reference StbMLocalTimeRef [0..1]: set at pre-compile, destination=OsCounter  # Optional sub container in case a local time shall be accessed. | In case this subcontainer is used, the destinated OS counter has to be configured properly, meaning: - the counter is directly driven by a HW timer - the counter's OsCounterTicksPerBase set to one tick in ms.
    container StbMTriggeredCustomer [1..*]  # The triggered customer is directliy triggered by the Synchronized Time-base Manager by getting synchronized with the current (global) definition of time and passage of time.
      function name StbMGlobalTimeCustomerCallback [0..1]: set at pre-compile  # Entry address of the customer specific call-back routine which shall be invoked by the StbM periodically for time value propagation. | This configuration is only valid if the explicit OS ScheduleTable is NOT defined as triggered customer (via the reference "StbMOSScheduleTableRef").
      function name StbMSyncStateCustomerCallback [0..1]: set at pre-compile  # Entry address of the customer specific call-back routine which shall be invoked by the StbM when state changes occur. | This configuration is only valid if the explicit OS ScheduleTable is NOT defined as triggered customer (via the reference "StbMOSScheduleTableRef").
      boolean StbMTriggerInSyncState: set at pre-compile  # Activate/Deactivate the triggering of the customer in case the related time-base (StbmSynchronizedTimeBaseRef) is not synchronized. | True: the customer will only be triggered when the related time-base is synchronized. False: the customer will be triggered with the local time-base when no synchronization for the related time-base is established.
      integer StbMTriggeredCustomerPeriod: 0..4294967295, set at pre-compile  # The triggering period of the triggered customer, called by the StbM_MainFunction. | The period is documented in microseconds.
      reference StbMOSScheduleTableRef [0..1]: set at pre-compile, destination=OsScheduleTable  # Optional reference to synchronized OS ScheduleTables. | This configuration is only valid if the triggered customer shall be an OS ScheduleTable. In this case, the OS ScheduleTable will be explicitely synchronized by the StbM.
      symbolic name reference StbMSynchronizedTimeBaseRef: set at pre-compile, destination=StbMSynchronizedTimeBase  # Mandatory reference to the required synchronized time-base.
  module definition UdpNm [0..1]: variants link-time/pre-compile
    container UdpNmGlobalConfig: multiple-configuration-container=true  # This container contains all global configuration parameters of UDP NM configured from the NM Module perspective.
      boolean UdpNmBusSynchronizationEnabled: set at pre-compile  # Pre-processor switch for enabling bus synchronization support. | This feature is required for gateway nodes only. It must not be defined if UDPNM_PASSIVE_MODE_ENABLED is defined. This parameter shall be derived from NM_BUS_SYNCHRONIZATION_ENABLED.
      boolean UdpNmComControl_Enabled: set at pre-compile  # Pre-processor switch for enabling the Communication Control support. | This parameter shall be derived from NM_COM_CONTROL_ENABLED.
      boolean UdpNmComUserDataSupport: set at pre-compile  # Enable/disable the user data support.
      boolean UdpNmCoordinatorEnabled: set at link  # Enable/disable the NM Coordination algorithm to being able to initiate the synchronization algorithm. | TRUE: Option is enabled FALSE: The parameter shall be FALSE by default and shall only be allowed to be TRUE if the parameter UDPNM_REMOTE_SLEEP_IND_ENABLED is TRUE.
      integer UdpNmCoordinatorId: 0..3, set at pre-compile  # Set the NM coordination ID for this gateway. | 0x00: passive coordinator only 0x01 - 0x03: coordinator priority Only valid, if UDPNM_COORDINATOR_ENABLED is TRUE.
      boolean UdpNmCoordinatorSyncSupport: set at pre-compile  # Enables/disables the coordinator synchronisation support.
      boolean UdpNmDevErrorDetect: set at pre-compile  # Pre-processor switch for enabling development error detection support.
      boolean UdpNmImmediateRestartEnabled: set at pre-compile  # Pre-processor switch for enabling the asynchronous transmission of a NM PACKET upon bus-communication request in Prepare-Bus-Sleep mode. | Must not be defined if UDPNM_PASSIVE_MODE_ENABLED is defined.
      boolean UdpNmNodeDetectionEnabled: set at pre-compile  # Pre-processor switch for enabling the node detection support. | This parameter shall be derived from NM_NODE_DETECTION_ENABLED. This parameter shall only be enabled if UDPNM_NODE_ID_ENABLED is defined. If(UdpNmPduCbvPosition != UDPNM_PDU_OFF) then Equal(NmNodeDetectionEnabled) else Equal(False).
      boolean UdpNmNodeIdEnabled: set at pre-compile  # Pre-processor switch for enabling the source node identifier. | This parameter shall be derived from NM_NODE_ID_ENABLED.
      integer UdpNmNumberOfChannels: 1..255, set at pre-compile  # Number of NM channels allowed within one ECU.
      boolean UdpNmPassiveModeEnabled: set at pre-compile  # Pre-processor switch for enabling support of the Passive Mode. | This parameter shall be derived from NM_PASSIVE_MODE_ENABLED.
      boolean UdpNmPduRxIndicationEnabled: set at pre-compile  # Pre-processor switch for enabling the PDU Rx Indication. | This parameter shall be derived from NM_PDU_RX_INDICATION_ENABLED.
      boolean UdpNmRemoteSleepIndEnabled: set at pre-compile  # Pre-processor switch for enabling remote sleep indication support. | This feature is required for gateway nodes only. It must not be defined if UDPNM_PASSIVE_MODE_ENABLED is defined. This parameter shall be derived from NM_REMOTE_SLEEP_IND_ENABLED.
      boolean UdpNmRepeatMsgIndEnabled: set at pre-compile  # Enable/disable the notification that a RepeatMessageRequest bit has been received. | This parameter shall be derived from NM_REPEAT_MSG_IND_ENABLED.
      boolean UdpNmStateChangeIndEnabled: set at pre-compile  # Pre-processor switch for enabling the UDP NM state change notification. | This parameter shall be derived from NM_STATE_CHANGE_ID_ENABLED.
      boolean UdpNmUserDataEnabled: set at pre-compile  # Pre-processor switch for enabling user data support. | This parameter shall be derived from NM_USER_DATA_ENABLED.
      boolean UdpNmVersionInfoApi: set at pre-compile  # Pre-processor switch for enabling version info API support.
      container UdpNmChannelConfig [1..*]  # This container contains the channel-specific configuration parameters of the UdpNm.
        integer UdpNmNodeId: 0..255, set at link in variant link-time / pre-compile in variant pre-compile  # Node identifier of local node. | This parameter is only valid if UDPNM_PASSIVE_MODE_ENABLED is set to OFF and UDPNM_NODE_DETECTION_ENABLED is set to ON.
        enumeration UdpNmPduCbvPosition: {UDPNM_PDU_BYTE_0, UDPNM_PDU_BYTE_1, UDPNM_PDU_OFF}, set at link in variant link-time / pre-compile in variant pre-compile  # Defines the position of the control bit vector within the NM PACKET. | The value of the parameter represents the location of the control bit vector in the NM PACKET (UDPNM_PDU_BYTE_0 means byte 0, UDPNM_PDU_BYTE_1 means byte 1, UDPNM_PDU_OFF means the control bit vector is not part of the NM PACKET) See also UDPNM_PDU_NID_POSITION if (UDPNM_PDU_CBV_POSITION != UDPNM_PDU_OFF && UDPNM_PDU_NID_POSITION != UDPNM_PDU_OFF) then UDPNM_PDU_CBV_POSITION != UDPNM_PDU_NID_POSITION if (UDPNM_PDU_CBV_POSITION != UDPNM_PDU_OFF && UDPNM_PDU_NID_POSITION == UDPNM_PDU_OFF) then UDPNM_PDU_CBV_POSITION = UDPNM_PDU_BYTE0
        integer UdpNmPduLength: 0..8, set at link in variant link-time / pre-compile in variant pre-compile  # Defines the length of the NM PACKET in bytes. | Valid values are within the range 0 <= UDPNM_PDU_LENGTH <= 8.
        enumeration UdpNmPduNidPosition: {UDPNM_PDU_BYTE_0, UDPNM_PDU_BYTE_1, UDPNM_PDU_OFF}, set at link in variant link-time / pre-compile in variant pre-compile  # Defines the position of the source node identifier within the NM PACKET. | ImplementationType: UdpNm_PduPositionType The value of the parameter represents the location of the source node identifier in the NM PACKET (UDPNM_PDU_BYTE_0 means byte 0, UDPNM_PDU_BYTE_1 means byte 1, UDPNM_PDU_OFF means source node identifier is not part of the NM PACKET) See also UDPNM_PDU_CBV_POSITION if (UDPNM_PDU_NID_POSITION != UDPNM_PDU_OFF && UDPNM_PDU_CBV_POSITION != UDPNM_PDU_OFF) then UDPNM_PDU_NID_POSITION != UDPNM_PDU_CBV_POSITION if (UDPNM_PDU_NID_POSITION != UDPNM_PDU_OFF && UDPNM_PDU_CBV_POSITION == UDPNM_PDU_OFF) then UDPNM_PDU_IND_POSITION = UDPNM_PDU_BYTE0
        integer UdpNmUserDataLength: 0..8, set at link in variant link-time / pre-compile in variant pre-compile  # Defines the length of the user data contained in the NM PACKET. | The difference between UDPNM_PDU_LENGTH and applied standardized bytes (source node identifier and control bit vector) within the NM PACKET. Valid values are 0x00..0x08.
        float UpdNmMainFunctionPeriod: 0.001..0.255, set at link in variant link-time / pre-compile in variant pre-compile  # Call cycle of UdpNm_MainFunction_x for the respective instance in [s].
        float UpdNmMsgCycleOffset: 0..65.535, set at link in variant link-time / pre-compile in variant pre-compile  # Time offset in the periodic transmission node. It determines the start delay of the transmission. | < UDPNM_MSG_CYCLE_TIME This parameter is only valid if UDPNM_PASSIVE_MODE_ENABLED is disabled.
        float UpdNmMsgCycleTime: 0.001..65.535, set at link in variant link-time / pre-compile in variant pre-compile  # Period of a NM-message. It determines the periodic rate in the "periodic transmission mode with bus load reduction" and is the basis for transmit scheduling in the "periodic transmission mode without bus load reduction". | NM_TIMEOUT_TIME = n * UDPNM_MSG_CYCLE_TIME This parameter is only valid if UDPNM_PASSIVE_MODE_ENABLED is disabled.
        float UpdNmMsgTimeoutTime: 0.001..65.535, set at link in variant link-time / pre-compile in variant pre-compile  # Transmission Timout of NM-message. If there is no transmission confirmation by the UDP Interface within this timeout, the UDPNM module shall gibe an error notification. | This parameter is only valid if UDPNM_PASSIVE_MODE_ENABLED is disabled. UDPNM_MSG_TIMEOUT_TIME should be a multiple of UDPNM_MSG_CYCLE_TIME.
        float UpdNmRemoteSleepIndTime: 0.001..65.535, set at link in variant link-time / pre-compile in variant pre-compile  # Timeout for Remote Sleep Indication. | It defines the time in [s] how long it shall take to recognize that all other nodes are ready to sleep. Typically it should be equal to: n * UDPNM_MSG_CYCLE_TIME, where n denotes the number of NM packets that are normally sent before Remote Sleep Indication is detected. The value of n decremented by one determines the amount of lost NM packets that can be tolerated by the Remote Sleep Indication procedure.
        float UpdNmRepeatMessageTime: 0..65.535, set at link in variant link-time / pre-compile in variant pre-compile  # Timeout for Repeat Message State. | It defines the time in [s] how long the NM shall stay in the Repeat Message State. Typically it should be equal to: n * UDPNM_MSG_CYCLE_TIME, where n denotes the number of NM packets that are normally sent in the Repeat Message State. The value of n decremented by one determines the amount of lost NM packets that can be tolerated by the node detection procedure. The value 0 denotes that no Repeat Message State is configured. It means that Repeat Message State is transient what implicates that it is left immediately after entrance and in result no start-up stability is guaranteed and no node detection procedure is possible.
        float UpdNmTimeoutTime: 0.002..65.535, set at link in variant link-time / pre-compile in variant pre-compile  # Network Timeout for NM packets. | It denotes the time in [s] how long the NM shall stay in the Network Mode before transition into Prepare Bus-Sleep Mode shall take place. It shall be equal for all nodes in the cluster. It shall be greater than UDPNM_MSG_CYCLE_TIME. Typically, it should be equal to: x * UDPNM_MSG_CYCLE_TIME, where n denotes the number of NM PACKET cycle times in the Ready Sleep State before transition into the Bus-Sleep Mode is initiated. The value of n decremented by one determines the amount of lost NM packets that can be tolerated by the coordination algorithm.
        float UpdNmWaitBusSleepTime: 0.001..65.535, set at link in variant link-time / pre-compile in variant pre-compile  # Timeout for bus calm down phase. | It denotes the time in [s] how long the NM shall stay in the Prepare Bus-Sleep Mode before transition into Bus-Sleep Mode shall take place. It shall be equal for all nodes in the cluster. It shall be long enough to empty all Tx-buffer empty.
        symbolic name reference UdpNmComMNetworkHandleRef: set at link in variant link-time / pre-compile in variant pre-compile, destination=ComMChannel  # This reference points to the unique channel defined by the ComMChannel and provides access to the unique channel index value in ComMChannelId.
        container UdpNmRxPdu [0..*]  # This container describes the UdpNm RX PDU's.
          integer UdpNmRxPduId: 0..4294967296, set at pre-compile, symbolic-name-value=true  # ID of the RxPdu that will be used by a RxIndication of the lower layer.
          reference UdpNmRxPduRef: set at link in variant link-time / pre-compile in variant pre-compile, destination=Pdu  # The reference to a PDU in the global PDU structure described in the AUTOSAR ECU Configuration Specification. This reference will be used by the UdpNm module to derive the PDU Id.
        container UdpNmTxPdu [0..*]  # This container describes the UdpNm TX PDU's.
          integer UdpNmTxConfirmationPduId: 0..4294967296, set at pre-compile, symbolic-name-value=true  # Id of the TxPdu that will be used by a TxConfirmation from the lower layer.
          reference UdpNmTxPduRef: set at link in variant link-time / pre-compile in variant pre-compile, destination=Pdu  # The reference to a PDU in the global PDU structure described in the AUTOSAR ECU Configuration Specification. This reference will be used by the UdpNm module to derive the PDU Id.
        container UdpNmUserDataTxPdu [0..1]  # This optional container is used to configure the UserNm PDU. This container is only available if UdpNmComUserDataSupport is enabled.
          integer UdpNmTxUserDataPduId: 0..65535, set at link in variant link-time / pre-compile in variant pre-compile, symbolic-name-value=true  # This parameter defines the Handle ID of the NM User Data I-PDU.
          reference UdpNmTxUserDataPduRef: set at link in variant link-time / pre-compile in variant pre-compile, destination=Pdu  # Reference to the NM User Data I-PDU in the global PDU collection.
      container UdpNmDemEventParameterRefs [0..1]  # Container for the references to DemEventParameter elements which shall be invoked using the API Dem_ReportErrorStatus API in case the corresponding error occurs. The EventId is taken from the referenced DemEventParameter's DemEventId value. The standardized errors are provided in the container and can be extended by vendor specific error references.
        symbolic name reference UDPNM_E_INIT_FAILED [0..1]: set at pre-compile, destination=DemEventParameter  # Reference to the DemEventParameter which shall be issued when the error "UdpNm initialization has failed, e.g. selected configuration set doesn't exist" has occured.
        symbolic name reference UDPNM_E_NETWORK_TIMEOUT [0..1]: set at pre-compile, destination=DemEventParameter  # Reference to the DemEventParameter which shall be issued when the error "NM-Timeout Timer has abnormally expired outside of the Ready Sleep State" has occured.
        symbolic name reference UDPNM_E_TCPIP_TRANSMIT_ERROR [0..1]: set at pre-compile, destination=DemEventParameter  # Reference to the DemEventParameter which shall be issued when the error "A call to the TCP/IP stack has failedA call to the TCP/IP stack has failed" has occured.
  module definition Wdg [0..*]: variants link-time/post-build/pre-compile  # Configuration of the Wdg (Watchdog driver) module.
    container WdgDemEventParameterRefs [0..1]  # Container for the references to DemEventParameter elements which shall be invoked using the API Dem_ReportErrorStatus in case the corresponding error occurs. The EventId is taken from the referenced DemEventParameter's DemEventId value. | The standardized errors are provided in the container and can be extended by vendor-specific error references.
      symbolic name reference WDG_E_DISABLE_REJECTED [0..1]: set at pre-compile, destination=DemEventParameter  # Reference to the DemEventParameter which shall be issued when the error "Initialization or mode switch failed because it would disable the watchdog" has occurred.
      symbolic name reference WDG_E_MODE_FAILED [0..1]: set at pre-compile, destination=DemEventParameter  # Reference to the DemEventParameter which shall be issued when the error "Setting a watchdog mode failed (during initialization or mode switch)" has occurred.
    container WdgGeneral  # All general parameters of the watchdog driver are collected here.
      boolean WdgDevErrorDetect: set at pre-compile  # Compile switch to enable / disable development error detection for this module. | True: Development error detection enabled False: Development error detection disabled
      boolean WdgDisableAllowed: set at pre-compile  # Compile switch to allow / forbid disabling the watchdog driver during runtime. | True: Disabling the watchdog driver at runtime is allowed. False: Disabling the watchdog driver at runtime is not allowed.
      integer WdgIndex: 0..255, set at pre-compile, symbolic-name-value=true  # Represents the watchdog driver's ID so that it can be referenced by the watchdog interface.
      float WdgInitialTimeout: 0..65.535, set at pre-compile  # The initial timeout (sec) for the trigger condition to be initialized during Init function. It shall be not larger than WdgMaxTimeout.
      float WdgMaxTimeout: 0..65.535, set at pre-compile  # The maximum timeout (sec) to which the watchdog trigger condition can be initialized.
      enumeration WdgRunArea: {RAM, ROM}, set at pre-compile  # Represents the watchdog driver execution area is either from ROM(Flash) or RAM as required with the particular microcontroller.
      function name WdgTriggerLocation: set at pre-compile  # Location (memory address) of the watchdog trigger routine.
      boolean WdgVersionInfoApi: set at pre-compile  # Compile switch to enable / disable the version information API | * True: API enabled * False: API disabled
    container WdgPublishedInformation  # Container holding all Wdg specific published information parameters
      enumeration WdgTriggerMode: {WDG_BOTH, WDG_TOGGLE, WDG_WINDOW}, set at published-information  # Watchdog trigger mode (toggle/window/both)
    container WdgSettingsConfig: multiple-configuration-container=true  # Configuration items for the different watchdog settings, including those for external watchdog hardware. | Note: All postbuild parameters are handled via this container.
      enumeration WdgDefaultMode: {WDGIF_FAST_MODE, WDGIF_OFF_MODE, WDGIF_SLOW_MODE}, set at link in variant link-time / post-build in variant post-build / pre-compile in variant pre-compile  # Default mode for watchdog driver initialization. | ImplementationType: WdgIf_ModeType
      container WdgExternalConfiguration [0..1]  # Configuration items for an external watchdog hardware
        choice reference WdgExternalContainerRef [0..1]: set at link in variant link-time / post-build in variant post-build / pre-compile in variant pre-compile, destination=[DioChannelGroup, SpiSequence]  # Reference to either | - a DioChannelGroup container in case the hardware watchdog is connected via DIO pins - an SpiSequenceConfiguration container in case the watchdog hardware is accessed via SPI
      container WdgSettingsFast  # Hardware dependent settings for the watchdog driver's "fast" mode.
      container WdgSettingsOff  # Hardware dependent settings for the watchdog driver's "off" mode.
      container WdgSettingsSlow  # Hardware dependent settings for the watchdog driver's "slow" mode.
  module definition WdgIf [0..1]: variants pre-compile  # Configuration of the WdgIf (Watchdog Interface) module.
    container WdgIfDevice [1..*]  # It contains the information for the selection of a particular Watchdog device in case multiple Watchdog drivers are connected.
      integer WdgIfDeviceIndex: 0..255, set at pre-compile, symbolic-name-value=true  # Represents the watchdog interface ID so that it can be referenced by the watchdog manager.
      symbolic name reference WdgIfDriverRef: set at pre-compile, destination=WdgGeneral  # Reference to the watchdog drivers that are controlled by the watchdog interface.
    container WdgIfGeneral  # This container collects all generic watchdog interface parameters.
      boolean WdgIfDevErrorDetect: set at pre-compile  # Pre-processor switch for enabling the development error detection and reporting. | true: Development error detection enabled false: Development error detection disabled
      boolean WdgIfVersionInfoApi: set at pre-compile  # Pre-processor switch to enable / disable the service returning the version information. | true: Version information service enabled false: Version information service disabled
  module definition WdgM [0..1]: variants post-build/pre-compile  # Configuration of the WdgM (Watchdog Manager) module.
    container WdgMConfigSet: multiple-configuration-container=true  # This container describes one of multiple configuration sets of WdgM. | This is a MultipleConfigurationContainer, i.e. this container and its sub-containers exist once per configuration set.
      symbolic name reference WdgMInitialMode: set at post-build in variant post-build / pre-compile in variant pre-compile, destination=WdgMMode  # The mode that the Watchdog Manager is in after it has been initialized.
      container WdgMDemEventParameterRefs [0..1]  # Container for the references to DemEventParameter elements which shall be invoked using the API Dem_ReportErrorStatus API in case the corresponding error occurs. The EventId is taken from the referenced DemEventParameter's DemEventId value. The standardized errors are provided in the container and can be extended by vendor specific error references.
        symbolic name reference WDGM_E_IMPROPER_CALLER [0..1]: set at post-build in variant post-build / pre-compile in variant pre-compile, destination=DemEventParameter  # Reference to the DemEventParameter which shall be issued when the defensive behavior checks have detected an improper caller.
        symbolic name reference WDGM_E_MONITORING [0..1]: set at post-build in variant post-build / pre-compile in variant pre-compile, destination=DemEventParameter  # Reference to the DemEventParameter which shall be issued when the error "Monitoring has failed and a watchdog reset will occur" has occured.
        symbolic name reference WDGM_E_SET_MODE [0..1]: set at post-build in variant post-build / pre-compile in variant pre-compile, destination=DemEventParameter  # Reference to the DemEventParameter which shall be issued when the error "Watchdog drivers' mode switch has failed" has occured.
      container WdgMMode [1..255]  # The container describes one of several modes of the Watchdog Manager.
        integer WdgMExpiredSupervisionCycleTol: 0..65535, set at post-build in variant post-build / pre-compile in variant pre-compile  # This parameter shall be used to define a value that fixes the amount of expired supervision cycles for how long the blocking of watchdog triggering shall be postponed, AFTER THE GLOBAL SUPERVISION STATUS HAS REACHED THE STATE EXPIRED.
        integer WdgMModeId: 0..255, set at post-build in variant post-build / pre-compile in variant pre-compile, symbolic-name-value=true  # This parameter fixes the identfier for the mode. This identifier is for instance passed as a parameter to the WdgM_SetMode service.
        float WdgMSupervisionCycle: 0..Inf, set at post-build in variant post-build / pre-compile in variant pre-compile  # This parameter defines the schedule period of the main function WdgM_MainFunction. | Unit: [s]
        container WdgMAliveSupervision [0..65535]  # This container collects all configuration parameters of Alive-Supervision of one Checkpoint. Note that each Checkpoint may have different parameters. For example, it may have different min and max margin.
          integer WdgMExpectedAliveIndications: 0..65535, set at post-build in variant post-build / pre-compile in variant pre-compile  # This parameter contains the amount of expected alive indications of the Checkpoint within the referenced amount of defined supervision cycles according to corresponding SE.
          integer WdgMMaxMargin: 0..255, set at post-build in variant post-build / pre-compile in variant pre-compile  # This parameter contains the amount of alive indications of the Checkpoint that are acceptable to be additional to the expected alive indications within the corresponding supervision reference cycle.
          integer WdgMMinMargin: 0..255, set at post-build in variant post-build / pre-compile in variant pre-compile  # This parameter contains the amount of alive indications of the Checkpoint that are acceptable to be missed from the expected alive indications within the corresponding supervision reference cycle.
          integer WdgMSupervisionReferenceCycle: 1..65535, set at post-build in variant post-build / pre-compile in variant pre-compile  # This parameter shall contain the amount of supervision cycles to be used as reference by the alive-supervision mechanism to perform the checkup with counted alive indications according to corresponding SE.
          symbolic name reference WdgMAliveSupervisionCheckpointRef: set at post-build in variant post-build / pre-compile in variant pre-compile, destination=WdgMCheckpoint  # Reference to Checkpoint within a Supervised Entity that shall be supervised.
        container WdgMDeadlineSupervision [0..65535]  # This container collects all configuration parameters for Deadline Supervision for a Supervised Entity.
          float WdgMDeadlineMax: 0..Inf, set at post-build in variant post-build / pre-compile in variant pre-compile  # This parameter contains the longest time span after which the deadline is considered to be met. | Unit: [s]
          float WdgMDeadlineMin: 0..Inf, set at post-build in variant post-build / pre-compile in variant pre-compile  # This parameter contains the shortest time span after which the deadline is considered to be met. | Unit: [s]
          symbolic name reference WdgMDeadlineStartRef: set at post-build in variant post-build / pre-compile in variant pre-compile, destination=WdgMCheckpoint  # This is the reference to the start Checkpoint for Deadline Supervision.
          symbolic name reference WdgMDeadlineStopRef: set at post-build in variant post-build / pre-compile in variant pre-compile, destination=WdgMCheckpoint  # This is the reference to the stop Checkpoint for Deadline Supervision.
        container WdgMExternalLogicalSupervision [0..65535]  # This container collects all configuration parameters for Logical Supervision for one external graph.
          symbolic name reference WdgMExternalCheckpointFinalRef [1..65535]: set at post-build in variant post-build / pre-compile in variant pre-compile, destination=WdgMCheckpoint  # This is the reference to the final Checkpoint(s) for this External Graph.
          symbolic name reference WdgMExternalCheckpointInitialRef [1..65535]: set at post-build in variant post-build / pre-compile in variant pre-compile, destination=WdgMCheckpoint  # This is the reference to the initial Checkpoint(s) for this External Graph.
          container WdgMExternalTransition [0..65535]  # This container collects the Checkpoints for an External Transition across Supervised Entities.
            symbolic name reference WdgMExternalTransitionDestRef: set at post-build in variant post-build / pre-compile in variant pre-compile, destination=WdgMCheckpoint  # This is the reference to the destination Checkpoint of an External Transition.
            symbolic name reference WdgMExternalTransitionSourceRef: set at post-build in variant post-build / pre-compile in variant pre-compile, destination=WdgMCheckpoint  # This is the reference to the source Checkpoint of an External Transition.
        container WdgMLocalStatusParams [0..65535]  # This container collects all configuration parameters for the Local Status of a Supervised Entity.
          integer WdgMFailedAliveSupervisionRefCycleTol: 0..255, set at post-build in variant post-build / pre-compile in variant pre-compile  # This parameter shall contain the acceptable amount of reference cycles with incorrect/failed alive supervisions for this Supervised Entity.
          symbolic name reference WdgMLocalStatusSupervisedEntityRef: set at post-build in variant post-build / pre-compile in variant pre-compile, destination=WdgMSupervisedEntity  # This is the reference to the Supervised Entity for which the Local Status parameters are specified.
        container WdgMTrigger [0..255]  # This container collects all configuration parameters for the triggering of hardware watchdogs.
          integer WdgMTriggerConditionValue: 1..65535, set at post-build in variant post-build / pre-compile in variant pre-compile  # This parameter shall contain the value that is passed to WdgIf_SetTriggerCondition for this watchdog.
          enumeration WdgMWatchdogMode: {WDGIF_FAST_MODE, WDGIF_OFF_MODE, WDGIF_SLOW_MODE}, set at post-build in variant post-build / pre-compile in variant pre-compile  # This parameter contains the watchdog mode that shall be used for the referenced watchdog in this Watchdog Manager mode. | Implementation Type: WdgIf_ModeType
          symbolic name reference WdgMTriggerWatchdogRef: set at post-build in variant post-build / pre-compile in variant pre-compile, destination=WdgMWatchdog  # This parameter is a reference to the configured watchdog.
    container WdgMGeneral  # Container defines all general configuration parameters of the Watchdog Manager.
      boolean WdgMDefensiveBehavior: set at pre-compile, default-value=false  # Preprocessor switch to enable/disable the defensive behavior of the Watchdog Manager module.
      boolean WdgMDemStoppedSupervisionReport: set at pre-compile  # Parameter to enable/disable the error reporting to DEM. | true: A notification to DEM is sent if the Watchdog Manager reaches the state WDGM_GLOBAL_STATUS_STOPPED. false: The notification is disabled.
      boolean WdgMDevErrorDetect: set at pre-compile  # Preprocessor switch to enable/disable development error detection and reporting. | Shall be used to remove unneeded code segments regarding DET features true: Development error detection is enabled false: Development error detection is disabled
      boolean WdgMImmediateReset: set at pre-compile  # This parameter enables/disablse the immediate reset feature in case of alive-supervision failure. | true: Immediate reset is enabled false: Immediate reset is disabled
      boolean WdgMOffModeEnabled: set at pre-compile  # This parameter enables/disables the selection of the "OffMode" of the watchdog driver. | true: "OffMode" selection is allowed false: "OffMode" selection is disallowed
      boolean WdgMVersionInfoApi: set at pre-compile  # Preprocessor switch to enable/disable the existence of the API WdgM_GetVersionInfo. Shall be used to remove unneeded code segments. | true: API is enabled false: API is disabled
      container WdgMCallerIds [0..1]  # Contains the definition of valid CallerIds for the callers who have permission to call the function WdgM_SetMode.
        integer WdgMCallerId [0..255]: 0..65535, set at pre-compile  # This parameter defines one valid CallerId for the callers who have permission to call the function WdgM_SetMode.
      container WdgMSupervisedEntity [0..65535]  # This container collects all common (mode-independent) parameters of a Supervised Entity to be supervised by the Watchdog Manager.
        integer WdgMSupervisedEntityId: 0..65535, set at pre-compile, symbolic-name-value=true  # This parameter shall contain the unique identifier of the supervised entity.
        reference WdgMEcucPartitionRef [0..1]: set at pre-compile, destination=EcucPartition  # Denotes in which "EcucPartition" the supervised entity is executed. When the partition is stopped, the supervised entity shall be de-activated in the WdgM to avoid an ECU reset.
        reference WdgMOsApplicationRef [0..1]: set at pre-compile, destination=OsApplication  # Optional reference to an OS Application. Beware, the Watchdog Manager module will trigger a partition restart of this OS Application when the corresponding Supervised Entity reaches WDGM_LOCAL_STATUS_FAILED.
        symbolic name reference WdgMInternalCheckpointInitialRef: set at pre-compile, destination=WdgMCheckpoint  # This is the reference to the initial Checkpoint for this Supervised Entity.
        symbolic name reference WdgMInternallCheckpointFinalRef [1..65535]: set at pre-compile, destination=WdgMCheckpoint  # This is the reference to the final Checkpoint(s) for this Supervised Entity.
        container WdgMCheckpoint [1..65535]  # This container collects all Checkpoints of this Supervised Entity. Each Supervised Entity has at least one Checkpoint.
          integer WdgMCheckpointId: 0..65535, set at pre-compile, symbolic-name-value=true  # This parameter shall contain the unique identifier of Checkpoint.
        container WdgMInternalTransition [0..65535]  # This container defines the graph of Internal Transitions within this Supervised Entity.
          symbolic name reference WdgMInternalTransitionDestRef: set at pre-compile, destination=WdgMCheckpoint  # This is the reference to the destination Checkpoint of a Internal Transition within this Supervised Entity.
          symbolic name reference WdgMInternalTransitionSourceRef: set at pre-compile, destination=WdgMCheckpoint  # This is the reference to the source Checkpoint of a Internal Transition within this Supervised Entity.
      container WdgMWatchdog [0..255]  # This container collects all common (mode-independent) parameters of a Watchdog to be triggered by the Watchdog Manager.
        string WdgMWatchdogName: set at pre-compile, symbolic-name-value=true  # This parameter shall contain the symbolic name of the watchdog instance.
        symbolic name reference WdgMWatchdogDeviceRef: set at pre-compile, destination=WdgIfDevice  # Reference to one device container of Watchdog Interface. In the referenced container WdgIfDevice, the parameter WdgIfDeviceIndex contains the Index parameter that WdgM has to use for WdgIf_SetTriggerCondition calls for that watchdog instance.
  module definition Xcp [0..1]: variants post-build/pre-compile  # Configuration of the XCP module
    container XcpConfig: multiple-configuration-container=true
      container XcpDaqList [1..*]  # This container contains the configuration of the DAQs.
        integer XcpDaqListNumber: 0..65534, set at pre-compile, symbolic-name-value=true  # Index number of the DAQ list
        enumeration XcpDaqListType: {DAQ, DAQ_STIM, STIM}, set at pre-compile  # This indicates whether this DAQ list represents a DAQ or a STIM.
        integer XcpMaxOdt: 0..252, set at pre-compile  # MAX_ODT indicates the maximum amount of ODTs in this DAQ list | (STATIC configuration)
        integer XcpMaxOdtEntries: 0..255, set at pre-compile  # This parameter indicates the maximum amount of entries in an ODT of this DAQ list (STATIC configuration).
        container XcpDto [0..*]  # This container collects data transfer object specific parameters for the DAQ list.
          integer XcpDtoPid: 0..251, set at pre-compile, symbolic-name-value=true  # Packet identifier (PID) of the DTO that identifies the ODT the content of the DTO.
          choice reference XcpDto2PduMapping: set at pre-compile, destination=[XcpRxPdu, XcpTxPdu]  # This reference specifies the mapping of the DTO to the PDUs from the lower-layer interfaces (CanIf, FrIf, SoAd and Cdd). | A reference to a XcpRxPdu is only feasible if the the DaqListType is DAQ_STIM. A reference to a XcpTxPdu is only feasible if the DaqListType is DAQ.
        container XcpOdt [1..*]  # This container contains ODT-specific parameter for the DAQ list.
          integer XcpOdtEntryMaxSize: 0..254, set at pre-compile  # This parameter indicates the upper limit for the size of the element described by an ODT entry. Depending on the DaqListType this ODT belongs to it describes the limit for a DAQ (MAX_ODT_ENTRY_SIZE_DAQ) or a STIM (MAX_ODT_ENTRY_SIZE_STIM).
          integer XcpOdtNumber: 0..251, set at pre-compile, symbolic-name-value=true  # Index number of this ODT within the DAQ list.
          reference XcpOdt2DtoMapping: set at pre-compile, destination=XcpDto  # This reference maps the ODT to the according DTO in which it will be transmitted.
          container XcpOdtEntry [1..*]  # This container collects all configuration parameters that comprise an ODT entry.
            linker symbol XcpOdtEntryAddress: set at pre-compile  # Memory address that the ODT entry is referencing to.
            integer XcpOdtEntryLength: 0..255, set at pre-compile  # Length of the referenced memory area that is referenced by the ODT entry.
            integer XcpOdtEntryNumber: 0..254, set at pre-compile  # Index number of the ODT entry
      container XcpDemEventParameterRefs [0..1]  # Container for the references to DemEventParameter elements which shall be invoked using the API Dem_ReportErrorStatus API in case the corresponding error occurs. The EventId is taken from the referenced DemEventParameter's DemEventId value. The standardized errors are provided in the container and can be extended by vendor specific error references.
        symbolic name reference XCP_E_INIT_FAILED [0..1]: set at post-build in variant post-build / pre-compile in variant pre-compile, destination=DemEventParameter  # Reference to the DemEventParameter which shall be issued when the error "Initialization of XCP failed" has occured.
      container XcpEventChannel [1..*]  # This container contains the configuration of event channels on the XCP slave.
        enumeration XcpEventChannelConsistency: {DAQ, EVENT, ODT}, set at pre-compile, default-value=ODT  # Type of consistency used by event channel
        integer XcpEventChannelMaxDaqList: 0..255, set at pre-compile  # Maximum amount of DAQ lists that are handled by this event channel.
        integer XcpEventChannelNumber: 0..65534, set at pre-compile, symbolic-name-value=true  # Index number of the event channel.
        integer XcpEventChannelPriority: 0..255, set at pre-compile  # Priority of the event channel
        integer XcpEventChannelTimeCycle: 0..255, set at pre-compile  # The event channel time cycle indicates which sampling period is used to process this event channel. A value of 0 means 'Not cyclic'.
        enumeration XcpEventChannelTimeUnit [0..1]: {TIMESTAMP_UNIT_100MS, TIMESTAMP_UNIT_100NS, TIMESTAMP_UNIT_100PS, TIMESTAMP_UNIT_100US, TIMESTAMP_UNIT_10MS, TIMESTAMP_UNIT_10NS, TIMESTAMP_UNIT_10PS, TIMESTAMP_UNIT_10US, TIMESTAMP_UNIT_1MS, TIMESTAMP_UNIT_1NS, TIMESTAMP_UNIT_1PS, TIMESTAMP_UNIT_1S, TIMESTAMP_UNIT_1US}, set at pre-compile  # This configuration parameter indicates the unit of the event channel time cycle.
        enumeration XcpEventChannelType: {DAQ, DAQ_STIM, STIM}, set at pre-compile, default-value=DAQ  # This configuration parameter indicates what kind of DAQ list can be allocated to this event channel.
        reference XcpEventChannelTriggeredDaqListRef [1..*]: set at pre-compile, destination=XcpDaqList  # References all DAQ lists that are trigged by this event channel.
      choice container XcpPdu [1..*]  # Contains PDU information. A PDU may be either a transmission PDU or a reception PDU.
        container XcpRxPdu [0..1]  # This container specifies received PDUs.
          integer XcpRxPduId: 0..65535, set at pre-compile, symbolic-name-value=true  # ID of the PDU that will be received via a Xcp_<module>RxIndication.
          reference XcpRxPduRef: set at post-build in variant post-build / pre-compile in variant pre-compile, destination=Pdu
        container XcpTxPdu [0..1]  # This container specifies transmission PDUs.
          integer XcpTxPduId: 0..65535, set at pre-compile, symbolic-name-value=true  # The PDU identifier, which has to be used by the lower layer BSW module for TxConfirmations or TriggerTransmits.
          reference XcpTxPduRef: set at post-build in variant post-build / pre-compile in variant pre-compile, destination=Pdu  # Reference to the external PDU definition.
    container XcpGeneral  # This container contains the general configuration parameters of the XCP.
      enumeration XcpDaqConfigType: {DAQ_DYNAMIC, DAQ_STATIC}, set at pre-compile  # Sets the DAQ_CONFIG_TYPE bit within the DAQ_PROPERTIES parameter to "static" or to "dynamic". If DAQ_STATIC is selected, the DAQ_CONFIG_TYPE bit is set to "0". If DAQ_DYNAMIC is selected, the DAQ_CONFIG_TYPE bit is set to "1".
      integer XcpDaqCount: 0..65535, set at pre-compile  # Indicates the number of DAQ lists for dynamic configuration.
      boolean XcpDevErrorDetect: set at pre-compile  # Switches the Development Error Detection and Notification on or off. | TRUE: Development Error Detection and Notificiation on FALSE: Development Error Detection and Notification off
      enumeration XcpIdentificationFieldType: {ABSOLUTE, RELATIVE_BYTE, RELATIVE_WORD, RELATIVE_WORD_ALIGNED}, set at pre-compile  # Type of Identification Field the slave will use when transferring DAQ Packets to the master. The master has to use the same Type of Identification Field when transferring STIM Packets to the slave.
      float XcpMainFunctionPeriod: 0..Inf, set at pre-compile  # The XCP does not require this information but the BSW scheduler, which invokes the main function, needs it in order to plan its tasks.
      integer XcpMaxCto: 8..255, set at pre-compile  # MAX_CTO shows the maximum length of a CTO packet in bytes.
      integer XcpMaxDto: 8..65535, set at pre-compile  # MAX_DTO shows the maximum length of a DTO packet in bytes.
      integer XcpMaxEventChannel: 0..65535, set at pre-compile
      integer XcpMinDaq: 0..255, set at pre-compile  # Indicates the number of predefined, read only DAQ lists on the XCP slave.
      integer XcpOdtCount: 0..252, set at pre-compile  # This parameter indicates the amount of ODTs of a DAQ list using dynamic DAQ list configuration.
      integer XcpOdtEntriesCount: 0..255, set at pre-compile  # Indicates the amount of entries into an ODT using dynamic DAQ list configuration.
      integer XcpOdtEntrySizeDaq: 0..255, set at pre-compile  # Indicates the size of an element described by an ODT entry to the DaqListType for a DAQ.
      integer XcpOdtEntrySizeStim: 0..255, set at pre-compile  # Indicates the size of an element described by an ODT entry to the DaqListType for a stim.
      boolean XcpOnCanEnabled: set at pre-compile  # Enabling of XCPonCAN functionality
      boolean XcpOnCddEnabled: set at pre-compile  # Enabling of XCPonCdd functionality
      boolean XcpOnEthernetEnabled: set at pre-compile  # Enabling of XCPonEthernet functionality
      boolean XcpOnFlexRayEnabled: set at pre-compile  # Enabling of XCPonFlexRay functionality
      boolean XcpPrescalerSupported: set at pre-compile  # This parameter enables and disables the support for Prescaler support. True is Enabled, False is disabled
      boolean XcpSuppressTxSupport: set at pre-compile  # Switches the support of suppressing transmission of PDUs per communication channel on or off. | TRUE: Suppressing of TxPDUs supported FALSE: Suppressing of TxPDUs not supported
      integer XcpTimestampTicks: 0..65535, set at pre-compile  # This parameter defines the timestamp that will increment based TIMESTAMP_TICKS per unit and wrap around if an overflow occurs.
      enumeration XcpTimestampType: {FOUR_BYTE, NO_TIME_STAMP, ONE_BYTE, TWO_BYTE}, set at pre-compile  # This parameter indicates the number of bytes used for the timestamp field. In case No_TIME_STAMP is selected the timestamp field is not available.
      enumeration XcpTimestampUnit: {TIMESTAMP_UNIT_100MS, TIMESTAMP_UNIT_100NS, TIMESTAMP_UNIT_100PS, TIMESTAMP_UNIT_100US, TIMESTAMP_UNIT_10MS, TIMESTAMP_UNIT_10NS, TIMESTAMP_UNIT_10PS, TIMESTAMP_UNIT_10US, TIMESTAMP_UNIT_1MS, TIMESTAMP_UNIT_1NS, TIMESTAMP_UNIT_1PS, TIMESTAMP_UNIT_1S, TIMESTAMP_UNIT_1US}, set at pre-compile  # This parameter indicates the resolution of the data acquisition clock of the slave when transferring data to master.
      boolean XcpVersionInfoApi: set at pre-compile  # Enables/disables the existence of the XCP_GetVersionInfo() API service. | TRUE: XCP_GetVersionInfo() API service exists FALSE: XCP_GetVersionInfo() API service does not exist
      reference XcpCounterRef: set at pre-compile, destination=OsCounter  # This parameter contains a reference to the counter, which is used by XCP.
