[part 3 of 6: package /AUTOSAR/EcucDefs]
AUTOSAR XML (schema 4-0-3)
package /AUTOSAR/EcucDefs  (continued)
  module definition Dem [0..1]: variants post-build/pre-compile  # Configuration of the Dem (Diagnostic Event Manager) module.
    container DemConfigSet: multiple-configuration-container=true  # This container contains the configuration parameters and sub containers of the Dem module supporting multiple configuration sets. This container is a MultipleConfigurationContainer, i.e. this container and its sub-containers exist once per configuration set.
      container DemDTCClass [0..65535]  # This container contains the configuration (parameters) for DTCClass.
        integer DemDTCFunctionalUnit [0..1]: 0..255, set at pre-compile  # DTCFuncitonalUnit is a 1-byte value which identifies the corresponding basic vehicle / system function which reports the DTC. This parameter is necessary for the report of severity information. | If this parameter is configured for no DTC, the Dem provides no DTC functional unit information.
        enumeration DemDTCSeverity [0..1]: {DEM_DTC_SEV_CHECK_AT_NEXT_HALT, DEM_DTC_SEV_IMMEDIATELY, DEM_DTC_SEV_MAINTENANCE_ONLY, DEM_DTC_SEV_NO_SEVERITY}, set at pre-compile, default-value=DEM_DTC_SEV_NO_SEVERITY  # DTC severity according to ISO 14229-1. This parameter depends on the automotive manufacturer. | If it is not configured, the value is counted as 'no severity'. If this parameter is configured for no DTC, the Dem provides no DTC severity information.
        boolean DemImmediateNvStorage: set at pre-compile  # Switch to enable immediate storage triggering of an according event memory entriy persistently to NVRAM. | true: immediate non-volatile storage triggering enabled false: immediate non-volatile storage triggering disabled
        integer DemJ1939DTC [0..1]: 1..16777214, set at post-build in variant post-build / pre-compile in variant pre-compile  # Unique Diagnostic Trouble Code value for J1939 (consiting of SPN and FMI)
        integer DemObdDTC [0..1]: 1..65535, set at post-build in variant post-build / pre-compile in variant pre-compile  # Unique Diagnostic Trouble Code value for OBD
        integer DemUdsDTC [0..1]: 1..16777214, set at post-build in variant post-build / pre-compile in variant pre-compile  # Unique Diagnostic Trouble Code value for UDS | (Range: 0x000000 and 0xFFFFFF are reserved for DTC groups by ISO 14229-1)
        reference DemJ1939DTC_NodeAddressRef [0..1]: set at post-build in variant post-build / pre-compile in variant pre-compile, destination=DemJ1939NodeAddress  # Reference to a J1939 NodeAddress
        container DemCallbackInitMForF [0..*]  # In case the container has a DemCallbackInitMForFFnc, this parameter defines the name of the function that the Dem will call. In case there is no DemCallbackInitMForFFnc, the Dem will have an R-Port requiring the interface CallbackInitMonitorForFunction, whose name is generated by using the unique callback-prefix followed by the event name.
          function name DemCallbackInitMForFFnc [0..1]: set at pre-compile  # Function name of prototype "InitMonitorForFunction".
      container DemDtr [0..1]  # This container holds the configuration of one individual DTR.
        float DemDtrCompuDenominator0: set at pre-compile  # Part of the conversion between the binary representation and the physical meaning analogous to the SW-C Template conversion CompuRationalCoeffs with 2 numerator coefficients and 1 denominator coefficient in the direction compuInternalToPhys. | This is the only one supported denominator value, a constant divisor. The value 0 is not allowed.
        float DemDtrCompuNumerator0: set at pre-compile  # Part of the conversion between the binary representation and the physical meaning analogous to the SW-C Template conversion CompuRationalCoeffs with 2 numerator coefficients and 1 denominator coefficient in the direction compuInternalToPhys. | This is the first numerator value, which is multiplied with x^0, i.e., the offset.
        float DemDtrCompuNumerator1: set at pre-compile  # Part of the conversion between the binary representation and the physical meaning analogous to the SW-C Template conversion CompuRationalCoeffs with 2 numerator coefficients and 1 denominator coefficient in the direction compuInternalToPhys. | This is the second numerator value, which is multiplied with x^1, i.e., the factor.
        integer DemDtrId: 0..65535, set at pre-compile, symbolic-name-value=true  # The index identifier value assigned to this DTR. The value is generated during the Dem configuration process.
        integer DemDtrMid: 0..255, set at post-build in variant post-build / pre-compile in variant pre-compile  # The OBDMID of the DTR. | The values 0x00, 0x20, 0x40, 0x60, 0x80, 0xA0, 0xC0, 0xE0 are reserved.
        integer DemDtrTid: 0..255, set at post-build in variant post-build / pre-compile in variant pre-compile  # The OBDTID of the DTR.
        integer DemDtrUasid: 0..255, set at post-build in variant post-build / pre-compile in variant pre-compile  # The UaSId the DTR data shall be scaled to, and reported together with the rescaled DTR data.
        enumeration DemDtrUpdateKind [0..1]: {DEM_DTR_UPDATE_ALWAYS, DEM_DTR_UPDATE_STEADY}, set at pre-compile  # Update conditions applied by the Dem to reports of DTR values. Only supported if a related Event is configured. If no related Event is configured, the Dem behaves as if DemDtrUpdateKind is configured to "DEM_DTR_UPDATE_ALWAYS".
        reference DemDtrEventRef [0..1]: set at pre-compile, destination=DemEventParameter  # Reference to the DemEventParameter this DTR is related to. If the related event is not configured, the Dem cannot ensure consistency between the DTR and the event.
      container DemEventParameter [1..65535]  # This container contains the configuration (parameters) for events. | Note that this container definition does not explicitly define a symbolic name parameter. Instead, the short name of the container will be used in the Ecu Configuration Description to specify the symbolic name of the diagnostic event.
        boolean DemEventAvailable: set at post-build in variant post-build / pre-compile in variant pre-compile  # This parameter configures an Event as unavailable. | It is treated by Dem as if it does not exist. true = Event is available false = Event is not available
        integer DemEventId: 1..65535, set at pre-compile, symbolic-name-value=true  # Unique identifier of a diagnostic event. | This parameter should not be changeable by user, because the Id should be generated by Dem itself to prevent gaps and multiple use of an Id. The events should be sequentially ordered beginning with 1 and no gaps in between.
        enumeration DemEventKind: {DEM_EVENT_KIND_BSW, DEM_EVENT_KIND_SWC}, set at pre-compile  # This parameter is used to distinguish between SW-C and BSW events. SW-C events are reported by Dem_SetEventStatus API and BSW events are reported by Dem_ReportErrorStatus API.
        integer DemMaxNumberFreezeFrameRecords [0..1]: 0..255, set at pre-compile  # This parameter defines the number of according freeze frame records, which can maximal be stored for this event. Therefore all these freeze frame records have the same freeze frame class. | This parameter is only required for calculated record numeration (refer to DemTypeOfFreezeFrameRecordNumeration).
        reference DemDTCClassRef [0..1]: set at pre-compile, destination=DemDTCClass  # This parameter defines the DTC configuration associated with the diagnostic event. | It is allowed to have events without a DTC (e.g. for ECU-internal events triggering safety reactions without being reported via diagnostic communication). The same DemDTCClass can be used from several events, to combine these (refer to chapter "Combination of diagnostic event").
        reference DemExtendedDataClassRef [0..1]: set at pre-compile, destination=DemExtendedDataClass  # This reference defines the link to an extended data class sampler.
        reference DemFreezeFrameClassRef [0..1]: set at pre-compile, destination=DemFreezeFrameClass  # These references define the links to a freeze frame class sampler.
        reference DemFreezeFrameRecNumClassRef [0..1]: set at pre-compile, destination=DemFreezeFrameRecNumClass  # This parameter defines the list of dedicated freeze frame record numbers associated with the diagnostic event. These record numbers are assigned to the freeze frame records (instead of calculated record numbers). | This parameter is only required for configured record numeration (refer to DemTypeOfFreezeFrameRecordNumeration).
        reference DemJ1939ExpandedFreezeFrameClassRef [0..1]: set at pre-compile, destination=DemJ1939FreezeFrameClass  # These references define the links to a J1939 freeze frame class sampler.
        reference DemJ1939FreezeFrameClassRef [0..1]: set at pre-compile, destination=DemJ1939FreezeFrameClass  # These references define the links to a J1939 freeze frame class sampler.
        reference DemOBDGroupingAssociativeEventsRef [0..1]: set at pre-compile, destination=DemEventParameter  # This parameter defines a reference which points to a representative event of one group of associate events. | The "reverence event" must refer to it self. Note: One event is only allowed to be reverenced to only one group of associate events.
        container DemCallbackClearEventAllowed [0..1]  # The presence of this container indicates that the Dem has access to a "ClearEventAllowed" callback. | In case there is a DemCallbackClearEventAllowedFnc, this parameter defines the name of the function that the Dem will call. In case there is no DemCallbackClearEventAllowedFnc, the Dem will have an R-Port requiring the interface CallbackClearEventAllowed whose name is generated by using the unique callback-prefix followed by the event name.
          function name DemCallbackClearEventAllowedFnc [0..1]: set at pre-compile  # Function name of prototype "ClearEventAllowed".
          enumeration DemClearEventAllowedBehavior: {DEM_NO_STATUS_BYTE_CHANGE, DEM_ONLY_THIS_CYCLE_AND_READINESS}, set at pre-compile, default-value=DEM_NO_STATUS_BYTE_CHANGE  # Defines the resulting UDS status byte for the related event, which must not be cleared according to the ClearEventAllowed callback.
        container DemCallbackEventDataChanged [0..1]  # The presence of this container indicates that the Dem has access to an "EventDataChanged" callback. | In case there is a DemCallbackEventDataChangedFnc, this parameter defines the name of the function that the Dem will call. In case there is no DemCallbackEventDataChangedFnc, the Dem will have an R-Port requiring the interface CallbackEventDataChanged whose name is generated by using the unique callback-prefix followed by the event name.
          function name DemCallbackEventDataChangedFnc [0..1]: set at pre-compile  # Function name of prototype "EventDataChanged"
        container DemCallbackEventStatusChanged [0..*]  # The presence of this container indicates, that the Dem has access to an "EventStatusChanged" callback, which the Dem will call to notify other components about the change in the status of an event. | In case there is a DemCallbackEvenStatusChangedFnc, this parameter defines the name of the function that the Dem will call. In case there is no DemCallbackEvenStatusChangedFnc, the Dem will have an R-Port requiring the interface CallbackEventStatusChanged, whose name is generated by using the unique callback-prefix followed by the event name.
          function name DemCallbackEventStatusChangedFnc [0..1]: set at pre-compile  # Function name of prototype "EventStatusChanged"
        container DemCallbackInitMForE [0..1]  # The presence of this container indicates, that the Dem has access to an "InitMonitorForEvent" callback, which the Dem will call to initialize a monitor. | In case the container has a DemCallbackInitMForEFnc, this parameter defines the name of the function that the Dem will call. In case there is no DemCallbackInitMForEFnc, the Dem will have an R-Port requiring the interface CallbackInitMonitorForEvent, whose name is generated by using the unique callback-prefix followed by the event name.
          function name DemCallbackInitMForEFnc [0..1]: set at pre-compile  # Function name of prototype "InitMonitorForEvent".
        container DemEventClass  # This container contains the configuration (parameters) for EventClass
          boolean DemAgingAllowed: set at pre-compile  # Switch to allow aging/unlearning of the event or not. | true: aging allowed false: aging not allowed
          integer DemAgingCycleCounterThreshold [0..1]: 1..256, set at pre-compile  # Number of aging cycles needed to unlearn/delete the event.
          boolean DemConsiderPtoStatus: set at pre-compile  # This parameter is TRUE, when the event is affected by the Dem PTO handling.
          enumeration DemEventDestination [0..4]: {DEM_DTC_ORIGIN_MIRROR_MEMORY, DEM_DTC_ORIGIN_PRIMARY_MEMORY, DEM_DTC_ORIGIN_SECONDARY_MEMORY}, set at pre-compile  # The event destination assigns events to none, one or multiple origins. | If no event destination is assigned to a specific event, the event is handled internally and is not visible externally to the Dcm. If more than one event destination is assigned to a specific event, the event can be present in the corresponding origins.
          integer DemEventFailureCycleCounterThreshold [0..1]: 1..256, set at pre-compile  # Defines the number of failure cycles for the event based fault confirmation. | If this parameter is enabled, fault confirmation of the event is enabled accordingly.
          integer DemEventMemoryEntryFdcThresholdStorageValue [0..1]: 0..255, set at pre-compile  # Threshold to allocate an event memory entry and to capture the Freeze Frame.
          enumeration DemEventOBDReadinessGroup [0..1]: {DEM_OBD_RDY_AC, DEM_OBD_RDY_BOOSTPR, DEM_OBD_RDY_CAT, DEM_OBD_RDY_CMPRCMPT, DEM_OBD_RDY_EGSENS, DEM_OBD_RDY_ERG, DEM_OBD_RDY_EVAP, DEM_OBD_RDY_FLSYS, DEM_OBD_RDY_FLSYS_NONCONT, DEM_OBD_RDY_HCCAT, DEM_OBD_RDY_HTCAT, DEM_OBD_RDY_MISF, DEM_OBD_RDY_NONE, DEM_OBD_RDY_NOXCAT, DEM_OBD_RDY_O2SENS, DEM_OBD_RDY_O2SENSHT, DEM_OBD_RDY_PMFLT, DEM_OBD_RDY_SECAIR}, set at pre-compile  # This parameter specifies the Event OBD Readiness group for PID $01 and PID $41 computation. | This parameter is only applicable for emission-related ECUs.
          integer DemEventPriority: 1..256, set at pre-compile  # Priority of the event, in view of full event buffer.
          enumeration DemEventSignificance [0..1]: {DEM_EVENT_SIGNIFICANCE_FAULT, DEM_EVENT_SIGNIFICANCE_OCCURRENCE}, set at pre-compile  # Significance of the event, which indicates additional information concerning fault classification and resolution. | It can be mapped as Dem-internal data element. It shall be configured, if it is a part of event related data.
          boolean DemFFPrestorageSupported: set at pre-compile  # If this parameter is set to true, then the Prestorage of FreezeFrames is supported by the assigned event. This parameter is useful to calculate the buffer size.
          choice reference DemAgingCycleRef [0..1]: set at pre-compile, origin=AUTOSAR_ECUC V1.0.0, destination=[DemAgingCycle, DemOperationCycle]  # Reference to the cycle which is triggering the aging of the event. This can either be the same as the operation cycle of the event, or a separate aging cycle reported via API Dem_SetAgingCycleState. If external aging is configured (refer to DemAgingCycleCounterProcessing), this parameter is not used.
          reference DemEnableConditionGroupRef [0..1]: set at pre-compile, origin=AUTOSAR_ECUC V1.0.0, destination=DemEnableConditionGroup  # References an enable condition group.
          reference DemEventFailureCycleRef [0..1]: set at pre-compile, origin=AUTOSAR_ECUC V1.0.0, destination=DemOperationCycle  # Kind of failure cycle for the event based fault confirmation. | If fault confirmation of an event is enabled, but this parameter is disabled, the operation cycle (refer to DemOperationCycleRef) is used for fault confirmation.
          reference DemOperationCycleRef: set at pre-compile, origin=AUTOSAR_ECUC V1.0.0, destination=DemOperationCycle  # Kind of operation cycle for the event (e.g. power cycle, driving cycle, ...)
          reference DemStorageConditionGroupRef [0..1]: set at pre-compile, origin=AUTOSAR_ECUC V1.0.0, destination=DemStorageConditionGroup  # References a storage condition group.
          choice container DemDebounceAlgorithmClass  # Debounce algorithm class: counter based, time based, or monitor internal.
            container DemDebounceCounterBased [0..1]  # This container contains the configuration (parameters) for counter based debouncing.
              enumeration DemDebounceBehavior: {DEM_DEBOUNCE_FREEZE, DEM_DEBOUNCE_RESET}, set at pre-compile  # This parameter defines how the event debounce algorithm will behave, if a related enable condition is not fulfilled or ControlDTCSetting of the related event is disabled.
              integer DemDebounceCounterDecrementStepSize: 1..32768, set at pre-compile  # Defines the step size for decrementation of the internal debounce counter (PREPASSED).
              integer DemDebounceCounterFailedThreshold: 1..32767, set at pre-compile  # Defines the value of the internal debounce counter, which indicates the failed status.
              integer DemDebounceCounterIncrementStepSize: 1..32767, set at pre-compile  # Defines the step size for incrementation of the internal debounce counter (PREFAILED).
              boolean DemDebounceCounterJumpDown: set at pre-compile  # Switch for the activation of Jump-Down. | true: Jump-Down activated false: Jump-Down deactivated
              integer DemDebounceCounterJumpDownValue: -32768..32767, set at pre-compile, default-value=0  # Jump-Down value of the internal debounce counter which is taken as initialization value for the counter when the respective step-down occurs.
              boolean DemDebounceCounterJumpUp: set at pre-compile  # Switch for the activation of Jump-Up. | true: Jump-Up activated false: Jump-Up deactivated
              integer DemDebounceCounterJumpUpValue: -32768..32767, set at pre-compile, default-value=0  # Jump-Up value of the internal debounce counter which is taken as initialization value for the counter when the respective step-up occurs.
              integer DemDebounceCounterPassedThreshold: -32768..-1, set at pre-compile  # Defines the value of the internal debounce counter, which indicates the passed status.
              boolean DemDebounceCounterStorage: set at pre-compile, default-value=false  # Switch to store the debounce counter value non-volatile or not. | true: debounce counter value shall be stored non-volatile false: debounce counter value is volatile
            container DemDebounceMonitorInternal [0..1]  # This container contains the configuration (parameters) for monitor internal debouncing.
              container DemCallbackGetFDC [0..1]  # The presence of this container indicates, that the Dem has access to a "GetFaultDetectionCounter" callback, which the Dem will call to obtain the value of the fault detection counter. | In case the container has a DemCallbackGetFDCFnc, this parameter defines the name of the function that the Dem will call. In case there is no DemCallbackGetFDCFnc, the Dem will have a R-Port requiring the interface CallbackGetFaultDetectionCounter, whose name is generated by using the unique callback-prefix followed by the event name.
                function name DemCallbackGetFDCFnc [0..1]: set at pre-compile  # Function name of prototype "GetFaultDetectionCounter".
            container DemDebounceTimeBase [0..1]  # This container contains the configuration (parameters) for time based debouncing.
              enumeration DemDebounceBehavior: {DEM_DEBOUNCE_FREEZE, DEM_DEBOUNCE_RESET}, set at pre-compile  # This parameter defines how the event debounce algorithm will | behave, if a related enable condition is not fulfilled or ControlDTCSetting of the related event is disabled.
              float DemDebounceTimeFailedThreshold: 0.001..3600, set at pre-compile  # Defines the time out duration for "Event Failed" qualification. | The AUTOSAR configuration standard is to use SI units, so this parameter is defined as float value in seconds. Dem configuration tools must convert this float value to the appropriate value format for the use in the software implementation of Dem.
              float DemDebounceTimePassedThreshold: 0.001..3600, set at pre-compile  # Defines the time out duration for "Event Passed" qualification. | The AUTOSAR configuration standard is to use SI units, so this parameter is defined as float value in seconds. Dem configuration tools must convert this float value to the appropriate value format for the use in the software implementation of Dem.
          container DemIndicatorAttribute [0..255]  # This container contains the event specific configuration of Indicators.
            enumeration DemIndicatorBehaviour: {DEM_INDICATOR_BLINKING, DEM_INDICATOR_BLINK_CONT, DEM_INDICATOR_CONTINUOUS, DEM_INDICATOR_FAST_FLASH, DEM_INDICATOR_SLOW_FLASH}, set at post-build in variant post-build / pre-compile in variant pre-compile  # Behaviour of the linked indicator
            integer DemIndicatorFailureCycleCounterThreshold [0..1]: 0..255, set at pre-compile  # Defines the number of failure cycles for the WarningIndicatorOnCriteria.
            enumeration DemIndicatorFailureCycleSource: {DEM_FAILURE_CYCLE_EVENT, DEM_FAILURE_CYCLE_INDICATOR}, set at pre-compile  # This parameter defines, which failure cycle is used for the WarningIndicatorOnCriteria handling.
            integer DemIndicatorHealingCycleCounterThreshold: 0..255, set at pre-compile  # Defines the number of healing cycles for the WarningIndicatorOffCriteria.
            reference DemIndicatorFailureCycleRef [0..1]: set at pre-compile, destination=DemOperationCycle  # Kind of failure cycle for the indicator controlled by the according event used for the WarningIndicatorOnCriteria.
            reference DemIndicatorHealingCycleRef: set at pre-compile, destination=DemOperationCycle  # Kind of healing cycle for the indicator controlled by the according event used for the WarningIndicatorOffCriteria.
            reference DemIndicatorRef: set at pre-compile, destination=DemIndicator  # Reference to the used indicator.
      container DemJ1939NodeAddress [0..255]: post-build-changeable=true  # Contains the parameters for the support of a logical J1939 node (identified by an ECU address).
        symbolic name reference DemJ1939NmNodeRef [1..255]: set at post-build in variant post-build / pre-compile in variant pre-compile, destination=J1939NmNode  # Reference to the corresponding J1939Nm node.
      container DemPidClass [0..255]  # This container contains the different PIDs for the single global OBD relevant freeze frame class. It is assembled out of one or several data elements.
        integer DemPidIdentifier: 0..255, set at post-build in variant post-build / pre-compile in variant pre-compile  # identifier of the PID
        container DemPidDataElement [1..255]  # This container contains the different data elements contained in the specific PID.
          choice reference DemPidDataElementClassRef: set at post-build in variant post-build / pre-compile in variant pre-compile, destination=[DemExternalCSDataElementClass, DemExternalSRDataElementClass, DemInternalDataElementClass]  # This reference contains the link to a data element class.
    container DemGeneral  # This container contains the configuration (parameters) of the BSW Dem
      enumeration DemAgingCycleCounterProcessing: {DEM_PROCESS_AGINGCTR_EXTERN, DEM_PROCESS_AGINGCTR_INTERN}, set at pre-compile  # This configuration switch defines, whether the aging counter is calculated Dem-internally or provided via Dem_SetAgingCycleCounterValue.
      boolean DemAgingRequieresTestedCycle: set at pre-compile  # Defines if the aging cycle counter is processed every aging cycles or if only tested aging cycle are considered. | true: only tested aging cycle are considered for aging cycle counter false: aging cycle counter is processed every aging cycle
      enumeration DemAvailabilitySupport: {DEM_EVENT_AVAILABILITY, DEM_NO_AVAILABILITY}, set at pre-compile  # This configuration switch defines, whether support for availability is enabled or not.
      integer DemBswErrorBufferSize: 0..255, set at pre-compile  # Maximum number of elements in buffer for handling of BSW errors (ref. to Dem107).
      enumeration DemClearDTCBehavior: {DEM_CLRRESP_NONVOLATILE_FINISH, DEM_CLRRESP_NONVOLATILE_TRIGGER, DEM_CLRRESP_VOLATILE}, set at pre-compile  # Defines the clearing process of diagnostic information for volatile and non-volatile memory and the positive response handling for the Dcm module.
      enumeration DemClearDTCLimitation: {DEM_ALL_SUPPORTED_DTCS, DEM_ONLY_CLEAR_ALL_DTCS}, set at pre-compile, default-value=DEM_ALL_SUPPORTED_DTCS  # Defines the supported Dem_<...>ClearDTC API scope.
      enumeration DemDataElementDefaultEndianness: {BIG_ENDIAN, LITTLE_ENDIAN, OPAQUE}, set at pre-compile  # Defines the default endianness of the data belonging to a data element which is applicable if the DemExternalSRDataElementClass does not define a endianness.
      boolean DemDebounceCounterBasedSupport: set at pre-compile  # This configuration switch defines, whether support for counter based debouncing is enabled or not. | true: counter based debouncing support is enabled false: counter based debouncing support is disabled
      boolean DemDebounceTimeBasedSupport: set at pre-compile  # This configuration switch defines, whether support for time based debouncing is enabled or not. | true: time based debouncing support is enabled false: time based debouncing support is disabled
      boolean DemDevErrorDetect: set at pre-compile  # Activate/Deactivate the Development Error Detection and Notification. | true: Development Error Detection and Notification activated false: Development Error Detection and Notification deactivated
      integer DemDtcStatusAvailabilityMask: 0..255, set at pre-compile  # Mask for the supported DTC status bits by the Dem. This mask is used by UDS service 0x19.
      boolean DemEnableConditionSupport: set at pre-compile  # This configuration switch defines, whether support for enable conditions is enabled or not. | true: support for enable conditions is enabled false: support for enable conditions is disabled
      enumeration DemEventCombinationSupport: {DEM_EVCOMB_DISABLED, DEM_EVCOMB_TYPE1, DEM_EVCOMB_TYPE2}, set at pre-compile  # This parameter defines the type of event combination supported by the Dem.
      enumeration DemEventDisplacementStrategy: {DEM_DISPLACEMENT_FULL, DEM_DISPLACEMENT_NONE, DEM_DISPLACEMENT_PRIO_OCC}, set at pre-compile  # This configuration switch defines, whether support for event displacement is enabled or not, and which displacement strategy is followed.
      enumeration DemEventMemoryEntryStorageTrigger: {DEM_STORAGE_ON_CONFIRMED, DEM_STORAGE_ON_FDC_THRESHOLD, DEM_STORAGE_ON_PENDING, DEM_STORAGE_ON_TEST_FAILED}, set at pre-compile, default-value=DEM_STORAGE_ON_TEST_FAILED  # Configures the primary trigger to allocate an event memory entry.
      enumeration DemExtendedDataCapture [0..1]: {DEM_TRIGGER_EVENT_MEMORY_STORAGE, DEM_TRIGGER_TESTFAILED}, set at pre-compile  # This parameter defines the point in time, when the extended data collection is done for the initial event memory entry.
      enumeration DemFreezeFrameCapture [0..1]: {DEM_TRIGGER_EVENT_MEMORY_STORAGE, DEM_TRIGGER_TESTFAILED}, set at pre-compile  # This parameter defines the point in time, when the freeze frame data collection is done for the initial event memory entry.
      boolean DemGeneralInterfaceSupport: set at pre-compile  # The interfaces GeneralEvtInfo, GeneralCallbackEventDataChanged and GeneralCallbackEventStatusChange are provided if DemGeneralInterfaceSupport is equal to true.
      string DemHeaderFileInclusion [0..*]: set at pre-compile, regular-expression=[a-zA-Z0-9_]([a-zA-Z0-9\._])*  # Name of the header file(s) to be included by the Dem module containing the used C-callback declarations.
      integer DemImmediateNvStorageLimit [0..1]: 1..255, set at pre-compile  # This parameter defines the maximum number of occurrences, a specific event memory entry is allowed, to be stored in NVRAM immediately (refer to DemImmediateNvStorage).
      integer DemMaxNumberEventEntryMirror: 0..255, set at pre-compile  # Maximum number of events which can be stored in the mirror memory
      integer DemMaxNumberEventEntryPermanent: 0..255, set at pre-compile  # Maximum number of events which can be stored in the permanent memory. | The assignment of an event to this memory type is dynamic and used for emission-related events only.
      integer DemMaxNumberEventEntryPrimary: 1..255, set at pre-compile  # Maximum number of events which can be stored in the primary memory
      integer DemMaxNumberEventEntrySecondary: 0..255, set at pre-compile  # Maximum number of events which can be stored in the secondary memory
      integer DemMaxNumberPrestoredFF: 0..255, set at pre-compile  # Defines the maximum number for prestored freeze frames. | If set to 0, then freeze frame prestorage is not supported by the ECU.
      enumeration DemOBDSupport: {DEM_OBD_DEP_SEC_ECU, DEM_OBD_MASTER_ECU, DEM_OBD_NO_OBD_SUPPORT, DEM_OBD_PRIMARY_ECU}, set at pre-compile  # This configuration switch defines OBD support and kind of OBD ECU.
      enumeration DemOccurrenceCounterProcessing: {DEM_PROCESS_OCCCTR_CDTC, DEM_PROCESS_OCCCTR_TF}, set at pre-compile  # This configuration switch defines the consideration of the fault confirmation process for the occurrence counter. For OBD and mixed systems (OBD/non OBD, refer to DemOBDSupport) configuration switch shall always set to DEM_PROCESS_OCCCTR_TF.
      enumeration DemOperationCycleProcessing [0..1]: {DEM_PROCESS_OPCYC_COUNTER, DEM_PROCESS_OPCYC_STATE}, set at pre-compile, default-value=DEM_PROCESS_OPCYC_STATE  # This configuration switch defines, whether the operation cycles are triggered by DEM_CYCLE_STATE_START or collecting an external counter value, which results in respective state changes. Tags: atp.Status=obsolete, atp.StatusComment=This parameter is obsolete since the option DEM_PROCESS_OPCYC_COUNTER is not longer supported by AUTOSAR., atp.StatusRevisionBegin=4.1.1 | This parameter is obsolete since the option DEM_PROCESS_OPCYC_COUNTER is not longer supported by AUTOSAR. This element is obsolete and will be removed in a future revision.
      boolean DemOperationCycleStatusStorage: set at pre-compile  # Defines if the operation cycle state is available over the power cycle (stored non-volatile) or not. | true: the operation cycle state is stored non-volatile false: the operation cycle state is only stored volatile
      boolean DemPTOSupport: set at pre-compile  # This configuration switch defines, whether PTO support (and therefore PID $1E support) is enabled or not.
      boolean DemResetConfirmedBitOnOverflow: set at pre-compile, default-value=true  # This configuration switch defines, whether the confirmed bit is reset or not while an event memory entry will be displaced.
      enumeration DemStatusBitHandlingTestFailedSinceLastClear: {DEM_STATUS_BIT_AGING_AND_DISPLACEMENT, DEM_STATUS_BIT_NORMAL}, set at pre-compile  # This configuration switch defines, whether the aging and displacement mechanism shall be applied to the "TestFailedSinceLastClear" status bits.
      boolean DemStatusBitStorageTestFailed: set at pre-compile  # Activate/Deactivate the permanent storage of the "TestFailed" status bits. | true: storage activated false: storage deactivated
      boolean DemStorageConditionSupport: set at pre-compile  # This configuration switch defines, whether support for storage conditions is enabled or not. | true: support for storage conditions is enabled false: support for storage conditions is disabled
      enumeration DemSuppressionSupport: {DEM_DTC_SUPPRESSION, DEM_EVENT_AND_DTC_SUPPRESSION, DEM_EVENT_SUPPRESSION, DEM_NO_SUPPRESSION}, set at pre-compile  # This configuration switch defines, whether support for suppression is enabled or not.
      float DemTaskTime: 0.001..0.1, set at pre-compile, origin=AUTOSAR_ECUC V1.0.0  # Allow to configure the time for the periodic cyclic task. Please note: This configuration value shall be equal to the value in the Basic Software Scheduler configuration of the RTE module. | The AUTOSAR configuration standard is to use SI units, so this parameter is defined as float value in seconds. Dem configuration tools must convert this float value to the appropriate value format for the use in the software implementation of Dem. min: A negative value is not allowed. max: After event status was reported, processing shall be completed within 100ms in order to have the fault entry status information updated as soon as possible (e.g. for PID $01). upperMultiplicity: Exactly one TaskTime must be specified per configuration. lowerMultiplicity: Exactly one TaskTime must be specified per configuration.
      boolean DemTriggerDcmReports: set at pre-compile  # Activate/Deactivate the notification to the Diagnostic Communication Manager for ROE processing. | true: Dcm ROE notification activated false: Dcm ROE notification deactivated
      boolean DemTriggerDltReports: set at pre-compile  # Activate/Deactivate the notification to the Diagnostic Log and Trace. | true: Dlt notification activated false: Dlt notification deactivated
      boolean DemTriggerFiMReports: set at pre-compile  # Activate/Deactivate the notification to the Function Inhibition Manager. | true: FiM notification activated false: FiM notification deactivated
      boolean DemTriggerMonitorInitBeforeClearOk: set at pre-compile  # Defines if the monitor re-initialization has to be triggered before or after the Dem module returns DEM_CLEAR_OK. | true: trigger re-initialization before DEM_CLEAR_OK false: trigger re-initialization after DEM_CLEAR_OK
      enumeration DemTypeOfDTCSupported: {DEM_DTC_TRANSLATION_ISO11992_4, DEM_DTC_TRANSLATION_ISO14229_1, DEM_DTC_TRANSLATION_ISO15031_6, DEM_DTC_TRANSLATION_SAEJ1939_73}, set at pre-compile  # This parameter defines the format returned by Dem_DcmGetTranslationType and does not relate to/influence the supported Dem functionality.
      enumeration DemTypeOfFreezeFrameRecordNumeration: {DEM_FF_RECNUM_CALCULATED, DEM_FF_RECNUM_CONFIGURED}, set at pre-compile  # This parameter defines the type of assigning freeze frame record numbers for event-specific freeze frame records.
      boolean DemVersionInfoApi: set at pre-compile  # Activate/Deactivate the version information API. | true: version information activated false: version information deactivated
      reference DemMILIndicatorRef [0..1]: set at pre-compile, destination=DemIndicator  # This parameter defines the indicator representing the MIL. | This parameter is mandatory for ECUs supporting OBD (refer to DemOBDSupport).
      container DemAgingCycle [0..256]  # Note that this container definition does not explicitly define a symbolic name parameter. Instead, the short name of the container will be used in the Ecu Configuration Description to specify the symbolic name of the aging cycle name. These aging cycles are reported via API Dem_SetAgingCycleState only.
      container DemCallbackDTCStatusChanged [0..*]  # The presence of this container indicates, that the Dem has access to a "DTCStatusChanged" callback, which the Dem will call to notify other components about the change in the status of a DTC. | In case there is a DemCallbackDTCStatusChangedFnc, this parameter defines the name of the function that the Dem will call. In case there is no DemCallbackDTCStatusChangedFnc, the Dem will have an R-Port requiring the interface CallbackDTCStatusChanged whose name is generated by using the unique callback-prefix followed by the event name. Status change notifications are supported for DTCs in primary memory only.
        function name DemCallbackDTCStatusChangedFnc [0..1]: set at pre-compile  # Function name of prototype "DTCStatusChanged". | Note: If the parameter DemTriggerDcmReports is enabled, this parameter shall not be "Dcm_DemTriggerOnDTCStatus".
      choice container DemDataElementClass [0..255]  # This container contains the configuration (parameters) for an internal/external data element class.
        container DemExternalCSDataElementClass [0..1]  # This container contains the configuration (parameters) for an external client/server based data element class. | It defines, how the Dem can obtain the value of the data element from either a SW-C or another BSW module. Whether a client/server port or a C function-call is used, is defined by DemDataElementUsePort.
          integer DemDataElementDataSize: 1..255, set at pre-compile  # Defines the size of the data element in bytes.
          function name DemDataElementReadFnc [0..1]: set at pre-compile  # In case of DemDataElementUsePort is false, this parameter defines the prototype of the C function "ReadDataElement" used to get the according value.
          boolean DemDataElementUsePort: set at pre-compile  # If the parameter is set to True, a R-Port is generated, to obtain the data element (interface DataServices_<SyncDataElement>). | If the parameter is set to False, the information is obtained by C function-call on another BSW module specified by the parameter DemDataElementReadFnc.
        container DemExternalSRDataElementClass [0..1]  # This container contains the configuration (parameters) for an external sender/receiver based data element class. It defines, how the Dem can obtain the value of the data element from a SW-C, by using a sender/receiver port.
          integer DemDataElementDataSize: 1..255, set at pre-compile  # Defines the size of the data element in bits.
          enumeration DemDataElementDataType [0..1]: {BOOLEAN, SINT16, SINT32, SINT8, UINT16, UINT32, UINT8}, set at pre-compile  # Provide the implementation data type of data belonging to a external data.
          enumeration DemDataElementEndianness [0..1]: {BIG_ENDIAN, LITTLE_ENDIAN, OPAQUE}, set at pre-compile  # Defines the endianness of the data belonging to an external data. | If no DemDataElementEndianness is defined the value of DemDataElementDefaultEndianness is applicable.
          choice container DemDiagnosisScaling [0..1]  # This container contains the configuration (parameters) of an alternative Diagnosis Representation. Out if this the scaling between Diagnosis and ECU internal representation and vice versa can be calculated.
            container DemAlternativeDataInterface [0..1]  # This container contains the configuration (parameters) of an alternative Diagnosis Representation by the means of a VariableDataPrototoype in a DataInterface. | Additionally a reference to PortInterfaceMapping can be defined which provide already the mapping rules between the VariableDataPrototoype in a DataInterface used by the software component (DemSRDataElementClass) and the intended Diagnosis Representation defined by DemExternalSRDataElementClass.
              foreign reference DemDataElement: set at pre-compile, destination-type=VARIABLE-DATA-PROTOTYPE  # Alternative Diagnosis Representation for the data defined by the means of a VariableDataPrototoype in a DataInterface.
              foreign reference DemPortInterfaceMapping [0..1]: set at pre-compile, destination-type=PORT-INTERFACE-MAPPING  # Optional reference to PortInterfaceMapping which defines the mapping rules.
            container DemAlternativeDataProps [0..1]  # This container contains the configuration (parameters) of an alternative Diagnosis Representation by the means of ECU configuration parameters. | The physical unit of the alternative data representation is defined by the DataPrototype referenced by DemSRDataElementClass. Additionally the definition of a text table mapping can be a defined for DemDataTypeCategory TEXTTABLE and SCALE_LINEAR_AND_TEXTTABLE
              enumeration DemDataTypeCategory: {SCALE_LINEAR_AND_TEXTTABLE, TEXTTABLE}, set at pre-compile  # Data category of the alternative Diagnosis Representation.
              container DemLinearScale [0..1]  # This container contains the configuration (parameters) of an linear scale of the alternative Diagnosis Representation.
                float DemDiagnosisRepresentationDataLowerRange: set at pre-compile  # Lower Range for this scale of the data in the alternative Diagnosis Representation.
                float DemDiagnosisRepresentationDataOffset: 0..Inf, set at pre-compile, default-value=0  # Data offset of the alternative Diagnosis Representation for this scale.
                float DemDiagnosisRepresentationDataResolution: 0..Inf, set at pre-compile  # Data resolution of the alternative Diagnosis Representation for this scale.
                float DemDiagnosisRepresentationDataUpperRange: set at pre-compile  # Upper Range for this scale of the data in the alternative Diagnosis Representation.
              container DemTextTableMapping [0..*]  # This container contains the configuration (parameters) of the mapping a DataPrototype typed by AutosarDataType that refer to a CompuMethods of category TEXTTABLE or SCALE_LINEAR_AND_TEXTTABLE. | Each DemTextTableMapping defines a value pair which is used to map the ECU internal value (DemInternalDataValue) to the vale used in the diagnosis representation (DemDiagnosisRepresentationDataValue) and vice versa. The set of all DemTextTableMapping defines the whole mapping of an data.
                integer DemDiagnosisRepresentationDataValue: 0..18446744073709551615, set at pre-compile  # The data value in the diagnosis representation.
                integer DemInternalDataValue: 0..18446744073709551615, set at pre-compile  # The ECU internal data value.
            container DemAlternativeDataType [0..1]  # This container contains the configuration (parameters) of an alternative Diagnosis Representation by the means of an ApplicationDataType. | Additionally the definition of a text table mapping can be a defined for ApplicationDataTypes of category TEXTTABLE and SCALE_LINEAR_AND_TEXTTABLE.
              foreign reference DemApplicationDataType: set at pre-compile, destination-type=APPLICATION-PRIMITIVE-DATA-TYPE  # Alternative Diagnosis Representation for the data defined by the means of a ApplicationPrimitiveDataType of category VALUE or BOOLEAN.
              container DemTextTableMapping [0..*]  # This container contains the configuration (parameters) of the mapping a DataPrototype typed by AutosarDataType that refer to a CompuMethods of category TEXTTABLE or SCALE_LINEAR_AND_TEXTTABLE. | Each DemTextTableMapping defines a value pair which is used to map the ECU internal value (DemInternalDataValue) to the vale used in the diagnosis representation (DemDiagnosisRepresentationDataValue) and vice versa. The set of all DemTextTableMapping defines the whole mapping of an data.
                integer DemDiagnosisRepresentationDataValue: 0..18446744073709551615, set at pre-compile  # The data value in the diagnosis representation.
                integer DemInternalDataValue: 0..18446744073709551615, set at pre-compile  # The ECU internal data value.
          choice container DemSRDataElementClass  # This container defines the source of data in a provided port which shall be read for a external data element | This container shall contain either one DemSubElementInDataElementInstance OR DemDataElementInstance OR DemSubElementInImplDataElementInstance reference.
            container DemDataElementInstance [0..1]  # Instance Reference to the primitive data in a port where the data element is typed with an ApplicationPrimitveDataType or an ImplementationDataType.
              instance reference DemDataElementInstanceRef: set at pre-compile, destination-context=ROOT-SW-COMPOSITION-PROTOTYPE SW-COMPONENT-PROTOTYPE PORT-PROTOTYPE, destination-type=AUTOSAR-DATA-PROTOTYPE  # Instance Reference to the primitive data which shall be read or written. | Supported are VariableDataPrototypes in SenderReceiverInterfaces and NvDataInterfaces and ParameterDataPrototypes in ParameterInterfaces (read only). This reference is applicable if the AutosarDataPrototype is typed with a ApplicationPrimitiveDataType of category VALUE or BOOLEAN or if the AutosarDataPrototype is typed with a ImplementationDataType of category VALUE or TYPE_REFERENCE that in turn boils down to VALUE
            container DemSubElementInDataElementInstance [0..1]  # Instance Reference to the primitve sub-element (at any level) of composite data in a port where the data element is typed with an ApplicationCompositeDataType.
              instance reference DemSubElementInDataElementInstanceRef: set at pre-compile, destination-context=ROOT-SW-COMPOSITION-PROTOTYPE SW-COMPONENT-PROTOTYPE PORT-PROTOTYPE AUTOSAR-DATA-PROTOTYPE APPLICATION-COMPOSITE-ELEMENT-DATA-PROTOTYPE*, destination-type=AUTOSAR-DATA-PROTOTYPE  # Instance Reference to the primitve sub-element (at any level) of composite data in a port which shall be read or written. | Supported are VariableDataPrototypes in SenderReceiverInterfaces and NvDataInterfaces and ParameterDataPrototypes in ParameterInterfaces (read only). This reference is applicable if the AutosarDataPrototype is typed with a ApplicationCompositeDataType.
            container DemSubElementInImplDataElementInstance [0..1]  # Instance Reference to the primitve sub-element (at any level) of composite data in a port where the data element is typed with an ImplementationDataType of category STRUCTURE or ARRAY.
              instance reference DemSubElementInImplDataElementInstanceRef: set at pre-compile, destination-context=ROOT-SW-COMPOSITION-PROTOTYPE SW-COMPONENT-PROTOTYPE PORT-PROTOTYPE AUTOSAR-DATA-PROTOTYPE IMPLEMENTATION-DATA-TYPE-ELEMENT*, destination-type=IMPLEMENTATION-DATA-TYPE-ELEMENT  # Instance Reference to the primitve sub-element (at any level) of composite data in a port which shall be read or written. | Supported are VariableDataPrototypes in SenderReceiverInterfaces and NvDataInterfaces and ParameterDataPrototypes in ParameterInterfaces (read only). This reference is applicable if the AutosarDataPrototype is typed with a ImplementationDataType of category STRUCTURE or ARRAY. Please note that in case of ARRAY the index attribute in the target reference has to be set to select a single array element.
        container DemInternalDataElementClass [0..1]  # This container contains the configuration (parameters) for an internal data element class.
          integer DemDataElementDataSize: 1..255, set at pre-compile  # Defines the size of the data element in bytes.
          enumeration DemInternalDataElement: {DEM_AGINGCTR_DOWNCNT, DEM_AGINGCTR_UPCNT, DEM_CURRENT_FDC, DEM_CYCLES_SINCE_FIRST_FAILED, DEM_CYCLES_SINCE_LAST_FAILED, DEM_FAILED_CYCLES, DEM_MAX_FDC_DURING_CURRENT_CYCLE, DEM_MAX_FDC_SINCE_LAST_CLEAR, DEM_OCCCTR, DEM_OVFLIND, DEM_SIGNIFICANCE}, set at pre-compile  # This parameter defines the Dem-internal data value, which is mapped to the data element.
      container DemDidClass [0..255]  # This container contains the configuration (parameters) for a data Id class. It is assembled out of one or several data elements.
        integer DemDidIdentifier: 0..65535, set at pre-compile  # Identifier of the Data ID.
        choice reference DemDidDataElementClassRef [1..255]: set at pre-compile, destination=[DemExternalCSDataElementClass, DemExternalSRDataElementClass, DemInternalDataElementClass]  # This reference contains the link to a data element class.
      container DemEnableCondition [0..255]  # This container contains the configuration (parameters) for enable conditions.
        integer DemEnableConditionId: 0..255, set at pre-compile, symbolic-name-value=true  # Defines a unique enable condition Id. | This parameter should not be changeable by user, because the Id should be generated by Dem itself to prevent gaps and multiple use of an Id. The enable conditions should be sequentially ordered beginning with 0 and no gaps in between.
        boolean DemEnableConditionStatus: set at pre-compile  # Defines the initial status for enable or disable of acceptance of event reports of a diagnostic event. | The value is the initialization after power up (before this condition is reported the first time). true: acceptance of a diagnostic event enabled false: acceptance of a diagnostic event disabled
      container DemEnableConditionGroup [0..255]  # This container contains the configuration (parameters) for enable condition groups.
        reference DemEnableConditionRef [1..255]: set at pre-compile, origin=AUTOSAR_ECUC V1.0.0, destination=DemEnableCondition  # References an enable condition.
      container DemExtendedDataClass [0..*]  # This class contains the combinations of extended data records for an extended data class.
        reference DemExtendedDataRecordClassRef [1..253]: set at pre-compile, destination=DemExtendedDataRecordClass  # This reference contains the link to an extended data class record.
      container DemExtendedDataRecordClass [0..253]  # This container contains the configuration (parameters) for an extended data record class. | It is assembled out of one or several data elements.
        integer DemExtendedDataRecordNumber: 0..253, set at pre-compile  # This configuration parameter specifies an unique identifier for an extended data record. | One or more extended data records can be assigned to one diagnostic event/DTC. 0xFF and 0xFE are reserved by ISO (therefore the maximal value equals 253).
        enumeration DemExtendedDataRecordTrigger [0..1]: {DEM_EXTENDED_DATA_CAPTURE_ON_CONFIRMED, DEM_EXTENDED_DATA_CAPTURE_ON_FDC_THRESHOLD, DEM_EXTENDED_DATA_CAPTURE_ON_PENDING, DEM_EXTENDED_DATA_CAPTURE_ON_TEST_FAILED}, set at pre-compile  # Configures the primary trigger to allocate an event memory entry.
        enumeration DemExtendedDataRecordUpdate [0..1]: {DEM_UPDATE_RECORD_NO, DEM_UPDATE_RECORD_YES}, set at pre-compile  # This extended data record is captured if the configured trigger condition in "DemExtendedDataRecordTrigger" is fulfilled.
        choice reference DemDataElementClassRef [1..255]: set at pre-compile, destination=[DemExternalCSDataElementClass, DemExternalSRDataElementClass, DemInternalDataElementClass]  # This reference contains the link to a data element class.
      container DemFreezeFrameClass [0..255]  # This container contains the combinations of DIDs for a non OBD relevant freeze frame class.
        reference DemDidClassRef [1..255]: set at pre-compile, destination=DemDidClass  # For OBD relevant data | Multiple PIDs can be relevant per freeze frame.
      container DemFreezeFrameRecNumClass [0..255]  # This container contains a list of dedicated, different freeze frame record numbers assigned to an event. The order of record numbers in this list is assigned to the chronological order of the according freeze frame records. | dependency: DemTypeOfFreezeFrameRecordNumeration = DEM_FF_RECNUM_CONFIGURED
        reference DemFreezeFrameRecordClassRef [1..254]: set at pre-compile, destination=DemFreezeFrameRecordClass  # This parameter references record number(s) for a freeze frame record.
      container DemFreezeFrameRecordClass [0..255]  # This container contains a list of dedicated, different freeze frame record numbers.
        integer DemFreezeFrameRecordNumber: 1..254, set at pre-compile  # This parameter defines a record number for a freeze frame record. This record number is unique per freeze frame record number class. | The range of this value is defined by ISO 14229-1 (0x01 .. 0xFE).
        enumeration DemFreezeFrameRecordTrigger: {DEM_FREEZE_FRAME_CAPTURE_ON_CONFIRMED, DEM_FREEZE_FRAME_CAPTURE_ON_FDC_THRESHOLD, DEM_FREEZE_FRAME_CAPTURE_ON_PENDING, DEM_FREEZE_FRAME_CAPTURE_ON_TEST_FAILED}, set at pre-compile  # Configures the primary trigger to allocate an event memory entry.
        enumeration DemFreezeFrameRecordUpdate: {DEM_UPDATE_RECORD_NO, DEM_UPDATE_RECORD_YES}, set at pre-compile  # This parameter defines the case, when the freeze frame record is stored/updated. Tags: atp.Status=obsolete, atp.StatusRevisionBegin=4.1.1
      container DemGeneralJ1939 [0..1]  # This container contains the general J1939-specific configuration (parameters) of the Dem module. | If the container exists the J1939 support is enabled.
        boolean DemJ1939ClearDtcSupport: set at pre-compile  # This configuration switch defines whether clearing J1939 DTCs (DM3 und DM11) is supported or not. | This switches on and off the API Dem_J1939DcmClearDTC.
        boolean DemJ1939Dm31Support: set at pre-compile  # This configuration switch defines whether J1939 DM31 is supported or not. | This switches on and off the APIs Dem_J1939DcmFirstDTCwithLampStatus and Dem_J1939DcmGetNextDTCwithLampStatus. .
        boolean DemJ1939ExpandedFreezeFrameSupport: set at pre-compile  # This configuration switch defines whether J1939 expanded freeze frames are supported or not. | This switches on and off the APIs Dem_J1939DcmSetFreezeFrameFilter, Dem_J1939DcmGetNextFreezeFrame and Dem_J1939DcmGetNextSPNInFreezeFrame.
        boolean DemJ1939FreezeFrameSupport: set at pre-compile  # This configuration switch defines whether J1939 freeze frames are supported or not. | This switches on and off the APIs Dem_J1939DcmSetFreezeFrameFilter and Dem_J1939DcmGetNextFreezeFrame.
        boolean DemJ1939RatioSupport: set at pre-compile  # This configuration switch defines whether J1939 performance ratios are supported or not. | This switches on and off the APIs Dem_J1939DcmSetRatioFilter and Dem_J1939DcmGetNextFilteredRatio.
        boolean DemJ1939Readiness1Support: set at pre-compile  # This configuration switch defines whether J1939 diagnostic readiness 1 is supported or not. | This switches on and off the API Dem_J1939DcmReadDiagnosticReadiness1.
        boolean DemJ1939Readiness2Support: set at pre-compile  # This configuration switch defines whether J1939 diagnostic readiness 2 is supported or not. | This switches on and off the API Dem_J1939DcmReadDiagnosticReadiness2.
        boolean DemJ1939Readiness3Support: set at pre-compile  # This configuration switch defines whether J1939 diagnostic readiness 3 is supported or not. | This switches on and off the API Dem_J1939DcmReadDiagnosticReadiness3.
        boolean DemJ1939ReadingDtcSupport: set at pre-compile  # This configuration switch defines whether J1939 DTC readout is supported or not. | This switches on and off the APIs Dem_J1939DcmSetDTCFilter, Dem_J1939DcmGetNumberOfFilteredDTC and Dem_J1939DcmGetNextFilteredDTC.
        reference DemAmberWarningLampIndicatorRef [0..1]: set at pre-compile, destination=DemIndicator  # This parameter defines the indicator representing the AmberWarningLamp . This parameter may be used for ECUs supporting J1939.
        reference DemProtectLampIndicatorRef [0..1]: set at pre-compile, destination=DemIndicator  # This parameter defines the indicator representing the ProtectLamp. This parameter may be used for ECUs supporting J1939.
        reference DemRedStopLampIndicatorRef [0..1]: set at pre-compile, destination=DemIndicator  # This parameter defines the indicator representing the RedStopLamp. This parameter may be used for ECUs supporting J1939.
        container DemCallbackJ1939DTCStatusChanged [0..*]  # The presence of this container indicates, that the Dem has access to a "DTCStatusChanged" callback, which the Dem will call to notify other components about the change in the status of a DTC. | In case there is a DemCallbackDTCStatusChangedFnc, this parameter defines the name of the function that the Dem will call. In case there is no DemCallbackDTCStatusChangedFnc, the Dem will have an R-Port requiring the interface CallbackDTCStatusChanged whose name is generated by using the unique callback-prefix followed by the event name. Status change notifications are supported for DTCs in primary memory only.
          function name DemCallbackDTCStatusChangedFnc [0..1]: set at pre-compile  # Function name of prototype "DTCStatusChanged". | Note: If the parameter DemTriggerDcmReports is enabled, this parameter shall not be "Dcm_DemTriggerOnDTCStatus".
        container DemJ1939FreezeFrameClass [0..255]  # This container contains the combinations of SPNs s for a J1939 relevant freeze frame.
          reference DemSPNClassRef [1..255]: set at pre-compile, destination=DemSPNClass  # Reference to an SPN. This reference defines requiresIndex = true since it represents a ordered list of references where the order describes the order of single SPNs in the J1939 Freeze Frame.
        container DemSPNClass [0..*]  # This container contains the configuration (parameters) for a SPN.
          integer DemSPNId: 0..524287, set at pre-compile  # Suspect parameter number
          choice reference DemSPNDataElementClassRef: set at pre-compile, destination=[DemExternalCSDataElementClass, DemExternalSRDataElementClass, DemInternalDataElementClass]  # This reference contains the link to a data element class.
      container DemGeneralOBD [0..1]  # This container contains the general OBD-specific configuration (parameters) of the Dem module.
        boolean DemOBDCentralizedPID21Handling: set at pre-compile  # Switch to enable the centralized handling of PID $21. | true: centralized handling of PID $21 enabled false: centralized handling of PID $21 disabled
        boolean DemOBDCentralizedPID31Handling: set at pre-compile  # Switch to enable the centralized handling of PID $31. | true: centralized handling of PID $31 enabled false: centralized handling of PID $31 disabled
        integer DemOBDCompliancy: 0..255, set at post-build in variant post-build / pre-compile in variant pre-compile  # Configuration value to define the appropriate value to PID$1C "OBD requirements to which vehicle or engine is certified." according to the respective standards, e.g. OBD, OBDII, JOBD etc. | Notice as well J1979 or the "DiagnosticReadiness 1" DM5 message of J1939-73
        enumeration DemOBDDestinationOfEvents: {DEM_DTC_ORIGIN_PRIMARY_MEMORY, DEM_DTC_ORIGIN_SECONDARY_MEMORY}, set at pre-compile  # The destination of events assigns where the OBD events shall be stored.
        boolean DemOBDEventDisplacement: set at pre-compile  # Activate/Deactivate a different displacement behavior for OBD events. | OBD events with special Conditions (e.g. Pending, MIL_On…) shall not be displaced.
        choice reference DemOBDInputAcceleratorPedalInformation [0..1]: set at pre-compile, destination=[DemExternalCSDataElementClass, DemExternalSRDataElementClass]  # Input variable for the accelerator padal information, which is assigned to a specific data element used as interface for the Dem-internal PID calculations.
        choice reference DemOBDInputAmbientPressure [0..1]: set at pre-compile, destination=[DemExternalCSDataElementClass, DemExternalSRDataElementClass]  # Input variable for the ambient pressure, which is assigned to a specific data element used as interface for the Dem-internal PID calculations.
        choice reference DemOBDInputAmbientTemperature [0..1]: set at pre-compile, destination=[DemExternalCSDataElementClass, DemExternalSRDataElementClass]  # Input variable for the ambient temperature, which is assigned to a specific data element used as interface for the Dem-internal PID calculations.
        choice reference DemOBDInputDistanceInformation [0..1]: set at pre-compile, destination=[DemExternalCSDataElementClass, DemExternalSRDataElementClass]  # Input variable for the distance information, which is assigned to a specific data element used as interface for the Dem-internal PID calculations.
        choice reference DemOBDInputEngineSpeed [0..1]: set at pre-compile, destination=[DemExternalCSDataElementClass, DemExternalSRDataElementClass]  # Input variable for the engine speed, which is assigned to a specific data element used as interface for the Dem-internal PID calculations.
        choice reference DemOBDInputEngineTemperature [0..1]: set at pre-compile, destination=[DemExternalCSDataElementClass, DemExternalSRDataElementClass]  # Input variable for the engine temperature, which is assigned to a specific data element used as interface for the Dem-internal PID calculations.
        choice reference DemOBDInputProgrammingEvent [0..1]: set at pre-compile, destination=[DemExternalCSDataElementClass, DemExternalSRDataElementClass]  # Input variable for the programming event, which is assigned to a specific data element used as interface for the Dem-internal PID calculations.
        choice reference DemOBDInputVehicleSpeed [0..1]: set at pre-compile, destination=[DemExternalCSDataElementClass, DemExternalSRDataElementClass]  # Input variable for the vehicle speed, which is assigned to a specific data element used as interface for the Dem-internal PID calculations.
        choice reference DemOBDTimeSinceEngineStart [0..1]: set at pre-compile, destination=[DemExternalCSDataElementClass, DemExternalSRDataElementClass, DemInternalDataElementClass]  # Input variable for the Time Since Engine Start information, which is assigned to a specific data element.
        container DemCallbackOBDDTCStatusChanged [0..*]  # The presence of this container indicates, that the Dem has access to a "DTCStatusChanged" callback, which the Dem will call to notify other components about the change in the status of a DTC. | In case there is a DemCallbackDTCStatusChangedFnc, this parameter defines the name of the function that the Dem will call. In case there is no DemCallbackDTCStatusChangedFnc, the Dem will have an R-Port requiring the interface CallbackDTCStatusChanged whose name is generated by using the unique callback-prefix followed by the event name. Status change notifications are supported for DTCs in primary memory only.
          function name DemCallbackDTCStatusChangedFnc [0..1]: set at pre-compile  # Function name of prototype "DTCStatusChanged". | Note: If the parameter DemTriggerDcmReports is enabled, this parameter shall not be "Dcm_DemTriggerOnDTCStatus".
      container DemGroupOfDTC [0..255]  # This container contains the configuration (parameters) for DTC groups.
        integer DemGroupDTCs: 0..16777214, set at pre-compile, symbolic-name-value=true  # DTC value of the selected group of DTC | (Range: 3 byte, 0x000000 is only available for the emission-related DTC group, 0xFFFFFF is reserved for 'all DTCs', according to ISO14229-1 Annex D.1,) The DTC group 'all DTCs' is always available and will not be configured.
      container DemIndicator [0..255]  # This container contains the configuration (parameters) for Indicators. | Note that this container definition does not explicitly define a symbolic name parameter. Instead, the short name of the container will be used in the Ecu Configuration Description to specify the symbolic name of the INDICATOR_NAME.
        integer DemIndicatorID: 0..255, set at pre-compile, symbolic-name-value=true  # Unique identifier of an indicator.
      container DemNvRamBlockId [0..*]  # This container contains the configuration (parameters) for a non-volatile memory block, which is used from the Dem. If no permanent storage of event memory entries is required, no block needs to be configured. | The number of blocks which are necessary depends on the implementation and configuration (e.g. number of used event memories) of the Dem module.
        symbolic name reference DemNvRamBlockIdRef: set at pre-compile, origin=AUTOSAR_ECUC V1.0.0, destination=NvMBlockDescriptor  # This reference contains the link to a non-volatile memory block. For post build time configurations worst case scenario shall be used.
      container DemOperationCycle [1..256]  # Note that this container definition does not explicitly define a symbolic name parameter. Instead, the short name of the container will be used in the Ecu Configuration Description to specify the symbolic name of the operation cycle name.
        boolean DemOperationCycleAutomaticEnd: set at pre-compile, default-value=false  # If DemOperationCycleAutomaticEnd is configured to TRUE, Dem shall automatically end the driving cycle at either Dem_Shutdown() or Dem_Init().
        boolean DemOperationCycleAutostart: set at pre-compile, default-value=false  # The autostart property defines if the operation cycles is automatically (re-)started during Dem_PreInit.
        enumeration DemOperationCycleType: {DEM_OPCYC_IGNITION, DEM_OPCYC_OBD_DCY, DEM_OPCYC_OTHER, DEM_OPCYC_POWER, DEM_OPCYC_TIME, DEM_OPCYC_WARMUP}, set at pre-compile  # Operation cycles types for the Dem to be supported by cycle-state APIs. | Further cycle types can be specified as part of the Dem delivery.
      container DemRatio [0..65535]  # This container contains the OBD-specific in-use-monitor performance ratio configuration. | It is related to a specific event, a FID, and an IUMPR group.
        enumeration DemIUMPRDenGroup: {DEM_IUMPR_DEN_500MILL, DEM_IUMPR_DEN_COLDSTART, DEM_IUMPR_DEN_EVAP, DEM_IUMPR_DEN_NONE, DEM_IUMPR_DEN_PHYS_API}, set at pre-compile  # This parameter specifies the assigned denominator type which is applied in addition to the General Denominator conditions.
        enumeration DemIUMPRGroup: {DEM_IUMPR_BOOSTPRS, DEM_IUMPR_CAT1, DEM_IUMPR_CAT2, DEM_IUMPR_EGR, DEM_IUMPR_EGSENSOR, DEM_IUMPR_EVAP, DEM_IUMPR_FLSYS, DEM_IUMPR_NMHCCAT, DEM_IUMPR_NOXADSORB, DEM_IUMPR_NOXCAT, DEM_IUMPR_OXS1, DEM_IUMPR_OXS2, DEM_IUMPR_PMFILTER, DEM_IUMPR_PRIVATE, DEM_IUMPR_SAIR, DEM_IUMPR_SECOXS1, DEM_IUMPR_SECOXS2}, set at pre-compile  # This parameter specifies the assigned IUMPR group of the ratio Id.
        integer DemRatioId: 0..65535, set at pre-compile, symbolic-name-value=true  # Defines a unique ratio Id. | This parameter should not be changeable by user, because the Id should be generated by Dem itself to prevent gaps and multiple use of an Id. The ratio Ids should be sequentially ordered beginning with 0 and no gaps in between.
        enumeration DemRatioKind: {DEM_RATIO_API, DEM_RATIO_OBSERVER}, set at pre-compile  # This parameter defines whether the ratio will be calculated API or observer based.
        reference DemDiagnosticEventRef: set at pre-compile, destination=DemEventParameter  # This reference contains the link to a diagnostic event.
        symbolic name reference DemFunctionIdRef: set at pre-compile, destination=FiMFID  # This reference contains the link to a function identifier within the FiM which is used as a primary FID.
        symbolic name reference DemSecondaryFunctionIdRef [0..*]: set at pre-compile, destination=FiMFID  # This reference contains the link to a function identifier within the FiM which is used as a secondary FID. | The "primary" and all "secondary" FID inhibitions are combined by "OR".
      container DemStorageCondition [0..255]  # This container contains the configuration (parameters) for storage conditions.
        integer DemStorageConditionId: 0..255, set at pre-compile, symbolic-name-value=true  # Defines a unique storage condition Id. This parameter should not be changeable by user, because the Id should be generated by Dem itself to prevent gaps and multiple use of an Id. The storage conditions should be sequentially ordered beginning with 0 and no gaps in between.
        boolean DemStorageConditionStatus: set at pre-compile  # Defines the initial status for enable or disable of storage of a diagnostic event. | The value is the initialization after power up (before this condition is reported the first time). true: storage of a diagnostic event enabled false: storage of a diagnostic event disabled
      container DemStorageConditionGroup [0..255]  # This container contains the configuration (parameters) for storage condition groups.
        reference DemStorageConditionRef [1..255]: set at pre-compile, origin=AUTOSAR_ECUC V1.0.0, destination=DemStorageCondition  # References an enable condition.
  module definition Det [0..1]: variants pre-compile  # Det configuration includes the functions to be called at notification. On one | side the application functions are specified and in general it can be decided whether Dlt shall be called at each call of Det.
    container DetGeneral  # Generic configuration parameters of the Det module.
      boolean DetForwardToDlt [0..1]: set at pre-compile  # Only if the parameter is present and set to true, the Det requires the Dlt interface and forwards it's call to the function Dlt_DetForwardErrorTrace. In this case the optional interface to Dlt_Det is required.
      boolean DetVersionInfoApi: set at pre-compile  # Pre-processor switch to enable / disable the API to read out the modules version information. | true: Version info API enabled. false: Version info API disabled.
    container DetNotification [0..1]  # Configuration of the notification functions.
      function name DetErrorHook [0..*]: set at pre-compile  # Optional list of functions to be called by the Development Error Tracer in context of each call of Det_ReportError. | The type of these functions shall be identical the type of Det_ReportError itself: Std_ReturnType (*f)(uint16, uint8, uint8, uint8).
  module definition Dio [0..1]: variants post-build/pre-compile  # Configuration of the Dio (Digital IO) module.
    container DioConfig: multiple-configuration-container=true  # This container contains the configuration parameters and sub containers of the AUTOSAR DIO module. This container is a MultipleConfigurationContainer, i.e. this container and its sub-containers exist once per configuration set.
      container DioPort [1..*]  # Configuration of individual DIO ports, consisting of channels and possible channel groups. | Note that this container definition does not explicitly define a symbolic name parameter. Instead, the container's short name will be used in the Ecu Configuration Description to specify the symbolic name of the port.
        integer DioPortId: 0..4294967295, set at post-build in variant post-build / pre-compile in variant pre-compile, symbolic-name-value=true  # Numeric identifier of the DIO port. Not all MCU ports may be used for DIO, thus there may be "gaps" in the list of all IDs. This value will be | assigned to the DIO port symbolic name (i.e. the SHORT-NAME of the DioPort container).
        container DioChannel [0..*]  # Configuration of an individual DIO channel. Besides a HW specific channel name which is typically fixed for a specific micro controller, additional symbolic names can be defined per channel. | Note hat this container definition does not explicitly define a symbolic name parameter. Instead, the container's short name will be used in the Ecu Configuration Description to specify the symbolic name of the channel.
          integer DioChannelId: 0..4294967295, set at post-build in variant post-build / pre-compile in variant pre-compile, symbolic-name-value=true  # Channel Id of the DIO channel. This value will be assigned to the symbolic names.
        container DioChannelGroup [0..*]  # Definition and configuration of DIO channel groups. A channel group represents several adjoining DIO channels represented by a logical group. | Note hat this container definition does not explicitly define a symbolic name parameter. Instead, the container's short name will be used in the Ecu Configuration Description to specify the symbolic name of the channel group.
          string DioChannelGroupIdentification: set at pre-compile, symbolic-name-value=true  # The DIO channel group is identified in DIO API by a pointer to a data structure (of type Dio_ChannelGroupType). That data structure contains the channel group information. | This parameter contains the code fragment that has to be inserted in the API call of the calling module to get the address of the variable in memory which holds the channel group information. Example values are "&MyDioGroup1" or "&MyDioGroupArray[0]"
          integer DioPortMask: 0..4294967295, set at post-build in variant post-build / pre-compile in variant pre-compile  # This shall be the mask which defines the positions of the channel | group. The channels shall consist of adjoining bits in the same port. The data type depends on the port width.
          integer DioPortOffset: 0..31, set at post-build in variant post-build / pre-compile in variant pre-compile  # The position of the Channel Group on the port, counted | from the LSB. This value can be derived from DioPortMask. calculationFormula = Position of the first bit of DioPortMask which is set to '1' counted from LSB
    container DioGeneral  # General DIO module configuration parameters.
      boolean DioDevErrorDetect: set at pre-compile  # Switches the Development Error Detection and Notification | ON or OFF
      boolean DioFlipChannelApi: set at pre-compile  # Adds / removes the service Dio_FlipChannel() from the code.
      boolean DioVersionInfoApi: set at pre-compile  # Adds / removes the service Dio_ GetVersionInfo() from the code.
  module definition Dlt [0..1]: variants link-time/post-build/pre-compile
    container DltGeneral  # Flags for adding removing functionality from code.
      boolean DltDevErrorDetect: set at pre-compile  # Enables/Disables development error detection.
      boolean DltImplementAppIdContextIdQuery: set at pre-compile  # If set the functionality for Verbose Mode shall be available.
      boolean DltImplementExtendedHeader: set at pre-compile  # If set the extended functionality for the header shall be available.
      boolean DltImplementFilterMessages: set at pre-compile  # This flag is for code generation of Dlt. If set the functionality for filtering messages shall be included in the code.
      boolean DltImplementNVRamStorage: set at pre-compile  # If set the functionality for storing and loading information in and from NVRam shall be availible.
      boolean DltImplementSWCInjection: set at pre-compile  # If the remote call from functions over the Dlt in SW-C shall be available.
      boolean DltImplementTimestamp: set at pre-compile  # If set the timestamp functionality for the header shall be available.
      boolean DltImplementVerboseMode: set at pre-compile  # If set the functionality for Verbose Mode shall be available.
      boolean DltImplementVfbTrace: set at pre-compile  # If set the the header files and the implementation of VFB-trace shall be generated.
      integer DltVfbTraceLogLevel: 0..6, set at link in variant link-time / pre-compile in variant post-build+pre-compile  # The log level of the log messages generated by the VFB-Trace. | ImplementationType: Dlt_MessageLogLevelType
      symbolic name reference DltGptChannel: set at pre-compile, destination=GptChannelConfiguration  # Reference to the hardware free running timer of the GPT module for time stamps (if no HWFRT is applied, calls to add timestamps are ignored).
    container DltMemory  # Configuration parameters for reserving memory for some internal storing and buffer.
      integer DltInitBufferSize: 0..4294967295, set at link in variant link-time / pre-compile in variant post-build+pre-compile  # Buffer size for the C-init buffer. This buffer is for storing messages from other BSW modules before Dlt is initialized. | Unit: byte
      integer DltMaxCountAppIds: 1..4294967295, set at link in variant link-time / pre-compile in variant post-build+pre-compile  # The maximum count of register able Application Ids. There shall be a table to manage registered Application IDs, this is the number of lines to hold in this table. | Unit: byte
      integer DltMaxCountContextIds: 1..4294967295, set at link in variant link-time / pre-compile in variant post-build+pre-compile  # The maximum count of registrable Context Ids. There shall be a table to manage registered Context IDs, this is the number of lines to hold in this table. | Unit: byte
      integer DltMaxCountContextIdsPerAppId: 1..4294967295, set at link in variant link-time / pre-compile in variant post-build+pre-compile  # Each Context ID belongs to a specific Application ID. Dlt shall handle the correlation between them. The table of the registered Application IDs shall hold for every Application ID several references to the proper Context IDs. This is the maximum count for Context IDs per Application ID. | Unit: byte
      integer DltMessageBufferSize: 0..4294967295, set at link in variant link-time / pre-compile in variant post-build+pre-compile  # Buffer size for storing Dlt messages for waiting to transmit over the Network (send buffer). | Unit: byte
    container DltMultipleConfigurationContainer: multiple-configuration-container=true  # Container holding the sub-structure for multiple configuration support.
      symbolic name reference DltNvRamBlockRef: set at post-build in variant post-build / pre-compile in variant pre-compile, destination=NvMBlockDescriptor  # Reference to the NvM Block which is used to store the Dlt parameters.
      container DltBandwidth  # Configuration parameters controlling network and diagnostic interfaces bandwidth. If DltImplementNVRamStorage is enabled this parameters are the initial values for the NVRam. If DltImplementNVRamStorage is not set, Link-Time or Post-Build configuration shall be uesd.
        integer DltBandwidthForComModule: 0..4294967295, set at link in variant link-time / post-build in variant post-build / pre-compile in variant pre-compile  # For communication over the Dlt Communication Module the maximum bandwidth shall be set. | Unit: kbit per second
        integer DltBandwidthForDiagChannel: 0..4294967295, set at link in variant link-time / post-build in variant post-build / pre-compile in variant pre-compile  # For communication over the DCM and as follows over the diagnostic interface the maximum bandwidth shall be set. | Unit: kbit per second
        float DltTimePeriodTrafficShaping: 0..Inf, set at link in variant link-time / post-build in variant post-build / pre-compile in variant pre-compile  # For implementing a traffic shaping, a time window for measuring shall be provided. | Unit: second
      container DltMessageFiltering  # Configuration parameters for setting message filtering properties in Dlt module.
        integer DltDefaultMaxLogLevel: 0..6, set at link in variant link-time / post-build in variant post-build / pre-compile in variant pre-compile  # The maximum log level a received message (from SW-C to Dlt) can have. This can also be modified at runtime and stored persistently in NVRAM. If DltImplementNVRamStorage is enabled this parameter is the initial value for the corospending NVRam entry. If DltImplementNVRamStorage is not set, Link-Time or Post-Build configuration shall be uesd. The value 0 means loging is disabled. | ImplementationType: Dlt_MessageLogLevelType
        boolean DltDefaultTraceStatus: set at link in variant link-time / post-build in variant post-build / pre-compile in variant pre-compile  # Tells if trace messages shall be forwarded by Dlt. This functionality can also be modified at runtime and changed can stored persistently in NVRAM. If DltImplementNVRamStorage is enabled this parameter is the initial value for the corresponding NVRam entry. If DltImplementNVRamStorage is not set, Link-Time or Post-Build configuration shall be used.
        integer DltFactoryDefaultMaxLogLevel: 0..6, set at link in variant link-time / post-build in variant post-build / pre-compile in variant pre-compile  # The maximum log level a received message (from SW-C to Dlt) can have. This is for setting DltDefaultMaxLogLevel to factory defaults. The value 0 means loging is disabled. | ImplementationType: Dlt_MessageLogLevelType
        boolean DltFilterMessages: set at link in variant link-time / pre-compile in variant post-build+pre-compile  # This flag gives the Dlt the instruction to filter or not to filter incoming log or trace messages. If it is not set all incoming messages are forwarded to the communication channel. So also the caller of the DltSendXXXMessage can leave the field trace_info or log_info empty. | If DltImplementNVRamStorage is enabled this parameter is the initial value for the corospending NVRam entry. If DltImplementNVRamStorage is not set, Link-Time or Post-Build configuration shall be uesd.
      container DltProtocol  # Configuration parameters for handling the specific protocol variants.
        string DltEcuId: set at link in variant link-time / post-build in variant post-build / pre-compile in variant pre-compile  # This is the name of the ECU for use within the Dlt protocol. The meaning is described in the document. This name is transimitted within the Dlt protocol. There this are 4 characters. If you want to use an number representation type this as character.
        enumeration DltHeaderPayloadEndianes: {BigEndian, LittleEndian}, set at pre-compile  # Determines the endianes of the CPU (Most Significant Byte).
        boolean DltHeaderUseEcuId: set at link in variant link-time / post-build in variant post-build / pre-compile in variant pre-compile  # Corresponds to field WEID (With ECU ID). If set ECU ID shall be placed in the header, else not. | If DltImplementNVRamStorage is enabled this parameter is the initial value for the corospending NVRam entry. If DltImplementNVRamStorage is not set, Link-Time or Post-Build configuration shall be uesd.
        boolean DltHeaderUseExtendedHeader: set at link in variant link-time / post-build in variant post-build / pre-compile in variant pre-compile  # Corresponds to field UEH (Use Extended Header). If set the Extended Header shall be attached, else not. | If DltImplementNVRamStorage is enabled this parameter is the initial value for the corospending NVRam entry. If DltImplementNVRamStorage is not set, Link-Time or Post-Build configuration shall be uesd.
        boolean DltHeaderUseSessionID: set at link in variant link-time / post-build in variant post-build / pre-compile in variant pre-compile  # Corresponds to field WSID (with Session ID). If set the Session ID shall be placed in the header, else not. | If DltImplementNVRamStorage is enabled this parameter is the initial value for the corospending NVRam entry. If DltImplementNVRamStorage is not set, Link-Time or Post-Build configuration shall be uesd.
        boolean DltHeaderUseTimestamp: set at link in variant link-time / post-build in variant post-build / pre-compile in variant pre-compile  # Corresponds to field WTMS (With Timestamp). If set the timestamp shall be placed in the header, else not. | If DltImplementNVRamStorage is enabled this parameter is the initial value for the corospending NVRam entry. If DltImplementNVRamStorage is not set, Link-Time or Post-Build configuration shall be uesd.
        integer DltMaxMessageLength: 8..65535, set at link in variant link-time / pre-compile in variant post-build+pre-compile  # The maximum length of a Dlt log or trace message.
        boolean DltUseVerboseMode: set at link in variant link-time / post-build in variant post-build / pre-compile in variant pre-compile  # If this flag is set Dlt shall use the Verbose Mode for generating the header of the transport protocol. Also it shall store the information provided by registering Context ID and Application ID (description) at runtime if flag is set. If it is not set, the Non Verbose Mode shall be used. | If DltImplementNVRamStorage is enabled this parameter is the initial value for the corospending NVRam entry. If DltImplementNVRamStorage is not set, Link-Time or Post-Build configuration shall be uesd.
    container DltVfbTrace [0..*]  # All functions to trace from the VFB by the Dlt.
      function name DltVfbTraceFunction: set at pre-compile  # The Dlt generator shall enable VFB tracing for a given hook function when there is a #define in the Dlt-VFB configuration header file for the hook function name and tracing is globally enabled. | Example: #define Dlt_Rte WriteHook i1 p1 a Start. Also the corresponding function shall be generated. The exact argument description for the function is to take from the provieded BSWModudulDescription from the RTE module.
      foreign reference DltBswModuleEntryRef: set at pre-compile, destination-type=BSW-MODULE-ENTRY  # Foreign reference to the BSWModuleEntry describing the trace function implementation.
  module definition DoIP [0..1]: variants link-time/post-build/pre-compile  # Configuration of the DoIP (Diagnostic over IP) module.
    container DoIPConfigSet: multiple-configuration-container=true  # This container contains the configuration parameters and sub containers of the AUTOSAR DoIP module. This container is a MultipleConfigurationContainer, i.e. this container and its sub-containers exist once per configuration set.
      integer DoIPEid [0..1]: 1..281474976710656, set at link in variant link-time / post-build in variant post-build / pre-compile in variant pre-compile  # Configured EID (Entity ID of) for vehicle identification/vehicle announcement. Only necessary if DoIPUseMacAddressForIdentification is set to FALSE.
      integer DoIPGid [0..1]: 1..281474976710656, set at link in variant link-time / post-build in variant post-build / pre-compile in variant pre-compile  # Configured GID (Group ID of) for vehicle identification/vehicle announcement.
      integer DoIPLogicalAddress: 1..65535, set at link in variant link-time / post-build in variant post-build / pre-compile in variant pre-compile  # Describes the logical address of the DoIP entity, i.e. the SA that will route diagnostic requests to the Dcm of the DoIP entity.
      container DoIPChannel [1..65536]  # Configuration of one DoIPChannel.
        reference DoIPChannelSARef: destination=DoIPTester  # Reference to the DoIPTester.
        reference DoIPChannelTARef: destination=DoIPTargetAddress  # Reference to the target address.
        container DoIPPduRRxPdu  # This container contains the Rx Pdus to connect with the Rx Pdus of the PduR.
          integer DoIPPduRRxPduId: 1..65535, set at link in variant link-time / post-build in variant post-build / pre-compile in variant pre-compile, symbolic-name-value=true  # The DoIPPduRRxPduId is required by the API call DoIP_CancelReceive.
          reference DoIPPduRRxPduRef: set at link in variant link-time / post-build in variant post-build / pre-compile in variant pre-compile, destination=Pdu  # Reference to the "global" Pdu structure to allow harmonization of handle IDs in the COM-Stack.
        container DoIPPduRTxPdu  # This container contains the Tx Pdus to connect with the Tx Pdus of the PduR.
          integer DoIPPduRTxPduId: 1..65535, set at link in variant link-time / post-build in variant post-build / pre-compile in variant pre-compile, symbolic-name-value=true  # The DoIPPduRTxPduId is required by DoIP_Transmit and DoIP_CancelTransmit.
          reference DoIPPduRTxPduRef: set at link in variant link-time / post-build in variant post-build / pre-compile in variant pre-compile, destination=Pdu  # Reference to the "global" Pdu structure to allow harmonization of handle IDs in the COM-Stack.
      container DoIPConnections  # Container contains all lower layer connection specific information, i.e. the single Pdu References and Handle IDs to the SoAd.
        container DoIPTargetAddress [1..255]  # This container describes a possible TargetAddress that is supported by DoIP.
          integer DoIPTargetAddressValue: 1..65535, set at link in variant link-time / post-build in variant post-build / pre-compile in variant pre-compile  # Valid Target Address of a DoIP target address.
        container DoIPTcpConnection [1..255]  # Each container describes a tcp connection to the lower layer SoAd module.
          container DoIPSoAdRxPdu  # This container contains the Rx Pdus received by DoIP
            integer DoIPSoAdRxPduId: 1..65535, set at link in variant link-time / post-build in variant post-build / pre-compile in variant pre-compile, symbolic-name-value=true  # The DoIPSoAdRxPduId is required by the API call DoIP_SoAdTpRxIndication to receive I-PDUs from the SoAd.
            reference DoIPSoAdRxPduRef: set at link in variant link-time / post-build in variant post-build / pre-compile in variant pre-compile, destination=Pdu  # Reference to the "global" Pdu structure to allow harmonization of handle IDs in the COM-Stack.
          container DoIPSoAdTxPdu  # This container describes the TxPdu sent via the SoAd
            integer DoIPSoAdTxPduId: 1..65535, set at link in variant link-time / post-build in variant post-build / pre-compile in variant pre-compile, symbolic-name-value=true  # The DoIPSoAdTxPduId is required by the API call DoIP_SoAdTpTxConfirmation that is called by the SoAd to confirm that the IPdu has been transmitted successfully.
            reference DoIPSoAdTxPduRef: set at link in variant link-time / post-build in variant post-build / pre-compile in variant pre-compile, destination=Pdu  # Reference to the "global" Pdu structure to allow harmonization of handle IDs in the COM-Stack.
        container DoIPUdpConnection [1..255]  # This Container describes the udp connection to the lower layer SoAd module.
          container DoIPSoAdRxPdu  # This container contains the Rx Pdus received by DoIP
            integer DoIPSoAdRxPduId: 1..65535, set at link in variant link-time / post-build in variant post-build / pre-compile in variant pre-compile, symbolic-name-value=true  # The DoIPSoAdRxPduId is required by the API call DoIP_SoAdTpRxIndication to receive I-PDUs from the SoAd.
            reference DoIPSoAdRxPduRef: set at link in variant link-time / post-build in variant post-build / pre-compile in variant pre-compile, destination=Pdu  # Reference to the "global" Pdu structure to allow harmonization of handle IDs in the COM-Stack.
          container DoIPSoAdTxPdu  # This container describes the TxPdu sent via the SoAd
            integer DoIPSoAdTxPduId: 1..65535, set at link in variant link-time / post-build in variant post-build / pre-compile in variant pre-compile, symbolic-name-value=true  # The DoIPSoAdTxPduId is required by the API call DoIP_SoAdTpTxConfirmation that is called by the SoAd to confirm that the IPdu has been transmitted successfully.
            reference DoIPSoAdTxPduRef: set at link in variant link-time / post-build in variant post-build / pre-compile in variant pre-compile, destination=Pdu  # Reference to the "global" Pdu structure to allow harmonization of handle IDs in the COM-Stack.
      container DoIPRoutingActivation [0..255]: post-build-changeable=true  # This container describes the routing activation possibilities by representing for each container a possible routing activation request message to the DoIP entity and the according references to the activated diagnostic messages.
        integer DoIPRoutingActivationNumber: 0..255, set at link in variant link-time / post-build in variant post-build / pre-compile in variant pre-compile  # Identifies the Routing activation Number which is received for a DoIP routing activation request message.
        reference DoIPTargetAddressRef [1..255]: set at link in variant link-time / post-build in variant post-build / pre-compile in variant pre-compile, destination=DoIPTargetAddress  # Reference to all DoIPTargetAddress which are activated on this Routing activation.
        container DoIPRoutingActivationAuthenticationCallback [0..1]  # Container describes the Callbackfunction to call on a Routing Activation Request for Authentication. If this container is configured but the DoIPRoutingAcivationAuthenticationFunc parameter is not present, the DoIP module will use an RPort of ServiceInterface <RoutingActivation>_RoutingActivation with the name "CB<RoutingActivation>RoutingActivation". <RoutingActivation> is the ShortName of the DoIPRoutingActiviation container.
          function name DoIPRoutingAcivationAuthenticationFunc [0..1]: set at link in variant link-time+post-build / pre-compile in variant pre-compile  # Direct C Callback function to trigger the authentication function for routing activation. If the DoIPRoutingAcivationAuthenticationFunc parameter is present, the DoIP module will not use an RPort of ServiceInterface <RoutingActivation>_RoutingActivation but call the configured function.
          integer DoIPRoutingActivationAuthenticationReqLength: 0..4, set at link in variant link-time+post-build / pre-compile in variant pre-compile  # Describes the amount of bytes used to handle to the authentication function on routing activation. If 0 is configured as length the parameter AuthenticationReqData will not be handled to the API.
          integer DoIPRoutingActivationAuthenticationResLength: 0..4, set at link in variant link-time+post-build / pre-compile in variant pre-compile  # Describes the amount of bytes used to read by the authentication function on routing activation. If 0 is configured as length the parameter AuthenticationResData will not be fetched via the API.
        container DoIPRoutingActivationConfirmationCallback [0..1]  # Container describes the Callbackfunction to call on a Routing Activation Request for Confirmation. If this container is configured but the DoIPRoutingAcivationConfirmationFunc parameter is not present the DoIP module will use an RPort of ServiceInterface <RoutingActivation>_RoutingActivation with the name "CB<RoutingActivation>RoutingActivation". <RoutingActivation> is the ShortName of the DoIPRoutingActiviation container.
          function name DoIPRoutingAcivationConfirmationFunc [0..1]: set at link in variant link-time+post-build / pre-compile in variant pre-compile  # Direct C Callback function to trigger the confirmation function for routing activation. If the DoIPRoutingAcivationConfirmationFunc parameter is present the DoIP module will not use an RPort of ServiceInterface <RoutingActivation>_RoutingActivation but call the configured function.
          integer DoIPRoutingActivationConfirmationReqLength: 0..4, set at link in variant link-time+post-build / pre-compile in variant pre-compile  # Describes the amount of bytes used to handle to the confirmation function on routing activation. If 0 is configured as length the parameter ConfirmedReqData will not be handled to the API.
          integer DoIPRoutingActivationConfirmationResLength: 0..4, set at link in variant link-time+post-build / pre-compile in variant pre-compile  # Describes the amount of bytes used to read by the confirmation function on routing activation. If 0 is configured as length the parameter ConfirmedResData will not be fetched via the API.
      container DoIPTester [0..255]: post-build-changeable=true  # This container describes the properties of the possible connectable Tester for the DoIP entity.
        integer DoIPNumByteDiagAckNack: 1..18446744073709551611, set at link in variant link-time / post-build in variant post-build / pre-compile in variant pre-compile  # Specifies the number of original Diagnostic request bytes the DoIP entity responses on a NACK of a diagnostic response message to the Tester.
        integer DoIPTesterSA: 1..65535, set at link in variant link-time / post-build in variant post-build / pre-compile in variant pre-compile  # Source Address of the Tester sent via routing activation or diagnostic message.
        reference DoIPRoutingActivationRef [1..255]: set at link in variant link-time / post-build in variant post-build / pre-compile in variant pre-compile, destination=DoIPRoutingActivation  # Reference to a DoIPRoutingActivation describing the possible routing activations of the DoIPTester
    container DoIPGeneral  # This container specifies the general configuration parameters of the DoIP module.
      float DoIPAliveCheckResponseTimeout: 0..Inf, set at pre-compile  # Timeout in [s] for waiting for a response to an Alive Check request before the connection is considered to be disconnected. Represents parameter T_TCP_AliveCheck of ISO 13400-2:2012.
      boolean DoIPDevelopmentErrorDetect: set at pre-compile  # Pre-processor switch for enabling development error detection support.
      boolean DoIPDhcpOptionVinUse: set at pre-compile  # If DoIPDhcpOptionVinUse is set to true the DoIP module will add the VIN to the Dhcp host name if no valid Dhcp host name is already set.
      boolean DoIPEntityStatusMaxByteFieldUse: set at pre-compile  # This parameter is used to distinguish the optional support of the Max data size element of a diagnostic entity status response.
      integer DoIPGIDInvalidityPattern: 0..255, set at pre-compile  # Specifies the Byte pattern that is used for response messages if no valid GID could be retrieved.
      float DoIPGeneralInactivityTime: 0..Inf, set at pre-compile  # Timeout in [s] for maximum inactivity of a TCP socket connection before the DoIP module will close the according socket connection. Represents parameter T_TCP_General_Inactivity of ISO 13400-2:2012
      string DoIPHeaderFileInclusion [0..*]: set at pre-compile  # Name of the header file(s) to be included by the DoIP module containing the used C-callback declarations.
      float DoIPInitialInactivityTime: 0..Inf, set at pre-compile  # Timeout in [s] used for initial inactivity of a connected TCP socket connection directly after socket connection. Represents parameter T_TCP_Initial_Inactivity of ISO 13400-2:2012
      float DoIPInitialVehicleAnnouncementTime: 0..Inf, set at pre-compile  # Time to wait in [s] for sending first vehicle anouncement message after IP address assignment. Represents parameter A_DoIP_Announce_Wait of ISO 13400-2:2012
      float DoIPMainFunctionPeriod: 0..Inf, set at pre-compile  # Determines the frequency at which the DoIP_MainFunction() is called in [s].
      integer DoIPMaxRequestBytes: 1..18446744073709551615, set at pre-compile  # Specifies the maximum allowed bytes of a DoIP message request without the DoIP header.
      integer DoIPMaxTesterConnections: 1..255, set at pre-compile  # Maximum ammount of tester connections that shall be maintained at one time before alive check is performed.
      enumeration DoIPNodeType: {DOIP_GATEWAY, DOIP_NODE}, set at pre-compile  # Describes the Type of the DoIP node.
      boolean DoIPUseEIDasGID: set at pre-compile  # Specifies if the DoIP entity shall use its EID if it is the Master for vehicle identification gid on the vehicle identification/vehicle announcement.
      boolean DoIPUseMacAddressForIdentification: set at pre-compile  # Provided the information if a configured EID at vehicle identification response/vehicle announment is used or the MAC address. | TRUE: Use MAC Address instead of EID for Vehicle identification/announcement. FALSE: Use configured EID for vehicle identification/announcement. Dependencies: DoIPEID
      boolean DoIPUseVehicleIdentificationSyncStatus: set at pre-compile  # Defines if the optional VIN/GID synchronization status is used additionally in the vehicle identification/announcement.
      float DoIPVehicleAnnouncementInterval: 0..Inf, set at pre-compile  # Time to wait in [s] for sending subsequent vehicle anouncement messages. Represents parameter A_DoIP_Announce_Interval of ISO 13400-2:2012
      integer DoIPVehicleAnnouncementRepetition: 1..255, set at pre-compile  # Amount of repetitions of the vehicle announcement message on IP address assignment. Represents parameter A_DoIP_Annunce_Num of ISO 13400-2:2012
      boolean DoIPVersionInfoApi: set at pre-compile  # Activates the DoIP_GetVersionInfo() API. | TRUE: Enables the DoIP_GetVersionInfo() API. FALSE: DoIP_GetVersionInfo() API is not included.
      boolean DoIPVinGidMaster: set at pre-compile  # Specifies if the DoIP entity is the Vehicle identification Master for the GID (Group ID).
      integer DoIPVinInvalidityPattern: 0..255, set at pre-compile  # Specifies the Byte pattern that is used for response messages if no valid VIN could be retrieved.
      container DoIPGetGid [0..1]  # This container describes the Callbackfunction to get the GID. | If this container is not configured no Callbackfunction will be used. If this container is configured but the DoIPGetGID parameter is not present, the DoIP module will use an RPort of ServiceInterface CallbackGetGID with the name "CBGetGID".
        function name DoIPGetGID [0..1]: set at link in variant link-time+post-build / pre-compile in variant pre-compile  # Direct C Callback function to get the GID of the DoIP entity. If the DoIPGetGID parameter is present, the DoIP module will not use an RPort of ServiceInterface CallbackGetGID but call the configured function.
      container DoIPPowerModeCallback  # This container describes the Callbackfunction to get the Power Mode. This container shall always be present. | If the DoIPPowerMode parameter is not present, the DoIP module will use an RPort of ServiceInterface CallbackGetPowerMode with the name "CBGetPowerMode".
        function name DoIPPowerMode [0..1]: set at link in variant link-time+post-build / pre-compile in variant pre-compile  # Direct C Callback function to get the Power Mode of the DoIP entity. If the DoIPPowerMode parameter is present, the DoIP module will not use an RPort of ServiceInterface CallbackGetPowerMode but will call the configured function.
      container DoIPTriggerGidSynchronization [0..1]  # This container describes the Callbackfunction to trigger the GID synchronisation. | If this container is not configured no Callbackfunction will be used. If this container is configured but the DoIPTriggerGIDSynchronzation parameter is not present, the DoIP module will use an RPort of ServiceInterface CallbackTriggerGIDSynchronization with the name "CBTriggerGIDSynchronization".
        function name DoIPTriggerGIDSynchronzation [0..1]: set at link in variant link-time+post-build / pre-compile in variant pre-compile  # Direct C Callback function to trigger the synchronization of the GID. If the DoIPTriggerGIDSynchronzation parameter is present, the DoIP module will not use an RPort of ServiceInterface CallbackTriggerGIDSynchronization but call the configured function.
  module definition Ea [0..1]: variants pre-compile  # Configuration of the Ea (EEPROM Abstraction) module. | The module shall abstract from the device specific addressing scheme and segmentation and provide the upper layers with a virtual addressing scheme and segmentation as well as a 'virtually' unlimited number of erase cycles.
    container EaBlockConfiguration [1..*]  # Configuration of block specific parameters for the EEPROM abstraction module.
      integer EaBlockNumber: 1..65534, set at pre-compile, symbolic-name-value=true  # Block identifier (handle). | 0x0000 and 0xFFFF shall not be used for block numbers (see EA006). Range: min = 2^NVM_DATASET_SELECTION_BITS max = 0xFFFF -2^NVM_DATASET_SELECTION_BITS Note: Depending on the number of bits set aside for dataset selection several other block numbers shall also be left out to ease implementation.
      integer EaBlockSize: 1..65535, set at pre-compile  # Size of a logical block in bytes.
      boolean EaImmediateData: set at pre-compile  # Marker for high priority data. | true: Block contains immediate data. false: Block does not contain immediate data.
      integer EaNumberOfWriteCycles: 0..4294967295, set at pre-compile  # Number of write cycles required for this block.
      symbolic name reference EaDeviceIndex: set at pre-compile, destination=EepGeneral  # Device index (handle). | Range: 0 .. 254 (0xFF reserved for broadcast call to GetStatus function).
    container EaGeneral  # General configuration of the EEPROM abstraction module. This container lists block independent configuration parameters.
      boolean EaDevErrorDetect: set at pre-compile  # Pre-processor switch to enable and disable development error detection. | true: Development error detection enabled. false: Development error detection disabled.
      integer EaIndex: 0..254, set at pre-compile  # Specifies the InstanceId of this module instance. If only one instance is present it shall have the Id 0.
      function name EaNvmJobEndNotification [0..1]: set at pre-compile  # Mapped to the job end notification routine provided by the upper layer module (NvM_JobEndNotification).
      function name EaNvmJobErrorNotification [0..1]: set at pre-compile  # Mapped to the job error notification routine provided by the upper layer module (NvM_JobErrorNotification).
      boolean EaPollingMode: set at pre-compile  # Pre-processor switch to enable and disable the polling mode for this module. | true: Polling mode enabled, callback functions (provided to EEP module) disabled. false: Polling mode disabled, callback functions (provided to EEP module) enabled.
      boolean EaSetModeSupported: set at pre-compile, default-value=true  # Compile switch to enable / disable the function Ea_SetMode.
      boolean EaVersionInfoApi: set at pre-compile  # Pre-processor switch to enable / disable the API to read out the modules version information. | true: Version info API enabled. false: Version info API disabled.
      integer EaVirtualPageSize: 0..65535, set at pre-compile  # The size in bytes to which logical blocks shall be aligned.
    container EaPublishedInformation  # Additional published parameters not covered by CommonPublishedInformation container. | Note that these parameters do not have any configuration class setting, since they are published information.
      integer EaBlockOverhead: 0..65535, set at published-information  # Management overhead per logical block in bytes. | Note: If the management overhead depends on the block size or block location a formula has to be provided that allows the configurator to calculate the management overhead correctly.
      float EaMaximumBlockingTime: 0..Inf, set at published-information  # The maximum time the EA module's API routines shall be blocked (delayed) by internal operations. (EA070) | Note: Internal operations in that case means operations that are not explicitly invoked from the upper layer module but need to be handled for proper operation of this module or the underlying memory driver.
      integer EaPageOverhead: 0..65535, set at published-information  # Management overhead per page in bytes. | Note: If the management overhead depends on the block size or block location a formula has to be provided that allows the configurator to calculate the management overhead correctly.
  module definition EcuC [0..1]: variants post-build/pre-compile  # Virtual module to collect ECU Configuration specific / global configuration information.
    container EcucPartitionCollection [0..1]  # Collection of Partitions defined for this ECU.
      container EcucPartition [0..*]  # Definition of one Partition on this ECU. | One Partition will be implemented using one Os-Application.
        boolean EcucPartitionBswModuleExecution: set at pre-compile  # Denotes that this partition will execute all BSW Modules. BSW Modules can only be executed in one partition.
        boolean PartitionCanBeRestarted: set at pre-compile  # Specifies the requirement whether the Partition can be restarted. If set to true all software executing in this partition shall be capable of handling a restart.
        instance reference EcucPartitionSoftwareComponentInstanceRef [0..*]: set at pre-compile, destination-context=ROOT-SW-COMPOSITION-PROTOTYPE, destination-type=SW-COMPONENT-PROTOTYPE  # References the SW Component instances from the Ecu Extract that shall be executed in this partition.
    container EcucPduCollection [0..1]  # Collection of all Pdu objects flowing through the Com-Stack.
      enumeration PduIdTypeEnum: {UINT16, UINT8}  # The PduIdType is used within the entire AUTOSAR Com Stack except for bus drivers. The size of this global type depends on the maximum number of PDUs used within one software module. If no software module deals with more PDUs that 256, this type can be set to uint8. If at least one software module handles more than 256 PDUs, this type must be set to uint16. See AUTOSAR_SWS_CommunicationStackTypes for more details.
      enumeration PduLengthTypeEnum: {UINT16, UINT32, UINT8}  # The PduLengthType is used within the entire AUTOSAR Com Stack except for bus drivers. The size of this global type depends on the maximum length of PDUs to be sent by an ECU. If no segmentation is used the length depends on the maximum payload size of a frame of the underlying communication system (for FlexRay maximum size is 255 bytes, therefore uint8). If segementation is used it depends on the maximum length of a segmeneted N-PDU (in general uint16 is used). See AUTOSAR_SWS_CommunicationStackTypes for more details.
      container Pdu [0..*]  # One Pdu flowing through the COM-Stack. | This Pdu is used by all Com-Stack modules to agree on referencing the same Pdu.
        integer PduLength: 0..4095, set at post-build in variant post-build / pre-compile in variant pre-compile  # Length of the Pdu in bytes. It should be noted that in former AUTOSAR releases (Rel 2.1, Rel 3.0, Rel 3.1, Rel 4.0 Rev. 1) this parameter was defined in bits.
        foreign reference SysTPduToFrameMappingRef [0..1]: set at pre-compile, destination-type=PDU-TO-FRAME-MAPPING  # Optional reference to the PduToFrameMapping from the SystemTemplate which this Pdu represents.
    container EcucVariationResolver [0..1]  # Collection of PredefinedVariant elements containing definition of values for SwSystemconst which shall be applied when resolving the variability during ECU Configuration.
      foreign reference PredefinedVariantRef [1..*]: set at pre-compile, destination-type=PREDEFINED-VARIANT
    container EcucHardware [0..1]  # Hardware definition of this Ecu.
      container EcucCoreDefinition [0..*]  # Definition of one Core on this Ecu.
        integer EcucCoreId: 0..65535, set at pre-compile, symbolic-name-value=true  # ID of the core.
        foreign reference EcucCoreHwRef [0..1]: set at pre-compile, destination-type=HW-ELEMENT  # Optional reference to the HwElement of HwCategory ProcessingUnit that represents this Core in the ECU Resource Template.
  module definition EcuM [0..1]: variants post-build  # Configuration of the EcuM (ECU State Manager) module.
    container EcuMConfiguration: multiple-configuration-container=true  # This container contains the configuration (parameters) of the ECU State Manager.
      container EcuMCommonConfiguration  # This container contains the common configuration (parameters) of the ECU State Manager.
        integer EcuMConfigConsistencyHash: 0..18446744073709551615, set at link  # A hash value generated across all pre-compile and link-time parameters of all BSW modules. This hash value is compared against a field in the EcuM_ConfigType and hence allows checking the consistency of the entire configuration.
        reference EcuMDefaultAppMode: set at post-build, destination=OsAppMode  # The default application mode loaded when the ECU comes out of reset.
        reference EcuMOSResource [1..*]: set at pre-compile, destination=OsResource  # This parameter is a reference to a OS ressource which is used to bring the ECU into sleep mode. | In case of multi core each core shall have an own OsResource.
        container EcuMDefaultShutdownTarget  # This container describes the default shutdown target to be selected by EcuM. The actual shutdown target may be overridden by the EcuM_SelectShutdownTarget service.
          enumeration EcuMDefaultState: {EcuMStateOff, EcuMStateReset, EcuMStateSleep}, set at post-build  # This parameter describes the state part of the default shutdown target selected when the ECU comes out of reset. If EcuMStateSleep is selected, the parameter EcuMDefaultSleepModeRef selects the specific sleep mode.
          symbolic name reference EcuMDefaultResetModeRef [0..1]: set at post-build, destination=EcuMResetMode  # If EcuMDefaultShutdownTarget is EcuMStateReset, this parameter selects the default reset mode. Otherwise this parameter may be ignored.
          symbolic name reference EcuMDefaultSleepModeRef [0..1]: set at post-build, destination=EcuMSleepMode  # If EcuMDefaultShutdownTarget is EcuMStateSleep, this parameter selects the default sleep mode. Otherwise this parameter may be ignored.
        container EcuMDemEventParameterRefs [0..1]  # Container for the references to DemEventParameter elements which shall be invoked using the API Dem_ReportErrorStatus in case the corresponding error occurs. The EventId is taken from the referenced DemEventParameter's DemEventId value. | The standardized errors are provided in this container and can be extended by vendor specific error references.
          symbolic name reference ECUM_E_ALL_RUN_REQUESTS_KILLED [0..1]: set at pre-compile, destination=DemEventParameter  # Reference to the DemEventParameter which shall be issued when the error "ECUM_E_ALL_RUN_REQUESTS_KILLED" has occured.
          symbolic name reference ECUM_E_CONFIGURATION_DATA_INCONSISTENT [0..1]: set at pre-compile, destination=DemEventParameter  # Reference to the DemEventParameter which shall be issued when the error "ECUM_E_CONFIGURATION_DATA_INCONSISTENT" has occured.
          symbolic name reference ECUM_E_RAM_CHECK_FAILED [0..1]: set at pre-compile, destination=DemEventParameter  # Reference to the DemEventParameter which shall be issued when the error "ECUM_E_RAM_CHECK_FAILED" has occured.
        container EcuMDriverInitListOne [0..1]  # Container for Init Block I. | This container holds a list of module IDs that will be initialised. Each module in the list will be called for initialisation in the list order. All modules in this list are initilialised before the OS is started and so these modules require no OS support.
          container EcuMDriverInitItem [1..*]  # These containers describe the entries in a driver init list.
            string EcuMModuleID: set at pre-compile  # Short name of the module to be initialized, e.g. Mcu, Gpt etc.
            string EcuMModuleService: set at pre-compile  # The service to be called to initialize that module, e.g. Init, PreInit, Start etc. | If the service is Init and the parameter EcuMModuleConfigurationRef has been set for that module, the corresponding pointer to the init structure (<Module>_ConfigType) and in case of multiple instantiation an uint8 value to identify the instance of the module(<MSN>_CtrlIdx) shall be passed as arguments.
        container EcuMDriverInitListZero [0..1]  # Container for Init Block 0. | This container holds a list of module IDs that will be initialised. Each module in the list will be called for initialisation in the list order. All modules in this list are initilialised before the post-build configuration has been loaded and the OS is initialized. Therefore, these modules may not use post-build configuration.
          container EcuMDriverInitItem [1..*]  # These containers describe the entries in a driver init list.
            string EcuMModuleID: set at pre-compile  # Short name of the module to be initialized, e.g. Mcu, Gpt etc.
            string EcuMModuleService: set at pre-compile  # The service to be called to initialize that module, e.g. Init, PreInit, Start etc. | If the service is Init and the parameter EcuMModuleConfigurationRef has been set for that module, the corresponding pointer to the init structure (<Module>_ConfigType) and in case of multiple instantiation an uint8 value to identify the instance of the module(<MSN>_CtrlIdx) shall be passed as arguments.
        container EcuMDriverRestartList [0..1]  # List of module IDs. | EcuM2719: A configuration tool shall fill the callout EcuM_AL_DriverRestart with initialization calls to the listed drivers in the order in which they occur in the list. EcuM2720: Entries in this list must appear in the same order as in the combined list of EcuM_DriverInitListOne and EcuM_DriverInitListTwo. This list may be a real subset though. In all other cases, the generation tool shall report an error. The included container has the same structure as EcuM_DriverInitItem
          container EcuMDriverInitItem [1..*]  # These containers describe the entries in a driver init list.
            string EcuMModuleID: set at pre-compile  # Short name of the module to be initialized, e.g. Mcu, Gpt etc.
            string EcuMModuleService: set at pre-compile  # The service to be called to initialize that module, e.g. Init, PreInit, Start etc. | If the service is Init and the parameter EcuMModuleConfigurationRef has been set for that module, the corresponding pointer to the init structure (<Module>_ConfigType) and in case of multiple instantiation an uint8 value to identify the instance of the module(<MSN>_CtrlIdx) shall be passed as arguments.
        container EcuMSleepMode [1..*]  # These containers describe the configured sleep modes. | The names of these containers specify the symbolic names of the different sleep modes.
          integer EcuMSleepModeId: 0..255, set at pre-compile, symbolic-name-value=true  # This ID identifies this sleep mode in services like EcuM_SelectShutdownTarget.
          boolean EcuMSleepModeSuspend: set at pre-compile  # Flag, which is set true, if the CPU is suspended, halted, or powered off in the sleep mode. If the CPU keeps running in this sleep mode, then this flag must be set to false.
          symbolic name reference EcuMSleepModeMcuModeRef: set at pre-compile, destination=McuModeSettingConf  # This parameter is a reference to the corresponding MCU mode for this sleep mode.
          symbolic name reference EcuMWakeupSourceMask [1..*]: set at pre-compile, destination=EcuMWakeupSource  # These parameters are references to the wakeup sources that shall be enabled for this sleep mode.
        container EcuMWakeupSource [1..*]  # These containers describe the configured wakeup sources.
          float EcuMValidationTimeout [0..1]: 0..Inf, set at pre-compile  # The validation timeout (period for which the ECU State Manager will wait for the validation of a wakeup event) can be defined for each wakeup source independently. The timeout is specified in seconds. | When the timeout is not instantiated, there is no validation routine and the ECU Manager shall not validate the wakeup source.
          integer EcuMWakeupSourceId: 0..31, set at pre-compile, symbolic-name-value=true  # This parameter defines the identifier of this wakeup source.
          boolean EcuMWakeupSourcePolling: set at pre-compile  # This parameter describes if the wakeup source needs polling.
          symbolic name reference EcuMComMChannelRef [0..1]: set at pre-compile, destination=ComMChannel  # This parameter is a reference to a Network (channel) defined in the Communication Manager. No reference indicates that the wakeup source is not a communication channel.
          symbolic name reference EcuMResetReasonRef: set at pre-compile, destination=McuResetReasonConf  # This parameter describes the mapping of reset reasons detected by the MCU driver into wakeup sources.
      container EcuMFixedConfiguration [0..1]  # This container contains the configuration (parameters) of the EcuMFixed. | Only applicable if EcuMFixed is implemented.
        float EcuMNvramReadallTimeout: 0..Inf, set at post-build  # Period given in seconds for which the ECU State Manager will wait until it considers a ReadAll job of the NVRAM Manager as failed.
        float EcuMNvramWriteallTimeout: 0..Inf, set at post-build  # Period given in seconds for which the ECU State Manager will wait until it considers a WriteAll job of the NVRAM Manager as failed.
        float EcuMRunMinimumDuration: 0..Inf, set at post-build  # Duration given in seconds for which the ECU State Manager will | stay in RUN state even when no one requests RUN. This duration should be long at least as long as a SW-Cs needs to request RUN.
        choice reference EcuMFixedModuleConfigurationRef [0..*]: set at post-build, destination=[AdcConfigSet, CanConfigSet, CanIfInitCfg, CanNmGlobalConfig, CanSMConfiguration, CanTpConfig, CanTrcvConfigSet, ComConfig, ComMConfigSet, DbgMultipleConfigurationContainer, DcmConfigSet, DemConfigSet, DioConfig, DltMultipleConfigurationContainer, EepInitConfiguration, EthConfigSet, EthIfConfigSet, EthTrcvConfigSet, FiMConfigSet, FlsConfigSet, FlsTstConfigSet, FrArTpMultipleConfig, FrIfConfig, FrMultipleConfiguration, FrNmChannelConfig, FrSMConfig, FrTpMultipleConfig, GptChannelConfigSet, IcuConfigSet, IpduMConfig, J1939TpConfiguration, LinGlobalConfig, LinIfGlobalConfig, LinSMConfigSet, LinTpGlobalConfig, McuModuleConfiguration, PduRRoutingTables, PortConfigSet, PwmChannelConfigSet, RtePostBuildVariantConfiguration, SoAdDoIpConfig, SpiDriver, UdpNmGlobalConfig, WdgMConfigSet, WdgSettingsConfig, XcpConfig]  # These parameters contain references to the init structure of the corresponding BSW module.
        symbolic name reference EcuMComMCommunicationAllowedList [0..*]: set at pre-compile, destination=ComMChannel  # These parameters contain references to the ComMChannels for which EcuM has to call ComM_CommunicationAllowed.
        symbolic name reference EcuMNormalMcuModeRef: set at pre-compile, destination=McuModeSettingConf  # This parameter is a reference to the normal MCU mode to be restored after a sleep.
        container EcuMDriverInitListThree [0..1]  # Container for Init Block III. | This container holds a list of module IDs that will be initialised. Each module in the list will be called for initialisation in the list order. All modules in this list are initilialised after the OS is started and so these modules may use OS support. These modules may also rely on the Nvram ReadAll job to have provided all data.
          container EcuMDriverInitItem [1..*]  # These containers describe the entries in a driver init list.
            string EcuMModuleID: set at pre-compile  # Short name of the module to be initialized, e.g. Mcu, Gpt etc.
            string EcuMModuleService: set at pre-compile  # The service to be called to initialize that module, e.g. Init, PreInit, Start etc. | If the service is Init and the parameter EcuMModuleConfigurationRef has been set for that module, the corresponding pointer to the init structure (<Module>_ConfigType) and in case of multiple instantiation an uint8 value to identify the instance of the module(<MSN>_CtrlIdx) shall be passed as arguments.
        container EcuMDriverInitListTwo [0..1]  # Container for Init Block II. | This container holds a list of module IDs that will be initialised. Each module in the list will be called for initialisation in the list order. All modules in this list are initilialised after the OS is started and so these modules may use OS support. These modules may not rely on the Nvram ReadAll job to have provided all data.
          container EcuMDriverInitItem [1..*]  # These containers describe the entries in a driver init list.
            string EcuMModuleID: set at pre-compile  # Short name of the module to be initialized, e.g. Mcu, Gpt etc.
            string EcuMModuleService: set at pre-compile  # The service to be called to initialize that module, e.g. Init, PreInit, Start etc. | If the service is Init and the parameter EcuMModuleConfigurationRef has been set for that module, the corresponding pointer to the init structure (<Module>_ConfigType) and in case of multiple instantiation an uint8 value to identify the instance of the module(<MSN>_CtrlIdx) shall be passed as arguments.
        container EcuMFixedUserConfig [1..*]  # These containers describe the identifiers that are needed to refer to a software component or another appropriate entity in the system which is designated to request the RUN state. Application requestors refer to entities above RTE, system requestors to entities below RTE (e.g. Communication Manager).
          integer EcuMFixedUser: 0..255, set at pre-compile, symbolic-name-value=true  # Parameter used to identify one user.
        container EcuMTTII [0..*]  # These containers describe the structures and the following configuration items describe its elements. These structures are concatenated to build a list as indicated by Figure 27 - Configuration Container Diagram. | The list must contain at least one element when ECUM_TTII_ENABLED is set to true.
          integer EcuMDivisor: 0..18446744073709551615, set at pre-compile  # This parameter defines the divisor preload value.
          symbolic name reference EcuMSleepModeRef: set at pre-compile, destination=EcuMSleepMode  # This configuration parameter is a reference to a configured sleep mode that is used for TTII.
          symbolic name reference EcuMSuccessorRef [0..1]: set at pre-compile, destination=EcuMSleepMode  # This parameter is a reference to the next sleep mode in the TTII protocol.
      container EcuMFlexConfiguration [0..1]  # This container contains the configuration (parameters) of the EcuMFlex. | Only applicable if EcuMFlex is implemented.
        choice reference EcuMFlexModuleConfigurationRef [0..*]: set at post-build, destination=[AdcConfigSet, CanConfigSet, DemConfigSet, FlsConfigSet, GptChannelConfigSet, IcuConfigSet, LinGlobalConfig, McuModuleConfiguration, PortConfigSet, PwmChannelConfigSet, SpiDriver, WdgMConfigSet, WdgSettingsConfig]  # These parameters contain references to the init structure of the corresponding BSW module.
        symbolic name reference EcuMNormalMcuModeRef: set at pre-compile, destination=McuModeSettingConf  # This parameter is a reference to the normal MCU mode to be restored after a sleep.
        container EcuMAlarmClock [0..*]  # These containers describe the configured alarm clocks. | The name of these conatiners allows giving a symbolic name to one alarm clock.
          integer EcuMAlarmClockId: 0..255, set at pre-compile, symbolic-name-value=true  # This ID identifies this alarmclock.
          float EcuMAlarmClockTimeOut: 0..Inf, set at pre-compile  # This parameter allows to define a timout for this alarm clock.
          symbolic name reference EcuMAlarmClockUser: set at pre-compile, destination=EcuMFlexUserConfig  # This parameter allows an alarm to be assigned to a user.
        container EcuMFlexUserConfig [1..*]  # These containers describe the identifiers that are needed to refer to a software component or another appropriate entity in the system which uses the EcuMFlex Interfaces.
          integer EcuMFlexUser: 0..255, set at pre-compile, symbolic-name-value=true  # Parameter used to identify one user.
          reference EcuMFlexEcucPartitionRef [0..1]: set at pre-compile, destination=EcucPartition  # Denotes in which "EcucPartition" the user of the EcuM is executed.
        container EcuMGoDownAllowedUsers [0..1]  # This container describes the collection of allowed users which are allowed to call the EcuM_GoDown API.
          symbolic name reference EcuMGoDownAllowedUserRef [1..*]: set at pre-compile, destination=EcuMFlexUserConfig  # These parameters describe the references to the users which are allowed to call the EcuM_GoDown API.
        container EcuMResetMode [1..*]  # These containers describe the configured reset modes. | The name of these containers allows one of the following symbolic names to be given to the different reset modes: - ECUM_RESET_MCU - ECUM_RESET_WDGM - ECUM_RESET_IO.
          integer EcuMResetModeId: 0..255, set at pre-compile, symbolic-name-value=true  # This ID identifies this reset mode in services like EcuM_SelectShutdownTarget.
        container EcuMSetClockAllowedUsers [0..1]  # This container describes the collection of allowed users which are allowed to call the EcuM_SetClock API.
          symbolic name reference EcuMSetClockAllowedUserRef [1..*]: set at pre-compile, destination=EcuMFlexUserConfig  # These parameters describe the references to the users which are allowed to call the EcuM_SetClock API.
        container EcuMShutdownCause [1..*]  # These containers describe the configured shut down or reset causes. | The name of these containers allows to give one of the following symbolic names to the diffenrent shut down causes: - ECUM_CAUSE_ECU_STATE - ECU state machine entered a state for shutdown, - ECUM_CAUSE_WDGM - WdgM detected failure, - ECUM_CAUSE_DCM - Dcm requests shutdown (split into UDS services?), - and values from configuration.
          integer EcuMShutdownCauseId: 0..255, set at pre-compile, symbolic-name-value=true  # This ID identifies this shut down cause.
        container EcuMShutdownTarget [1..*]  # These containers describe the configured shut down targets. | The name of these containers allows to give symbolic names to the different shut down targets.
          integer EcuMShutdownTargetId: 0..255, set at pre-compile, symbolic-name-value=true  # This ID identifies this shut down target in services like EcuM_SelectShutdownTarget.
    container EcuMFixedGeneral [0..1]  # This container holds the general, pre-compile configuration parameters for the EcuMFixed. | Only applicable if EcuMFixed is implemented.
      boolean EcuMIncludeComM: set at pre-compile  # This configuration parameter defines whether the communication manager is supported by EcuM. This feature is presented for development purpose to compile out the communication manager in the early debugging phase.
      boolean EcuMIncludeNvM: set at pre-compile  # This configuration parameter defines whether the non volatile memory manager is supported by EcuM. This feature is presented for development purpose to compile out the volatile memory manager in the early debugging phase.
      boolean EcuMIncludeNvramMgr: set at pre-compile  # If NVRAM manager is enabled but both flash and EEPROM driver are missing, then an error shall be flagged by the configuration tool
      boolean EcuMTTIIEnabled: set at pre-compile  # Boolean switch to enable / disable TTII
      symbolic name reference EcuMTTIIWakeupSourceRef: set at pre-compile, destination=EcuMWakeupSource  # This configuration parameter references the initial sleep mode to be used by TTII when TTII is activated after a RUN mode. | EcuM2785: Whenever RUN mode is reached, the TTII protocol shall be reset to use the wakeup source referenced by this parameter. This configuration parameter is a human readable name for a TTII wakeup source which is only needed by the configuration tool. For imlementation on the ECU, this parameter may be dropped and replaced by a generated list index of EcuM_TTII.
    container EcuMFlexGeneral [0..1]  # This container holds the general, pre-compile configuration parameters for the EcuMFlex. | Only applicable if EcuMFlex is implemented.
      boolean EcuMAlarmClockPresent: set at pre-compile  # This flag indicates whether the optional AlarmClock feature is present.
      boolean EcuMEnableDefBehaviour [0..1]: set at pre-compile  # Switches the defensive behaviour on or off.
      boolean EcuMResetLoopDetection: set at pre-compile  # If false, no reset loop detection is performed.
      symbolic name reference EcuMAlarmWakeupSource [0..1]: set at pre-compile, destination=EcuMWakeupSource  # This parameter describes the reference to the EcuMWakeupSource being used for the EcuM AlarmClock.
    container EcuMGeneral  # This container holds the general, pre-compile configuration parameters.
      boolean EcuMDevErrorDetect: set at pre-compile  # If false, no debug artifacts (e.g. calls to DET) shall remain in the executable object. Initialization of DET, however is controlled by configuration of optional BSW modules.
      boolean EcuMIncludeDem: set at pre-compile  # If enabled, the according BSW module will be included to the ECU State Manager.
      boolean EcuMIncludeDet: set at pre-compile  # If defined, the according BSW module will be initialized by the ECU State Manager
      float EcuMMainFunctionPeriod: 0..Inf, set at pre-compile  # This parameter defines the schedule period of EcuM_MainFunction. | Unit: [s]
      boolean EcuMVersionInfoApi: set at pre-compile  # Switches the version info API on or off
  module definition Eep [0..*]: variants post-build/pre-compile  # Configuration of the Eep (internal or external EEPROM driver) module. | Its multiplicity describes the number of EEPROM drivers present, so there will be one container for each EEPROM driver in the ECUC template. When no EEPROM driver is present then the multiplicity is 0.
    container EepGeneral  # Container for general configuration parameters of the EEPROM driver. These parameters are always pre-compile.
      boolean EepDevErrorDetect: set at pre-compile, default-value=true  # Pre-processor switch to enable and disable development error detection. | true: Development error detection enabled. false: Development error detection disabled.
      integer EepDriverIndex: 0..254, set at pre-compile, symbolic-name-value=true  # Index of the driver, used by EA.
      boolean EepUseInterrupts: set at pre-compile, default-value=false  # Switches to activate or deactivate interrupt controlled job processing. | true: Interrupt controlled job processing enabled. false: Interrupt controlled job processing disabled.
      boolean EepVersionInfoApi: set at pre-compile, default-value=false  # Pre-processor switch to enable / disable the API to read out the modules version information. | true: Version info API enabled. false: Version info API disabled.
      boolean EepWriteCycleReduction: set at pre-compile, default-value=false  # Switches to activate or deactivate write cycle reduction (EEPROM value is read and compared before being overwritten). | true: Write cycle reduction enabled. false: Write cycle reduction disabled.
    container EepInitConfiguration: multiple-configuration-container=true  # Container for runtime configuration parameters of the EEPROM driver. | Implementation Type: Eep_ConfigType.
      integer EepBaseAddress: 0..4294967295, set at post-build in variant post-build / pre-compile in variant pre-compile  # This parameter is the EEPROM device base address. | Implementation Type: Eep_AddressType.
      enumeration EepDefaultMode: {MEMIF_MODE_FAST, MEMIF_MODE_SLOW}, set at post-build in variant post-build / pre-compile in variant pre-compile, default-value=MEMIF_MODE_SLOW  # This parameter is the default EEPROM device mode after initialization. | Implementation Type: MemIf_ModeType.
      integer EepFastReadBlockSize: 0..4294967295, set at post-build in variant post-build / pre-compile in variant pre-compile  # Number of bytes read within one job processing cycle in fast mode. If the hardware does not support burst mode this parameter shall be set to the same value as EepNormalReadBlockSize. | Implementation Type: Eep_LengthType.
      integer EepFastWriteBlockSize: 0..4294967295, set at post-build in variant post-build / pre-compile in variant pre-compile  # Number of bytes written within one job processing cycle in fast mode. If the hardware does not support burst mode this parameter shall be set to the same value as EepNormalWriteBlockSize. | Implementation Type: Eep_LengthType.
      float EepJobCallCycle [0..1]: 0..Inf, set at post-build in variant post-build / pre-compile in variant pre-compile  # Call cycle time of the EEPROM driver's main function. Unit: [s]
      function name EepJobEndNotification [0..1]: set at post-build in variant post-build / pre-compile in variant pre-compile  # This parameter is a reference to a callback function for positive job result (see EEP045).
      function name EepJobErrorNotification [0..1]: set at post-build in variant post-build / pre-compile in variant pre-compile  # This parameter is a reference to a callback function for negative job result (see EEP046).
      integer EepNormalReadBlockSize: 0..4294967295, set at post-build in variant post-build / pre-compile in variant pre-compile  # Number of bytes read within one job processing cycle in normal mode. | Implementation Type: Eep_LengthType.
      integer EepNormalWriteBlockSize: 0..4294967295, set at post-build in variant post-build / pre-compile in variant pre-compile  # Number of bytes written within one job processing cycle in normal mode. | Implementation Type: Eep_LengthType.
      integer EepSize: 0..4294967295, set at post-build in variant post-build / pre-compile in variant pre-compile  # This parameter is the used size of EEPROM device in bytes. | Implementation Type: Eep_LengthType.
      container EepDemEventParameterRefs [0..1]  # Container for the references to DemEventParameter elements which shall be invoked using the API Dem_ReportErrorStatus API in case the corresponding error occurs. The EventId is taken from the referenced DemEventParameter's DemEventId value. The standardized errors are provided in the container and can be extended by vendor specific error references.
        symbolic name reference EEP_E_COMPARE_FAILED [0..1]: set at post-build in variant post-build / pre-compile in variant pre-compile, destination=DemEventParameter  # Reference to the DemEventParameter which shall be issued when the error "EEPROM compare failed (HW)" has occurred.
        symbolic name reference EEP_E_ERASE_FAILED [0..1]: set at post-build in variant post-build / pre-compile in variant pre-compile, destination=DemEventParameter  # Reference to the DemEventParameter which shall be issued when the error "EEPROM erase failed (HW)" has occurred.
        symbolic name reference EEP_E_READ_FAILED [0..1]: set at post-build in variant post-build / pre-compile in variant pre-compile, destination=DemEventParameter  # Reference to the DemEventParameter which shall be issued when the error "EEPROM read failed (HW)" has occurred.
        symbolic name reference EEP_E_WRITE_FAILED [0..1]: set at post-build in variant post-build / pre-compile in variant pre-compile, destination=DemEventParameter  # Reference to the DemEventParameter which shall be issued when the error "EEPROM write failed (HW)" has occurred.
      container EepExternalDriver [0..1]  # This container is present for external EEPROM drivers only. Internal EEPROM drivers do not use the parameter listed in this container, hence its multiplicity is 0 for internal drivers.
        symbolic name reference EepSpiReference [1..*]: set at post-build in variant post-build / pre-compile in variant pre-compile, destination=SpiSequence  # Reference to SPI sequence (required for external EEPROM drivers).
    container EepPublishedInformation  # Additional published parameters not covered by CommonPublishedInformation container. | Note that these parameters do not have any configuration class setting, since they are published information.
      integer EepAllowedWriteCycles: 0..4294967295, set at published-information  # Specified maximum number of write cycles under worst case conditions of specific EEPROM hardware (e.g. +90°C)
      float EepEraseTime: 0..Inf, set at published-information  # Maximum time for erasing one EEPROM data unit.
      integer EepEraseUnitSize: 0..4294967295, set at published-information  # Size of smallest erasable EEPROM data unit in bytes.
      integer EepEraseValue: 0..255, set at published-information  # Value of an erased EEPROM cell.
      integer EepMinimumAddressType: 0..4294967295, set at published-information  # Minimum expected size of Eep_AddressType.
      integer EepMinimumLengthType: 0..4294967295, set at published-information  # Minimum expected size of Eep_LengthType.
      integer EepReadUnitSize: 0..4294967295, set at published-information  # Size of smallest readable EEPROM data unit in bytes.
      integer EepSpecifiedEraseCycles: 0..4294967295, set at published-information  # Number of erase cycles specified for the EEP device (usually given in the device data sheet).
      integer EepTotalSize: 0..4294967295, set at published-information  # Total size of EEPROM in bytes. | Implementation Type: Eep_LengthType.
      float EepWriteTime: 0..Inf, set at published-information  # Maximum time for writing one EEPROM data unit.
      integer EepWriteUnitSize: 0..4294967295, set at published-information  # Size of smallest writeable EEPROM data unit in bytes.
  module definition Eth [0..*]: variants link-time/post-build/pre-compile  # Configuration of the Eth (Ethernet Driver) module.
    container EthConfigSet: multiple-configuration-container=true  # All included containers and parameters that may be part of a multiple configuration set.
      container EthCtrlConfig [1..*]  # Configuration of the individual controller
        boolean EthCtrlEnableMii: set at pre-compile  # Enables / Disables Media Independent Interface (MII) for transceiver access
        boolean EthCtrlEnableRxInterrupt: set at pre-compile  # Enables / Disables receive interrupt
        boolean EthCtrlEnableTxInterrupt: set at pre-compile  # Enables / Disables transmit interrupt
        integer EthCtrlIdx: 0..255, set at link in variant link-time / post-build in variant post-build / pre-compile in variant pre-compile, symbolic-name-value=true  # Specifies the instance ID of the configured controller.
        string EthCtrlPhyAddress [0..1]: set at link in variant link-time / post-build in variant post-build / pre-compile in variant pre-compile, max-length=17, min-length=17  # Specifies the unique 48-bit physical address (MAC address) of the controller in network byte order. | Regular Expression: [0-9a-fA-F]{2}[[:-][0-9a-fA-F]{2}]{5}
        integer EthCtrlRxBufLenByte: 0..1522, set at link in variant link-time / post-build in variant post-build / pre-compile in variant pre-compile  # Limits the maximum receive buffer length (frame length) in bytes.
        integer EthCtrlTxBufLenByte: 0..1522, set at link in variant link-time / post-build in variant post-build / pre-compile in variant pre-compile  # Limits the maximum transmit buffer length (frame length) in bytes.
        integer EthRxBufTotal: 0..255, set at link in variant link-time / post-build in variant post-build / pre-compile in variant pre-compile  # Configures the number of receive buffers.
        integer EthTxBufTotal: 0..255, set at link in variant link-time / post-build in variant post-build / pre-compile in variant pre-compile  # Configures the number of transmit buffers.
        container EthDemEventParameterRefs [0..1]  # Container for the references to DemEventParameter elements which shall be invoked using the API Dem_ReportErrorStatus in case the corresponding error occurs. The EventId is taken from the referenced DemEventParameter's DemEventId value. The standardized errors are provided in the container and can be extended by vendor specific error references.
          symbolic name reference ETH_E_ACCESS [0..1]: set at link in variant link-time / post-build in variant post-build / pre-compile in variant pre-compile, destination=DemEventParameter  # Reference to the DemEventParameter which shall be issued when the error "Controller access failed" has occured.
    container EthGeneral  # General configuration of Ethernet Driver module
      boolean EthDevErrorDetect: set at pre-compile  # Enables / Disables development error detection.
      integer EthIndex: 0..255, set at pre-compile  # Specifies the InstanceId of this module instance. If only one instance is present it shall have the Id 0.
      integer EthMaxCtrlsSupported: 1..255, set at pre-compile  # Limits the total number of supported controllers.
      boolean EthUpdatePhysAddrFilter: set at pre-compile, default-value=false  # Enables/Disables optional API Eth_UpdatePhysAddrFilter.
      boolean EthVersionInfoApi: set at pre-compile  # Enables / Disables version info API
  module definition EthIf [0..1]: variants link-time/post-build/pre-compile  # Configuration of the EthIf (Ethernet Interface) module.
    container EthIfConfigSet: multiple-configuration-container=true  # Collecting container for all parameters with post-build configuration classes.
      container EthIfController [1..*]  # This container contains the configuration of EthIfController.
        integer EthIfCtrlIdx: 0..255, set at link in variant link-time / post-build in variant post-build / pre-compile in variant pre-compile, symbolic-name-value=true  # This parameter provides a zero-based consecutive index of the Ethernet Communication Controllers. Upper layer BSW modules and the EthIf itself use this index to identify a Ethernet CC.
        integer EthIfCtrlMtu: 64..9000, set at link in variant link-time / post-build in variant post-build / pre-compile in variant pre-compile  # Specifies the maximum transmission unit (MTU) of the EthIfCtrl in [bytes]. | Note: in case a VLAN tag is used for the EthIfCtrl, the MTU is 4 bytes smaller than the maximum payload size of an Ethernet frame which can be transmitted on the network.
        integer EthIfVlanId: 0..4095, set at link in variant link-time / post-build in variant post-build / pre-compile in variant pre-compile  # A virtual-LAN is identified by this attribute according to IEEE 802.1Q.
        symbolic name reference EthIfEthCtrlRef: set at link in variant link-time / post-build in variant post-build / pre-compile in variant pre-compile, destination=EthCtrlConfig  # Reference to a Controller, which is handled by a specific Driver. This reference is unique for the ECU.
        symbolic name reference EthIfEthTrcvRef: set at link in variant link-time / post-build in variant post-build / pre-compile in variant pre-compile, destination=EthTrcvConfig  # Reference to a Ethernet Transceiver.
      container EthIfFrameOwnerConfig [1..*]  # Configuration of Ethernet frame owner
        integer EthIfFrameType: 0..65535, set at link in variant link-time / post-build in variant post-build / pre-compile in variant pre-compile  # Selects the Ethernet frame type.
        integer EthIfOwner: 0..255, set at link in variant link-time / post-build in variant post-build / pre-compile in variant pre-compile  # Selects the owner of an Ethernet frame type. The owner is a zero based index into the callback function configuration 'EthIfRxIndicationConfig'. I.e. an Ethernet frame of type IPv4 (0x800) at index 0 will call the first callback function configured in 'EthIfRxIndicationConfig'.
      container EthIfRxIndicationConfig [1..*]  # Configuration of receive callback functions.
        function name EthIfRxIndicationFunction: set at link in variant link-time / post-build in variant post-build / pre-compile in variant pre-compile  # Specifies receive indication callback function.
      container EthIfTrcvLinkStateChgConfig [1..*]  # Specifies link state change callback function
        function name EthIfTrcvLinkStateChgFunction: set at link in variant link-time / post-build in variant post-build / pre-compile in variant pre-compile  # Specifies link state change callback function
      container EthIfTxConfirmationConfig [1..*]  # Configuration of transmit indication callback functions.
        function name EthIfTxConfirmationFunction: set at link in variant link-time / post-build in variant post-build / pre-compile in variant pre-compile  # Specifies transmit indication callback function
    container EthIfGeneral  # This container contains the general configuration parameters of the Ethernet Interface.
      boolean EthIfDevErrorDetect: set at pre-compile  # Enables / Disables development error detection.
      boolean EthIfEnableRxInterrupt: set at pre-compile  # Enables / Disables receive interrupt.
      boolean EthIfEnableTxInterrupt: set at pre-compile  # Enables / Disables the transmit interrupt.
      boolean EthIfGetBaudRate: set at pre-compile  # Enables / Disables GetBaudRate API.
      boolean EthIfGetCounterState: set at pre-compile  # Enables / Disables GetCounterState API.
      float EthIfMainFunctionPeriod: 0..Inf, set at pre-compile  # Specifies the period of main function EthIf_MainFunctionRx and EthIf_MainFunctionTx in seconds. Ethernet Interface does not require this information but the BSW scheduler.
      float EthIfMainFunctionRxTimeout: 0..Inf, set at pre-compile  # Timeout in seconds after which the EthIf stops to receive frames in an EthIfMainFunctionRx period.
      integer EthIfMaxTrcvsTotal: 1..255, set at pre-compile  # Limits the total number of transceivers.
      integer EthIfMaxTxBufsTotal: 1..255, set at pre-compile  # Limits the total number of transmit buffers.
      string EthIfPublicCddHeaderFile [0..*]: set at pre-compile, max-length=32, min-length=1  # Defines header files for callback functions which shall be included in case of CDDs. Range of characters is 1.. 32.
      integer EthIfRxIndicationIterations: 0..65535, set at pre-compile  # Maximum number of Ethernet frames per Ethernet controller polled from the Ethernet driver within EthIf_MainFunctionRx.
      boolean EthIfStartAutoNegotiation: set at pre-compile  # Enables / Disables StartAutoNegotiation API.
      integer EthIfTrcvLinkStateChgMainReload: 1..255, set at pre-compile  # Specifies the frequency of transceiver link state change checks in each | period of main function EthIf_MainFunctionTx.
      boolean EthIfVersionInfoApi: set at pre-compile  # Enables / Disables version info API
      boolean EthIfVersionInfoApiMacro: set at pre-compile  # Enables / Disables version info API macro implementation.
  module definition EthSM [0..1]: variants pre-compile  # Configuration of the Ethernet State Manager
    container EthSMGeneral  # This container contains the global parameter of the Ethernet State Manager.
      boolean EthSMDevErrorDetect: set at pre-compile  # Enables and disables the development error detection and notification mechanism.
      boolean EthSMDummyMode: set at pre-compile  # Disables the API to the EthIf. The API to the ComM is available but the functionality is deactivated. The function calls from the ComM will be answered with the return value E_OK.
      float EthSMMainFunctionPeriod: 0.005..1, set at pre-compile  # Specifies the period in seconds that the MainFunction has to be triggered with.
      boolean EthSMVersionInfoApi: set at pre-compile  # Enables and disables the version info API.
    container EthSMNetwork [1..*]  # This container contains the Ethernet network-specific parameters of each Ethernet network. It also contains the controller and transceiver IDs assigned to a Ethernet network.
      float EthSMConfirmationTimeout: 0..Inf, set at pre-compile  # Timeout in seconds for the calls to EthIf: | EthIf_ControllerInit EthIf_TransceiverInit EthIf_SetControllerMode EthIf_SetTransceiverMode
      symbolic name reference EthSMComMNetworkHandleRef: set at pre-compile, destination=ComMChannel  # Unique handle to identify one certain Ethernet network. Reference to one of the network handles configured for the ComM.
      symbolic name reference EthSMEthIfControllerRef: set at pre-compile, destination=EthIfController  # Reference to EthIfCtrl container where a ETH controller and | transceiver (optional) combination is configured.
      container EthSMDemEventParameterRefs [0..1]  # Container for the references to DemEventParameter elements which shall be invoked using the API Dem_ReportErrorStatus API in case the corresponding error occurs. The EventId is taken from the referenced DemEventParameter's DemEventId value. The standardized errors are provided in the container and can be extended by vendor specific error references.
        symbolic name reference ETHSM_E_LINK_DOWN [0..1]: set at pre-compile, destination=DemEventParameter  # Reference to configured DEM event to report bus off errors for this Eth network.
  module definition EthSwt [0..*]: variants link-time/post-build/pre-compile  # Configuration of the EthSwt (Ethernet Switch Driver) module.
    container EthSwtConfig [1..*]  # Configuration of one Ethernet Switch.
      integer EthSwtIdx: 0..255, symbolic-name-value=true  # Specifies the instance ID of the configured Ethernet Switch.
      container EthSwtDemEventParameterRefs [0..1]  # Container for the references to DemEventParameter elements which shall be invoked using the API Dem_ReportErrorStatus in case the corresponding error occurs. The EventId is taken from the referenced DemEventParameter's DemEventId value. The standardized errors are provided in the container and can be extended by vendor specific error references.
        symbolic name reference ETHSWT_E_ACCESS [0..1]: destination=DemEventParameter  # Reference to the DemEventParameter which shall be issued when the error "Ethernet Switch Access Failure" has occurred.
      container EthSwtNvm [0..1]  # Configuration of one Ethernet Switch Nvm usage in case the module requires non volatile memory in the Ecu to store switch configuration.
        symbolic name reference EthSwtNvmBlockDescriptorRef: destination=NvMBlockDescriptor  # Reference to the Nvm block description in the Nvm module configuration.
      container EthSwtPort [1..*]  # Configuration of one Ethernet Switch Port.
        boolean EthSwtPortEnableLinkDownCallback  # Enables the callback <User>_LinkDown for this EthSwtPort if an IEEE802.1X link loss is detected. | <User> is defined by EthSwtLinkDownUser.
        integer EthSwtPortIdx: 0..255, symbolic-name-value=true  # Specifies the instance ID of the configured Ethernet Switch Port.
        enumeration EthSwtPortPhysicalLayerType: {ETHSWT_PORT_BASE_T, ETHSWT_PORT_BROAD_R_REACH, ETHSWT_PORT_RTPGE, ETHSWT_PORT_X_MII}  # Defines the physical layer type on this EthSwtPort.
        string EthSwtPortPredefinedMacAddresses [0..*]: regular-expression=[0-9a-fA-F]{2}[[:-][0-9a-fA-F]{2}]{5}  # Specifies a list of 48-bit physical addresses (MAC addresses) which can be reached via this port in network byte order. | Note that further addresses can be learned during runtime.
        enumeration EthSwtPortSpeed [0..1]: {ETHSWT_PORT_SPEED_10, ETHSWT_PORT_SPEED_100, ETHSWT_PORT_SPEED_1000}  # Defines the communication speed in Mbit per second on this EthSwtPort in case no EthSwtPortTrcvRef is defined. | Is optional if EthSwtPortTrcvRef is defined.
        symbolic name reference EthSwtPortTrcvRef [0..1]: destination=EthTrcvConfig  # Reference to the ethernet transceiver driver this EthSwtPort is connected with.
        container EthSwtPortEgress  # Configuration of one Ethernet Switch Port Egress behavior.
          reference EthSwtPortEgressLastSchedulerRef: destination=EthSwtPortScheduler  # Reference to the port scheduler which is the last in the egress port structure.
          container EthSwtPortFifo [1..*]  # Represents a Fifo in the egress port.
            integer EthSwtPortFifoTrafficClassAssignment [0..8]: 0..7  # Defines which traffic classes are assigned to this Fifo.
          container EthSwtPortScheduler [1..*]  # Represents a Scheduler in the egress port.
            enumeration EthSwtPortSchedulerAlgorithm: {ETHSWT_SCHEDULER_DEFICIT_ROUND_ROBIN, ETHSWT_SCHEDULER_STRICT_PRIORITY, ETHSWT_SCHEDULER_WEIGHTED_ROUND_ROBIN}  # Defines the scheduler algorithm.
            container EthSwtPortSchedulerPredecessor [1..*]  # Defines an ordered list of predecessors for this scheduler.
              integer EthSwtPortSchedulerPredecessorOrder: 0..18446744073709551615  # Defines the order of the scheduler predecessors.
              choice reference EthSwtPortEgressPredecessorRef: destination=[EthSwtPortFifo, EthSwtPortScheduler, EthSwtPortShaper]  # Choice reference to the scheduler predecessor.
          container EthSwtPortShaper [0..*]  # Represents a Shaper in the egress port.
            integer EthSwtPortShaperIdleSlope [0..1]: 0..18446744073709551615  # Defines the increase of credit in bits per second for the AVB shaper.
            reference EthSwtPortEgressPredecessorFifoRef: destination=EthSwtPortFifo  # Reference to the fifo which is the predecessor for this shaper.
          container EthSwtPortVlanForwarding [0..*]  # Defines how messages with a specific VLAN Id shall be handled at this egress port wrt. their VLAN Id.
            integer EthSwtPortVlanDefaultPriority: 0..7  # Determines the standard output-priority outgoing messages will be tagged with.
            integer EthSwtPortVlanForwardingId: 1..4094  # Determines the VLAN Id the VlanForwarding shall apply to.
            enumeration EthSwtPortVlanForwardingType: {ETHSWT_NOT_SENT, ETHSWT_SENT_TAGGED, ETHSWT_SENT_UNTAGGED}  # Defines how the message with a specific VLAN Id shall be handled.
        container EthSwtPortIngress  # Configuration of one Ethernet Switch Port ingress behavior.
          integer EthSwtPortIngressVlanModification [0..1]: 1..4094  # If this parameter is defined all messages which arrive at this ingress port will be tagged with this VLAN Id. This tagging happen also if the arriving message already has a VLAN Id, it will be overwritten by the defined one. | If this parameter is not defined no changes to the VLAN Id shall happen at this ingress port.
          integer EthSwtPortTrafficClassAssignment [0..1]: 0..7  # If this parameter is defined all arriving messages at this ingress port shall be assigned this traffic class. | If this parameter is not defined no general port based traffic class assignment is done.
          container EthSwtPriorityRegeneration [0..8]  # Defines a priority regeneration where the EthSwtPriorityRegenerationIngressPriority is replaced by EthSwtPriorityRegenerationRegeneratedPriority. | The EthSwtPriorityRegeneration is optional in case no priority regeneration shall be performed. In case a EthSwtPriorityRegeneration is defined it shall have 8 mappings, one for each priority.
            integer EthSwtPriorityRegenerationIngressPriority: 0..7  # Message priority of the incoming message.
            integer EthSwtPriorityRegenerationRegeneratedPriority: 0..7  # Message priority the incoming message will be tagged with.
          container EthSwtPriorityTrafficClassAssignment [0..8]  # Defines a priority based traffic class assignment. All messages with a specific priority (EthSwtPriorityTrafficClassAssignmentPriority) arriving at this ingress port or, if enabled regenerated priorities (EthSwtPriorityRegeneration), shall be assigned to a traffic class (EthSwtPriorityTrafficClassAssignmentTrafficClass).
            integer EthSwtPriorityTrafficClassAssignmentPriority: 0..7  # Message priority.
            integer EthSwtPriorityTrafficClassAssignmentTrafficClass: 0..7  # Traffic Class value.
      container EthSwtSpi [0..1]  # Configuration of one Ethernet Switch SPI access (if SPI is used).
        container EthSwtSpiSequence [1..*]  # Container gives EthSwt driver information about one SPI sequence. | One SPI sequence used by EthSwt driver is in exclusive use for it. No other driver is allowed to access this sequence. EthSwt driver may use one sequence to access n EthSwt hardware chips of the same type or n sequences are used to access one single EthSwt hardware chip. If a EthSwt hardware has no SPI interface, there is no instance of this container.
          boolean EthSwtSpiAccessSynchronous [0..1]  # This parameter is used to define whether the access to the Spi sequence is synchronous or asynchronous. | true: SPI access is synchronous. false: SPI access is asynchronous.
          symbolic name reference EthSwtSpiSequenceName [0..*]: destination=SpiSequence  # Reference to a Spi sequence configuration container.
    container EthSwtGeneral  # General configuration of Ethernet Switch Driver module.
      boolean EthSwtDevErrorDetect  # Enables / Disables development error detection.
      boolean EthSwtEnableVlanApi  # Enables / Disables EthSwt_EnableVLAN API.
      boolean EthSwtGetArlTableApi  # Enables / Disables EthSwt_GetArlTable API.
      boolean EthSwtGetBufferLevelApi  # Enables / Disables API to fetch the switch buffer utilization.
      boolean EthSwtGetDropCountApi  # Enables / Disables EthSwt_GetDropCount API.
      boolean EthSwtGetEtherStatsApi  # Enables / Disables EthSwt_GetEtherStats API.
      boolean EthSwtGetMacLearningModeApi  # Enables / Disables EthSwt_GetMacLearningMode API.
      boolean EthSwtGetPortMacAddrApi  # Enables / Disables EthSwt_GetPortMacAddr API.
      boolean EthSwtGetSwitchRegApi  # Enables / Disables EthSwt_GetSwitchReg API.
      integer EthSwtIndex: 0..255  # Specifies the InstanceId of this module instance. If only one instance is present it shall have the Id 0.
      function name EthSwtLinkDownUser [0..1]  # Defines the <User> function name for the <User>_LinkDown callback.
      function name EthSwtLinkUpUser [0..1]  # Defines the <User> function name for the <User>_LinkUp callback.
      boolean EthSwtPersistentConfigurationResult  # Enables / Disables the callback API <User>_PersistentConfigurationResult.
      function name EthSwtPersistentConfigurationResultUser [0..1]  # Defines the <User> function name for the <User>_PersistentConfigurationResult callback.
      string EthSwtPublicCddHeaderFile [0..*]: max-length=32, min-length=1  # Defines header files for callback functions which shall be included in case of CDDs.
      boolean EthSwtReadTrcvRegisterApi  # Enables / Disables EthSwt_ReadTrcvRegister API.
      boolean EthSwtResetConfigurationApi  # Enables / Disables EthSwt_ResetConfiguration API.
      boolean EthSwtSetMacLearningModeApi  # Enables / Disables EthSwt_SetMacLearningMode API.
      boolean EthSwtSetSwitchRegApi  # Enables / Disables EthSwt_SetSwitchReg API.
      boolean EthSwtStoreConfigurationApi  # Enables / Disables EthSwt_StoreConfiguration API.
      boolean EthSwtVersionInfoApi  # Enables / Disables version info API.
      boolean EthSwtWriteTrcvRegisterApi  # Enables / Disables EthSwt_WriteTrcvRegister API.
  module definition EthTSyn [0..1]: category=VENDOR_SPECIFIC_MODULE_DEFINITION, variants pre-compile  # Configuration of the Synchronized Time-base Manager (StbM) module with respect to global time handling on Ethernet.
    container EthTSynGeneral  # This container holds the general parameters of the Ethernet-specific Synchronized Time-base Manager
      boolean EthTSynDevErrorDetect: set at pre-compile, default-value=true  # This parameter switches the Development Error Detection and Notification ON or OFF. true: Development error detection is enabled. false: Development error detection is disabled. Note: In general, the development error detection is recommended during pre-test phase. It is not recommended to enable the development error detection in production code due to increased runtime and ROM needs.
      boolean EthTSynHardwareTimestampSupport: set at pre-compile, default-value=true  # Activate/Deactivate the hardware time stamping functionality of the Ethernet hardware. True: Clock is administrated by EthIf-Lower layer (e.g. Eth). Timestamps are requested from EthIf (e.g. EthIf_GetIngressTimestamp()) False: Clock is administrated by StbM, therefore timestamps are provided by the StbM. | True: Timestamp is retrieved from the Ethernet hardware False: Timestamp is retrieved from the StbM
      float EthTSynMainFunctionPeriod: 0..1.7976931348623157E+308, set at pre-compile, default-value=0.005  # Schedule period of the main function EthTSyn_MainFunction. Unit: [s].
      boolean EthTSynVersionInfo: default-value=false  # Activate/Deactivate the version information API (EthTSyn_GetVersionInfo) to get major, minor and patch version information. True: version information API activated False: version information API deactivated.
      string EthTSynDestPhyAddr: set at pre-compile, origin=Vector Informatik, default-value=01:80:C2:00:00:0E  # Destination Physical Address (MAC-Address) | Destination Physical Hardware Address (MAC-Address) of EthTSyn-gPTP Frames. Input format has to match xx::xx::xx::xx::xx::xx, where x stands for a hex value between 0 and F.
      string EthTSynUserConfigFile [0..1]: set at pre-compile, origin=Vector Informatik  # Reference to an external user configuration file that will be included during generation. The content of the user configuration file will be added at the end of the generated module configuration file and allows altering or extending the generated code. Caution: User configuration files can cause the software module to malfunction and must only be used with great care!
      string EthTSynPublicCddHeaderFile [0..*]: set at pre-compile, origin=Vector Informatik, max-length=32, min-length=1  # Defines header files for call-back functions (e.g. Sync / FollowUp sent) which shall be included in case of CDDs. Range of characters is 1.. 32.
      boolean EthTSynGmCapable: origin=Vector Informatik, default-value=false  # Grand Master Capable | Select whether the EthTSyn can act as Grand Master. In a bridge configuration, the ECU will take over the role of the GM in case a Sync-Timeout is detected on the Slave-Por
      reference EthTSynEthIfFrameType: set at pre-compile, origin=Vector Informatik, destination=EthIfFrameOwnerConfig  # Frame Type | The chosen frame owner determines which frames (in respect to ethertype) are received.
    container EthTSynGlobalTimeDomain [1..*]  # This represents the existence of a global time domain on Ethernet. The EthTSyn module can administrate several global time domains at the same time that in itself form a hierarchy of domains and sub-domains. | If the EthTSyn exists it is assumed that at least one global time domain exists.
      integer EthTSynGlobalTimeDomainId: 0..31, set at pre-compile, symbolic-name-value=true, default-value=0  # The global time domain ID.
      float EthTSynGlobalTimeFollowUpTimeout: 0..1.7976931348623157E+308, set at pre-compile, default-value=0.125  # Specifies the time waited for the reception of a FollowUp message after receiving a Sync message. After the Timeout the Sync message will be discarded. Unit: seconds
      float EthTSynGlobalTimeSyncTimeout [0..1]: 0..255, origin=Vector Informatik, default-value=0.25  # This parameter is only used in a Bridge configuration. It specifies the time, the bridge is waiting for the reception of a new Sync message on its slave port before a Grand Master timeout is assumed and the Bridge begins to generate its own Sync and FollowUp messages.
      boolean EthTSynBridgeKeepSourcePortIdentity [0..1]: origin=Vector Informatik, default-value=false  # This parameter is only used in a bridge configuration. When this parameter is enabled, the source port identity of forwarded Sync/FollowUp messages is not modified.
      symbolic name reference EthTSynSynchronizedTimeBaseRef: set at pre-compile, destination=StbMSynchronizedTimeBase  # Optional reference to the synchronized time-base. The refernece is only used when a TimeSource with STBM_TIMESTAMPING as TimestampMethdo is used.
      reference EthTSynTimeSourceRef: set at pre-compile, origin=Vector Informatik, destination=EthTSynTimeSourceConfig  # Refernece to the Time Source which will be used for the TimeDomain.
      container EthTSynGlobalTimeMaster [0..1]  # Configuration of the global time master. Each global time domain is required to have exactly one global time master. This master may or may not exist on the configured ECU.
        float EthTSynGlobalTimeTxFollowUpOffset: 0..Inf  # This represents configuration of the TX offset for Follow_Up / Pdelay_Resp_Follow_Up messages. Unit: seconds
        float EthTSynGlobalTimeTxPdelayReqPeriod: 0..Inf  # This represents configuration of the TX period for Pdelay_Req messages. Unit: seconds
        float EthTSynGlobalTimeTxPeriod: 0..Inf  # This represents configuration of the TX period. Unit: seconds
        reference EthTSynGlobalTimeEthIfRef: destination=EthIfController  # This represents the reference to the Ethernet interface taken to fetch the global time information.
      container EthTSynGlobalTimeSlave [0..1]  # Configuration of a time slave. Each global time domain is required to have at least one time slave. The configured ECU may or may not represent a time slave.
        float EthTSynGlobalTimeTxFollowUpOffset: 0..Inf  # This represents configuration of the TX offset for Follow_Up / Pdelay_Resp_Follow_Up messages. Unit: seconds
        float EthTSynGlobalTimeTxPdelayReqPeriod: 0..Inf  # This represents configuration of the TX period for Pdelay_Req messages. Unit: seconds
        float EthTSynTimeHardwareCorrectionThreshold [0..1]  # This parameter can be taken to define the maximum deviation between the local time and the time obtained from SYNC message that triggers a correction of the time drift caused by the hardware on the local node.
        reference EthTSynGlobalTimeEthIfRef: destination=EthIfController  # This represents the reference to the Ethernet interface taken to fetch the global time information.
    container EthTSynTimeSourceConfig [1..*]  # Configuration of the Time Sources used by the EthTSyn module
      enumeration EthTSynTimestampMethod: {HW_TIMESTAMPING, STBM_TIMESTAMPING, GPT_TIMESTAMPING, OS_TIMESTAMPING, CALLOUT_TIMESTAMPING}, set at pre-compile, origin=Vector Informatik, default-value=HW_TIMESTAMPING  # Select which timestamping method is used. HW_TIMESTAMPING: - Clock is managed in HW STBM_TIMESTAMPING: - Clock is managed in StbM OS/GPT/CALLOUT_TIMESTAMPING: - Clock is managed in EthTSyn - Local Time is derived from Os/Gpt Counter or from UserCallout
      choice reference EthTSynTimeBaseRef [0..1]: set at pre-compile, origin=Vector Informatik, destination=[OsCounter, GptChannelConfiguration]  # Reference to the Counter/EthIfController used as Time base. This parameter is only used if EthTSynTImestampMethod is set to: GPT_TIMESTAMPING OS_TIMESTAMPING
      container EthTSynTimestampCalloutConfig [0..1]  # Configuration of Timestamp Usercallout.
        function name EthTSynTimestampUserCallout: set at pre-compile, origin=Vector Informatik  # Name of the User-Callout function when Timestamp Method is set to "CALLOUT-TIMESTAMPING". This Function is called when EthTSyn_GetCurrentTimeRaw is invoked. The Callout-function has the following signature: Std_ReturnType TimestampUserCallout(EthTSyn_TimestampTickType *CurrentTickTime) The function shall return "E_OK" when the retrieval of the Time was successful and "E_NOT_OK" otherwise.
        integer EthTSynUserCalloutMaxValue: 1..4294967296, set at pre-compile, origin=Vector Informatik, default-value=1000000000  # Max Tick Value returned by the Usercallout.
        string EthTSynUserIncludeFile: set at pre-compile, origin=Vector Informatik  # This parameter defines a header file name which shall be included by EthTSyn for the Timestamp UserCallout.
        float EthTSynUserCalloutNsPerTick: 1..1000000000, set at pre-compile, origin=Vector Informatik, default-value=1  # Time of one "Tick" (returned by the Usercallout) in Nanoseconds.
  module definition EthTrcv [0..*]: variants link-time/post-build/pre-compile  # Configuration of Ethernet Transceiver Driver module
    container EthTrcvConfigSet: multiple-configuration-container=true  # All underlying parameters may be part of a multiple configuration set.
      container EthTrcvConfig [1..*]  # Configuration of the individual transceiver
        boolean EthTrcvAutoNegotiationEnabled: set at link in variant link-time / post-build in variant post-build / pre-compile in variant pre-compile  # Specifies if Auto-Negotiation is enabled (TRUE) or disabled (FALSE) for determination of the Ethernet transceiver speed.
        integer EthTrcvCtrlIdx: 0..255, set at link in variant link-time / post-build in variant post-build / pre-compile in variant pre-compile  # Specifies the controller used for MII access to the transceiver
        enumeration EthTrcvDuplexMode: {ETHTRCV_DUPLEX_MODE_FULL, ETHTRCV_DUPLEX_MODE_HALF}, set at link in variant link-time / post-build in variant post-build / pre-compile in variant pre-compile  # Specifies the duplex mode of the Ethernet transceiver link if Auto-Negotiation is disabled. This parameter is ignored if Auto-Negotiation is enabled.
        integer EthTrcvIdx: 0..255, set at link in variant link-time / post-build in variant post-build / pre-compile in variant pre-compile, symbolic-name-value=true  # Specifies the instance ID of the configured transceiver.
        integer EthTrcvMiiIdx: 0..255, set at link in variant link-time / post-build in variant post-build / pre-compile in variant pre-compile  # Specifies the transceiver index used for MII access to the transceiver
        enumeration EthTrcvSpeed: {TRCV_SPEED_10, TRCV_SPEED_100, TRCV_SPEED_1000}, set at link in variant link-time / post-build in variant post-build / pre-compile in variant pre-compile  # Specifies the speed of the Ethernet transceiver link in [MBit/s]. If AutoNegotiation is enabled this is the maximum speed advertised for Auto-Negotiation.
        container EthTrcvDemEventParameterRefs [0..1]  # Container for the references to DemEventParameter elements which shall be invoked using the API Dem_ReportErrorStatus API in case the corresponding error occurs. The EventId is taken from the referenced DemEventParameter's DemEventId value. The standardized errors are provided in the container and can be extended by vendor specific error references.
          symbolic name reference ETHTRCV_E_ACCESS [0..1]: set at link in variant link-time / post-build in variant post-build / pre-compile in variant pre-compile, destination=DemEventParameter  # Reference to the DemEventParameter which shall be issued when the error "Transceiver access failed" has occurred.
    container EthTrcvGeneral  # General configuration of Ethernet Transceiver Driver module
      boolean EthTrcvDevErrorDetect: set at pre-compile  # Enables / Disables development error detection
      boolean EthTrcvGetBaudRateApi: set at pre-compile  # Enables / Disables EthTrcv_GetBaudRate API
      boolean EthTrcvGetDuplexModeApi: set at pre-compile  # Enables / Disables EthTrcv_GetDuplexMode API
      boolean EthTrcvGetLinkStateApi: set at pre-compile  # Enables / Disables EthTrcv_GetLinkState API
      boolean EthTrcvGetTransceiverModeApi: set at pre-compile  # Enables / Disables EthTrcv_GetTransceiverMode API
      integer EthTrcvIndex: 0..255, set at pre-compile  # Specifies the InstanceId of this module instance. If only one instance is present it shall have the Id 0.
      integer EthTrcvMaxTrcvsSupported: 0..255, set at pre-compile, default-value=1
      boolean EthTrcvSetTransceiverModeApi: set at pre-compile  # Enables / Disables EthTrcv_SetTransceiverMode API
      boolean EthTrcvStartAutoNegotiationApi: set at pre-compile  # Enables / Disables EthTrcv_StartAutoNegotiation API
      boolean EthTrcvVersionInfoApi: set at pre-compile  # Enables / Disables version info API
      boolean EthTrcvVersionInfoApiMacro: set at pre-compile  # Enables / Disables version info API macro implementation
  module definition Fee [0..1]: variants pre-compile  # Configuration of the Fee (Flash EEPROM Emulation) module.
    container FeeBlockConfiguration [1..*]  # Configuration of block specific parameters for the Flash EEPROM Emulation module.
      integer FeeBlockNumber: 1..65534, set at pre-compile, symbolic-name-value=true  # Block identifier (handle). | 0x0000 and 0xFFFF shall not be used for block numbers (see FEE006). Range: min = 2^NVM_DATASET_SELECTION_BITS max = 0xFFFF -2^NVM_DATASET_SELECTION_BITS Note: Depending on the number of bits set aside for dataset selection several other block numbers shall also be left out to ease implementation.
      integer FeeBlockSize: 1..65535, set at pre-compile  # Size of a logical block in bytes.
      boolean FeeImmediateData: set at pre-compile  # Marker for high priority data. | true: Block contains immediate data. false: Block does not contain immediate data.
      integer FeeNumberOfWriteCycles: 0..4294967295, set at pre-compile  # Number of write cycles required for this block.
      symbolic name reference FeeDeviceIndex: set at pre-compile, destination=FlsGeneral  # Device index (handle). | Range: 0 .. 254 (0xFF reserved for broadcast call to GetStatus function).
    container FeeGeneral  # Container for general parameters. These parameters are not specific to a block.
      boolean FeeDevErrorDetect: set at pre-compile  # Pre-processor switch to enable and disable development error detection. | true: Development error detection enabled. false: Development error detection disabled.
      integer FeeIndex: 0..254, set at pre-compile  # Specifies the InstanceId of this module instance. If only one instance is present it shall have the Id 0.
      function name FeeNvmJobEndNotification [0..1]: set at pre-compile  # Mapped to the job end notification routine provided by the upper layer module (NvM_JobEndNotification).
      function name FeeNvmJobErrorNotification [0..1]: set at pre-compile  # Mapped to the job error notification routine provided by the upper layer module (NvM_JobErrorNotification).
      boolean FeePollingMode: set at pre-compile  # Pre-processor switch to enable and disable the polling mode for this module. | true: Polling mode enabled, callback functions (provided to FLS module) disabled. false: Polling mode disabled, callback functions (provided to FLS module) enabled.
      boolean FeeSetModeSupported: set at pre-compile  # Compiler switch to enable/disable the 'SetMode' functionality of the FEE module. | TRUE: SetMode functionality supported / code present, FALSE: SetMode functionality not supported / code not present. Note: This configuration setting has to be consistent with that of all underlying flash device drivers (configuration parameter FlsSetModeApi).
      boolean FeeVersionInfoApi: set at pre-compile  # Pre-processor switch to enable / disable the API to read out the modules version information. | true: Version info API enabled. false: Version info API disabled.
      integer FeeVirtualPageSize: 0..65535, set at pre-compile  # The size in bytes to which logical blocks shall be aligned.
    container FeePublishedInformation  # Additional published parameters not covered by CommonPublishedInformation container. | Note that these parameters do not have any configuration class setting, since they are published information.
      integer FeeBlockOverhead: 0..65535, set at published-information  # Management overhead per logical block in bytes. | Note: If the management overhead depends on the block size or block location a formula has to be provided that allows the configurator to calculate the management overhead correctly.
      float FeeMaximumBlockingTime: 0..Inf, set at published-information  # The maximum time the FEE module's API routines shall be blocked (delayed) by internal operations. | Note: Internal operations in that case means operations that are not explicitly invoked from the upper layer module but need to be handled for proper operation of this module or the underlying memory driver.
      integer FeePageOverhead: 0..65535, set at published-information  # Management overhead per page in bytes. | Note: If the management overhead depends on the block size or block location a formula has to be provided that allows the configurator to calculate the management overhead correctly.
  module definition FiM [0..1]: variants post-build/pre-compile  # Configuration of the FiM (Function Inhibition Manager) module.
    container FiMConfigSet: multiple-configuration-container=true  # This container contains the configuration parameters and sub containers of the FiM module supporting multiple configuration sets. | This container is a MultipleConfigurationContainer, i.e. this container and its sub-containers exist once per configuration set.
      container FiMEventSummary [0..*]  # The summarized EventId definition record consists of a summarized event ID and a specific EventId. | This record means that a particular FID that has to be disabled in case of summarized event (defined above) is to be disabled in any of the specific events. A possible solution could be assigning events as summarized events along with a list of specific events. During the configuration process the summarized event substitutes the referenced single events. However, it is not outlined how this requirement is solved - whether by configuration process or by implementation within the FiM. The FiM configuration tool could also build up a suitable data structure for summarized events and deal with it in the FiM implementation.
        symbolic name reference FiMInputSumEventRef [1..*]: set at post-build in variant post-build / pre-compile in variant pre-compile, destination=DemEventParameter
        symbolic name reference FiMOutputSumEventRef: set at post-build in variant post-build / pre-compile in variant pre-compile, destination=FiMSummaryEventId
      container FiMFID [0..*]  # This container includes symbolic names of all FIDs.
        integer FiMFunctionId: 0..65535, set at pre-compile, symbolic-name-value=true  # The configuration parameter is used as an ID which represents a functionality. FiMFunctionId is the unique identifier assigned during FIM configuration. | Implementation Type: FiM_FunctionIdType.
      container FiMInhibitionConfiguration [0..*]  # This container includes all configuration parameters concerning the relationship between event and FID.
        enumeration FiMInhInhibitionMask: {FIM_LAST_FAILED, FIM_NOT_TESTED, FIM_TESTED, FIM_TESTED_AND_FAILED}, set at post-build in variant post-build / pre-compile in variant pre-compile  # The configuration parameter is used to specify the inhibition mask for an event - FID relation.
        reference FiMInhFunctionIdRef: set at post-build in variant post-build / pre-compile in variant pre-compile, destination=FiMFID
        container FiMInhEventId  # The configuration parameter is used for an existing DEM event and summarized events as well.
          choice container FiMInhRefChoice
            container FiMInhChoiceDemRef [0..1]
              symbolic name reference FiMInhEventRef: destination=DemEventParameter
            container FiMInhChoiceSumRef [0..1]
              symbolic name reference FiMInhSumRef [1..*]: destination=FiMSummaryEventId
      container FiMSummaryEventId [0..*]  # This container defines the name of a summarized event.
        integer FiMEventSumId: 0..65535, set at post-build in variant post-build / pre-compile in variant pre-compile, symbolic-name-value=true  # The summarized EventId definition record defines the existence of a summarized event with a specific name. This summarized event can be referenced in the EventSummary (as FimSummaryEventId) and Inhibition configuration (as FimInhEventId).
    container FiMGeneral
      boolean FiMDataFixed: set at pre-compile  # Enable or disable calibration of inhibit relations The scope of the parameter is to meet the requirement (FIM008) to have the option to calibrate inhibit data on the one hand side and also to provide the option to protect inhibit data for consistency reasons.
      boolean FiMDevErrorDetect: set at pre-compile  # This configuration parameter is used to switch on or to switch off the detection of development errors during development.
      boolean FiMEventUpdateTriggeredByDem: set at pre-compile  # This configuration parameter specifies the way FIM obtains status of EventIds. | TRUE: the DEM informs FIM about changes of event status, FALSE: the FIM polls event status from the DEM module either cyclically or on demand.
      integer FiMMaxEventFidLinks: 1..65535, set at pre-compile  # This configuration parameter specifies the total maximum number of links between EventIds and FIDs.
      integer FiMMaxEventsPerFid: 1..65535, set at pre-compile  # This configuration parameter specifies the maximum number of EventIds that can be linked to a single FID.
      integer FiMMaxFidsPerEvent: 1..65535, set at pre-compile  # This configuration parameter specifies the maximum number of FIDs that can be linked to a single event.
      integer FiMMaxSummaryEvents: 0..65535, set at pre-compile  # This configuration parameter specifies the maximum number of summarized events that can be configured.
      integer FiMMaxSummaryLinks: 0..65535, set at pre-compile  # This configuration parameter specifies the total maximum number of links between EventIds and summarized events.
      integer FiMMaxTotalLinks: 1..65535, set at pre-compile  # This configuration parameter specifies the total maximum number of links between EventIds and FIDs plus the number of links between EventIds and summarized events.
      float FiMTaskTime: 0..0.1, set at pre-compile, origin=AUTOSAR_ECUC V1.0.0  # Allow to configure the time for the periodic cyclic task. Please note: This configuration value shall be equal to the value in the Basic Software Scheduler configuration of the RTE module. | The AUTOSAR configuration standard is to use SI units, so this parameter is defined as float value in seconds. DEM configuration tools must convert this float value to the appropriate value format for the use in the software implementation of DEM. min: A negative value is not allowed. max: FID must be set after a maximal time of 100ms after DEM status is set. upperMultiplicity: Exactly one TaskTime must be specified per configuration. lowerMultiplicity: Exactly one TaskTime must be specified per configuration.
      boolean FiMVersionInfoApi: set at pre-compile  # This configuration parameter is used to switch on or to switch off the API to get the version information.
