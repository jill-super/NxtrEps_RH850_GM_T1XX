[part 2 of 4: package /COM/VECTOR/CFG/WORKFLOW/SYSDESC/SYNC]
AUTOSAR XML (schema 4-0-3)
package /COM/VECTOR/CFG/WORKFLOW/SYSDESC/SYNC  (continued)
  flat map FLATMAP  (continued)
    3200 x flat instance descriptor:  (continued)
      AssemblySwConnector_1613: ecu-extract-reference=SerlComInpProxyDLstRxnTiMsg34ABusHiSpdDGmMsg34ABusHiSpdDLstRxnTiMsg34ABusHiSpd
      AssemblySwConnector_1614: ecu-extract-reference=SerlComInpProxyDWhlGndVelLeNonDrvnRawBusHiSpdDGmMsg34ABusHiSpdDWhlGndVelLeNonDrvnRawBusHiSpd
      AssemblySwConnector_1615: ecu-extract-reference=SerlComInpProxyDWhlGndVelLeNonDrvnVldRawBusHiSpdDGmMsg34ABusHiSpdDWhlGndVelLeNonDrvnVldRawBusHiSpd
      AssemblySwConnector_1616: ecu-extract-reference=SerlComInpProxyDWhlGndVelRiNonDrvnRawBusHiSpdDGmMsg34ABusHiSpdDWhlGndVelRiNonDrvnRawBusHiSpd
      AssemblySwConnector_1617: ecu-extract-reference=SerlComInpProxyDWhlGndVelRiNonDrvnVldRawBusHiSpdDGmMsg34ABusHiSpdDWhlGndVelRiNonDrvnVldRawBusHiSpd
      AssemblySwConnector_1621: ecu-extract-reference=SerlComInpProxyDLstRxnTiMsg3F1DGmMsg3F1BusHiSpdDLstRxnTiMsg3F1
      AssemblySwConnector_1622: ecu-extract-reference=SerlComInpProxyDOutdAirTCorrdValMaskRawDGmMsg3F1BusHiSpdDOutdAirTCorrdValMaskRaw
      AssemblySwConnector_1623: ecu-extract-reference=SerlComInpProxyDOutdAirTCorrdValRawDGmMsg3F1BusHiSpdDOutdAirTCorrdValRaw
      AssemblySwConnector_1624: ecu-extract-reference=SerlComInpProxyDOutdAirTCorrdValVldRawDGmMsg3F1BusHiSpdDOutdAirTCorrdValVldRaw
      AssemblySwConnector_1629: ecu-extract-reference=StabyCmpDAssiCmdDAssiSumLimDAssiCmd
      AssemblySwConnector_1630: ecu-extract-reference=StOutpCtrlDSysMotTqCmdScaDEotProtnDSysMotTqCmdSca
      AssemblySwConnector_1631: ecu-extract-reference=StOutpCtrlDSysMotTqCmdScaDLimrCdngDSysMotTqCmdSca
      AssemblySwConnector_1632: ecu-extract-reference=StOutpCtrlDSysStReqDiDSysStModDSysStReqDi
      AssemblySwConnector_1633: ecu-extract-reference=SysStModDSysStDBattVltgCorrlnDSysSt
      AssemblySwConnector_1634: ecu-extract-reference=SysStModDSysStDCDD_CurrMeasDSysSt
      AssemblySwConnector_1635: ecu-extract-reference=SysStModDSysStDCDD_MotCtrlMgrDSysSt
      AssemblySwConnector_1636: ecu-extract-reference=SysStModDSysStDCDD_TSG31CfgAndUseDSysSt
      AssemblySwConnector_1637: ecu-extract-reference=SysStModDSysStDCmnMfgSrvDSysSt
      AssemblySwConnector_1638: ecu-extract-reference=SysStModDSysStDCurrMeasCorrlnDSysSt
      AssemblySwConnector_1639: ecu-extract-reference=SysStModDSysStDDiagcMgrDSysSt
      AssemblySwConnector_1641: ecu-extract-reference=SysStModDSysStDMotDrvDiagcDSysSt
      AssemblySwConnector_1642: ecu-extract-reference=SysStModDSysStDMotTqTranlDampgDSysSt
      AssemblySwConnector_1643: ecu-extract-reference=SysStModDSysStDPwrDiscnctDSysSt
      AssemblySwConnector_1644: ecu-extract-reference=SysStModDSysStDPwrSplyDSysSt
      AssemblySwConnector_1645: ecu-extract-reference=SysStModDSysStDPwrUpSeqDSysSt
      AssemblySwConnector_1646: ecu-extract-reference=TEstimnDAssiMechTDDampgDAssiMechT
      AssemblySwConnector_1647: ecu-extract-reference=TEstimnDMotFetTDDutyCycThermProtnDMotFetT
      AssemblySwConnector_1648: ecu-extract-reference=TEstimnDMotMagTDDutyCycThermProtnDMotMagT
      AssemblySwConnector_1649: ecu-extract-reference=TEstimnDMotWidgTDDutyCycThermProtnDMotWidgT
      AssemblySwConnector_1650: ecu-extract-reference=TEstimnDAssiMechTDHysCmpDAssiMechT
      AssemblySwConnector_1651: ecu-extract-reference=TEstimnDMotFetTDMotCtrlPrmEstimnDMotFetT
      AssemblySwConnector_1652: ecu-extract-reference=TEstimnDMotMagTDMotCtrlPrmEstimnDMotMagT
      AssemblySwConnector_1653: ecu-extract-reference=TEstimnDMotWidgTDMotCtrlPrmEstimnDMotWidgT
      AssemblySwConnector_1654: ecu-extract-reference=TEstimnDAssiMechTDRtnDAssiMechT
      AssemblySwConnector_1655: ecu-extract-reference=TmplMonrDTmplMonrIninTestCmplDPwrUpSeqDTmplMonIninTestCmpl
      AssemblySwConnector_1656: ecu-extract-reference=TqLoaDTqLoaCmdDAssiSumLimDTqLoaCmd
      AssemblySwConnector_1657: ecu-extract-reference=TqLoaDTqLoaAvlDLoaMgrDTqLoaAvl
      AssemblySwConnector_1658: ecu-extract-reference=TunSelnAuthyDXcpCalChgReqDCDD_XcpIfDXcpCalChgReq
      AssemblySwConnector_1659: ecu-extract-reference=TunSelnAuthyDRtCalChgReqDTunSelnMngtDRtCalChgReq
      AssemblySwConnector_1661: ecu-extract-reference=TunSelnMngtDActvGroupDCDD_XcpIfDActvGroup
      AssemblySwConnector_1662: ecu-extract-reference=TunSelnMngtDActvIninIdxDCDD_XcpIfDActvIninIdx
      AssemblySwConnector_1663: ecu-extract-reference=TunSelnMngtDActvRtIdxDCDD_XcpIfDActvRtIdx
      AssemblySwConnector_1665: ecu-extract-reference=TunSelnMngtDCopyCalPageReqDCDD_XcpIfDCopyCalPageReq
      AssemblySwConnector_1666: ecu-extract-reference=TunSelnMngtDGetCalPageReqDCDD_XcpIfDGetCalPageReq
      AssemblySwConnector_1668: ecu-extract-reference=TunSelnMngtDSetCalPageReqDCDD_XcpIfDSetCalPageReq
      AssemblySwConnector_1669: ecu-extract-reference=VehSigCdngDVehSpdDAssiDVehSpd
      AssemblySwConnector_1670: ecu-extract-reference=VehSigCdngDVehSpdDAssiHiFrqDVehSpd
      AssemblySwConnector_1671: ecu-extract-reference=VehSigCdngDVehSpdDAssiSumLimDVehSpd
      AssemblySwConnector_1672: ecu-extract-reference=VehSigCdngDVehSpdDCDD_CurrMeasDVehSpd
      AssemblySwConnector_1673: ecu-extract-reference=VehSigCdngDVehSpdVldDCDD_CurrMeasDVehSpdVld
      AssemblySwConnector_1674: ecu-extract-reference=VehSigCdngDVehSpdDDampgDVehSpd
      AssemblySwConnector_1675: ecu-extract-reference=VehSigCdngDVehSpdDEotProtnDVehSpd
      AssemblySwConnector_1676: ecu-extract-reference=VehSigCdngDVehSpdDGmMsg0C9BusHiSpdDVehSpd
      AssemblySwConnector_1677: ecu-extract-reference=VehSigCdngDVehSpdVldDGmMsg0C9BusHiSpdDVehSpdVld
      AssemblySwConnector_1678: ecu-extract-reference=VehSigCdngDVehSpdVldDGmMsg184BusHiSpdDVehSpdVld
      AssemblySwConnector_1679: ecu-extract-reference=VehSigCdngDVehSpdDGmStrtStopDVehSpd
      AssemblySwConnector_1680: ecu-extract-reference=VehSigCdngDVehSpdVldDGmStrtStopDVehSpdVld
      AssemblySwConnector_1681: ecu-extract-reference=VehSigCdngDVehSpdDHysCmpDVehSpd
      AssemblySwConnector_1682: ecu-extract-reference=VehSigCdngDVehLgtADInertiaCmpVelDVehLgtA
      AssemblySwConnector_1683: ecu-extract-reference=VehSigCdngDVehSpdDInertiaCmpVelDVehSpd
      AssemblySwConnector_1684: ecu-extract-reference=VehSigCdngDVehSpdDLimrCdngDVehSpd
      AssemblySwConnector_1685: ecu-extract-reference=VehSigCdngDVehSpdDMotCurrRegCfgDVehSpd
      AssemblySwConnector_1686: ecu-extract-reference=VehSigCdngDVehSpdDMotTqTranlDampgDVehSpd
      AssemblySwConnector_1687: ecu-extract-reference=VehSigCdngDVehSpdDPullCmpActvDVehSpd
      AssemblySwConnector_1688: ecu-extract-reference=VehSigCdngDVehSpdVldDPullCmpActvDVehSpdVld
      AssemblySwConnector_1690: ecu-extract-reference=VehSigCdngDVehSpdDRtnDVehSpd
      AssemblySwConnector_1691: ecu-extract-reference=VehSigCdngDVehSpdDStabyCmpDVehSpd
      AssemblySwConnector_1693: ecu-extract-reference=VehSigCdngDVehLatAVldDTqLoaDVehLatAVld
      AssemblySwConnector_1694: ecu-extract-reference=VehSigCdngDVehSpdDTqLoaDVehSpd
      AssemblySwConnector_1695: ecu-extract-reference=VehSigCdngDVehSpdVldDTqLoaDVehSpdVld
      AssemblySwConnector_1696: ecu-extract-reference=VehSigCdngDVehSpdDTunSelnAuthyDVehSpd
      AssemblySwConnector_1697: ecu-extract-reference=VehSigCdngDVehSpdDVehSpdLimrDVehSpd
      AssemblySwConnector_1698: ecu-extract-reference=VehSpdLimrDVehSpdMotTqLimDLimrCdngDVehSpdMotTqLim
      ComponentPrototype_145: upstream-reference=ECU_Composition.ProgMfgSrv, ecu-extract-reference=COMPOSITIONTYPE.ProgMfgSrv
      ComponentPrototype_146: upstream-reference=ECU_Composition.NxtrSwIds, ecu-extract-reference=COMPOSITIONTYPE.NxtrSwIds
      ComponentPrototype_147: upstream-reference=ECU_Composition.NxtrCalIds, ecu-extract-reference=COMPOSITIONTYPE.NxtrCalIds
      AssemblySwConnector_134: ecu-extract-reference=CalRegn01CmnDNxtrCalIdsCal0DevlpAuthorDNxtrCalIdsDNxtrCalIdsCal0DevlpAuthor
      AssemblySwConnector_135: ecu-extract-reference=CalRegn01CmnDNxtrCalIdsCal0DevlpDescDNxtrCalIdsDNxtrCalIdsCal0DevlpDescr
      AssemblySwConnector_136: ecu-extract-reference=CalRegn01CmnDNxtrCalIdsCal0DevlpRelNrDNxtrCalIdsDNxtrCalIdsCal0DevlpRelNr
      AssemblySwConnector_137: ecu-extract-reference=CalRegn01CmnDNxtrCalIdsCal0DevlpRelStDNxtrCalIdsDNxtrCalIdsCal0DevlpRelSt
      AssemblySwConnector_138: ecu-extract-reference=CalRegn01CmnDNxtrCalIdsCal0DevlpTiStampDNxtrCalIdsDNxtrCalIdsCal0DevlpTiStamp
      AssemblySwConnector_139: ecu-extract-reference=CalRegn01CmnDNxtrCalIdsCal0DevlpVersDNxtrCalIdsDNxtrCalIdsCal0DevlpVers
      AssemblySwConnector_1705: ecu-extract-reference=CalRegn02CmnDNxtrCalIdsCal1DevlpAuthorDNxtrCalIdsDNxtrCalIdsCal1DevlpAuthor
      AssemblySwConnector_1706: ecu-extract-reference=CalRegn02CmnDNxtrCalIdsCal1DevlpDescDNxtrCalIdsDNxtrCalIdsCal1DevlpDescr
      AssemblySwConnector_1707: ecu-extract-reference=CalRegn02CmnDNxtrCalIdsCal1DevlpRelNrDNxtrCalIdsDNxtrCalIdsCal1DevlpRelNr
      AssemblySwConnector_1708: ecu-extract-reference=CalRegn02CmnDNxtrCalIdsCal1DevlpRelStDNxtrCalIdsDNxtrCalIdsCal1DevlpRelSt
      AssemblySwConnector_1709: ecu-extract-reference=CalRegn02CmnDNxtrCalIdsCal1DevlpTiStampDNxtrCalIdsDNxtrCalIdsCal1DevlpTiStamp
      AssemblySwConnector_1710: ecu-extract-reference=CalRegn02CmnDNxtrCalIdsCal1DevlpVersDNxtrCalIdsDNxtrCalIdsCal1DevlpVers
      AssemblySwConnector_1711: ecu-extract-reference=CalRegn03CmnDNxtrCalIdsCal2DevlpAuthorDNxtrCalIdsDNxtrCalIdsCal2DevlpAuthor
      AssemblySwConnector_1712: ecu-extract-reference=CalRegn03CmnDNxtrCalIdsCal2DevlpDescDNxtrCalIdsDNxtrCalIdsCal2DevlpDescr
      AssemblySwConnector_1713: ecu-extract-reference=CalRegn03CmnDNxtrCalIdsCal2DevlpRelNrDNxtrCalIdsDNxtrCalIdsCal2DevlpRelNr
      AssemblySwConnector_1714: ecu-extract-reference=CalRegn03CmnDNxtrCalIdsCal2DevlpRelStDNxtrCalIdsDNxtrCalIdsCal2DevlpRelSt
      AssemblySwConnector_1715: ecu-extract-reference=CalRegn03CmnDNxtrCalIdsCal2DevlpTiStampDNxtrCalIdsDNxtrCalIdsCal2DevlpTiStamp
      AssemblySwConnector_1716: ecu-extract-reference=CalRegn03CmnDNxtrCalIdsCal2DevlpVersDNxtrCalIdsDNxtrCalIdsCal2DevlpVers
      AssemblySwConnector_1717: ecu-extract-reference=CmnMfgSrvDDutyCycThermProtnDiDDutyCycThermProtnDDutyCycThermProtnDi
      AssemblySwConnector_1718: ecu-extract-reference=NxtrCalIdsDNxtrCalIdsCalDevlpRdDCmnMfgSrvDNxtrCalIdsCalDevlpRd
      AssemblySwConnector_1719: ecu-extract-reference=NxtrCalIdsDNxtrCalIdsCalRelRdDCmnMfgSrvDNxtrCalIdsCalRelRd
      AssemblySwConnector_1720: ecu-extract-reference=NxtrSwIdsDNxtrSwIdsPsrInfoRdDCmnMfgSrvDNxtrSwIdsPsrInfoRd
      AssemblySwConnector_1721: ecu-extract-reference=NxtrSwIdsDNxtrSwIdsSwBuildDateTiRdDCmnMfgSrvDNxtrSwIdsSwBuildDateTiRd
      AssemblySwConnector_1722: ecu-extract-reference=NxtrSwIdsDNxtrSwIdsSwRelInfoRdDCmnMfgSrvDNxtrSwIdsSwRelInfoRd
      AssemblySwConnector_1723: ecu-extract-reference=NxtrSwIdsDNxtrSwIdsSwRelNrRdDCmnMfgSrvDNxtrSwIdsSwRelNrRd
      AssemblySwConnector_1724: ecu-extract-reference=NxtrSwIdsDNxtrSwIdsSwRelVerRdDCmnMfgSrvDNxtrSwIdsSwRelVerRd
      AssemblySwConnector_1725: ecu-extract-reference=PartNrDPartNrBasMdlPartNrAlphaCodRdDProgMfgSrvDPartNrBasMdlPartNrAlphaCodRd
      AssemblySwConnector_1726: ecu-extract-reference=PartNrDPartNrBasMdlPartNrAlphaCodWrDProgMfgSrvDPartNrBasMdlPartNrAlphaCodWr
      AssemblySwConnector_1727: ecu-extract-reference=PartNrDPartNrBasMdlPartNrRdDProgMfgSrvDPartNrBasMdlPartNrRd
      AssemblySwConnector_1728: ecu-extract-reference=PartNrDPartNrBasMdlPartNrWrDProgMfgSrvDPartNrBasMdlPartNrWr
      AssemblySwConnector_1729: ecu-extract-reference=PartNrDPartNrCcaMfgTrakgRdDProgMfgSrvDPartNrCcaMfgTrakgRd
      AssemblySwConnector_1730: ecu-extract-reference=PartNrDPartNrCcaMfgTrakgWrDProgMfgSrvDPartNrCcaMfgTrakgWr
      AssemblySwConnector_1731: ecu-extract-reference=PartNrDPartNrCtrlPidSeedKeyWrDProgMfgSrvDPartNrCtrlPidSeedKeyWr
      AssemblySwConnector_1732: ecu-extract-reference=PartNrDPartNrCustMfgEnaCntrRdDProgMfgSrvDPartNrCustMfgEnaCntrRd
      AssemblySwConnector_1733: ecu-extract-reference=PartNrDPartNrCustMfgEnaCntrWrDProgMfgSrvDPartNrCustMfgEnaCntrWr
      AssemblySwConnector_1734: ecu-extract-reference=PartNrDPartNrDataUniversalNrSysIdRdDProgMfgSrvDPartNrDataUniversalNrSysIdRd
      AssemblySwConnector_1735: ecu-extract-reference=PartNrDPartNrDataUniversalNrSysIdWrDProgMfgSrvDPartNrDataUniversalNrSysIdWr
      AssemblySwConnector_1736: ecu-extract-reference=PartNrDPartNrEndMdlPartNrAlphaCodRdDProgMfgSrvDPartNrEndMdlPartNrAlphaCodRd
      AssemblySwConnector_1737: ecu-extract-reference=PartNrDPartNrEndMdlPartNrAlphaCodWrDProgMfgSrvDPartNrEndMdlPartNrAlphaCodWr
      AssemblySwConnector_1738: ecu-extract-reference=PartNrDPartNrEndMdlPartNrRdDProgMfgSrvDPartNrEndMdlPartNrRd
      AssemblySwConnector_1739: ecu-extract-reference=PartNrDPartNrEndMdlPartNrWrDProgMfgSrvDPartNrEndMdlPartNrWr
      AssemblySwConnector_1740: ecu-extract-reference=PartNrDPartNrNxtrMfgTrakgRdDProgMfgSrvDPartNrNxtrMfgTrakgRd
      AssemblySwConnector_1741: ecu-extract-reference=PartNrDPartNrNxtrMfgTrakgWrDProgMfgSrvDPartNrNxtrMfgTrakgWr
      AssemblySwConnector_1742: ecu-extract-reference=PartNrDPartNrProgmDateRdDProgMfgSrvDPartNrProgmDateRd
      AssemblySwConnector_1743: ecu-extract-reference=PartNrDPartNrProgmDateWrDProgMfgSrvDPartNrProgmDateWr
      AssemblySwConnector_1744: ecu-extract-reference=PartNrDPartNrProgmSessionSeedKeyWrDProgMfgSrvDPartNrProgmSessionSeedKeyWr
      AssemblySwConnector_1745: ecu-extract-reference=PartNrDPartNrRepairShopCodRdDProgMfgSrvDPartNrRepairShopCodRd
      AssemblySwConnector_1746: ecu-extract-reference=PartNrDPartNrRepairShopCodWrDProgMfgSrvDPartNrRepairShopCodWr
      AssemblySwConnector_1747: ecu-extract-reference=PartNrDPartNrSysCodVersNrRdDProgMfgSrvDPartNrSysCodVersNrRd
      AssemblySwConnector_1748: ecu-extract-reference=PartNrDPartNrSysCodVersNrWrDProgMfgSrvDPartNrSysCodVersNrWr
      AssemblySwConnector_1749: ecu-extract-reference=PartNrDPartNrSysNameRdDProgMfgSrvDPartNrSysNameRd
      AssemblySwConnector_1750: ecu-extract-reference=PartNrDPartNrSysNameWrDProgMfgSrvDPartNrSysNameWr
      AssemblySwConnector_1751: ecu-extract-reference=PartNrDPartNrVinDataRdDProgMfgSrvDPartNrVinDataRd
      AssemblySwConnector_1752: ecu-extract-reference=PartNrDPartNrVinDataWrDProgMfgSrvDPartNrVinDataWr
      AssemblySwConnector_1009: ecu-extract-reference=CDD_FlsMemDCodFlsCrcChkCmplDPwrUpSeqDCodFlsCrcChkCmpl
      AssemblySwConnector_1753: ecu-extract-reference=CDD_NxtrTiDGetTiSpan100MicroSec32bitDCDD_FlsMemDGetTiSpan100MicroSec32bit
      AssemblySwConnector_1754: ecu-extract-reference=CDD_SyncCrcDResvCrcHwUnitDCDD_FlsMemDResvCrcHwUnit
      AssemblySwConnector_1755: ecu-extract-reference=CDD_SyncCrcDCalc32BitCrc_u32DTunSelnMngtDSyncCrcCalc32_32BitWide
      ComponentPrototype_148: upstream-reference=ECU_Composition.CDD_VrfyCritReg, ecu-extract-reference=COMPOSITIONTYPE.CDD_VrfyCritReg
      AssemblySwConnector_1756: ecu-extract-reference=DiagcMgrProxyAppl10DSetNtcSts10DCDD_VrfyCritRegDSetNtcSts
      AssemblySwConnector_445: ecu-extract-reference=CalRegn01CmnDHwTq2MeasHwTq2PrtclFltFailStepDCDD_HwTq2MeasDHwTq2MeasHwTq2PrtclFltFailStep
      AssemblySwConnector_446: ecu-extract-reference=CalRegn01CmnDHwTq2MeasHwTq2PrtclFltPassStepDCDD_HwTq2MeasDHwTq2MeasHwTq2PrtclFltPassStep
      AssemblySwConnector_447: ecu-extract-reference=CalRegn01CmnDHwTq3MeasHwTq3PrtclFltFailStepDCDD_HwTq3MeasDHwTq3MeasHwTq3PrtclFltFailStep
      AssemblySwConnector_448: ecu-extract-reference=CalRegn01CmnDHwTq3MeasHwTq3PrtclFltPassStepDCDD_HwTq3MeasDHwTq3MeasHwTq3PrtclFltPassStep
      AssemblySwConnector_1757: ecu-extract-reference=IoHwAbDSetFctPrphlHwTq0DCDD_HwTq0MeasDIoHwAb_SetFctPrphlHwTq0
      AssemblySwConnector_1758: ecu-extract-reference=IoHwAbDSetFctPrphlHwTq1DCDD_HwTq1MeasDIoHwAb_SetFctPrphlHwTq1
      AssemblySwConnector_1759: ecu-extract-reference=IoHwAbDSetFctPrphlHwTq2DCDD_HwTq2MeasDIoHwAb_SetFctPrphlHwTq2
      AssemblySwConnector_1760: ecu-extract-reference=IoHwAbDSetFctPrphlHwTq3DCDD_HwTq3MeasDIoHwAb_SetFctPrphlHwTq3
      AssemblySwConnector_1761: ecu-extract-reference=IoHwAbDSetFctPrphlHwAg0DHwAg0MeasDIoHwAb_SetFctPrphlHwAg0
      AssemblySwConnector_1762: ecu-extract-reference=IoHwAbDSetFctPrphlHwAg1DHwAg1MeasDIoHwAb_SetFctPrphlHwAg1
      ComponentPrototype_149: upstream-reference=ECU_Composition.HwAgTrakgServo, ecu-extract-reference=COMPOSITIONTYPE.HwAgTrakgServo
      ComponentPrototype_150: upstream-reference=ECU_Composition.CmplncErr, ecu-extract-reference=COMPOSITIONTYPE.CmplncErr
      AssemblySwConnector_1763: ecu-extract-reference=CDD_MotVelDMotVelCrfDHwAgTrakgServoDMotVelCrf
      AssemblySwConnector_1764: ecu-extract-reference=CmplncErrDCmplncErrMotToPinionDHwAgSysArbnDCmplncErrMotToPinion
      AssemblySwConnector_1765: ecu-extract-reference=CmplncErrDCmplncErrPinionToHwDHwAgSysArbnDCmplncErrPinionToHw
      AssemblySwConnector_1766: ecu-extract-reference=GmOvrlStMgrDLkaStDGmTqArbnDLkaSt
      AssemblySwConnector_1767: ecu-extract-reference=GmOvrlStMgrDHwAgServoCmdDHwAgTrakgServoDHwAgTrakgServoCmd
      AssemblySwConnector_1768: ecu-extract-reference=GmOvrlStMgrDHwAgServoEnaDHwAgTrakgServoDHwAgTrakgServoEna
      AssemblySwConnector_1769: ecu-extract-reference=GmTqArbnDEscLimdActvDGmOvrlStMgrDEscLimdActv
      AssemblySwConnector_1770: ecu-extract-reference=HwAgSysArbnDPinionAgDHwAgTrakgServoDHwAg
      AssemblySwConnector_1771: ecu-extract-reference=HwAgTrakgServoDMotTqServoCmdDGmTqArbnDMtrTqServoCmd
      AssemblySwConnector_1774: ecu-extract-reference=MotTqTranlDampgDMotTqCmdCrfDampdDCmplncErrDMotTqCmdCrf
      AssemblySwConnector_1775: ecu-extract-reference=VehSigCdngDVehSpdDHwAgTrakgServoDVehSpd
      AssemblySwConnector_1780: ecu-extract-reference=CalRegn03Inin00DHwAgTrakgServoDftlTermLpFilFrqDHwAgTrakgServoDHwAgTrakgServoDftlTermLpFilFrq
      AssemblySwConnector_1781: ecu-extract-reference=CalRegn03Inin00DHwAgTrakgServoHwAgLpFilFrqDHwAgTrakgServoDHwAgTrakgServoHwAgLpFilFrq
      AssemblySwConnector_1782: ecu-extract-reference=CalRegn03Inin00DHwAgTrakgServoHwTqLpFilFrqDHwAgTrakgServoDHwAgTrakgServoHwTqLpFilFrq
      AssemblySwConnector_1804: ecu-extract-reference=CalRegn01CmnDCmplncErrHwAgNonLinCmplncDepTblYDCmplncErrDCmplncErrHwAgNonLinCmplncDepTblY
      AssemblySwConnector_1805: ecu-extract-reference=CalRegn01CmnDCmplncErrHwAgNonLinCmplncIndTblXDCmplncErrDCmplncErrHwAgNonLinCmplncIndTblX
      AssemblySwConnector_1806: ecu-extract-reference=CalRegn01CmnDCmplncErrMotAgNonLinCmplncDepTblYDCmplncErrDCmplncErrMotAgNonLinCmplncDepTblY
      AssemblySwConnector_1807: ecu-extract-reference=CalRegn01CmnDCmplncErrMotAgNonLinCmplncIndTblXDCmplncErrDCmplncErrMotAgNonLinCmplncIndTblX
      AssemblySwConnector_1838: ecu-extract-reference=CalRegn01Inin00DSnsrMeasStrtTrigDlyDCDD_SnsrMeasStrtDSnsrMeasStrtTrigDly
      AssemblySwConnector_1852: ecu-extract-reference=CalRegn03CmnDHwAgTrakgServoDiRateXDHwAgTrakgServoDHwAgTrakgServoDiRateX
      AssemblySwConnector_1853: ecu-extract-reference=CalRegn03CmnDHwAgTrakgServoDiRateYDHwAgTrakgServoDHwAgTrakgServoDiRateY
      AssemblySwConnector_1854: ecu-extract-reference=CalRegn03CmnDHwAgTrakgServoEnaRateDHwAgTrakgServoDHwAgTrakgServoEnaRate
      AssemblySwConnector_1855: ecu-extract-reference=CalRegn03CmnDHwAgTrakgServoExecRateDHwAgTrakgServoDHwAgTrakgServoExecRate
      AssemblySwConnector_1856: ecu-extract-reference=CalRegn03CmnDHwAgTrakgServoHwAgRateLimDHwAgTrakgServoDHwAgTrakgServoHwAgRateLim
      AssemblySwConnector_1857: ecu-extract-reference=CalRegn03CmnDHwAgTrakgServoMaxCmdXDHwAgTrakgServoDHwAgTrakgServoMaxCmdX
      AssemblySwConnector_1858: ecu-extract-reference=CalRegn03CmnDHwAgTrakgServoMaxCmdYDHwAgTrakgServoDHwAgTrakgServoMaxCmdY
      AssemblySwConnector_1859: ecu-extract-reference=CalRegn03CmnDHwAgTrakgServoMaxRampDHwAgTrakgServoDHwAgTrakgServoMaxRamp
      AssemblySwConnector_1860: ecu-extract-reference=CalRegn03CmnDHwAgTrakgServoMinRampDHwAgTrakgServoDHwAgTrakgServoMinRamp
      AssemblySwConnector_1861: ecu-extract-reference=CalRegn03CmnDHwAgTrakgServoPidLimDHwAgTrakgServoDHwAgTrakgServoPidLim
      AssemblySwConnector_1862: ecu-extract-reference=CalRegn03CmnDHwAgTrakgServoRampCmplDHwAgTrakgServoDHwAgTrakgServoRampCmpl
      AssemblySwConnector_1863: ecu-extract-reference=CalRegn03CmnDHwAgTrakgServoVehSpdBasdDHwAgTrakgServoDHwAgTrakgServoVehSpdBasd
      ComponentPrototype_020: upstream-reference=ECU_Composition.MotTqCmdSca, ecu-extract-reference=COMPOSITIONTYPE.MotTqCmdSca
      ComponentPrototype_152: upstream-reference=ECU_Composition.CDD_NvMProxy, ecu-extract-reference=COMPOSITIONTYPE.CDD_NvMProxy
      AssemblySwConnector_663: ecu-extract-reference=CalRegn01CmnDMotTqCmdScaMaxDMotTqCmdScaDMotTqCmdScaMax
      AssemblySwConnector_664: ecu-extract-reference=CalRegn01CmnDMotTqCmdScaMinDMotTqCmdScaDMotTqCmdScaMin
      AssemblySwConnector_665: ecu-extract-reference=DiagcMgrProxyAppl10DSetNtcSts10DCDD_NvMProxyDSetNtcSts
      AssemblySwConnector_666: ecu-extract-reference=MotTqCmdScaDMotTqCmdMrfScadDMotQuadDetnDMotTqCmd
      AssemblySwConnector_693: ecu-extract-reference=MotTqCmdScaDMotTqCmdMrfScadDMotRefMdlDMotTqCmdMrfScad
      AssemblySwConnector_694: ecu-extract-reference=PwrLimrDMotTqCmdPwrLimdDMotTqCmdScaDMotTqCmdMrf
      AssemblySwConnector_695: ecu-extract-reference=AssiSumLimDMotTqCmdDCustDiagcDMotTqCmd
      AssemblySwConnector_696: ecu-extract-reference=CDD_GmT1xxMcuCfgDBattVltgDCustDiagcDBattVltg
      AssemblySwConnector_697: ecu-extract-reference=EcuTMeasDEcuTFildDCustDiagcDEcuTFild
      AssemblySwConnector_698: ecu-extract-reference=EotLrngDHwAgCcwDetdDCustDiagcDHwAgCcwDetd
      AssemblySwConnector_699: ecu-extract-reference=EotLrngDHwAgCwDetdDCustDiagcDHwAgCwDetd
      AssemblySwConnector_700: ecu-extract-reference=EotLrngDHwAgEotCcwDCustDiagcDHwAgEotCcw
      AssemblySwConnector_701: ecu-extract-reference=EotLrngDHwAgEotCwDCustDiagcDHwAgEotCw
      AssemblySwConnector_702: ecu-extract-reference=GmMsg0C9BusHiSpdDEngRunActvDCustDiagcDEngRunActv
      AssemblySwConnector_703: ecu-extract-reference=GmMsg0C9BusHiSpdDEngSpdDCustDiagcDEngSpd
      AssemblySwConnector_704: ecu-extract-reference=GmMsg180BusHiSpdDLkaCmdDCustDiagcDLkaCmd
      AssemblySwConnector_705: ecu-extract-reference=GmMsg232BusHiSpdDDesRtIdxDCustDiagcDDesRtIdx
      AssemblySwConnector_706: ecu-extract-reference=GmMsg337BusChassisExpDSteerWhlAgReqTarAgDCustDiagcDSteerWhlAgReqTarAg
      AssemblySwConnector_707: ecu-extract-reference=GmOvrlStMgrDApaStDCustDiagcDApaSt
      AssemblySwConnector_708: ecu-extract-reference=GmOvrlStMgrDLkaStDCustDiagcDLkaSt
      AssemblySwConnector_709: ecu-extract-reference=GmStrtStopDStrtStopStDCustDiagcDStrtStopSt
      AssemblySwConnector_710: ecu-extract-reference=HwAgSysArbnDPinionAgDCustDiagcDPinionAg
      AssemblySwConnector_711: ecu-extract-reference=HwAgSysArbnDPinionAgConfDCustDiagcDPinionAgConf
      AssemblySwConnector_713: ecu-extract-reference=MotCurrPeakEstimnDMotCurrPeakEstimdDCustDiagcDMotCurrPeakEstimd
      AssemblySwConnector_714: ecu-extract-reference=MotRefMdlDMotCurrDaxCmdDCustDiagcDMotCurrDaxCmd
      AssemblySwConnector_715: ecu-extract-reference=SysStModDSysStDCustDiagcDSysSt
      AssemblySwConnector_716: ecu-extract-reference=VehSigCdngDVehSpdDCustDiagcDVehSpd
      AssemblySwConnector_717: ecu-extract-reference=VehSigCdngDVehSpdVldDCustDiagcDVehSpdVld
      ComponentPrototype_048: upstream-reference=ECU_Composition.GmMsg4D1BusHiSpd, ecu-extract-reference=COMPOSITIONTYPE.GmMsg4D1BusHiSpd
      AssemblySwConnector_209: ecu-extract-reference=CDD_NxtrTiDGetRefTmr100MicroSec32bitDGmMsg4D1BusHiSpdDGetRefTmr100MicroSec32bit
      AssemblySwConnector_210: ecu-extract-reference=CDD_NxtrTiDGetTiSpan100MicroSec32bitDGmMsg4D1BusHiSpdDGetTiSpan100MicroSec32bit
      AssemblySwConnector_214: ecu-extract-reference=DiagcMgrProxyAppl6DSetNtcSts6DGmMsg4D1BusHiSpdDSetNtcSts
      AssemblySwConnector_215: ecu-extract-reference=GmMsg4D1BusHiSpdDEngOilTDTEstimnDEngOilT
      AssemblySwConnector_216: ecu-extract-reference=SerlComInpProxyDEngOilTRawDGmMsg4D1BusHiSpdDEngOilTRaw
      AssemblySwConnector_718: ecu-extract-reference=SerlComInpProxyDEngOilVldRawDGmMsg4D1BusHiSpdDEngOilVldRaw
      AssemblySwConnector_719: ecu-extract-reference=SerlComInpProxyDLstRxnTiMsg4D1DGmMsg4D1BusHiSpdDLstRxnTiMsg4D1
      ComponentPrototype_050: upstream-reference=ECU_Composition.GmMsg500BusHiSpd, ecu-extract-reference=COMPOSITIONTYPE.GmMsg500BusHiSpd
      ComponentPrototype_153: upstream-reference=ECU_Composition.GmMsg0C5BusHiSpd, ecu-extract-reference=COMPOSITIONTYPE.GmMsg0C5BusHiSpd
      AssemblySwConnector_720: ecu-extract-reference=CalRegn01CmnDGmMsg0C5BusHiSpdInvldTiOutDGmMsg0C5BusHiSpdDGmMsg0C5BusHiSpdInvldTiOut
      AssemblySwConnector_721: ecu-extract-reference=CalRegn01CmnDGmMsg0C5BusHiSpdMissTiOutDGmMsg0C5BusHiSpdDGmMsg0C5BusHiSpdMissTiOut
      AssemblySwConnector_722: ecu-extract-reference=CalRegn01CmnDGmMsg0C5BusHiSpdRstTiOutDGmMsg0C5BusHiSpdDGmMsg0C5BusHiSpdRstTiOut
      AssemblySwConnector_723: ecu-extract-reference=CalRegn01CmnDGmMsg0C5BusHiSpdSeqNrTiOutDGmMsg0C5BusHiSpdDGmMsg0C5BusHiSpdSeqNrTiOut
      AssemblySwConnector_735: ecu-extract-reference=CalRegn01CmnDGmMsg214BusHiSpdAbsActvProtdInvldTiOutDGmMsg214BusHiSpdDGmMsg214BusHiSpdAbsActvProtdInvldTiOut
      AssemblySwConnector_984: ecu-extract-reference=CalRegn01CmnDGmMsg337BusChassisExpInvldProtnValTiOutDGmMsg337BusChassisExpDGmMsg337BusChassisExpInvldProtnValTiOut
      AssemblySwConnector_985: ecu-extract-reference=CalRegn01CmnDGmMsg337BusChassisExpInvldRollgCntrTiOutDGmMsg337BusChassisExpDGmMsg337BusChassisExpInvldRollgCntrTiOut
      AssemblySwConnector_988: ecu-extract-reference=CalRegn01CmnDGmMsg4D1BusHiSpdEngOilTDftDGmMsg4D1BusHiSpdDGmMsg4D1BusHiSpdEngOilTDft
      AssemblySwConnector_989: ecu-extract-reference=CalRegn01CmnDGmMsg4D1BusHiSpdInvldTiOutDGmMsg4D1BusHiSpdDGmMsg4D1BusHiSpdInvldTiOut
      AssemblySwConnector_1121: ecu-extract-reference=CalRegn01CmnDGmMsg4D1BusHiSpdMissTiOutDGmMsg4D1BusHiSpdDGmMsg4D1BusHiSpdMissTiOut
      AssemblySwConnector_1145: ecu-extract-reference=CalRegn01CmnDGmMsg500BusHiSpdMissTiOutDGmMsg500BusHiSpdDGmMsg500BusHiSpdMissTiOut
      AssemblySwConnector_1147: ecu-extract-reference=CalRegn01CmnDGmMsg500BusHiSpdWhlPlsPerRevDftDGmMsg500BusHiSpdDGmMsg500BusHiSpdWhlPlsPerRevDft
      AssemblySwConnector_1529: ecu-extract-reference=CalRegn01CmnDGmMsg500BusHiSpdWhlRotlStsTiStampReslDftDGmMsg500BusHiSpdDGmMsg500BusHiSpdWhlRotlStsTiStampReslDft
      AssemblySwConnector_1530: ecu-extract-reference=CDD_NxtrTiDGetRefTmr100MicroSec32bitDGmMsg0C5BusHiSpdDGetRefTmr100MicroSec32bit
      AssemblySwConnector_1618: ecu-extract-reference=CDD_NxtrTiDGetTiSpan100MicroSec32bitDGmMsg0C5BusHiSpdDGetTiSpan100MicroSec32bit
      AssemblySwConnector_1619: ecu-extract-reference=CDD_NxtrTiDGetRefTmr100MicroSec32bitDGmMsg500BusHiSpdDGetRefTmr100MicroSec32bit
      AssemblySwConnector_1620: ecu-extract-reference=CDD_NxtrTiDGetTiSpan100MicroSec32bitDGmMsg500BusHiSpdDGetTiSpan100MicroSec32bit
      AssemblySwConnector_1625: ecu-extract-reference=DiagcMgrProxyAppl6DSetNtcSts6DGmMsg0C5BusHiSpdDSetNtcSts
      AssemblySwConnector_1626: ecu-extract-reference=DiagcMgrProxyAppl6DSetNtcSts6DGmMsg500BusHiSpdDSetNtcSts
      AssemblySwConnector_1627: ecu-extract-reference=SerlComInpProxyDLeWhlDstPlsCntrRawDGmMsg0C5BusHiSpdDLeWhlDstPlsCntrRaw
      AssemblySwConnector_1776: ecu-extract-reference=SerlComInpProxyDLeWhlDstTiStampRawDGmMsg0C5BusHiSpdDLeWhlDstTiStampRaw
      AssemblySwConnector_1777: ecu-extract-reference=SerlComInpProxyDLeWhlDstVldRawDGmMsg0C5BusHiSpdDLeWhlDstVldRaw
      AssemblySwConnector_1778: ecu-extract-reference=SerlComInpProxyDLeWhlRotlStsRstRawDGmMsg0C5BusHiSpdDLeWhlRotlStsRstRaw
      AssemblySwConnector_1779: ecu-extract-reference=SerlComInpProxyDLeWhlSeqNrRawDGmMsg0C5BusHiSpdDLeWhlSeqNrRaw
      AssemblySwConnector_1783: ecu-extract-reference=SerlComInpProxyDLstRxnTiMsg0C5DGmMsg0C5BusHiSpdDLstRxnTiMsg0C5BusHiSpd
      AssemblySwConnector_1784: ecu-extract-reference=SerlComInpProxyDRiWhlDstPlsCntrRawDGmMsg0C5BusHiSpdDRiWhlDstPlsCntrRaw
      AssemblySwConnector_1785: ecu-extract-reference=SerlComInpProxyDRiWhlDstTiStampRawDGmMsg0C5BusHiSpdDRiWhlDstTiStampRaw
      AssemblySwConnector_1786: ecu-extract-reference=SerlComInpProxyDRiWhlDstVldRawDGmMsg0C5BusHiSpdDRiWhlDstVldRaw
      AssemblySwConnector_1787: ecu-extract-reference=SerlComInpProxyDRiWhlRotlStsRstRawDGmMsg0C5BusHiSpdDRiWhlRotlStsRstRaw
      AssemblySwConnector_1788: ecu-extract-reference=SerlComInpProxyDRiWhlSeqNrRawDGmMsg0C5BusHiSpdDRiWhlSeqNrRaw
      AssemblySwConnector_1789: ecu-extract-reference=SerlComInpProxyDLstRxnTiMsg500BusHiSpdDGmMsg500BusHiSpdDLstRxnTiMsg500BusHiSpd
      AssemblySwConnector_1790: ecu-extract-reference=SerlComInpProxyDWhlPlsPerRevRawDGmMsg500BusHiSpdDWhlPlsPerRevRaw
      AssemblySwConnector_1791: ecu-extract-reference=SerlComInpProxyDWhlRotlStsTiStampReslRawDGmMsg500BusHiSpdDWhlRotlStsTiStampReslRaw
      ComponentPrototype_154: upstream-reference=ECU_Composition.Swp, ecu-extract-reference=COMPOSITIONTYPE.Swp
      AssemblySwConnector_1792: ecu-extract-reference=AssiSumLimDMotTqCmdDSwpDMotTqCmd
      AssemblySwConnector_1793: ecu-extract-reference=CDD_NxtrTiDGetRefTmr100MicroSec32bitDSwpDGetRefTmr100MicroSec32bit
      AssemblySwConnector_1794: ecu-extract-reference=CDD_NxtrTiDGetTiSpan100MicroSec32bitDSwpDGetTiSpan100MicroSec32bit
      AssemblySwConnector_1796: ecu-extract-reference=SwpDHwTqSwpDAssiDHwTq
      AssemblySwConnector_1797: ecu-extract-reference=SwpDHwTqSwpDAssiHiFrqDHwTq
      AssemblySwConnector_1798: ecu-extract-reference=SwpDHwTqSwpDCmplncErrDHwTq
      AssemblySwConnector_1799: ecu-extract-reference=SwpDHwTqSwpDCustDiagcDHwTq
      AssemblySwConnector_1800: ecu-extract-reference=SwpDHwTqSwpDDampgDHwTq
      AssemblySwConnector_1801: ecu-extract-reference=SwpDHwTqSwpDEotLrngDHwTq
      AssemblySwConnector_1803: ecu-extract-reference=SwpDHwTqSwpDEotProtnDHwTq
      AssemblySwConnector_1864: ecu-extract-reference=SwpDHwTqSwpDGmMsg184BusHiSpdDHwTq
      AssemblySwConnector_1865: ecu-extract-reference=SwpDHwTqSwpDGmMsg1CABusChassisExpDHwTq
      AssemblySwConnector_1866: ecu-extract-reference=SwpDHwTqSwpDGmOvrlStMgrDHwTq
      AssemblySwConnector_1867: ecu-extract-reference=SwpDHwTqSwpDGmStrtStopDHwTq
      AssemblySwConnector_1868: ecu-extract-reference=SwpDHwTqSwpDGmTqArbnDHwTq
      AssemblySwConnector_1869: ecu-extract-reference=SwpDHwTqSwpDGmVehPwrModDHwTq
      AssemblySwConnector_1870: ecu-extract-reference=SwpDHwTqSwpDHwAgTrakgServoDHwTq
      AssemblySwConnector_1871: ecu-extract-reference=SwpDHwTqSwpDHysCmpDHwTq
      AssemblySwConnector_1872: ecu-extract-reference=SwpDHwTqSwpDInertiaCmpVelDHwTq
      AssemblySwConnector_1873: ecu-extract-reference=SwpDMotTqCmdSwpDMotTqTranlDampgDMotTqCmdCrf
      AssemblySwConnector_1874: ecu-extract-reference=SwpDHwTqSwpDPullCmpActvDHwTq
      AssemblySwConnector_1875: ecu-extract-reference=SwpDHwTqSwpDRtnDHwTq
      AssemblySwConnector_1876: ecu-extract-reference=SwpDHwTqSwpDStabyCmpDHwTq
      AssemblySwConnector_1877: ecu-extract-reference=SwpDHwTqSwpDTunSelnAuthyDHwTq
      AssemblySwConnector_1878: ecu-extract-reference=VehSigCdngDVehSpdDSwpDVehSpd
      AssemblySwConnector_1879: ecu-extract-reference=VehSigCdngDVehSpdVldDSwpDVehSpdVld
      ComponentPrototype_155: upstream-reference=ECU_Composition.CDD_AdcDiagc, ecu-extract-reference=COMPOSITIONTYPE.CDD_AdcDiagc
      AssemblySwConnector_1361: ecu-extract-reference=CDD_GmT1xxMcuCfgDAdc1SelfDiag0DCDD_AdcDiagcDAdc1SelfDiag0
      AssemblySwConnector_1362: ecu-extract-reference=CDD_GmT1xxMcuCfgDAdc1SelfDiag2DCDD_AdcDiagcDAdc1SelfDiag2
      AssemblySwConnector_1363: ecu-extract-reference=CDD_GmT1xxMcuCfgDAdc1SelfDiag4DCDD_AdcDiagcDAdc1SelfDiag4
      AssemblySwConnector_1364: ecu-extract-reference=DiagcMgrProxyAppl10DGetNtcQlfrSts10DCDD_AdcDiagcDGetNtcQlfrSts
      AssemblySwConnector_1365: ecu-extract-reference=DiagcMgrProxyAppl10DSetNtcSts10DCDD_AdcDiagcDSetNtcSts
      AssemblySwConnector_1366: ecu-extract-reference=CDD_AdcDiagcDAdc0FaildDCDD_GmT1xxMcuCfgDAdc0Faild
      AssemblySwConnector_1367: ecu-extract-reference=CDD_AdcDiagcDAdc1FaildDCDD_GmT1xxMcuCfgDAdc1Faild
      AssemblySwConnector_1368: ecu-extract-reference=CDD_MotCtrlMgrDAdc0SelfDiag0DCDD_AdcDiagcDAdc0SelfDiag0
      AssemblySwConnector_1369: ecu-extract-reference=CDD_MotCtrlMgrDAdc0SelfDiag2DCDD_AdcDiagcDAdc0SelfDiag2
      AssemblySwConnector_1370: ecu-extract-reference=CDD_MotCtrlMgrDAdc0SelfDiag4DCDD_AdcDiagcDAdc0SelfDiag4
      ComponentPrototype_156: upstream-reference=ECU_Composition.TqOscn, ecu-extract-reference=COMPOSITIONTYPE.TqOscn
      ComponentPrototype_157: upstream-reference=ECU_Composition.SnsrOffsLrng, ecu-extract-reference=COMPOSITIONTYPE.SnsrOffsLrng
      ComponentPrototype_158: upstream-reference=ECU_Composition.SnsrOffsCorrn, ecu-extract-reference=COMPOSITIONTYPE.SnsrOffsCorrn
      ComponentPrototype_159: upstream-reference=ECU_Composition.HwAgTrajGenn, ecu-extract-reference=COMPOSITIONTYPE.HwAgTrajGenn
      AssemblySwConnector_1375: ecu-extract-reference=CDD_NxtrTiDGetRefTmr100MicroSec32bitDSnsrOffsLrngDGetRefTmr100MicroSec32bit
      AssemblySwConnector_1376: ecu-extract-reference=CDD_NxtrTiDGetTiSpan100MicroSec32bitDSnsrOffsLrngDGetTiSpan100MicroSec32bit
      AssemblySwConnector_1377: ecu-extract-reference=FltInjDFltInj_f32DTqOscnDFltInj_f32
      AssemblySwConnector_1378: ecu-extract-reference=GmOvrlStMgrDHwTqOscEnaDTqOscnDHwOscnEna
      AssemblySwConnector_1881: ecu-extract-reference=HwAgSysArbnDPinionAgConfDSnsrOffsLrngDHwAgAuthy
      AssemblySwConnector_1882: ecu-extract-reference=SnsrOffsLrngDHwAgOffsDSnsrOffsCorrnDHwAgOffs
      AssemblySwConnector_1883: ecu-extract-reference=SnsrOffsLrngDHwTqOffsDSnsrOffsCorrnDHwTqOffs
      AssemblySwConnector_1884: ecu-extract-reference=SnsrOffsLrngDVehYawRateOffsDSnsrOffsCorrnDVehYawRateOffs
      AssemblySwConnector_1888: ecu-extract-reference=TqOscnDHwOscnCmdDGmTqArbnDHwTqOscCmd
      AssemblySwConnector_1890: ecu-extract-reference=VehSigCdngDVehSpdDSnsrOffsLrngDVehSpd
      AssemblySwConnector_1891: ecu-extract-reference=VehSigCdngDVehSpdVldDSnsrOffsLrngDVehSpdVld
      ComponentPrototype_081: upstream-reference=ECU_Composition.RtnPahFwl, ecu-extract-reference=COMPOSITIONTYPE.RtnPahFwl
      ComponentPrototype_142: upstream-reference=ECU_Composition.EotProtnFwl, ecu-extract-reference=COMPOSITIONTYPE.EotProtnFwl
      ComponentPrototype_160: upstream-reference=ECU_Composition.DampgPahFwl, ecu-extract-reference=COMPOSITIONTYPE.DampgPahFwl
      ComponentPrototype_161: upstream-reference=ECU_Composition.AssiPahFwl, ecu-extract-reference=COMPOSITIONTYPE.AssiPahFwl
      AssemblySwConnector: ecu-extract-reference=AssiDAssiCmdBasDAssiPahFwlDAssiCmdBas
      AssemblySwConnector_004: ecu-extract-reference=AssiHiFrqDAssiHiFrqCmdDAssiPahFwlDAssiHiFrqCmd
      AssemblySwConnector_005: ecu-extract-reference=AssiPahFwlDAssiPahLimrActvDDampgPahFwlDAssiPahLimrActv
      AssemblySwConnector_439: ecu-extract-reference=AssiPahFwlDAssiCmdSumDStabyCmpDAssiCmdSum
      AssemblySwConnector_1034: ecu-extract-reference=AssiPahFwlDAssiPahLimrActvDStabyCmpDAssiPahLimrActv
      AssemblySwConnector_1382: ecu-extract-reference=CDD_MotVelDMotVelCrfDDampgPahFwlDMotVelCrf
      AssemblySwConnector_1383: ecu-extract-reference=CDD_MotVelDMotVelCrfDEotProtnFwlDMotVelCrf
      AssemblySwConnector_1539: ecu-extract-reference=CmnMfgSrvDAssiLnrGainEnaDAssiPahFwlDAssiLnrGainEna
      AssemblySwConnector_1772: ecu-extract-reference=CmnMfgSrvDMfgEnaStDAssiPahFwlDMfgEnaSt
      AssemblySwConnector_1894: ecu-extract-reference=CmnMfgSrvDDampgCmdBasDiDDampgPahFwlDDampgCmdBasDi
      AssemblySwConnector_1895: ecu-extract-reference=CmnMfgSrvDMfgEnaStDDampgPahFwlDMfgEnaSt
      AssemblySwConnector_1896: ecu-extract-reference=CmnMfgSrvDEotProtnDiDEotProtnFwlDEotProtnDi
      AssemblySwConnector_1897: ecu-extract-reference=CmnMfgSrvDMfgEnaStDEotProtnFwlDMfgEnaSt
      AssemblySwConnector_1898: ecu-extract-reference=CmnMfgSrvDMfgEnaStDRtnPahFwlDMfgEnaSt
      AssemblySwConnector_1899: ecu-extract-reference=CmnMfgSrvDRtnCmdDiDRtnPahFwlDRtnCmdDi
      AssemblySwConnector_1900: ecu-extract-reference=DampgDDampgCmdBasDDampgPahFwlDDampgCmdBas
      AssemblySwConnector_1901: ecu-extract-reference=DampgPahFwlDDampgCmdDAssiSumLimDDampgCmd
      AssemblySwConnector_1902: ecu-extract-reference=DiagcMgrProxyAppl10DGetNtcQlfrSts10DAssiPahFwlDGetNtcQlfrSts
      AssemblySwConnector_1903: ecu-extract-reference=DiagcMgrProxyAppl10DSetNtcSts10DAssiPahFwlDSetNtcSts
      AssemblySwConnector_1904: ecu-extract-reference=DiagcMgrProxyAppl10DGetNtcQlfrSts10DDampgPahFwlDGetNtcQlfrSts
      AssemblySwConnector_1905: ecu-extract-reference=DiagcMgrProxyAppl10DSetNtcSts10DDampgPahFwlDSetNtcSts
      AssemblySwConnector_1906: ecu-extract-reference=DiagcMgrProxyAppl10DSetNtcSts10DEotProtnFwlDSetNtcSts
      AssemblySwConnector_1907: ecu-extract-reference=DiagcMgrProxyAppl10DSetNtcSts10DGmOvrlStMgrDSetNtcSts
      AssemblySwConnector_1908: ecu-extract-reference=DiagcMgrProxyAppl10DSetNtcSts10DRtnPahFwlDSetNtcSts
      AssemblySwConnector_1909: ecu-extract-reference=EotProtnDEotActvCmdDEotProtnFwlDEotActvCmd
      AssemblySwConnector_1910: ecu-extract-reference=EotProtnDEotDampgCmdDEotProtnFwlDEotDampgCmd
      AssemblySwConnector_1911: ecu-extract-reference=EotProtnFwlDEotActvCmdLimdDAssiSumLimDEotActvCmd
      AssemblySwConnector_1912: ecu-extract-reference=EotProtnFwlDEotDampgCmdLimdDAssiSumLimDEotDampgCmd
      AssemblySwConnector_1913: ecu-extract-reference=GmMsg180BusHiSpdDLkaCmdDGmTqArbnDLkaTqCmd
      AssemblySwConnector_1914: ecu-extract-reference=GmOvrlStMgrDHwAgServoEnaDGmTqArbnDHwAgServoEna
      AssemblySwConnector_1915: ecu-extract-reference=GmOvrlStMgrDHwOscnFrqDTqOscnDHwOscnFrq
      AssemblySwConnector_1916: ecu-extract-reference=GmOvrlStMgrDHwOscnMotAmpDTqOscnDHwOscnMotAmp
      AssemblySwConnector_1917: ecu-extract-reference=GmTqArbnDHwTqOvrlDAssiPahFwlDHwTqOvrl
      AssemblySwConnector_1918: ecu-extract-reference=GmTqArbnDLkaTqCmdCdndDGmMsg184BusHiSpdDLkaTqDlvd
      AssemblySwConnector_1919: ecu-extract-reference=GmTqArbnDEscCmdArbdDGmMsg1CABusChassisExpDEscTqDlvd
      AssemblySwConnector_1921: ecu-extract-reference=HwAgSysArbnDPinionAgConfDEotProtnFwlDPinionAgConf
      AssemblySwConnector_1922: ecu-extract-reference=HwAgSysArbnDPinionAgDHwAgTrajGennDHwAg
      AssemblySwConnector_1923: ecu-extract-reference=HwAgSysArbnDPinionAgDRtnPahFwlDHwAg
      AssemblySwConnector_1924: ecu-extract-reference=HysCmpDHysCmpCmdDAssiPahFwlDHysCmpCmd
      AssemblySwConnector_1925: ecu-extract-reference=InertiaCmpVelDInertiaCmpVelCmdDDampgPahFwlDInertiaCmpVelCmd
      AssemblySwConnector_1926: ecu-extract-reference=RtnDRtnCmdDRtnPahFwlDRtnCmd
      AssemblySwConnector_1927: ecu-extract-reference=RtnPahFwlDRtnCmdLimdDAssiSumLimDRtnCmd
      AssemblySwConnector_1928: ecu-extract-reference=SwpDHwTqSwpDAssiPahFwlDHwTq
      AssemblySwConnector_1929: ecu-extract-reference=SysStModDSysStDGmOvrlStMgrDSysSt
      AssemblySwConnector_1930: ecu-extract-reference=VehSigCdngDVehSpdDAssiPahFwlDVehSpd
      AssemblySwConnector_1931: ecu-extract-reference=VehSigCdngDVehSpdDDampgPahFwlDVehSpd
      AssemblySwConnector_1932: ecu-extract-reference=VehSigCdngDVehSpdDEotProtnFwlDVehSpd
      AssemblySwConnector_1933: ecu-extract-reference=VehSigCdngDVehSpdDGmOvrlStMgrDVehSpd
      AssemblySwConnector_1934: ecu-extract-reference=VehSigCdngDVehSpdDRtnPahFwlDVehSpd
      AssemblySwConnector_1941: ecu-extract-reference=HwAgTrajGennDHwAgTrakgServoCmdDGmOvrlStMgrDHwAgTraj
      AssemblySwConnector_1942: ecu-extract-reference=HwTqArbnDHwTqDSnsrOffsCorrnDHwTq
      AssemblySwConnector_1943: ecu-extract-reference=HwTqArbnDHwTqDSnsrOffsLrngDHwTq
      AssemblySwConnector_1945: ecu-extract-reference=SnsrOffsCorrnDHwTqCorrdDSwpDHwTq
      AssemblySwConnector_483: ecu-extract-reference=CalRegn01Inin00DAssiPahFwlCmdSplitLpFilFrqDAssiPahFwlDAssiPahFwlCmdSplitLpFilFrq
      AssemblySwConnector_484: ecu-extract-reference=CalRegn01Inin00DAssiPahFwlFwlActvLpFilFrqDAssiPahFwlDAssiPahFwlFwlActvLpFilFrq
      AssemblySwConnector_486: ecu-extract-reference=CalRegn01Inin00DDampgPahFwlActvFwlLpFilFrqDDampgPahFwlDDampgPahFwlActvFwlLpFilFrq
      AssemblySwConnector_487: ecu-extract-reference=CalRegn01Inin00DDampgPahFwlDampgCmdLpFilFrqDDampgPahFwlDDampgPahFwlDampgCmdLpFilFrq
      AssemblySwConnector_488: ecu-extract-reference=CalRegn01Inin00DDampgPahFwlInertiaCmpLpFilFrqDDampgPahFwlDDampgPahFwlInertiaCmpLpFilFrq
      AssemblySwConnector_2046: ecu-extract-reference=GmMsg1E9BusHiSpdDSerlComYawRateVldDSnsrOffsLrngDVehYawRateVld
      AssemblySwConnector_2047: ecu-extract-reference=GmMsg1E9BusHiSpdDSerlComYawRateVldDVehSigCdngDVehYawRateVldSerlCom
      ComponentPrototype_164: upstream-reference=ECU_Composition.MotRplCoggCfg, ecu-extract-reference=COMPOSITIONTYPE.MotRplCoggCfg
      ComponentPrototype_165: upstream-reference=ECU_Composition.CDD_MotRplCoggCmd, ecu-extract-reference=COMPOSITIONTYPE.CDD_MotRplCoggCmd
      AssemblySwConnector_2008: ecu-extract-reference=CalRegn01Inin00DSysGlbPrmMotPoleCntDMotRplCoggCfgDSysGlbPrmMotPoleCnt
      AssemblySwConnector_2068: ecu-extract-reference=CDD_MotVelDMotVelMrfDMotRplCoggCfgDMotVelMrf
      AssemblySwConnector_2069: ecu-extract-reference=MotCtrlPrmEstimnDMotBackEmfConEstimdDMotRplCoggCfgDMotBackEmfConEstimd
      AssemblySwConnector_2070: ecu-extract-reference=MotCtrlPrmEstimnDMotInduDaxEstimdDMotRplCoggCfgDMotInduDaxEstimd
      AssemblySwConnector_2071: ecu-extract-reference=MotCtrlPrmEstimnDMotInduQaxEstimdDMotRplCoggCfgDMotInduQaxEstimd
      AssemblySwConnector_2072: ecu-extract-reference=MotRefMdlDMotCurrDaxCmdDMotRplCoggCfgDMotCurrDaxCmd
      AssemblySwConnector_2073: ecu-extract-reference=MotRefMdlDMotCurrQaxCmdDMotRplCoggCfgDMotCurrQaxCmd
      AssemblySwConnector_2074: ecu-extract-reference=MotRplCoggCfgDMotAgElecDlyRplDCDD_MotCtrlMgrDMotAgElecDlyRpl
      AssemblySwConnector_2075: ecu-extract-reference=MotRplCoggCfgDMotCurrQaxToMotTqGainDCDD_MotCtrlMgrDMotCurrQaxToMotTqGain
      AssemblySwConnector_2076: ecu-extract-reference=MotRplCoggCfgDMotTqRplCoggOrder1MgnDCDD_MotCtrlMgrDMotTqRplCoggOrder1Mgn
      AssemblySwConnector_2077: ecu-extract-reference=MotRplCoggCfgDMotTqRplCoggOrder1PhaDCDD_MotCtrlMgrDMotTqRplCoggOrder1Pha
      AssemblySwConnector_2078: ecu-extract-reference=MotRplCoggCfgDMotTqRplCoggOrder2MgnDCDD_MotCtrlMgrDMotTqRplCoggOrder2Mgn
      AssemblySwConnector_2079: ecu-extract-reference=MotRplCoggCfgDMotTqRplCoggOrder2PhaDCDD_MotCtrlMgrDMotTqRplCoggOrder2Pha
      AssemblySwConnector_2080: ecu-extract-reference=MotRplCoggCfgDMotTqRplCoggOrder3MgnDCDD_MotCtrlMgrDMotTqRplCoggOrder3Mgn
      AssemblySwConnector_2081: ecu-extract-reference=MotRplCoggCfgDMotTqRplCoggOrder3PhaDCDD_MotCtrlMgrDMotTqRplCoggOrder3Pha
      AssemblySwConnector_2082: ecu-extract-reference=MotTqCmdScaDMotTqCmdMrfScadDMotRplCoggCfgDMotTqCmdMrfScad
      ComponentPrototype_166: upstream-reference=ECU_Composition.StHlthSigStc, ecu-extract-reference=COMPOSITIONTYPE.StHlthSigStc
      ComponentPrototype_167: upstream-reference=ECU_Composition.StHlthSigNormn, ecu-extract-reference=COMPOSITIONTYPE.StHlthSigNormn
      ComponentPrototype_168: upstream-reference=ECU_Composition.HowDetn, ecu-extract-reference=COMPOSITIONTYPE.HowDetn
      AssemblySwConnector_2083: ecu-extract-reference=CalRegn01CmnDEcuTMeasRngDiagcMaxDStHlthSigNormnDEcuTMeasRngDiagcMax
      AssemblySwConnector_2084: ecu-extract-reference=CalRegn01CmnDEcuTMeasRngDiagcMinDStHlthSigNormnDEcuTMeasRngDiagcMin
      AssemblySwConnector_2114: ecu-extract-reference=DiagcMgrProxyAppl10DGetNtcQlfrSts10DStHlthSigNormnDGetNtcQlfrSts
      AssemblySwConnector_2115: ecu-extract-reference=EcuTMeasDEcuTFildDStHlthSigNormnDEcuTFild
      AssemblySwConnector_2117: ecu-extract-reference=StHlthSigNormnDCtrlrTStHlthDStHlthSigStcDCtrlrTStHlth
      AssemblySwConnector_2118: ecu-extract-reference=StHlthSigNormnDOutpAssiStHlthDStHlthSigStcDOutpAssiStHlth
      AssemblySwConnector_2119: ecu-extract-reference=SwpDHwTqSwpDHowDetnDHwTq
      AssemblySwConnector_2120: ecu-extract-reference=VehSigCdngDVehSpdDHowDetnDVehSpd
      AssemblySwConnector_2121: ecu-extract-reference=GmMsg0C9BusHiSpdDMissMsg0C9DCustDiagcDMissMsg0C9
      AssemblySwConnector_2122: ecu-extract-reference=GmMsg1F1BusHiSpdDMissMsg1F1DCustDiagcDMissMsg1F1
      AssemblySwConnector_2123: ecu-extract-reference=HwTqCorrlnDHwTqIdptSigDCustDiagcDHwTqIdptSig
      AssemblySwConnector_2124: ecu-extract-reference=IoHwAbDGetGpioMcuEnaDCustDiagcDGetGpioMcuEna
      AssemblySwConnector_2126: ecu-extract-reference=PartNrDPartNrCtrlPidSeedUpprByteWrDCustDiagcDPartNrCtrlPidSeedUpprByteWr
      AssemblySwConnector_2127: ecu-extract-reference=StHlthSigNormnDUpdRawSigDCDD_ChkPtAppl10DUpdRawSig
      AssemblySwConnector_2128: ecu-extract-reference=StHlthSigStcDGetSigStcHlthDataDCustDiagcDGetSigStcHlthData
      ComponentPrototype_132: upstream-reference=ECU_Composition.MotVelCtrl, ecu-extract-reference=COMPOSITIONTYPE.MotVelCtrl
      ComponentPrototype_136: upstream-reference=ECU_Composition.HwAgVehCentrTrim, ecu-extract-reference=COMPOSITIONTYPE.HwAgVehCentrTrim
      AssemblySwConnector_435: ecu-extract-reference=AssiSumLimDSetManTqCmdDMotVelCtrlDSetManTqCmd
      AssemblySwConnector_1837: ecu-extract-reference=CalRegn03CmnGroupADHysCmpEffLossYDHysCmpDHysCmpEffLossY
      AssemblySwConnector_1840: ecu-extract-reference=CalRegn03CmnGroupADHysCmpEffOffsYDHysCmpDHysCmpEffOffsY
      AssemblySwConnector_1937: ecu-extract-reference=CalRegn03CmnGroupADHysCmpHwTqScaXDHysCmpDHysCmpHwTqScaX
      AssemblySwConnector_1938: ecu-extract-reference=CalRegn03CmnGroupADHysCmpHwTqScaYDHysCmpDHysCmpHwTqScaY
      AssemblySwConnector_1944: ecu-extract-reference=CalRegn03CmnGroupADHysCmpNegHysCmpScaXDHysCmpDHysCmpNegHysCmpScaX
      AssemblySwConnector_1994: ecu-extract-reference=CalRegn03CmnGroupADHysCmpNegHysCmpScaYDHysCmpDHysCmpNegHysCmpScaY
      AssemblySwConnector_1995: ecu-extract-reference=CalRegn03CmnGroupADHysCmpNegHysCmpXDHysCmpDHysCmpNegHysCmpX
      AssemblySwConnector_1996: ecu-extract-reference=CalRegn03CmnGroupADHysCmpNegHysCmpYDHysCmpDHysCmpNegHysCmpY
      AssemblySwConnector_1997: ecu-extract-reference=CalRegn03CmnGroupADHysCmpRevGainDHysCmpDHysCmpRevGain
      AssemblySwConnector_1998: ecu-extract-reference=CalRegn03CmnGroupADHysCmpRiseXDHysCmpDHysCmpRiseX
      AssemblySwConnector_1999: ecu-extract-reference=CalRegn03CmnGroupADHysCmpRiseYDHysCmpDHysCmpRiseY
      AssemblySwConnector_2000: ecu-extract-reference=CalRegn03Inin00GroupADHysCmpFricTScaXDHysCmpDHysCmpFricTScaX
      AssemblySwConnector_2001: ecu-extract-reference=CalRegn03Inin00GroupADHysCmpFricTScaYDHysCmpDHysCmpFricTScaY
      AssemblySwConnector_2002: ecu-extract-reference=CalRegn03Inin00GroupADRtnTScaXDRtnDRtnTScaX
      AssemblySwConnector_2003: ecu-extract-reference=CalRegn03Inin00GroupADRtnTScaYDRtnDRtnTScaY
      AssemblySwConnector_2004: ecu-extract-reference=CDD_MotRplCoggCmdDGetMotCoggCmdPrmDCmnMfgSrvDGetMotCoggCmdPrm
      AssemblySwConnector_2005: ecu-extract-reference=CDD_MotRplCoggCmdDSetMotCoggCmdPrmDCmnMfgSrvDSetMotCoggCmdPrm
      AssemblySwConnector_2130: ecu-extract-reference=CDD_NxtrTiDGetRefTmr100MicroSec32bitDMotVelCtrlDGetRefTmr100MicroSec32bit
      AssemblySwConnector_2131: ecu-extract-reference=CDD_NxtrTiDGetTiSpan100MicroSec32bitDMotVelCtrlDGetTiSpan100MicroSec32bit
      AssemblySwConnector_2132: ecu-extract-reference=EotLrngDHwAgEotCcwDHwAgVehCentrTrimDHwAgEotCcw
      AssemblySwConnector_2133: ecu-extract-reference=EotLrngDHwAgCcwDetdDHwAgVehCentrTrimDHwAgEotCcwDetd
      AssemblySwConnector_2134: ecu-extract-reference=EotLrngDHwAgEotCwDHwAgVehCentrTrimDHwAgEotCw
      AssemblySwConnector_2135: ecu-extract-reference=EotLrngDHwAgCwDetdDHwAgVehCentrTrimDHwAgEotCwDetd
      AssemblySwConnector_2136: ecu-extract-reference=GmMsg0C9BusHiSpdDEngRunActvDHwAgVehCentrTrimDEngRunActv
      AssemblySwConnector_2137: ecu-extract-reference=GmOvrlStMgrDGetGmLoaIgnCntrDProgMfgSrvDGetGmLoaIgnCntr
      AssemblySwConnector_2138: ecu-extract-reference=GmOvrlStMgrDSetGmLoaIgnCntrDProgMfgSrvDSetGmLoaIgnCntr
      AssemblySwConnector_2139: ecu-extract-reference=HwAgArbnDHwAgDHwAgVehCentrTrimDHwAg
      AssemblySwConnector_2140: ecu-extract-reference=HwAgVehCentrTrimDClrHwAgTrimValDCmnMfgSrvDClrHwAgTrimVal
      AssemblySwConnector_2143: ecu-extract-reference=HwAgVehCentrTrimDUpdHwAgTrimValDCmnMfgSrvDUpdHwAgTrimVal
      AssemblySwConnector_2147: ecu-extract-reference=MotRplCoggCfgDGetMotRplCoggPrmDCmnMfgSrvDGetMotRplCoggPrm
      AssemblySwConnector_2148: ecu-extract-reference=MotRplCoggCfgDSetMotRplCoggPrmDCmnMfgSrvDSetMotRplCoggPrm
      AssemblySwConnector_2149: ecu-extract-reference=MotVelCtrlDGetCtrlPrmDCmnMfgSrvDGetCtrlPrm
      AssemblySwConnector_2150: ecu-extract-reference=MotVelCtrlDSetCtrlPrmDCmnMfgSrvDSetCtrlPrm
      AssemblySwConnector_2151: ecu-extract-reference=MotVelCtrlDStopCtrlDCmnMfgSrvDStopCtrl
      AssemblySwConnector_2152: ecu-extract-reference=MotVelCtrlDStrtCtrlDCmnMfgSrvDStrtCtrl
      AssemblySwConnector_2154: ecu-extract-reference=VehSigCdngDVehSpdDHwAgVehCentrTrimDVehSpd
      ComponentPrototype_170: upstream-reference=ECU_Composition.CalRegn01CmnGroupC, ecu-extract-reference=COMPOSITIONTYPE.CalRegn01CmnGroupC
      AssemblySwConnector_2155: ecu-extract-reference=CalRegn01CmnGroupCDHwAgVehCentrTrimHwAgLimDHwAgVehCentrTrimDHwAgVehCentrTrimHwAgLim
      AssemblySwConnector_2156: ecu-extract-reference=HwAgVehCentrTrimDClrHwAgTrimValDCustDiagcDClrHwAgTrimVal
      AssemblySwConnector_2157: ecu-extract-reference=HwAgVehCentrTrimDUpdHwAgTrimValDCustDiagcDUpdHwAgTrimVal
      AssemblySwConnector_2158: ecu-extract-reference=StHlthSigStcDUpdStHlthStcDataDCDD_ChkPtAppl10DUpdStHlthStcData
      AssemblySwConnector_2159: ecu-extract-reference=StHlthSigNormnDCtrlrTRngDCustDiagcDCtrlrTRng
      AssemblySwConnector_2160: ecu-extract-reference=StHlthSigNormnDVltgRngDCustDiagcDVltgRng
      AssemblySwConnector_2161: ecu-extract-reference=FltInjDFltInj_u08DHwAgCorrlnDFltInj_u08
      ComponentPrototype_171: upstream-reference=ECU_Composition.DiagcMgrStub, ecu-extract-reference=COMPOSITIONTYPE.DiagcMgrStub
      AssemblySwConnector_2162: ecu-extract-reference=DiagcMgrStubDGetDiagcDataStubDDiagcMgrDGetDiagcDataAppl0
      AssemblySwConnector_2163: ecu-extract-reference=DiagcMgrStubDGetDiagcDataStubDDiagcMgrDGetDiagcDataAppl1
      AssemblySwConnector_2164: ecu-extract-reference=DiagcMgrStubDGetDiagcDataStubDDiagcMgrDGetDiagcDataAppl2
      AssemblySwConnector_2165: ecu-extract-reference=DiagcMgrStubDGetDiagcDataStubDDiagcMgrDGetDiagcDataAppl3
      AssemblySwConnector_2166: ecu-extract-reference=DiagcMgrStubDGetDiagcDataStubDDiagcMgrDGetDiagcDataAppl4
      AssemblySwConnector_2167: ecu-extract-reference=DiagcMgrStubDGetDiagcDataStubDDiagcMgrDGetDiagcDataAppl5
      AssemblySwConnector_2168: ecu-extract-reference=DiagcMgrStubDGetDiagcDataStubDDiagcMgrDGetDiagcDataAppl7
      AssemblySwConnector_2169: ecu-extract-reference=DiagcMgrStubDGetDiagcDataStubDDiagcMgrDGetDiagcDataAppl8
      AssemblySwConnector_2170: ecu-extract-reference=DiagcMgrStubDGetDiagcDataStubDDiagcMgrDGetDiagcDataAppl9
      AssemblySwConnector_2171: ecu-extract-reference=DiagcMgrStubDGetNtcInfoStubDDiagcMgrDGetNtcInfoAppl0
      AssemblySwConnector_2172: ecu-extract-reference=DiagcMgrStubDGetNtcInfoStubDDiagcMgrDGetNtcInfoAppl1
      AssemblySwConnector_2173: ecu-extract-reference=DiagcMgrStubDGetNtcInfoStubDDiagcMgrDGetNtcInfoAppl2
      AssemblySwConnector_2174: ecu-extract-reference=DiagcMgrStubDGetNtcInfoStubDDiagcMgrDGetNtcInfoAppl3
      AssemblySwConnector_2175: ecu-extract-reference=DiagcMgrStubDGetNtcInfoStubDDiagcMgrDGetNtcInfoAppl4
      AssemblySwConnector_2176: ecu-extract-reference=DiagcMgrStubDGetNtcInfoStubDDiagcMgrDGetNtcInfoAppl5
      AssemblySwConnector_2177: ecu-extract-reference=DiagcMgrStubDGetNtcInfoStubDDiagcMgrDGetNtcInfoAppl7
      AssemblySwConnector_2178: ecu-extract-reference=DiagcMgrStubDGetNtcInfoStubDDiagcMgrDGetNtcInfoAppl8
      AssemblySwConnector_2179: ecu-extract-reference=DiagcMgrStubDGetNtcInfoStubDDiagcMgrDGetNtcInfoAppl9
      AssemblySwConnector_1353: ecu-extract-reference=HwAgSysArbnDPinionAgDPullCmpActvDHwAg
      AssemblySwConnector_1887: ecu-extract-reference=MotTqTranlDampgDMotTqCmdCrfDampdDSnsrOffsLrngDMotTqCmdCrf
      AssemblySwConnector_897: ecu-extract-reference=CDD_CurrMeasDMotCurrQlfr1DCDD_MotCtrlMgrDMotCurrQlfr1
      AssemblySwConnector_898: ecu-extract-reference=CDD_CurrMeasDMotCurrQlfr2DCDD_MotCtrlMgrDMotCurrQlfr2
      AssemblySwConnector_2180: ecu-extract-reference=CDD_CurrMeasDMotCurrQlfr1DCurrMeasCorrlnDMotCurrQlfr1
      AssemblySwConnector_2181: ecu-extract-reference=CDD_CurrMeasDMotCurrQlfr2DCurrMeasCorrlnDMotCurrQlfr2
      AssemblySwConnector_1689: ecu-extract-reference=GmMsg1E9BusHiSpdDSerlComYawRateDVehSigCdngDVehYawRateSerlCom
      AssemblySwConnector_1935: ecu-extract-reference=SnsrOffsCorrnDVehYawRateCorrdDPullCmpActvDVehYawRate
      AssemblySwConnector_1936: ecu-extract-reference=VehSigCdngDVehYawRateDSnsrOffsCorrnDVehYawRate
      AssemblySwConnector_1946: ecu-extract-reference=VehSigCdngDVehYawRateDSnsrOffsLrngDVehYawRate
      ComponentPrototype_130: upstream-reference=ECU_Composition.CalRegn03Inin00GroupC, ecu-extract-reference=COMPOSITIONTYPE.CalRegn03Inin00GroupC
      ComponentPrototype_162: upstream-reference=ECU_Composition.CalRegn02Inin00, ecu-extract-reference=COMPOSITIONTYPE.CalRegn02Inin00
      ComponentPrototype_172: upstream-reference=ECU_Composition.CalRegn02CmnGroupC, ecu-extract-reference=COMPOSITIONTYPE.CalRegn02CmnGroupC
      ComponentPrototype_173: upstream-reference=ECU_Composition.CalRegn01Inin00GroupC, ecu-extract-reference=COMPOSITIONTYPE.CalRegn01Inin00GroupC
      AssemblySwConnector_140: ecu-extract-reference=CalRegn01CmnDAssiPahFwlDiRcvrDAssiPahFwlDAssiPahFwlDiRcvr
      AssemblySwConnector_141: ecu-extract-reference=CalRegn01CmnDAssiPahFwlVehSpdDAssiPahFwlDAssiPahFwlVehSpd
      AssemblySwConnector_142: ecu-extract-reference=CalRegn01CmnDBasAssiPahFwlOverLimDiagcFailStepDAssiPahFwlDBasAssiPahFwlOverLimDiagcFailStep
      AssemblySwConnector_143: ecu-extract-reference=CalRegn01CmnDBasAssiPahFwlOverLimDiagcPassStepDAssiPahFwlDBasAssiPahFwlOverLimDiagcPassStep
      AssemblySwConnector_144: ecu-extract-reference=CalRegn01CmnDHiFrqAssiPahFwlOverLimDiagcFailStepDAssiPahFwlDHiFrqAssiPahFwlOverLimDiagcFailStep
      AssemblySwConnector_145: ecu-extract-reference=CalRegn01CmnDHiFrqAssiPahFwlOverLimDiagcPassStepDAssiPahFwlDHiFrqAssiPahFwlOverLimDiagcPassStep
      AssemblySwConnector_146: ecu-extract-reference=CalRegn01CmnDMotRplCoggCmdHrmncOrder1ElecDCDD_MotRplCoggCmdDMotRplCoggCmdHrmncOrder1Elec
      AssemblySwConnector_147: ecu-extract-reference=CalRegn01CmnDMotRplCoggCmdHrmncOrder2ElecDCDD_MotRplCoggCmdDMotRplCoggCmdHrmncOrder2Elec
      AssemblySwConnector_148: ecu-extract-reference=CalRegn01CmnDMotRplCoggCmdHrmncOrder3ElecDCDD_MotRplCoggCmdDMotRplCoggCmdHrmncOrder3Elec
      AssemblySwConnector_149: ecu-extract-reference=CalRegn01CmnDDampgPahFwlAssiAddlDampgXDDampgPahFwlDDampgPahFwlAssiAddlDampgX
      AssemblySwConnector_150: ecu-extract-reference=CalRegn01CmnDDampgPahFwlAssiAddlDampgYDDampgPahFwlDDampgPahFwlAssiAddlDampgY
      AssemblySwConnector_151: ecu-extract-reference=CalRegn01CmnDDampgPahFwlDampgCmdAddlDampgXDDampgPahFwlDDampgPahFwlDampgCmdAddlDampgX
      AssemblySwConnector_152: ecu-extract-reference=CalRegn01CmnDDampgPahFwlDampgCmdAddlDampgYDDampgPahFwlDDampgPahFwlDampgCmdAddlDampgY
      AssemblySwConnector_153: ecu-extract-reference=CalRegn01CmnDDampgPahFwlDampgCmdFwlOverLimDiagcFailStepDDampgPahFwlDDampgPahFwlDampgCmdFwlOverLimDiagcFailStep
      AssemblySwConnector_154: ecu-extract-reference=CalRegn01CmnDDampgPahFwlDampgCmdFwlOverLimDiagcPassStepDDampgPahFwlDDampgPahFwlDampgCmdFwlOverLimDiagcPassStep
      AssemblySwConnector_155: ecu-extract-reference=CalRegn01CmnDDampgPahFwlDftDampgXDDampgPahFwlDDampgPahFwlDftDampgX
      AssemblySwConnector_156: ecu-extract-reference=CalRegn01CmnDDampgPahFwlInertiaCmpCmdFwlOverLimDiagcFailStepDDampgPahFwlDDampgPahFwlInertiaCmpCmdFwlOverLimDiagcFailStep
      AssemblySwConnector_157: ecu-extract-reference=CalRegn01CmnDDampgPahFwlInertiaCmpCmdFwlOverLimDiagcPassStepDDampgPahFwlDDampgPahFwlInertiaCmpCmdFwlOverLimDiagcPassStep
      AssemblySwConnector_496: ecu-extract-reference=CalRegn01CmnDDampgPahFwlVehSpdDDampgPahFwlDDampgPahFwlVehSpd
      AssemblySwConnector_497: ecu-extract-reference=CalRegn01CmnDEotProtnFwlEotDampgActvBndXDEotProtnFwlDEotProtnFwlEotDampgActvBndX
      AssemblySwConnector_498: ecu-extract-reference=CalRegn01CmnDEotProtnFwlInactvLimDEotProtnFwlDEotProtnFwlInactvLim
      AssemblySwConnector_499: ecu-extract-reference=CalRegn01CmnDEotProtnFwlVehSpdDEotProtnFwlDEotProtnFwlVehSpd
      AssemblySwConnector_652: ecu-extract-reference=CalRegn01CmnDHwAgTrajGennAgMaxDHwAgTrajGennDHwAgTrajGennAgMax
      AssemblySwConnector_653: ecu-extract-reference=CalRegn01CmnDHwAgTrajGennAMaxDHwAgTrajGennDHwAgTrajGennAMax
      AssemblySwConnector_655: ecu-extract-reference=CalRegn01CmnDHwAgTrajGennVelMaxDHwAgTrajGennDHwAgTrajGennVelMax
      AssemblySwConnector_656: ecu-extract-reference=CalRegn01CmnDMotRplCoggCfgMotAgTiDlyDMotRplCoggCfgDMotRplCoggCfgMotAgTiDly
      AssemblySwConnector_657: ecu-extract-reference=CalRegn01CmnDMotRplCoggCfgMotCurrDaxRplBilnrSelnDMotRplCoggCfgDMotRplCoggCfgMotCurrDaxRplBilnrSeln
      AssemblySwConnector_658: ecu-extract-reference=CalRegn01CmnDMotRplCoggCfgMotCurrQaxRplDMotRplCoggCfgDMotRplCoggCfgMotCurrQaxRpl
      AssemblySwConnector_660: ecu-extract-reference=CalRegn01CmnDMotRplCoggCfgMotTqCmdCurrRgltrBwCmpMgnYDMotRplCoggCfgDMotRplCoggCfgMotTqCmdCurrRgltrBwCmpMgnY
      AssemblySwConnector_661: ecu-extract-reference=CalRegn01CmnDMotRplCoggCfgMotTqCmdCurrRgltrBwCmpPhaYDMotRplCoggCfgDMotRplCoggCfgMotTqCmdCurrRgltrBwCmpPhaY
      AssemblySwConnector_662: ecu-extract-reference=CalRegn01CmnDMotRplCoggCfgMotTqCmdCurrRgltrBwCmpXDMotRplCoggCfgDMotRplCoggCfgMotTqCmdCurrRgltrBwCmpX
      AssemblySwConnector_673: ecu-extract-reference=CalRegn01CmnDMotRplCoggCfgMotTqRplOrder1XDMotRplCoggCfgDMotRplCoggCfgMotTqRplOrder1X
      AssemblySwConnector_1244: ecu-extract-reference=CalRegn01CmnDMotRplCoggCfgMotTqRplOrder1YDMotRplCoggCfgDMotRplCoggCfgMotTqRplOrder1Y
      AssemblySwConnector_1341: ecu-extract-reference=CalRegn01CmnDMotRplCoggCfgMotTqRplOrder2XDMotRplCoggCfgDMotRplCoggCfgMotTqRplOrder2X
      AssemblySwConnector_1344: ecu-extract-reference=CalRegn01CmnDMotRplCoggCfgMotTqRplOrder2YDMotRplCoggCfgDMotRplCoggCfgMotTqRplOrder2Y
      AssemblySwConnector_1346: ecu-extract-reference=CalRegn01CmnDMotRplCoggCfgMotTqRplOrder3XDMotRplCoggCfgDMotRplCoggCfgMotTqRplOrder3X
      AssemblySwConnector_1699: ecu-extract-reference=CalRegn01CmnDMotRplCoggCfgMotTqRplOrder3YDMotRplCoggCfgDMotRplCoggCfgMotTqRplOrder3Y
      AssemblySwConnector_1700: ecu-extract-reference=CalRegn01CmnDMotRplCoggCfgMotVelBilnrSelnDMotRplCoggCfgDMotRplCoggCfgMotVelBilnrSeln
      AssemblySwConnector_1701: ecu-extract-reference=CalRegn01CmnDMotRplCoggCmdHrmncOrder1ElecDMotRplCoggCfgDMotRplCoggCmdHrmncOrder1Elec
      AssemblySwConnector_1702: ecu-extract-reference=CalRegn01CmnDMotRplCoggCmdHrmncOrder2ElecDMotRplCoggCfgDMotRplCoggCmdHrmncOrder2Elec
      AssemblySwConnector_1703: ecu-extract-reference=CalRegn01CmnDMotRplCoggCmdHrmncOrder3ElecDMotRplCoggCfgDMotRplCoggCmdHrmncOrder3Elec
      AssemblySwConnector_1830: ecu-extract-reference=CalRegn01CmnDTqOscnFallRampRateCalDTqOscnDTqOscnFallRampRateCal
      AssemblySwConnector_1835: ecu-extract-reference=CalRegn01CmnDTqOscnRisngRampRateCalDTqOscnDTqOscnRisngRampRateCal
      AssemblySwConnector_1836: ecu-extract-reference=CalRegn01CmnDTqOscnUseRampRateCalDTqOscnDTqOscnUseRampRateCal
      AssemblySwConnector_2007: ecu-extract-reference=CalRegn01Inin00DAssiPahFwlDftAssiXDAssiPahFwlDAssiPahFwlDftAssiX
      AssemblySwConnector_2009: ecu-extract-reference=CalRegn01Inin00DAssiPahFwlDftAssiYDAssiPahFwlDAssiPahFwlDftAssiY
      AssemblySwConnector_2010: ecu-extract-reference=CalRegn01Inin00DAssiPahFwlHiFrqUpprLimYDAssiPahFwlDAssiPahFwlHiFrqUpprLimY
      AssemblySwConnector_2011: ecu-extract-reference=CalRegn01Inin00DAssiPahFwlHysCmpLimDAssiPahFwlDAssiPahFwlHysCmpLim
      AssemblySwConnector_2012: ecu-extract-reference=CalRegn01Inin00DAssiPahFwlRestoreThdDAssiPahFwlDAssiPahFwlRestoreThd
      AssemblySwConnector_2013: ecu-extract-reference=CalRegn01Inin00DAssiPahFwlUpprLimXDAssiPahFwlDAssiPahFwlUpprLimX
      AssemblySwConnector_2014: ecu-extract-reference=CalRegn01Inin00DAssiPahFwlUpprLimYDAssiPahFwlDAssiPahFwlUpprLimY
      AssemblySwConnector_2015: ecu-extract-reference=CalRegn01Inin00DDampgPahFwlDampgCmdUpprLimXDDampgPahFwlDDampgPahFwlDampgCmdUpprLimX
      AssemblySwConnector_2016: ecu-extract-reference=CalRegn01Inin00DDampgPahFwlDampgCmdUpprLimYDDampgPahFwlDDampgPahFwlDampgCmdUpprLimY
      AssemblySwConnector_2017: ecu-extract-reference=CalRegn01Inin00DDampgPahFwlDftDampgYDDampgPahFwlDDampgPahFwlDftDampgY
      AssemblySwConnector_2018: ecu-extract-reference=CalRegn01Inin00DDampgPahFwlInertiaCmpUpprLimXDDampgPahFwlDDampgPahFwlInertiaCmpUpprLimX
      AssemblySwConnector_2019: ecu-extract-reference=CalRegn01Inin00DDampgPahFwlInertiaCmpUpprLimYDDampgPahFwlDDampgPahFwlInertiaCmpUpprLimY
      AssemblySwConnector_2020: ecu-extract-reference=CalRegn01Inin00DEotProtnFwlActvCmdLowrBndDEotProtnFwlDEotProtnFwlActvCmdLowrBnd
      AssemblySwConnector_2021: ecu-extract-reference=CalRegn01Inin00DEotProtnFwlActvCmdUpprBndDEotProtnFwlDEotProtnFwlActvCmdUpprBnd
      AssemblySwConnector_2092: ecu-extract-reference=CalRegn01Inin00DRtnPahFwlUpprBndTblXDRtnPahFwlDRtnPahFwlUpprBndTblX
      AssemblySwConnector_2093: ecu-extract-reference=CalRegn01Inin00DRtnPahFwlUpprBndTblYDRtnPahFwlDRtnPahFwlUpprBndTblY
      AssemblySwConnector_2094: ecu-extract-reference=CalRegn01Inin00DRtnPahFwlVehSpdDRtnPahFwlDRtnPahFwlVehSpd
      AssemblySwConnector_2095: ecu-extract-reference=CalRegn01Inin00DStHlthSigNormnHiCtrlrTDStHlthSigNormnDStHlthSigNormnHiCtrlrT
      AssemblySwConnector_2096: ecu-extract-reference=CalRegn01Inin00DStHlthSigNormnLoCtrlrTDStHlthSigNormnDStHlthSigNormnLoCtrlrT
      AssemblySwConnector_2097: ecu-extract-reference=CalRegn01Inin00GroupCDEotProtnFwlEotDampgActvBndYDEotProtnFwlDEotProtnFwlEotDampgActvBndY
      AssemblySwConnector_2100: ecu-extract-reference=CalRegn02CmnDSnsrOffsCorrnOffsEnaDSnsrOffsCorrnDSnsrOffsCorrnOffsEna
      AssemblySwConnector_2101: ecu-extract-reference=CalRegn02CmnGroupCDSnsrOffsLrngFctEnaDSnsrOffsLrngDSnsrOffsLrngFctEna
      AssemblySwConnector_2102: ecu-extract-reference=CalRegn02CmnGroupCDSnsrOffsLrngHwAgLrngEnaDSnsrOffsLrngDSnsrOffsLrngHwAgLrngEna
      AssemblySwConnector_2103: ecu-extract-reference=CalRegn02CmnGroupCDSnsrOffsLrngHwTqLrngEnaDSnsrOffsLrngDSnsrOffsLrngHwTqLrngEna
      AssemblySwConnector_2104: ecu-extract-reference=CalRegn02Inin00DGmStrtStopEnaDGmStrtStopDGmStrtStopEna
      AssemblySwConnector_2105: ecu-extract-reference=CalRegn03CmnGroupADAssiThermScaXDAssiDAssiThermScaX
      AssemblySwConnector_2106: ecu-extract-reference=CalRegn03CmnGroupADAssiThermScaYDAssiDAssiThermScaY
      AssemblySwConnector_2107: ecu-extract-reference=CalRegn03Inin00DHwAgTrakgServoSmotngYDHwAgTrakgServoDHwAgTrakgServoSmotngY
      AssemblySwConnector_2108: ecu-extract-reference=CalRegn03Inin00GroupCDHwAgTrakgServoDampgTqXDHwAgTrakgServoDHwAgTrakgServoDampgTqX
      AssemblySwConnector_2109: ecu-extract-reference=CalRegn03Inin00GroupCDHwAgTrakgServoDampgTqYDHwAgTrakgServoDHwAgTrakgServoDampgTqY
      AssemblySwConnector_2110: ecu-extract-reference=CalRegn03Inin00GroupCDHwAgTrakgServoDftlGainYDHwAgTrakgServoDHwAgTrakgServoDftlGainY
      AssemblySwConnector_2111: ecu-extract-reference=CalRegn03Inin00GroupCDHwAgTrakgServoIntglGainYDHwAgTrakgServoDHwAgTrakgServoIntglGainY
      AssemblySwConnector_2112: ecu-extract-reference=CalRegn03Inin00GroupCDHwAgTrakgServoIntglTermAntiWdupLimYDHwAgTrakgServoDHwAgTrakgServoIntglTermAntiWdupLimY
      AssemblySwConnector_2113: ecu-extract-reference=CalRegn03Inin00GroupCDHwAgTrakgServoPropGainXDHwAgTrakgServoDHwAgTrakgServoPropGainX
      AssemblySwConnector_2182: ecu-extract-reference=CalRegn03Inin00GroupCDHwAgTrakgServoPropGainYDHwAgTrakgServoDHwAgTrakgServoPropGainY
      AssemblySwConnector_2183: ecu-extract-reference=CalRegn03Inin00GroupCDHwAgTrakgServoSmotngXDHwAgTrakgServoDHwAgTrakgServoSmotngX
      ComponentPrototype_174: upstream-reference=ECU_Composition.GmRoadWhlInQlfr, ecu-extract-reference=COMPOSITIONTYPE.GmRoadWhlInQlfr
      AssemblySwConnector_2185: ecu-extract-reference=CalRegn01Inin00GroupBDGmRoadWhlInQlfrMaxAllwblFrqDGmRoadWhlInQlfrDGmRoadWhlInQlfrMaxAllwblFrq
      AssemblySwConnector_2186: ecu-extract-reference=CalRegn01Inin00GroupBDGmRoadWhlInQlfrMaxFrqChgDGmRoadWhlInQlfrDGmRoadWhlInQlfrMaxFrqChg
      AssemblySwConnector_2187: ecu-extract-reference=CDD_NxtrTiDGetRefTmr100MicroSec32bitDGmRoadWhlInQlfrDGetRefTmr100MicroSec32bit
      AssemblySwConnector_2188: ecu-extract-reference=CDD_NxtrTiDGetTiSpan100MicroSec32bitDGmRoadWhlInQlfrDGetTiSpan100MicroSec32bit
      AssemblySwConnector_2189: ecu-extract-reference=DiagcMgrProxyAppl10DSetNtcSts10DGmRoadWhlInQlfrDSetNtcSts
      AssemblySwConnector_2190: ecu-extract-reference=GmMsg0C5BusHiSpdDLeWhlDstPlsCntrDGmRoadWhlInQlfrDWhlLeDstPlsCntr
      AssemblySwConnector_2191: ecu-extract-reference=GmMsg0C5BusHiSpdDLeWhlDstTiStampDGmRoadWhlInQlfrDWhlLeDstTiStamp
      AssemblySwConnector_2192: ecu-extract-reference=GmMsg0C5BusHiSpdDLeWhlDstVldDGmRoadWhlInQlfrDWhlLeDstVld
      AssemblySwConnector_2193: ecu-extract-reference=GmMsg0C5BusHiSpdDRiWhlDstPlsCntrDGmRoadWhlInQlfrDWhlRiDstPlsCntr
      AssemblySwConnector_2194: ecu-extract-reference=GmMsg0C5BusHiSpdDRiWhlDstTiStampDGmRoadWhlInQlfrDWhlRiDstTiStamp
      AssemblySwConnector_2195: ecu-extract-reference=GmMsg0C5BusHiSpdDRiWhlDstVldDGmRoadWhlInQlfrDWhlRiDstVld
      AssemblySwConnector_2196: ecu-extract-reference=GmMsg500BusHiSpdDWhlPlsPerRevDGmRoadWhlInQlfrDWhlPlsPerRev
      AssemblySwConnector_2197: ecu-extract-reference=GmMsg500BusHiSpdDWhlRotlStsTiStampReslDGmRoadWhlInQlfrDWhlRotlStsTiStampResl
      ComponentPrototype_175: upstream-reference=ECU_Composition.CDD_DataAndAdrPar, ecu-extract-reference=COMPOSITIONTYPE.CDD_DataAndAdrPar
      AssemblySwConnector_2198: ecu-extract-reference=CDD_NxtrTiDGetRefTmr100MicroSec32bitDGmVehSpdArbnDGetRefTmr100MicroSec32bit
      AssemblySwConnector_2199: ecu-extract-reference=CDD_NxtrTiDGetTiSpan100MicroSec32bitDGmVehSpdArbnDGetTiSpan100MicroSec32bit
      AssemblySwConnector_2200: ecu-extract-reference=CDD_GmT1xxMcuCfgDBattVltgSwd1AdcFaildDBattVltgCorrlnDBattVltgSwd1AdcFaild
      AssemblySwConnector_2201: ecu-extract-reference=CDD_GmT1xxMcuCfgDBattVltgSwd2AdcFaildDBattVltgCorrlnDBattVltgSwd2AdcFaild
      AssemblySwConnector_072: ecu-extract-reference=CalRegn01CmnDSinVltgGennDthrLpFilCoeffDCDD_SinVltgGennDSinVltgGennDthrLpFilCoeff
      AssemblySwConnector_356: ecu-extract-reference=CalRegn01CmnDMotRefMdlCurrItrnTolrDMotRefMdlDMotRefMdlCurrItrnTolr
      AssemblySwConnector_359: ecu-extract-reference=CalRegn01CmnDMotRefMdlMinCurrItrnLimDMotRefMdlDMotRefMdlMinCurrItrnLim
      AssemblySwConnector_363: ecu-extract-reference=CalRegn01CmnDMotRefMdlQuad13VltgSdlXDMotRefMdlDMotRefMdlQuad13VltgSdlX
      AssemblySwConnector_364: ecu-extract-reference=CalRegn01CmnDMotRefMdlQuad13VltgSdlYDMotRefMdlDMotRefMdlQuad13VltgSdlY
      AssemblySwConnector_365: ecu-extract-reference=CalRegn01CmnDMotRefMdlQuad24VltgSdlXDMotRefMdlDMotRefMdlQuad24VltgSdlX
      AssemblySwConnector_366: ecu-extract-reference=CalRegn01CmnDMotRefMdlQuad24VltgSdlYDMotRefMdlDMotRefMdlQuad24VltgSdlY
      AssemblySwConnector_367: ecu-extract-reference=CalRegn01CmnDMotRefMdlRefLocnItrnLimDMotRefMdlDMotRefMdlRefLocnItrnLim
      AssemblySwConnector_368: ecu-extract-reference=CalRegn01CmnDMotRefMdlTqItrnLimDMotRefMdlDMotRefMdlTqItrnLim
      AssemblySwConnector_369: ecu-extract-reference=CalRegn01CmnDMotRefMdlTqItrnTolrDMotRefMdlDMotRefMdlTqItrnTolr
      AssemblySwConnector_371: ecu-extract-reference=CalRegn01CmnDMotRefMdlVltgOverRThdScaDMotRefMdlDMotRefMdlVltgOverRThdSca
      AssemblySwConnector_062: ecu-extract-reference=CalRegn01CmnDMotCurrRegCfgCurrLoopSecOrderTrfFctEnaDMotCurrRegCfgDMotCurrRegCfgCurrLoopSecOrderTrfFctEna
      AssemblySwConnector_081: ecu-extract-reference=CalRegn01CmnDMotCurrRegCfgIntglGainSampleTiDMotCurrRegCfgDMotCurrRegCfgIntglGainSampleTi
      AssemblySwConnector_334: ecu-extract-reference=CalRegn01CmnDMotCurrRegCfgMotCtrlPrmSelnXDMotCurrRegCfgDMotCurrRegCfgMotCtrlPrmSelnX
      AssemblySwConnector_335: ecu-extract-reference=CDD_GmT1xxMcuCfgDMotAg2CosAdcFaildDMotAg2MeasDMotAg2CosAdcFaild
      AssemblySwConnector_339: ecu-extract-reference=CDD_GmT1xxMcuCfgDMotAg2SinAdcFaildDMotAg2MeasDMotAg2SinAdcFaild
      AssemblySwConnector_667: ecu-extract-reference=CmnMfgSrvDSysMotTqCmdRampRateDiDStOutpCtrlDSysMotTqCmdRampRateDi
      AssemblySwConnector_668: ecu-extract-reference=MotTqCmdScaDGetMotTqCmdScaDCmnMfgSrvDGetMotTqCmdSca
      AssemblySwConnector_2202: ecu-extract-reference=MotTqCmdScaDSetMotTqCmdScaDCmnMfgSrvDSetMotTqCmdSca
      AssemblySwConnector_2203: ecu-extract-reference=SnsrOffsLrngDGetHwAgOffsDCmnMfgSrvDGetHwAgOffs
      AssemblySwConnector_2204: ecu-extract-reference=SnsrOffsLrngDGetHwTqOffsDCmnMfgSrvDGetHwTqOffs
      AssemblySwConnector_2205: ecu-extract-reference=SnsrOffsLrngDGetYawRateOffsDCmnMfgSrvDGetYawRateOffs
      AssemblySwConnector_2206: ecu-extract-reference=SnsrOffsLrngDRstHwTqDCmnMfgSrvDRstHwTq
      AssemblySwConnector_2207: ecu-extract-reference=SnsrOffsLrngDRstYawAndAgDCmnMfgSrvDRstYawAndAg
      AssemblySwConnector_2208: ecu-extract-reference=SnsrOffsLrngDSetHwAgOffsDCmnMfgSrvDSetHwAgOffs
      AssemblySwConnector_2209: ecu-extract-reference=SnsrOffsLrngDSetHwTqOffsDCmnMfgSrvDSetHwTqOffs
      AssemblySwConnector_2210: ecu-extract-reference=SnsrOffsLrngDSetYawRateOffsDCmnMfgSrvDSetYawRateOffs
      AssemblySwConnector_2211: ecu-extract-reference=CDD_GmT1xxMcuCfgDEcuTAdcFaildDEcuTMeasDEcuTAdcFaild
      ComponentPrototype_176: upstream-reference=ECU_Composition.WhlImbRejctn, ecu-extract-reference=COMPOSITIONTYPE.WhlImbRejctn
      ComponentPrototype_177: upstream-reference=ECU_Composition.CalRegn03Inin00GroupB, ecu-extract-reference=COMPOSITIONTYPE.CalRegn03Inin00GroupB
      ComponentPrototype_178: upstream-reference=ECU_Composition.CalRegn03CmnGroupB, ecu-extract-reference=COMPOSITIONTYPE.CalRegn03CmnGroupB
      AssemblySwConnector_2212: ecu-extract-reference=CalRegn01CmnGroupBDWhlImbRejctnDcTrendFltRcvryDlyDWhlImbRejctnDWhlImbRejctnDcTrendFltRcvryDly
      AssemblySwConnector_2213: ecu-extract-reference=CalRegn01CmnGroupBDWhlImbRejctnFrqDiagcFltRcvryDlyDWhlImbRejctnDWhlImbRejctnFrqDiagcFltRcvryDly
      AssemblySwConnector_2214: ecu-extract-reference=CalRegn01CmnGroupBDWhlImbRejctnMaxMgnFltRcvryDlyDWhlImbRejctnDWhlImbRejctnMaxMgnFltRcvryDly
      AssemblySwConnector_2215: ecu-extract-reference=CalRegn01CmnGroupBDWhlImbRejctnWhlSpdCorrlnFltRcvryDlyDWhlImbRejctnDWhlImbRejctnWhlSpdCorrlnFltRcvryDly
      AssemblySwConnector_2216: ecu-extract-reference=CalRegn01Inin00GroupBDWhlImbRejctnDcTrendFltRcvryNegStepDWhlImbRejctnDWhlImbRejctnDcTrendFltRcvryNegStep
      AssemblySwConnector_2217: ecu-extract-reference=CalRegn01Inin00GroupBDWhlImbRejctnDcTrendFltRcvryPosStepDWhlImbRejctnDWhlImbRejctnDcTrendFltRcvryPosStep
      AssemblySwConnector_2218: ecu-extract-reference=CalRegn01Inin00GroupBDWhlImbRejctnFrqDiagcFltRcvryNegStepDWhlImbRejctnDWhlImbRejctnFrqDiagcFltRcvryNegStep
      AssemblySwConnector_2219: ecu-extract-reference=CalRegn01Inin00GroupBDWhlImbRejctnFrqDiagcFltRcvryPosStepDWhlImbRejctnDWhlImbRejctnFrqDiagcFltRcvryPosStep
      AssemblySwConnector_2220: ecu-extract-reference=CalRegn01Inin00GroupBDWhlImbRejctnMaxMgnFltNegStepDWhlImbRejctnDWhlImbRejctnMaxMgnFltNegStep
      AssemblySwConnector_2221: ecu-extract-reference=CalRegn01Inin00GroupBDWhlImbRejctnMaxMgnFltPosStepDWhlImbRejctnDWhlImbRejctnMaxMgnFltPosStep
      AssemblySwConnector_2222: ecu-extract-reference=CalRegn01Inin00GroupBDWhlImbRejctnMaxMgnFltRcvryNegStepDWhlImbRejctnDWhlImbRejctnMaxMgnFltRcvryNegStep
      AssemblySwConnector_2223: ecu-extract-reference=CalRegn01Inin00GroupBDWhlImbRejctnMaxMgnFltRcvryPosStepDWhlImbRejctnDWhlImbRejctnMaxMgnFltRcvryPosStep
      AssemblySwConnector_2224: ecu-extract-reference=CalRegn01Inin00GroupBDWhlImbRejctnWhlSpdCorrlnFltRcvryNegStepDWhlImbRejctnDWhlImbRejctnWhlSpdCorrlnFltRcvryNegStep
      AssemblySwConnector_2225: ecu-extract-reference=CalRegn01Inin00GroupBDWhlImbRejctnWhlSpdCorrlnFltRcvryPosStepDWhlImbRejctnDWhlImbRejctnWhlSpdCorrlnFltRcvryPosStep
      AssemblySwConnector_2228: ecu-extract-reference=CalRegn03CmnDWhlImbRejctnCmdMgnLp1FilFrqDWhlImbRejctnDWhlImbRejctnCmdMgnLp1FilFrq
      AssemblySwConnector_2229: ecu-extract-reference=CalRegn03CmnDWhlImbRejctnCmdMgnLp2FilFrqDWhlImbRejctnDWhlImbRejctnCmdMgnLp2FilFrq
      AssemblySwConnector_2230: ecu-extract-reference=CalRegn03CmnDWhlImbRejctnDcTrendLpFilDWhlImbRejctnDWhlImbRejctnDcTrendLpFil
      AssemblySwConnector_2233: ecu-extract-reference=CalRegn03CmnGroupBDWhlImbRejctnAutScaTarDWhlImbRejctnDWhlImbRejctnAutScaTar
      AssemblySwConnector_2235: ecu-extract-reference=CalRegn03CmnGroupBDWhlImbRejctnRampDwnTiDWhlImbRejctnDWhlImbRejctnRampDwnTi
      AssemblySwConnector_2236: ecu-extract-reference=CalRegn03CmnGroupBDWhlImbRejctnScaCnclDWhlImbRejctnDWhlImbRejctnScaCncl
      AssemblySwConnector_2237: ecu-extract-reference=CalRegn03CmnGroupBDWhlImbRejctnUgrPoleMgnDWhlImbRejctnDWhlImbRejctnUgrPoleMgn
      AssemblySwConnector_2238: ecu-extract-reference=CalRegn03Inin00DWhlImbRejctnBlndCmdMgnLp1FilFrqDWhlImbRejctnDWhlImbRejctnBlndCmdMgnLp1FilFrq
      AssemblySwConnector_2239: ecu-extract-reference=CalRegn03Inin00DWhlImbRejctnBlndCmdMgnLp2FilFrqDWhlImbRejctnDWhlImbRejctnBlndCmdMgnLp2FilFrq
      AssemblySwConnector_2241: ecu-extract-reference=CalRegn03Inin00DWhlImbRejctnDistbnMgnLpFilDWhlImbRejctnDWhlImbRejctnDistbnMgnLpFil
      AssemblySwConnector_2247: ecu-extract-reference=CalRegn03Inin00DWhlImbRejctnWhlSpdLpFilDWhlImbRejctnDWhlImbRejctnWhlSpdLpFil
      AssemblySwConnector_2248: ecu-extract-reference=CalRegn03Inin00GroupBDWhlImbRejctnAdpvFacDWhlImbRejctnDWhlImbRejctnAdpvFac
      AssemblySwConnector_2249: ecu-extract-reference=CalRegn03Inin00GroupBDWhlImbRejctnCurrMgnSlewPerLoopDWhlImbRejctnDWhlImbRejctnCurrMgnSlewPerLoop
      AssemblySwConnector_2250: ecu-extract-reference=CalRegn03Inin00GroupBDWhlImbRejctnDcTrendTh2TqDWhlImbRejctnDWhlImbRejctnDcTrendTh2Tq
      AssemblySwConnector_2251: ecu-extract-reference=CalRegn03Inin00GroupBDWhlImbRejctnDcTrendThTqDWhlImbRejctnDWhlImbRejctnDcTrendThTq
      AssemblySwConnector_2252: ecu-extract-reference=CalRegn03Inin00GroupBDWhlImbRejctnDcTrendTi2SecDWhlImbRejctnDWhlImbRejctnDcTrendTi2Sec
      AssemblySwConnector_2253: ecu-extract-reference=CalRegn03Inin00GroupBDWhlImbRejctnDcTrendTiSecDWhlImbRejctnDWhlImbRejctnDcTrendTiSec
      AssemblySwConnector_2257: ecu-extract-reference=CalRegn03Inin00GroupBDWhlImbRejctnMaxMgnDWhlImbRejctnDWhlImbRejctnMaxMgn
      AssemblySwConnector_2260: ecu-extract-reference=CalRegn03Inin00GroupBDWhlImbRejctnMgnEstimnDeltaScaDWhlImbRejctnDWhlImbRejctnMgnEstimnDeltaSca
      AssemblySwConnector_2261: ecu-extract-reference=CalRegn03Inin00GroupBDWhlImbRejctnMgnEstimnDiThdDWhlImbRejctnDWhlImbRejctnMgnEstimnDiThd
      AssemblySwConnector_2262: ecu-extract-reference=CalRegn03Inin00GroupBDWhlImbRejctnMgnEstimnEnaThdDWhlImbRejctnDWhlImbRejctnMgnEstimnEnaThd
      AssemblySwConnector_2263: ecu-extract-reference=CalRegn03Inin00GroupBDWhlImbRejctnMgnEstimnFrqDWhlImbRejctnDWhlImbRejctnMgnEstimnFrq
      AssemblySwConnector_2264: ecu-extract-reference=CalRegn03Inin00GroupBDWhlImbRejctnMgnEstimnFrqDeltaDWhlImbRejctnDWhlImbRejctnMgnEstimnFrqDelta
      AssemblySwConnector_2265: ecu-extract-reference=CalRegn03Inin00GroupBDWhlImbRejctnMgnEstimnLeakDWhlImbRejctnDWhlImbRejctnMgnEstimnLeak
      AssemblySwConnector_2266: ecu-extract-reference=CalRegn03Inin00GroupBDWhlImbRejctnPhaAdjXDWhlImbRejctnDWhlImbRejctnPhaAdjX
      AssemblySwConnector_2267: ecu-extract-reference=CalRegn03Inin00GroupBDWhlImbRejctnPhaAdjYDWhlImbRejctnDWhlImbRejctnPhaAdjY
      AssemblySwConnector_2269: ecu-extract-reference=CalRegn03Inin00GroupBDWhlImbRejctnWhlSpdCorrlnThdDWhlImbRejctnDWhlImbRejctnWhlSpdCorrlnThd
      AssemblySwConnector_2270: ecu-extract-reference=CalRegn03Inin00GroupBDWhlImbRejctnWhlSpdCorrlnTiDWhlImbRejctnDWhlImbRejctnWhlSpdCorrlnTi
      AssemblySwConnector_2272: ecu-extract-reference=CDD_NxtrTiDGetRefTmr100MicroSec32bitDWhlImbRejctnDGetRefTmr100MicroSec32bit
      AssemblySwConnector_2273: ecu-extract-reference=CDD_NxtrTiDGetTiSpan100MicroSec32bitDWhlImbRejctnDGetTiSpan100MicroSec32bit
      AssemblySwConnector_2275: ecu-extract-reference=DiagcMgrProxyAppl10DSetNtcSts10DWhlImbRejctnDSetNtcSts
      AssemblySwConnector_2276: ecu-extract-reference=GmRoadWhlInQlfrDWhlFrqVldDWhlImbRejctnDWhlFrqVld
      AssemblySwConnector_2277: ecu-extract-reference=GmRoadWhlInQlfrDWhlLeFrqDWhlImbRejctnDWhlLeFrq
      AssemblySwConnector_2278: ecu-extract-reference=GmRoadWhlInQlfrDWhlRiFrqDWhlImbRejctnDWhlRiFrq
      AssemblySwConnector_2279: ecu-extract-reference=SwpDHwTqSwpDWhlImbRejctnDHwTq
      AssemblySwConnector_2280: ecu-extract-reference=SysStModDSysStDWhlImbRejctnDSysSt
      AssemblySwConnector_2281: ecu-extract-reference=VehSigCdngDVehSpdDWhlImbRejctnDVehSpd
      AssemblySwConnector_2282: ecu-extract-reference=VehSigCdngDVehSpdVldDWhlImbRejctnDVehSpdVld
      AssemblySwConnector_2283: ecu-extract-reference=WhlImbRejctnDWhlImbRejctnCmdDAssiSumLimDWhlImbRejctnCmd
      AssemblySwConnector_2284: ecu-extract-reference=WhlImbRejctnDWhlImbRejctnAmpDHysCmpDWhlImbRejctnAmp
      AssemblySwConnector_2286: ecu-extract-reference=WhlImbRejctnDWhlImbRejctnAmpDAssiDWhlImbRejctnAmp
      AssemblySwConnector_2287: ecu-extract-reference=WhlImbRejctnDWhlImbRejctnAmpDAssiHiFrqDWhlImbRejctnAmp
      AssemblySwConnector_2288: ecu-extract-reference=WhlImbRejctnDWhlImbRejctnAmpDInertiaCmpVelDWhlImbRejctnAmp
      AssemblySwConnector_2289: ecu-extract-reference=CalRegn01CmnDMotCurrRegVltgLimrMotCurrQaxRefMdfnRplEnaDCDD_MotCurrRegVltgLimrDMotCurrRegVltgLimrMotCurrQaxRefMdfnRplEna
      AssemblySwConnector_2290: ecu-extract-reference=CalRegn01CmnDMotCurrRegVltgLimrMotVltgBrdgFilEnaDCDD_MotCurrRegVltgLimrDMotCurrRegVltgLimrMotVltgBrdgFilEna
      AssemblySwConnector_2291: ecu-extract-reference=CalRegn01CmnDMotCurrRegVltgLimrMotVltgBrdgLpFilFrqDCDD_MotCurrRegVltgLimrDMotCurrRegVltgLimrMotVltgBrdgLpFilFrq
      AssemblySwConnector_2292: ecu-extract-reference=CalRegn01CmnDMotCurrRegVltgLimrMotVltgDaxIntglHiLimDCDD_MotCurrRegVltgLimrDMotCurrRegVltgLimrMotVltgDaxIntglHiLim
      AssemblySwConnector_2293: ecu-extract-reference=CalRegn01CmnDMotCurrRegVltgLimrMotVltgDaxIntglLoLimDCDD_MotCurrRegVltgLimrDMotCurrRegVltgLimrMotVltgDaxIntglLoLim
      AssemblySwConnector_2294: ecu-extract-reference=CalRegn01CmnDMotCurrRegVltgLimrMotVltgQaxFfFilEnaDCDD_MotCurrRegVltgLimrDMotCurrRegVltgLimrMotVltgQaxFfFilEna
      AssemblySwConnector_2295: ecu-extract-reference=CalRegn01CmnDMotCurrRegVltgLimrMotVltgQaxFfLpFilFrqDCDD_MotCurrRegVltgLimrDMotCurrRegVltgLimrMotVltgQaxFfLpFilFrq
      AssemblySwConnector_2296: ecu-extract-reference=CalRegn01CmnDMotCurrRegVltgLimrMotVltgQaxIntglHiLimDCDD_MotCurrRegVltgLimrDMotCurrRegVltgLimrMotVltgQaxIntglHiLim
      AssemblySwConnector_2297: ecu-extract-reference=CalRegn01CmnDMotCurrRegVltgLimrMotVltgQaxIntglLoLimDCDD_MotCurrRegVltgLimrDMotCurrRegVltgLimrMotVltgQaxIntglLoLim
      AssemblySwConnector_2298: ecu-extract-reference=CalRegn01CmnDMotCtrlPrmEstimnMotBackEmfConNomDMotRplCoggCfgDMotCtrlPrmEstimnMotBackEmfConNom
      AssemblySwConnector_2299: ecu-extract-reference=CalRegn01CmnDMotCtrlPrmEstimnMotBackEmfConSatnScaIvtrLoaMtgtnDMotCtrlPrmEstimnDMotCtrlPrmEstimnMotBackEmfConSatnScaIv_566c9b8d
      AssemblySwConnector_2300: ecu-extract-reference=CalRegn01CmnDMotCtrlPrmEstimnMotInduDaxIvtrLoaMtgtnDMotCtrlPrmEstimnDMotCtrlPrmEstimnMotInduDaxIvtrLoaMtgtn
      AssemblySwConnector_2301: ecu-extract-reference=CalRegn01CmnDMotCtrlPrmEstimnMotInduQaxIvtrLoaMtgtnDMotCtrlPrmEstimnDMotCtrlPrmEstimnMotInduQaxIvtrLoaMtgtn
      AssemblySwConnector_2302: ecu-extract-reference=LoaMgrDIvtrLoaMtgtnEnaDMotCtrlPrmEstimnDIvtrLoaMtgtnEna
      AssemblySwConnector_049: ecu-extract-reference=CDD_GmT1xxMcuCfgDMotCurrAdcVlyAAdcFaildDCDD_MotCtrlMgrDMotCurrAdcVlyAAdcFaild
      AssemblySwConnector_050: ecu-extract-reference=CDD_GmT1xxMcuCfgDMotCurrAdcVlyBAdcFaildDCDD_MotCtrlMgrDMotCurrAdcVlyBAdcFaild
      AssemblySwConnector_057: ecu-extract-reference=CDD_GmT1xxMcuCfgDMotCurrAdcVlyCAdcFaildDCDD_MotCtrlMgrDMotCurrAdcVlyCAdcFaild
      AssemblySwConnector_058: ecu-extract-reference=CDD_GmT1xxMcuCfgDMotCurrAdcVlyDAdcFaildDCDD_MotCtrlMgrDMotCurrAdcVlyDAdcFaild
      AssemblySwConnector_059: ecu-extract-reference=CDD_GmT1xxMcuCfgDMotCurrAdcVlyEAdcFaildDCDD_MotCtrlMgrDMotCurrAdcVlyEAdcFaild
      AssemblySwConnector_060: ecu-extract-reference=CDD_GmT1xxMcuCfgDMotCurrAdcVlyFAdcFaildDCDD_MotCtrlMgrDMotCurrAdcVlyFAdcFaild
      AssemblySwConnector_787: ecu-extract-reference=GmOvrlStMgrDHwOscnEnaDGmTqArbnDHwOscnEna
      AssemblySwConnector_789: ecu-extract-reference=IoHwAbDGetGpioMcuEnaDGmVehPwrModDGetGpioMcuEna
      AssemblySwConnector_791: ecu-extract-reference=HwAgVehCentrTrimDHwAgVehTrimOffsDSnsrOffsCorrnDHwAg
      AssemblySwConnector_793: ecu-extract-reference=HwAgVehCentrTrimDHwAgVehTrimOffsDSnsrOffsLrngDHwAg
      AssemblySwConnector_1939: ecu-extract-reference=DiagcMgrDSysStFltOutpReqDiDStOutpCtrlDSysStFltOutpReqDi
      AssemblySwConnector_099: ecu-extract-reference=CDD_GmT1xxMcuCfgDBattVltgAdcFaildDBattVltgCorrlnDBattVltgAdcFaild
      ComponentPrototype_179: upstream-reference=ECU_Composition.SysFricLrng, ecu-extract-reference=COMPOSITIONTYPE.SysFricLrng
      AssemblySwConnector_1071: ecu-extract-reference=CalRegn01Inin00DSysFricLrngAvrgFricFrqDSysFricLrngDSysFricLrngAvrgFricFrq
      AssemblySwConnector_1940: ecu-extract-reference=CalRegn01Inin00DSysFricLrngBasLineEolFricDSysFricLrngDSysFricLrngBasLineEolFric
      AssemblySwConnector_2141: ecu-extract-reference=CalRegn01Inin00DSysFricLrngBasLineFricDSysFricLrngDSysFricLrngBasLineFric
      AssemblySwConnector_2142: ecu-extract-reference=CalRegn01Inin00DSysFricLrngBasLineHysDSysFricLrngDSysFricLrngBasLineHys
      AssemblySwConnector_2146: ecu-extract-reference=CalRegn01Inin00DSysFricLrngBasLineRngCntrDSysFricLrngDSysFricLrngBasLineRngCntr
      AssemblySwConnector_2153: ecu-extract-reference=CalRegn01Inin00DSysFricLrngDataPrepLpFilFrqDSysFricLrngDSysFricLrngDataPrepLpFilFrq
      AssemblySwConnector_2303: ecu-extract-reference=CalRegn01Inin00DSysFricLrngEolFricDifHiLimDSysFricLrngDSysFricLrngEolFricDifHiLim
      AssemblySwConnector_2304: ecu-extract-reference=CalRegn01Inin00DSysFricLrngEolFricDifLoLimDSysFricLrngDSysFricLrngEolFricDifLoLim
      AssemblySwConnector_2305: ecu-extract-reference=CalRegn01Inin00DSysFricLrngEolFricDifScagFacDSysFricLrngDSysFricLrngEolFricDifScagFac
      AssemblySwConnector_2306: ecu-extract-reference=CalRegn01Inin00DSysFricLrngFricChgWghtDSysFricLrngDSysFricLrngFricChgWght
      AssemblySwConnector_2307: ecu-extract-reference=CalRegn01Inin00DSysFricLrngFricDiagcThdDSysFricLrngDSysFricLrngFricDiagcThd
      AssemblySwConnector_2308: ecu-extract-reference=CalRegn01Inin00DSysFricLrngFricDiagcTiThdDSysFricLrngDSysFricLrngFricDiagcTiThd
      AssemblySwConnector_2309: ecu-extract-reference=CalRegn01Inin00DSysFricLrngFricHysHwAgPtDSysFricLrngDSysFricLrngFricHysHwAgPt
      AssemblySwConnector_2311: ecu-extract-reference=CalRegn01Inin00DSysFricLrngFricOffsHiLimDSysFricLrngDSysFricLrngFricOffsHiLim
      AssemblySwConnector_2312: ecu-extract-reference=CalRegn01Inin00DSysFricLrngFricOffsLoLimDSysFricLrngDSysFricLrngFricOffsLoLim
      AssemblySwConnector_2313: ecu-extract-reference=CalRegn01Inin00DSysFricLrngFricOffsLpFilFrqDSysFricLrngDSysFricLrngFricOffsLpFilFrq
      AssemblySwConnector_2314: ecu-extract-reference=CalRegn01Inin00DSysFricLrngGainDSysFricLrngDSysFricLrngGain
      AssemblySwConnector_2315: ecu-extract-reference=CalRegn01Inin00DSysFricLrngHwPosnAuthyThdDSysFricLrngDSysFricLrngHwPosnAuthyThd
      AssemblySwConnector_2316: ecu-extract-reference=CalRegn01Inin00DSysFricLrngHwVelConstrLimDSysFricLrngDSysFricLrngHwVelConstrLim
      AssemblySwConnector_2317: ecu-extract-reference=CalRegn01Inin00DSysFricLrngHwVelHiLimDSysFricLrngDSysFricLrngHwVelHiLim
      AssemblySwConnector_2318: ecu-extract-reference=CalRegn01Inin00DSysFricLrngHwVelLoLimDSysFricLrngDSysFricLrngHwVelLoLim
      AssemblySwConnector_2319: ecu-extract-reference=CalRegn01Inin00DSysFricLrngIgnCycFricChgLimDSysFricLrngDSysFricLrngIgnCycFricChgLim
      AssemblySwConnector_2320: ecu-extract-reference=CalRegn01Inin00DSysFricLrngIvsTrsmRatXDSysFricLrngDSysFricLrngIvsTrsmRatX
      AssemblySwConnector_2321: ecu-extract-reference=CalRegn01Inin00DSysFricLrngIvsTrsmRatYDSysFricLrngDSysFricLrngIvsTrsmRatY
      AssemblySwConnector_2322: ecu-extract-reference=CalRegn01Inin00DSysFricLrngLatAHiLimDSysFricLrngDSysFricLrngLatAHiLim
      AssemblySwConnector_2323: ecu-extract-reference=CalRegn01Inin00DSysFricLrngLatALoLimDSysFricLrngDSysFricLrngLatALoLim
      AssemblySwConnector_2324: ecu-extract-reference=CalRegn01Inin00DSysFricLrngMaskVehSpdDSysFricLrngDSysFricLrngMaskVehSpd
      AssemblySwConnector_2325: ecu-extract-reference=CalRegn01Inin00DSysFricLrngRngCntrThdDSysFricLrngDSysFricLrngRngCntrThd
      AssemblySwConnector_2326: ecu-extract-reference=CalRegn01Inin00DSysFricLrngThdDSysFricLrngDSysFricLrngThd
      AssemblySwConnector_2327: ecu-extract-reference=CalRegn01Inin00DSysFricLrngTHiLimDSysFricLrngDSysFricLrngTHiLim
      AssemblySwConnector_2328: ecu-extract-reference=CalRegn01Inin00DSysFricLrngTLoLimDSysFricLrngDSysFricLrngTLoLim
      AssemblySwConnector_2329: ecu-extract-reference=CalRegn01Inin00DSysFricLrngVehSpdDSysFricLrngDSysFricLrngVehSpd
      AssemblySwConnector_2331: ecu-extract-reference=CDD_NxtrTiDGetRefTmr100MicroSec32bitDSysFricLrngDGetRefTmr100MicroSec32bit
      AssemblySwConnector_2332: ecu-extract-reference=CDD_NxtrTiDGetTiSpan100MicroSec32bitDSysFricLrngDGetTiSpan100MicroSec32bit
      AssemblySwConnector_2333: ecu-extract-reference=DiagcMgrProxyAppl10DSetNtcSts10DSysFricLrngDSetNtcSts
      AssemblySwConnector_2334: ecu-extract-reference=FltInjDFltInj_f32DSysFricLrngDFltInj_f32
      AssemblySwConnector_2335: ecu-extract-reference=HwAgSysArbnDPinionAgDSysFricLrngDHwAg
      AssemblySwConnector_2336: ecu-extract-reference=HwAgSysArbnDPinionAgConfDSysFricLrngDHwAgAuthy
      AssemblySwConnector_2337: ecu-extract-reference=MotTqTranlDampgDMotTqCmdCrfDampdDSysFricLrngDMotTqCmdCrf
      AssemblySwConnector_2338: ecu-extract-reference=SwpDHwTqSwpDSysFricLrngDHwTq
      AssemblySwConnector_2339: ecu-extract-reference=SysFricLrngDSysFricOffsDHysCmpDSysFricOffs
      AssemblySwConnector_2340: ecu-extract-reference=TEstimnDAssiMechTDSysFricLrngDAssiMechT
      AssemblySwConnector_2342: ecu-extract-reference=VehSigCdngDVehSpdDSysFricLrngDVehSpd
      AssemblySwConnector_2343: ecu-extract-reference=VehSigCdngDVehSpdVldDSysFricLrngDVehSpdVld
      AssemblySwConnector_2310: ecu-extract-reference=CalRegn01Inin00DSysFricLrngFricOffsDSysFricLrngDSysFricLrngFricOffs
      AssemblySwConnector_2344: ecu-extract-reference=GmMsg1E9BusHiSpdDVehLatAVldSerlComDVehSigCdngDVehLatAVldSerlCom
      AssemblySwConnector_2345: ecu-extract-reference=HwAgVehCentrTrimDHwAgTrimPrfmdDGmMsg1E5BusChassisExpDHwAgTrimPrfmd
      AssemblySwConnector_2346: ecu-extract-reference=HwAgVehCentrTrimDHwAgTrimPrfmdDGmMsg1E5BusHiSpdDHwAgTrimPrfmd
      ComponentPrototype_180: upstream-reference=ECU_Composition.CalRegn03Rt04GroupB, ecu-extract-reference=COMPOSITIONTYPE.CalRegn03Rt04GroupB
      ComponentPrototype_181: upstream-reference=ECU_Composition.CalRegn03Rt04GroupA, ecu-extract-reference=COMPOSITIONTYPE.CalRegn03Rt04GroupA
      ComponentPrototype_183: upstream-reference=ECU_Composition.CalRegn03Rt03GroupB, ecu-extract-reference=COMPOSITIONTYPE.CalRegn03Rt03GroupB
      ComponentPrototype_184: upstream-reference=ECU_Composition.CalRegn03Rt03GroupA, ecu-extract-reference=COMPOSITIONTYPE.CalRegn03Rt03GroupA
      ComponentPrototype_186: upstream-reference=ECU_Composition.CalRegn03Rt02GroupB, ecu-extract-reference=COMPOSITIONTYPE.CalRegn03Rt02GroupB
      ComponentPrototype_187: upstream-reference=ECU_Composition.CalRegn03Rt02GroupA, ecu-extract-reference=COMPOSITIONTYPE.CalRegn03Rt02GroupA
      ComponentPrototype_193: upstream-reference=ECU_Composition.CalRegn03Rt01GroupB, ecu-extract-reference=COMPOSITIONTYPE.CalRegn03Rt01GroupB
      ComponentPrototype_198: upstream-reference=ECU_Composition.CalRegn03Rt01GroupA, ecu-extract-reference=COMPOSITIONTYPE.CalRegn03Rt01GroupA
      ComponentPrototype_214: upstream-reference=ECU_Composition.CalRegn01Rt04, ecu-extract-reference=COMPOSITIONTYPE.CalRegn01Rt04
      ComponentPrototype_217: upstream-reference=ECU_Composition.CalRegn01Rt03, ecu-extract-reference=COMPOSITIONTYPE.CalRegn01Rt03
      ComponentPrototype_220: upstream-reference=ECU_Composition.CalRegn01Rt02, ecu-extract-reference=COMPOSITIONTYPE.CalRegn01Rt02
      ComponentPrototype_235: upstream-reference=ECU_Composition.CalRegn01Rt01, ecu-extract-reference=COMPOSITIONTYPE.CalRegn01Rt01
      AssemblySwConnector_1664: ecu-extract-reference=CmnMfgSrvDMfgEnaStDCDD_XcpIfDMfgEnaSt
      AssemblySwConnector_1660: ecu-extract-reference=TunSelnMngtDCalCopyStsDCDD_XcpIfDCalCopySts
      AssemblySwConnector_1667: ecu-extract-reference=TunSelnMngtDGetSegInfoReqDCDD_XcpIfDGetSegInfoReq
      AssemblySwConnector_2517: ecu-extract-reference=TunSelnMngtDOnlineTunRamAdrMpgDCDD_XcpIfDOnlineTunRamAdrMpg
      AssemblySwConnector_1042: ecu-extract-reference=DiagcMgrDClrDiagcFlgProxyDDiagcMgrProxyAppl10DClrDiagcFlgProxy
      AssemblySwConnector_1046: ecu-extract-reference=DiagcMgrDClrDiagcFlgProxyDDiagcMgrProxyAppl6DClrDiagcFlgProxy
      AssemblySwConnector_1052: ecu-extract-reference=CDD_MotVelDMotVelCrfDMotVelCtrlDMotVelCrf
      ComponentPrototype_236: upstream-reference=ECU_Composition.PwrpkCmpbltyChk, ecu-extract-reference=COMPOSITIONTYPE.PwrpkCmpbltyChk
      AssemblySwConnector_2518: ecu-extract-reference=CDD_HwTq2MeasDGearIdn1DPwrpkCmpbltyChkDGearIdn1
      AssemblySwConnector_2519: ecu-extract-reference=CDD_HwTq2MeasDGearIdn1VldDPwrpkCmpbltyChkDGearIdn1Vld
      AssemblySwConnector_2520: ecu-extract-reference=CDD_HwTq3MeasDGearIdn2DPwrpkCmpbltyChkDGearIdn2
      AssemblySwConnector_2521: ecu-extract-reference=CDD_HwTq3MeasDGearIdn2VldDPwrpkCmpbltyChkDGearIdn2Vld
      AssemblySwConnector_2522: ecu-extract-reference=CDD_NxtrTiDGetRefTmr100MicroSec32bitDPwrpkCmpbltyChkDGetRefTmr100MicroSec32bit
      AssemblySwConnector_2523: ecu-extract-reference=CDD_NxtrTiDGetTiSpan100MicroSec32bitDPwrpkCmpbltyChkDGetTiSpan100MicroSec32bit
      AssemblySwConnector_2524: ecu-extract-reference=DiagcMgrProxyAppl10DGetNtcQlfrSts10DPwrpkCmpbltyChkDGetNtcQlfrSts
      AssemblySwConnector_2525: ecu-extract-reference=DiagcMgrProxyAppl10DSetNtcSts10DPwrpkCmpbltyChkDSetNtcSts
      ComponentPrototype_237: upstream-reference=ECU_Composition.CDD_McuDiagc, ecu-extract-reference=COMPOSITIONTYPE.CDD_McuDiagc
      AssemblySwConnector_2526: ecu-extract-reference=CDD_MotCtrlMgrDFastLoopCntrDCDD_McuDiagcDFastLoopCntr
      AssemblySwConnector_2527: ecu-extract-reference=DiagcMgrProxyAppl10DSetNtcSts10DCDD_McuDiagcDSetNtcSts
      AssemblySwConnector_2528: ecu-extract-reference=CalRegn01CmnDCurrMeasCorrlnMaxErrCurrDStHlthSigNormnDCurrMeasCorrlnMaxErrCurr
      AssemblySwConnector_2529: ecu-extract-reference=CalRegn01CmnDDutyCycThermProtnDutyCycFildThdDStHlthSigNormnDDutyCycThermProtnDutyCycFildThd
      AssemblySwConnector_2530: ecu-extract-reference=CalRegn01CmnDHwTqCorrlnChATraSumSetFltThdDStHlthSigNormnDHwTqCorrlnChATraSumSetFltThd
      AssemblySwConnector_2531: ecu-extract-reference=CalRegn01CmnDHwTqCorrlnChBTraSumSetFltThdDStHlthSigNormnDHwTqCorrlnChBTraSumSetFltThd
      AssemblySwConnector_2532: ecu-extract-reference=CalRegn01CmnDMotDrvDiagcErrThdDStHlthSigNormnDMotDrvDiagcErrThd
      AssemblySwConnector_2533: ecu-extract-reference=CalRegn01CmnDStHlthSigNormnAbsltMotPosDifStHlthDiagThdDStHlthSigNormnDStHlthSigNormnAbsltMotPosDifStHlthDiagThd
      AssemblySwConnector_2534: ecu-extract-reference=CalRegn01CmnDStHlthSigNormnCurrMotSumStHlthDiagThdDStHlthSigNormnDStHlthSigNormnCurrMotSumStHlthDiagThd
      AssemblySwConnector_2535: ecu-extract-reference=CalRegn01CmnDStHlthSigNormnDigTqStHlthDiagThdDStHlthSigNormnDStHlthSigNormnDigTqStHlthDiagThd
      AssemblySwConnector_2536: ecu-extract-reference=CalRegn01CmnDStHlthSigNormnDutyCycFltLimThdDStHlthSigNormnDStHlthSigNormnDutyCycFltLimThd
      AssemblySwConnector_2537: ecu-extract-reference=CalRegn01CmnDStHlthSigNormnIdptSigStHlthScaDStHlthSigNormnDStHlthSigNormnIdptSigStHlthSca
      AssemblySwConnector_2538: ecu-extract-reference=CalRegn01CmnDStHlthSigNormnMinRackTrvlLimDStHlthSigNormnDStHlthSigNormnMinRackTrvlLim
      AssemblySwConnector_2539: ecu-extract-reference=CalRegn01CmnDStHlthSigNormnMotPosStHlthDiagThdDStHlthSigNormnDStHlthSigNormnMotPosStHlthDiagThd
      AssemblySwConnector_2540: ecu-extract-reference=CalRegn01CmnDStHlthSigNormnMotVelCalDStHlthSigNormnDStHlthSigNormnMotVelCal
      AssemblySwConnector_2541: ecu-extract-reference=CalRegn01CmnDStHlthSigNormnPhaInfoStHlthDiagThdDStHlthSigNormnDStHlthSigNormnPhaInfoStHlthDiagThd
      AssemblySwConnector_2542: ecu-extract-reference=CalRegn01CmnDStHlthSigNormnStHlthCorrlnErrDStHlthSigNormnDStHlthSigNormnStHlthCorrlnErr
      AssemblySwConnector_2543: ecu-extract-reference=CalRegn01CmnDStHlthSigNormnStHlthCurrMotSumDStHlthSigNormnDStHlthSigNormnStHlthCurrMotSum
      AssemblySwConnector_2544: ecu-extract-reference=CalRegn01CmnDStHlthSigNormnStHlthPhaInfoDStHlthSigNormnDStHlthSigNormnStHlthPhaInfo
      AssemblySwConnector_2545: ecu-extract-reference=CalRegn01CmnDStHlthSigNormnValMaxStHlthErrDStHlthSigNormnDStHlthSigNormnValMaxStHlthErr
      AssemblySwConnector_2546: ecu-extract-reference=CalRegn01CmnDStHlthSigNormnValMinStHlthErrDStHlthSigNormnDStHlthSigNormnValMinStHlthErr
      AssemblySwConnector_2548: ecu-extract-reference=CalRegn01Inin00DSysGlbPrmMotPoleCntDStHlthSigNormnDSysGlbPrmMotPoleCnt
      AssemblySwConnector_2549: ecu-extract-reference=CDD_HwTq0MeasDRackLimrEotSig0AvlDStHlthSigNormnDRackLimrEotSig0Avl
      AssemblySwConnector_2550: ecu-extract-reference=CDD_HwTq1MeasDRackLimrEotSig1AvlDStHlthSigNormnDRackLimrEotSig1Avl
      AssemblySwConnector_2551: ecu-extract-reference=CDD_MotVelDMotVelCrfDStHlthSigNormnDMotVelCrf
      AssemblySwConnector_2552: ecu-extract-reference=CDD_RamMemDLclRamEccSngBitCntrOutpDStHlthSigNormnDLclRamEccSngBitCntrOutp
      AssemblySwConnector_2553: ecu-extract-reference=CurrMeasCorrlnDCurrMotSumABCDStHlthSigNormnDCurrMotSumABC
      AssemblySwConnector_2554: ecu-extract-reference=CurrMeasCorrlnDCurrMotSumDEFDStHlthSigNormnDCurrMotSumDEF
      AssemblySwConnector_2555: ecu-extract-reference=DiagcMgrProxyAppl10DSetNtcSts10DStHlthSigNormnDSetNtcSts
      AssemblySwConnector_2556: ecu-extract-reference=DutyCycThermProtnDDutyCycThermProtnMaxOutpDStHlthSigNormnDDutyCycThermProtnMaxOutp
      AssemblySwConnector_2557: ecu-extract-reference=EotLrngDHwAgEotCcwDStHlthSigNormnDHwAgEotCcw
      AssemblySwConnector_2558: ecu-extract-reference=EotLrngDHwAgEotCwDStHlthSigNormnDHwAgEotCw
      AssemblySwConnector_2559: ecu-extract-reference=HwAgSysArbnDPinionAgDStHlthSigNormnDHwAg
      AssemblySwConnector_2560: ecu-extract-reference=HwAgSysArbnDPinionAgConfDStHlthSigNormnDHwAuthy
      AssemblySwConnector_2561: ecu-extract-reference=HwTqCorrlnDHwTqChACorrlnTraErrDStHlthSigNormnDHwTqChACorrlnTraErr
      AssemblySwConnector_2562: ecu-extract-reference=HwTqCorrlnDHwTqChBCorrlnTraErrDStHlthSigNormnDHwTqChBCorrlnTraErr
      AssemblySwConnector_2563: ecu-extract-reference=HwTqCorrlnDHwTqIdptSigDStHlthSigNormnDHwTqIdptSig
      AssemblySwConnector_2564: ecu-extract-reference=MotAg2MeasDMotAg2VltgSqdDStHlthSigNormnDMotAg2VltgSqd
      AssemblySwConnector_2565: ecu-extract-reference=MotAgCorrlnDMotAgABErrTermDStHlthSigNormnDMotAgABErrTerm
      AssemblySwConnector_2566: ecu-extract-reference=MotAgCorrlnDMotAgACErrTermDStHlthSigNormnDMotAgACErrTerm
      AssemblySwConnector_2567: ecu-extract-reference=MotAgCorrlnDMotAgBCErrTermDStHlthSigNormnDMotAgBCErrTerm
      AssemblySwConnector_2568: ecu-extract-reference=MotDrvDiagcDMotDrvErrADStHlthSigNormnDMotDrvErrA
      AssemblySwConnector_2569: ecu-extract-reference=MotDrvDiagcDMotDrvErrBDStHlthSigNormnDMotDrvErrB
      AssemblySwConnector_2570: ecu-extract-reference=MotDrvDiagcDMotDrvErrCDStHlthSigNormnDMotDrvErrC
      AssemblySwConnector_2571: ecu-extract-reference=MotDrvDiagcDMotDrvErrDDStHlthSigNormnDMotDrvErrD
      AssemblySwConnector_2572: ecu-extract-reference=MotDrvDiagcDMotDrvErrEDStHlthSigNormnDMotDrvErrE
      AssemblySwConnector_2573: ecu-extract-reference=MotDrvDiagcDMotDrvErrFDStHlthSigNormnDMotDrvErrF
      AssemblySwConnector_2574: ecu-extract-reference=StHlthSigNormnDAbsltMotPosABDifStHlthDStHlthSigStcDAbsltMotPosABDifStHlth
      AssemblySwConnector_2575: ecu-extract-reference=StHlthSigNormnDAbsltMotPosACDifStHlthDStHlthSigStcDAbsltMotPosACDifStHlth
      AssemblySwConnector_2576: ecu-extract-reference=StHlthSigNormnDAbsltMotPosBCDifStHlthDStHlthSigStcDAbsltMotPosBCDifStHlth
      AssemblySwConnector_2577: ecu-extract-reference=StHlthSigNormnDCurrMotSumABCStHlthDStHlthSigStcDCurrMotSumABCStHlth
      AssemblySwConnector_2578: ecu-extract-reference=StHlthSigNormnDCurrMotSumDEFStHlthDStHlthSigStcDCurrMotSumDEFStHlth
      AssemblySwConnector_2579: ecu-extract-reference=StHlthSigNormnDDigTqIdptSigStHlthDStHlthSigStcDDigTqIdptSigStHlth
      AssemblySwConnector_2580: ecu-extract-reference=StHlthSigNormnDDigTqSnsrAStHlthDStHlthSigStcDDigTqSnsrAStHlth
      AssemblySwConnector_2581: ecu-extract-reference=StHlthSigNormnDDigTqSnsrBStHlthDStHlthSigStcDDigTqSnsrBStHlth
      AssemblySwConnector_2582: ecu-extract-reference=StHlthSigNormnDDutyCycStHlthDStHlthSigStcDDutyCycStHlth
      AssemblySwConnector_2583: ecu-extract-reference=StHlthSigNormnDEotImpctStHlthDStHlthSigStcDEotImpctStHlth
      AssemblySwConnector_2584: ecu-extract-reference=StHlthSigNormnDMotPosStHlthDStHlthSigStcDMotPosStHlth
      AssemblySwConnector_2585: ecu-extract-reference=StHlthSigNormnDPhaAStHlthDStHlthSigStcDPhaAStHlth
      AssemblySwConnector_2586: ecu-extract-reference=StHlthSigNormnDPhaBStHlthDStHlthSigStcDPhaBStHlth
      AssemblySwConnector_2587: ecu-extract-reference=StHlthSigNormnDPhaCStHlthDStHlthSigStcDPhaCStHlth
      AssemblySwConnector_2588: ecu-extract-reference=StHlthSigNormnDPhaDStHlthDStHlthSigStcDPhaDStHlth
      AssemblySwConnector_2589: ecu-extract-reference=StHlthSigNormnDPhaEStHlthDStHlthSigStcDPhaEStHlth
      AssemblySwConnector_2590: ecu-extract-reference=StHlthSigNormnDPhaFStHlthDStHlthSigStcDPhaFStHlth
      AssemblySwConnector_2591: ecu-extract-reference=StHlthSigNormnDRamEccSngBitCorrnStHlthDStHlthSigStcDRamEccSngBitCorrnStHlth
      AssemblySwConnector_2592: ecu-extract-reference=CDD_CurrMeasDCurrMeasEolGainStsReqDCmnMfgSrvDCurrMeasEolGainStReq
      AssemblySwConnector_2593: ecu-extract-reference=CDD_CurrMeasDCurrMeasEolOffsStsReqDCmnMfgSrvDCurrMeasEolOffsStReq
      AssemblySwConnector_2594: ecu-extract-reference=CDD_CurrMeasDCurrMeasGainWrReqDCmnMfgSrvDCurrMeasGainWrReq
      AssemblySwConnector_2595: ecu-extract-reference=CDD_CurrMeasDCurrMeasOffsWrReqDCmnMfgSrvDCurrMeasOffsWrReq
      AssemblySwConnector_2596: ecu-extract-reference=DiagcMgrDClrAllDiagcDCmnMfgSrvDClrAllDiagc
      AssemblySwConnector_2597: ecu-extract-reference=HwAgVehCentrTrimDGetHwAgTrimValDCmnMfgSrvDGetHwAgTrimVal
      AssemblySwConnector_2598: ecu-extract-reference=HwAgVehCentrTrimDSetHwAgTrimValDCmnMfgSrvDSetHwAgTrimVal
      AssemblySwConnector_2599: ecu-extract-reference=SysFricLrngDClrFricLrngOperModDCmnMfgSrvDClrFricLrngOperMod
      AssemblySwConnector_2600: ecu-extract-reference=SysFricLrngDGetFricLrngDataDCmnMfgSrvDGetFricLrngData
      AssemblySwConnector_2601: ecu-extract-reference=SysFricLrngDGetFricOffsOutpDiDCmnMfgSrvDGetFricOffsOutpDi
      AssemblySwConnector_2602: ecu-extract-reference=SysFricLrngDInitFricLrngTblDCmnMfgSrvDInitFricLrngTbl
      AssemblySwConnector_2603: ecu-extract-reference=SysFricLrngDSetFricLrngDataDCmnMfgSrvDSetFricLrngData
      AssemblySwConnector_2604: ecu-extract-reference=SysFricLrngDSetFricOffsOutpDiDCmnMfgSrvDSetFricOffsOutpDi
      AssemblySwConnector_2605: ecu-extract-reference=GmMsg1F1BusHiSpdDSysPwrModDCustDiagcDSysPwrMod
      AssemblySwConnector_2606: ecu-extract-reference=PartNrDPartNrEcuIdRdDCustDiagcDPartNrEcuIdRd
      AssemblySwConnector_2607: ecu-extract-reference=PartNrDPartNrSecuBypAuthnRdDCustDiagcDPartNrSecuBypAuthnRd
      AssemblySwConnector_2608: ecu-extract-reference=PartNrDPartNrSecuBypAuthnWrDCustDiagcDPartNrSecuBypAuthnWr
      AssemblySwConnector_2609: ecu-extract-reference=PartNrDPartNrEcuIdRdDProgMfgSrvDPartNrEcuIdRd
      AssemblySwConnector_2610: ecu-extract-reference=PartNrDPartNrEcuIdWrDProgMfgSrvDPartNrEcuIdWr
      AssemblySwConnector_2611: ecu-extract-reference=PartNrDPartNrSecuBypAuthnRdDProgMfgSrvDPartNrSecuBypAuthnRd
      AssemblySwConnector_2612: ecu-extract-reference=PartNrDPartNrSecuBypAuthnWrDProgMfgSrvDPartNrSecuBypAuthnWr
      AssemblySwConnector_2613: ecu-extract-reference=CalRegn02CmnDDiagcMgrFltRespDCustDiagcDDiagcMgrFltResp
      AssemblySwConnector_2614: ecu-extract-reference=GmMsg1F1BusHiSpdDSysPwrModDCustDiagcDGmSysPwrMod
      AssemblySwConnector_2615: ecu-extract-reference=GmMsg1F1BusHiSpdDSysPwrModDPartNrDGmSysPwrMod
      AssemblySwConnector_2616: ecu-extract-reference=DiagcMgrProxyAppl6DGetNtcActv6DCustDiagcDGetNtcActv
      AssemblySwConnector_2617: ecu-extract-reference=DiagcMgrProxyAppl6DGetNtcSts6DCustDiagcDGetNtcSts
      AssemblySwConnector_1149: ecu-extract-reference=CalRegn02Inin00DGmStrtStopEnaDCustDiagcDGmStrtStopEna
      AssemblySwConnector_2623: ecu-extract-reference=DiagcMgrProxyAppl6DSetNtcSts6DSerlComOutpProxyDSetNtcSts
      AssemblySwConnector_2626: ecu-extract-reference=SerlComOutpProxyDBusOffHiSpdDGmVehPwrModDBusOffHiSpd
      AssemblySwConnector_2627: ecu-extract-reference=HwAgVehCentrTrimDHwAgTrimPrfmdDCustDiagcDHwAgTrimPrfmd
      AssemblySwConnector_2628: ecu-extract-reference=DiagcMgrDClrAllDiagcDCustDiagcDClrAllDiagc
      AssemblySwConnector_1023: ecu-extract-reference=CmnMfgSrvDSysStReqEnaOvrdDCustDiagcDSysStReqEnaOvrdNxtr
      AssemblySwConnector_2629: ecu-extract-reference=CustDiagcDSysStReqEnaOvrdCombdDGmVehPwrModDSysStEnaReqOvrd
      ComponentPrototype_070: upstream-reference=ECU_Composition.GmMsg778BusHiSpd, ecu-extract-reference=COMPOSITIONTYPE.GmMsg778BusHiSpd
      ComponentPrototype_238: upstream-reference=ECU_Composition.GmMsg148BusHiSpd, ecu-extract-reference=COMPOSITIONTYPE.GmMsg148BusHiSpd
      AssemblySwConnector_1062: ecu-extract-reference=CDD_NxtrTiDGetRefTmr100MicroSec32bitDGmMsg778BusHiSpdDGetRefTmr100MicroSec32bit
      AssemblySwConnector_2624: ecu-extract-reference=CDD_NxtrTiDGetTiSpan100MicroSec32bitDGmMsg778BusHiSpdDGetTiSpan100MicroSec32bit
      AssemblySwConnector_2625: ecu-extract-reference=GmMsg148BusHiSpdDPwrSteerIndcrDSerlComOutpProxyDPwrSteerIndcr
      AssemblySwConnector_2630: ecu-extract-reference=GmMsg148BusHiSpdDSteerAssiLimdDSerlComOutpProxyDSteerAssiLimd
      AssemblySwConnector_2631: ecu-extract-reference=GmMsg148BusHiSpdDSteerAssiLimdLvl2DSerlComOutpProxyDSteerAssiLimdLvl2
      AssemblySwConnector_2632: ecu-extract-reference=GmMsg148BusHiSpdDSteerAssiLimdLvl3DSerlComOutpProxyDSteerAssiLimdLvl3
      AssemblySwConnector_2633: ecu-extract-reference=GmMsg778BusHiSpdDCodSupportedDSerlComOutpProxyDCodSupported
      AssemblySwConnector_2634: ecu-extract-reference=GmMsg778BusHiSpdDCurrStsDSerlComOutpProxyDCurrSts
      AssemblySwConnector_2635: ecu-extract-reference=GmMsg778BusHiSpdDDtcFailrTypDSerlComOutpProxyDDtcFailrTyp
      AssemblySwConnector_2636: ecu-extract-reference=GmMsg778BusHiSpdDDtcFltTypDSerlComOutpProxyDDtcFltTyp
      AssemblySwConnector_2637: ecu-extract-reference=GmMsg778BusHiSpdDDtcNrDSerlComOutpProxyDDtcNr
      AssemblySwConnector_2638: ecu-extract-reference=GmMsg778BusHiSpdDDtcSrcDSerlComOutpProxyDDtcSrc
      AssemblySwConnector_2639: ecu-extract-reference=GmMsg778BusHiSpdDDtcTrigDSerlComOutpProxyDDtcTrig
      AssemblySwConnector_2640: ecu-extract-reference=GmMsg778BusHiSpdDHistStsDSerlComOutpProxyDHistSts
      AssemblySwConnector_2641: ecu-extract-reference=GmMsg778BusHiSpdDTstFaildCodClrdStsDSerlComOutpProxyDTstFaildCodClrdSts
      AssemblySwConnector_2642: ecu-extract-reference=GmMsg778BusHiSpdDTstFaildPwrUpStsDSerlComOutpProxyDTstFaildPwrUpSts
      AssemblySwConnector_2643: ecu-extract-reference=GmMsg778BusHiSpdDTstNotPassdCodClrdStsDSerlComOutpProxyDTstNotPassdCodClrdSts
      AssemblySwConnector_2644: ecu-extract-reference=GmMsg778BusHiSpdDTstNotPassdPwrUpStsDSerlComOutpProxyDTstNotPassdPwrUpSts
      AssemblySwConnector_2645: ecu-extract-reference=GmMsg778BusHiSpdDWarnIndcrReqdStsDSerlComOutpProxyDWarnIndcrReqdSts
      AssemblySwConnector_2646: ecu-extract-reference=SysStModDSysStDGmMsg148BusHiSpdDSysSt
      AssemblySwConnector_2647: ecu-extract-reference=SysStModDSysStDGmMsg778BusHiSpdDSysSt
      AssemblySwConnector_2648: ecu-extract-reference=DiagcMgrProxyAppl10DGetNtcDebCntrAppl10DDiagcMgrDGetNtcDebCntrAppl10
      AssemblySwConnector_2649: ecu-extract-reference=DiagcMgrProxyAppl6DGetNtcDebCntrAppl6DDiagcMgrDGetNtcDebCntrAppl6
      AssemblySwConnector_2650: ecu-extract-reference=DiagcMgrStubDGetNtcDebCntrStubDDiagcMgrDGetNtcDebCntrAppl0
      AssemblySwConnector_2651: ecu-extract-reference=DiagcMgrStubDGetNtcDebCntrStubDDiagcMgrDGetNtcDebCntrAppl1
      AssemblySwConnector_2652: ecu-extract-reference=DiagcMgrStubDGetNtcDebCntrStubDDiagcMgrDGetNtcDebCntrAppl2
      AssemblySwConnector_2653: ecu-extract-reference=DiagcMgrStubDGetNtcDebCntrStubDDiagcMgrDGetNtcDebCntrAppl3
      AssemblySwConnector_2654: ecu-extract-reference=DiagcMgrStubDGetNtcDebCntrStubDDiagcMgrDGetNtcDebCntrAppl4
      AssemblySwConnector_2655: ecu-extract-reference=DiagcMgrStubDGetNtcDebCntrStubDDiagcMgrDGetNtcDebCntrAppl5
      AssemblySwConnector_2656: ecu-extract-reference=DiagcMgrStubDGetNtcDebCntrStubDDiagcMgrDGetNtcDebCntrAppl7
      AssemblySwConnector_2657: ecu-extract-reference=DiagcMgrStubDGetNtcDebCntrStubDDiagcMgrDGetNtcDebCntrAppl8
      AssemblySwConnector_2658: ecu-extract-reference=DiagcMgrStubDGetNtcDebCntrStubDDiagcMgrDGetNtcDebCntrAppl9
      AssemblySwConnector_2659: ecu-extract-reference=BattVltgDBrdgVltgDDiagcMgrDBrdgVltg
      AssemblySwConnector_2660: ecu-extract-reference=CmnMfgSrvDIgnCntrDDiagcMgrDIgnCntr
      AssemblySwConnector_2661: ecu-extract-reference=EcuTMeasDEcuTFildDDiagcMgrDEcuTFild
      AssemblySwConnector_2662: ecu-extract-reference=FltInjDFltInj_loglDDiagcMgrDFltInj_logl
      AssemblySwConnector_2663: ecu-extract-reference=MotTqCmdScaDMotTqCmdMrfScadDDiagcMgrDMotTqCmdMrfScad
      AssemblySwConnector_2664: ecu-extract-reference=SwpDHwTqSwpDDiagcMgrDHwTq
      AssemblySwConnector_2665: ecu-extract-reference=VehSigCdngDVehSpdDDiagcMgrDVehSpd
      AssemblySwConnector_2666: ecu-extract-reference=CalRegn01Inin00DMcuDiagc2MilliSecCntrCompThdDCDD_McuDiagcDMcuDiagc2MilliSecCntrCompThd
      AssemblySwConnector_2667: ecu-extract-reference=CalRegn01Inin00DMcuDiagcFltFailStepDCDD_McuDiagcDMcuDiagcFltFailStep
      AssemblySwConnector_2668: ecu-extract-reference=CalRegn01Inin00DMcuDiagcFltPassStepDCDD_McuDiagcDMcuDiagcFltPassStep
      AssemblySwConnector_2669: ecu-extract-reference=CDD_McuDiagcDLoopCntr2MilliSecDCDD_MotCtrlMgrDLoopCntr2MilliSec
      AssemblySwConnector_2670: ecu-extract-reference=CDD_MotCtrlMgrDSlowLoopCntrDCDD_McuDiagcDSlowLoopCntr
      AssemblySwConnector_2671: ecu-extract-reference=CmnMfgSrvDVehSpdOvrdDVehSigCdngDVehSpdOvrd
      AssemblySwConnector_2672: ecu-extract-reference=CmnMfgSrvDVehSpdOvrdEnaDVehSigCdngDVehSpdOvrdEna
      AssemblySwConnector_2673: ecu-extract-reference=SwpDHwTqSwpDVehSigCdngDHwTq
      AssemblySwConnector_008: ecu-extract-reference=CDD_AdcDiagcDAdcDiagcEndPtrOutpDCDD_Adc1CfgAndUseDAdcDiagcEndPtrOutp
      AssemblySwConnector_712: ecu-extract-reference=CDD_AdcDiagcDAdcDiagcStrtPtrOutpDCDD_Adc1CfgAndUseDAdcDiagcStrtPtrOutp
      AssemblySwConnector_2674: ecu-extract-reference=GmVehSpdArbnDVehSpdMaxSecurVldDGmOvrlStMgrDVehSpdSecurMaxVld
      AssemblySwConnector_2675: ecu-extract-reference=GmVehSpdArbnDVehSpdMinSecurVldDGmOvrlStMgrDVehSpdSecurMinVld
      ComponentPrototype_123: upstream-reference=ECU_Composition.CalRegn02CmnGroupB, ecu-extract-reference=COMPOSITIONTYPE.CalRegn02CmnGroupB
      ComponentPrototype_128: upstream-reference=ECU_Composition.CalRegn02CmnGroupA, ecu-extract-reference=COMPOSITIONTYPE.CalRegn02CmnGroupA
      AssemblySwConnector_133: ecu-extract-reference=CalRegn01CmnDSysGlbPrmVehSpdBilnrSelnDAssiHiFrqDSysGlbPrmVehSpdBilnrSeln
      AssemblySwConnector_270: ecu-extract-reference=CalRegn01CmnDBrdgVltgMaxDBattVltgDBrdgVltgMax
      AssemblySwConnector_271: ecu-extract-reference=CalRegn01CmnDSysGlbPrmVehSpdBilnrSelnDDampgDSysGlbPrmVehSpdBilnrSeln
      AssemblySwConnector_451: ecu-extract-reference=CalRegn01CmnDSysGlbPrmVehSpdBilnrSelnDHysCmpDSysGlbPrmVehSpdBilnrSeln
      AssemblySwConnector_460: ecu-extract-reference=CalRegn01CmnDSysGlbPrmVehSpdBilnrSelnDInertiaCmpVelDSysGlbPrmVehSpdBilnrSeln
      AssemblySwConnector_2033: ecu-extract-reference=CalRegn01Inin00GroupCDGmVehPwrModHwTqMinKeepAssiDGmVehPwrModDGmVehPwrModHwTqMinKeepAssi
      AssemblySwConnector_2034: ecu-extract-reference=CalRegn01Inin00GroupCDGmVehPwrModHwTqMinKeepTmrDGmVehPwrModDGmVehPwrModHwTqMinKeepTmr
      AssemblySwConnector_2035: ecu-extract-reference=CalRegn01Inin00GroupCDGmVehPwrModVehSpdAssiOnMinDGmVehPwrModDGmVehPwrModVehSpdAssiOnMin
      AssemblySwConnector_2036: ecu-extract-reference=CalRegn01Inin00GroupCDGmVehPwrModVehSpdMinKeepAssiDGmVehPwrModDGmVehPwrModVehSpdMinKeepAssi
      AssemblySwConnector_2430: ecu-extract-reference=CalRegn02CmnGroupADGmOvrlStMgrApaMfgEnaDCustDiagcDGmOvrlStMgrApaMfgEna
      AssemblySwConnector_2431: ecu-extract-reference=CalRegn02CmnGroupADGmOvrlStMgrEscMfgEnaDCustDiagcDGmOvrlStMgrEscMfgEna
      AssemblySwConnector_2432: ecu-extract-reference=CalRegn02CmnGroupADGmOvrlStMgrLkaMfgEnaDCustDiagcDGmOvrlStMgrLkaMfgEna
      AssemblySwConnector_2433: ecu-extract-reference=CalRegn02CmnGroupADGmOvrlStMgrApaMfgEnaDGmOvrlStMgrDGmOvrlStMgrApaMfgEna
      AssemblySwConnector_2434: ecu-extract-reference=CalRegn02CmnGroupADGmOvrlStMgrEscMfgEnaDGmOvrlStMgrDGmOvrlStMgrEscMfgEna
      AssemblySwConnector_2435: ecu-extract-reference=CalRegn02CmnGroupADGmOvrlStMgrLkaMfgEnaDGmOvrlStMgrDGmOvrlStMgrLkaMfgEna
      AssemblySwConnector_2436: ecu-extract-reference=CalRegn02CmnGroupADGmOvrlStMgrApaMfgEnaDSerlComOutpProxyDGmOvrlStMgrApaMfgEna
      AssemblySwConnector_2437: ecu-extract-reference=CalRegn02CmnGroupADGmOvrlStMgrEscMfgEnaDSerlComOutpProxyDGmOvrlStMgrEscMfgEna
      AssemblySwConnector_2456: ecu-extract-reference=CalRegn02CmnGroupADGmOvrlStMgrLkaMfgEnaDSerlComOutpProxyDGmOvrlStMgrLkaMfgEna
      AssemblySwConnector_2457: ecu-extract-reference=CalRegn02CmnGroupBDWhlImbRejctnFctEnaDWhlImbRejctnDWhlImbRejctnFctEna
      AssemblySwConnector_2476: ecu-extract-reference=CalRegn03CmnDAssiHiFrqHpFilFrqYDAssiHiFrqDAssiHiFrqHpFilFrqY
      AssemblySwConnector_2477: ecu-extract-reference=CalRegn03CmnGroupADHysCmpHysSatnYDHysCmpDHysCmpHysSatnY
      AssemblySwConnector_2496: ecu-extract-reference=CalRegn03CmnGroupADHysCmpOutpLimDHysCmpDHysCmpOutpLim
      AssemblySwConnector_2497: ecu-extract-reference=CalRegn03CmnGroupBDWhlImbRejctnAutScaEnaDWhlImbRejctnDWhlImbRejctnAutScaEna
      AssemblySwConnector_2618: ecu-extract-reference=CalRegn03CmnGroupBDWhlImbRejctnVehSpdEnaDWhlImbRejctnDWhlImbRejctnVehSpdEna
      AssemblySwConnector_2619: ecu-extract-reference=CalRegn03Inin00GroupADHysCmpAssiInpLimDHysCmpDHysCmpAssiInpLim
      AssemblySwConnector_2620: ecu-extract-reference=CalRegn03Inin00GroupBDWhlImbRejctnEnaSlewPerLoopDWhlImbRejctnDWhlImbRejctnEnaSlewPerLoop
      AssemblySwConnector_2622: ecu-extract-reference=CalRegn03Inin00GroupBDWhlImbRejctnFrqScaTblXDWhlImbRejctnDWhlImbRejctnFrqScaTblX
      AssemblySwConnector_2676: ecu-extract-reference=CalRegn03Inin00GroupBDWhlImbRejctnFrqScaTblYDWhlImbRejctnDWhlImbRejctnFrqScaTblY
      AssemblySwConnector_2677: ecu-extract-reference=CalRegn03Inin00GroupBDWhlImbRejctnMaxDurnDWhlImbRejctnDWhlImbRejctnMaxDurn
      AssemblySwConnector_2678: ecu-extract-reference=CalRegn03Rt00GroupADHysCmpFricWhlImbRejctnBlndXDHysCmpDHysCmpFricWhlImbRejctnBlndX
      AssemblySwConnector_2679: ecu-extract-reference=CalRegn03Rt00GroupADHysCmpFricWhlImbRejctnBlndYDHysCmpDHysCmpFricWhlImbRejctnBlndY
      AssemblySwConnector_2680: ecu-extract-reference=CalRegn03Rt00GroupADHysCmpFricWhlImbRejctnOffYDHysCmpDHysCmpFricWhlImbRejctnOffY
      AssemblySwConnector_2681: ecu-extract-reference=CalRegn03Rt00GroupADHysCmpFricWhlImbRejctnOnYDHysCmpDHysCmpFricWhlImbRejctnOnY
      AssemblySwConnector_2682: ecu-extract-reference=CalRegn03Rt00GroupADRtnHwAgOffsCalcdXDRtnDRtnHwAgOffsCalcdX
      AssemblySwConnector_2683: ecu-extract-reference=CalRegn03Rt00GroupADRtnHwAgOffsCalcdYDRtnDRtnHwAgOffsCalcdY
      AssemblySwConnector_2684: ecu-extract-reference=CalRegn03Rt00GroupADRtnScaTqXDRtnDRtnScaTqX
      AssemblySwConnector_2685: ecu-extract-reference=CalRegn03Rt00GroupADRtnScaTqYDRtnDRtnScaTqY
      AssemblySwConnector_2686: ecu-extract-reference=CalRegn03Rt00GroupADRtnScaVelXDRtnDRtnScaVelX
      AssemblySwConnector_2687: ecu-extract-reference=CalRegn03Rt00GroupADRtnScaVelYDRtnDRtnScaVelY
      AssemblySwConnector_2729: ecu-extract-reference=CalRegn01CmnDSysGlbPrmVehSpdBilnrSelnDAssiDSysGlbPrmVehSpd
      AssemblySwConnector_2730: ecu-extract-reference=CalRegn01CmnDBattVltgCorrlnSysMinVltgDBattVltgDBattVltgCorrlnSysMinVltg
      AssemblySwConnector_2731: ecu-extract-reference=CalRegn01CmnDBattVltgCorrlnNtc0x03DFailStepDBattVltgCorrlnDBattVltgCorrlnNtc0x03DFailStep
      AssemblySwConnector_2732: ecu-extract-reference=CalRegn01CmnDBattVltgCorrlnNtc0x03DPassStepDBattVltgCorrlnDBattVltgCorrlnNtc0x03DPassStep
      AssemblySwConnector_2733: ecu-extract-reference=CalRegn01CmnDBattVltgCorrlnSysMinVltgDBattVltgCorrlnDBattVltgCorrlnSysMinVltg
      AssemblySwConnector_2734: ecu-extract-reference=CalRegn01CmnDTunSelnAuthyTunSelnRtDiCmdDTunSelnAuthyDTunSelnAuthyTunSelnRtDiCmd
      AssemblySwConnector_2735: ecu-extract-reference=CalRegn01Inin00DTunSelnAuthyVehSpdXDTunSelnAuthyDTunSelnAuthyVehSpdX
      AssemblySwConnector_222: ecu-extract-reference=CalRegn01CmnDHwAgSysArbnHwAgConf1SnsrDHwAgSysArbnDHwAgSysArbnHwAgConf1Snsr
      AssemblySwConnector_223: ecu-extract-reference=CalRegn01CmnDHwAgSysArbnHwAgConf2SnsrDHwAgSysArbnDHwAgSysArbnHwAgConf2Snsr
      AssemblySwConnector_224: ecu-extract-reference=CalRegn01CmnDHwAgSysArbnHwAgConfNoSnsrDHwAgSysArbnDHwAgSysArbnHwAgConfNoSnsr
      AssemblySwConnector_225: ecu-extract-reference=CalRegn01CmnDHwAgSysArbnHwAgCorrdCorrlnThdDHwAgSysArbnDHwAgSysArbnHwAgCorrdCorrlnThd
      AssemblySwConnector_226: ecu-extract-reference=CalRegn01CmnDHwAgSysArbnHwAgCorrlnFailDebStepDHwAgSysArbnDHwAgSysArbnHwAgCorrlnFailDebStep
      AssemblySwConnector_227: ecu-extract-reference=CalRegn01CmnDHwAgSysArbnHwAgCorrlnPassDebStepDHwAgSysArbnDHwAgSysArbnHwAgCorrlnPassDebStep
      AssemblySwConnector_228: ecu-extract-reference=CalRegn01CmnDHwAgSysArbnHwAgCorrlnRngDHwAgSysArbnDHwAgSysArbnHwAgCorrlnRng
      AssemblySwConnector_229: ecu-extract-reference=CalRegn01CmnDHwAgSysArbnHwAgSnsrlsCorrlnThdDHwAgSysArbnDHwAgSysArbnHwAgSnsrlsCorrlnThd
      AssemblySwConnector_230: ecu-extract-reference=CalRegn01CmnDHwAgSysArbnHwAgSnsrlsKineThdDHwAgSysArbnDHwAgSysArbnHwAgSnsrlsKineThd
      AssemblySwConnector_231: ecu-extract-reference=CalRegn01CmnDHwAgSysArbnHwAgToMotAgCorrlnElpdTiLimDHwAgSysArbnDHwAgSysArbnHwAgToMotAgCorrlnElpdTiLim
      AssemblySwConnector_232: ecu-extract-reference=CalRegn01CmnDHwAgSysArbnSerlComHwAgCorrdConfDHwAgSysArbnDHwAgSysArbnSerlComHwAgCorrdConf
      AssemblySwConnector_233: ecu-extract-reference=CalRegn01CmnDHwAgSysArbnSerlComHwAgSnsrlsConfDHwAgSysArbnDHwAgSysArbnSerlComHwAgSnsrlsConf
      AssemblySwConnector_1297: ecu-extract-reference=DiagcMgrProxyAppl10DSetNtcSts10DHwAgSysArbnDSetNtcSts
      AssemblySwConnector_2739: ecu-extract-reference=HwAgArbnDHwAgDHwAgSysArbnDHwAg
      AssemblySwConnector_2740: ecu-extract-reference=SnsrOffsCorrnDHwAgCorrdDHwAgSysArbnDHwAgCorrd
      ComponentPrototype_204: upstream-reference=ECU_Composition.HwAgSnsrls, ecu-extract-reference=COMPOSITIONTYPE.HwAgSnsrls
      AssemblySwConnector_2741: ecu-extract-reference=CalRegn01CmnDHwAgSnsrlsFCentrHwConfDHwAgSnsrlsDHwAgSnsrlsFCentrHwConf
      AssemblySwConnector_2742: ecu-extract-reference=CalRegn01CmnDHwAgSnsrlsPinionTqFilFrqDHwAgSnsrlsDHwAgSnsrlsPinionTqFilFrq
      AssemblySwConnector_2743: ecu-extract-reference=CalRegn01CmnDHwAgSnsrlsRelHwAgFil1FrqDHwAgSnsrlsDHwAgSnsrlsRelHwAgFil1Frq
      AssemblySwConnector_2744: ecu-extract-reference=CalRegn01CmnDHwAgSnsrlsRelHwAgFil2FrqDHwAgSnsrlsDHwAgSnsrlsRelHwAgFil2Frq
      AssemblySwConnector_2745: ecu-extract-reference=CalRegn01CmnDHwAgSnsrlsSmotngCoeffDHwAgSnsrlsDHwAgSnsrlsSmotngCoeff
      AssemblySwConnector_2746: ecu-extract-reference=CalRegn01CmnDHwAgSnsrlsSmotngStepThdDHwAgSnsrlsDHwAgSnsrlsSmotngStepThd
      AssemblySwConnector_2747: ecu-extract-reference=CalRegn01CmnDHwAgSnsrlsStordPinionConfDHwAgSnsrlsDHwAgSnsrlsStordPinionConf
      AssemblySwConnector_2748: ecu-extract-reference=CalRegn01CmnDHwAgSnsrlsStordPinionConfThdDHwAgSnsrlsDHwAgSnsrlsStordPinionConfThd
      AssemblySwConnector_2749: ecu-extract-reference=CalRegn01CmnDHwAgSnsrlsVehDynDifThdDHwAgSnsrlsDHwAgSnsrlsVehDynDifThd
      AssemblySwConnector_2750: ecu-extract-reference=CalRegn01CmnDHwAgSnsrlsVehDynHwConfDHwAgSnsrlsDHwAgSnsrlsVehDynHwConf
      AssemblySwConnector_2751: ecu-extract-reference=CalRegn01CmnDHwAgSnsrlsVehDynMotVelThdDHwAgSnsrlsDHwAgSnsrlsVehDynMotVelThd
      AssemblySwConnector_2752: ecu-extract-reference=CalRegn01CmnDHwAgSnsrlsVehDynPinionTqThdDHwAgSnsrlsDHwAgSnsrlsVehDynPinionTqThd
      AssemblySwConnector_2753: ecu-extract-reference=CalRegn01CmnDHwAgSnsrlsVehDynTmr1ThdDHwAgSnsrlsDHwAgSnsrlsVehDynTmr1Thd
      AssemblySwConnector_2754: ecu-extract-reference=CalRegn01CmnDHwAgSnsrlsVehDynTmr2ThdDHwAgSnsrlsDHwAgSnsrlsVehDynTmr2Thd
      AssemblySwConnector_2755: ecu-extract-reference=CalRegn01CmnDHwAgSnsrlsWhlFrqThdDHwAgSnsrlsDHwAgSnsrlsWhlFrqThd
      AssemblySwConnector_2756: ecu-extract-reference=CalRegn01CmnDHwAgSnsrlsWhlSpdHwAgCoeff1DHwAgSnsrlsDHwAgSnsrlsWhlSpdHwAgCoeff1
      AssemblySwConnector_2757: ecu-extract-reference=CalRegn01CmnDHwAgSnsrlsWhlSpdHwAgCoeff2DHwAgSnsrlsDHwAgSnsrlsWhlSpdHwAgCoeff2
      AssemblySwConnector_2758: ecu-extract-reference=CalRegn01CmnDHwAgSnsrlsWhlSpdHwAgThdDHwAgSnsrlsDHwAgSnsrlsWhlSpdHwAgThd
      AssemblySwConnector_2759: ecu-extract-reference=CalRegn01CmnDHwAgSnsrlsWhlSpdHwConfDHwAgSnsrlsDHwAgSnsrlsWhlSpdHwConf
      AssemblySwConnector_2760: ecu-extract-reference=CalRegn01CmnDHwAgSnsrlsWhlSpdRatThdDHwAgSnsrlsDHwAgSnsrlsWhlSpdRatThd
      AssemblySwConnector_2761: ecu-extract-reference=CalRegn01CmnDHwAgSnsrlsWhlSpdTmrThdDHwAgSnsrlsDHwAgSnsrlsWhlSpdTmrThd
      AssemblySwConnector_2762: ecu-extract-reference=CalRegn01CmnDHwAgSnsrlsWhlSpdVehSpdThdDHwAgSnsrlsDHwAgSnsrlsWhlSpdVehSpdThd
      AssemblySwConnector_2763: ecu-extract-reference=CalRegn01Inin00DHwAgSnsrlsVehDynVehSpdThdDHwAgSnsrlsDHwAgSnsrlsVehDynVehSpdThd
      AssemblySwConnector_2764: ecu-extract-reference=CalRegn01Inin00DHwAgSnsrlsVehDynYawRateThdDHwAgSnsrlsDHwAgSnsrlsVehDynYawRateThd
      AssemblySwConnector_2765: ecu-extract-reference=CalRegn01Inin00DHwAgSnsrlsYawRateFilFrqDHwAgSnsrlsDHwAgSnsrlsYawRateFilFrq
      AssemblySwConnector_2768: ecu-extract-reference=CDD_MotAgCmpDMotAgCumvAlgndCrfDHwAgSnsrlsDMotAgCumvAlgndCrf
      AssemblySwConnector_2769: ecu-extract-reference=CDD_MotVelDMotVelCrfDHwAgSnsrlsDMotVelCrf
      AssemblySwConnector_2770: ecu-extract-reference=CDD_NxtrTiDGetRefTmr100MicroSec32bitDHwAgSnsrlsDGetRefTmr100MicroSec32bit
      AssemblySwConnector_2771: ecu-extract-reference=CDD_NxtrTiDGetTiSpan100MicroSec32bitDHwAgSnsrlsDGetTiSpan100MicroSec32bit
      AssemblySwConnector_2772: ecu-extract-reference=CmplncErrDCmplncErrMotToPinionDHwAgSnsrlsDCmplncErrMotToPinion
      AssemblySwConnector_2773: ecu-extract-reference=DiagcMgrProxyAppl10DGetNtcQlfrSts10DHwAgSnsrlsDGetNtcQlfrSts
      AssemblySwConnector_2774: ecu-extract-reference=GmRoadWhlInQlfrDWhlFrqVldDHwAgSnsrlsDWhlFrqVld
      AssemblySwConnector_2775: ecu-extract-reference=GmRoadWhlInQlfrDWhlLeFrqDHwAgSnsrlsDWhlLeFrq
      AssemblySwConnector_2776: ecu-extract-reference=GmRoadWhlInQlfrDWhlRiFrqDHwAgSnsrlsDWhlRiFrq
      AssemblySwConnector_2777: ecu-extract-reference=HwAgSnsrlsDHwAgSnsrlsDHwAgSysArbnDHwAgSnsrls
      AssemblySwConnector_2778: ecu-extract-reference=HwAgSnsrlsDHwAgSnsrlsConfDHwAgSysArbnDHwAgSnsrlsConf
      AssemblySwConnector_2779: ecu-extract-reference=HwAgSysArbnDPinionAgDHwAgSnsrlsDPinionAg
      AssemblySwConnector_2780: ecu-extract-reference=HwAgSysArbnDPinionAgConfDHwAgSnsrlsDPinionAgConf
      AssemblySwConnector_2781: ecu-extract-reference=MotTqTranlDampgDMotTqCmdCrfDampdDHwAgSnsrlsDMotTqCmdCrf
      AssemblySwConnector_2782: ecu-extract-reference=SwpDHwTqSwpDHwAgSnsrlsDHwTq
      AssemblySwConnector_2783: ecu-extract-reference=VehSigCdngDVehSpdDHwAgSnsrlsDVehSpd
      AssemblySwConnector_2784: ecu-extract-reference=VehSigCdngDVehSpdVldDHwAgSnsrlsDVehSpdVld
      AssemblySwConnector_2785: ecu-extract-reference=VehSigCdngDVehYawRateDHwAgSnsrlsDVehYawRate
      AssemblySwConnector_1920: ecu-extract-reference=CalRegn01CmnDEotLrngHwAgOverTrvlCntDEotLrngDEotLrngHwAgOverTrvlCnt
      AssemblySwConnector_2144: ecu-extract-reference=HwAgSysArbnDHwAgNotCorrdDEotLrngDHwAg
      AssemblySwConnector_2145: ecu-extract-reference=HwAgSysArbnDHwAgNotCorrdDEotProtnDHwAg
      AssemblySwConnector_2786: ecu-extract-reference=HwAgSysArbnDHwAgNotCorrdDEotProtnFwlDHwAg
      AssemblySwConnector_2787: ecu-extract-reference=DiagcMgrProxyAppl10DSetNtcSts10DHwAgVehCentrTrimDSetNtcSts
      ComponentPrototype_205: upstream-reference=ECU_Composition.GmFctDiArbn, ecu-extract-reference=COMPOSITIONTYPE.GmFctDiArbn
      AssemblySwConnector_1196: ecu-extract-reference=CalRegn01CmnDGmFctDiArbnEotHwAgThdDGmFctDiArbnDGmFctDiArbnEotHwAgThd
      AssemblySwConnector_1200: ecu-extract-reference=CalRegn01CmnDGmFctDiArbnEotTiDGmFctDiArbnDGmFctDiArbnEotTi
      AssemblySwConnector_1262: ecu-extract-reference=CalRegn01CmnDGmFctDiArbnOnCentrHwAgThdDGmFctDiArbnDGmFctDiArbnOnCentrHwAgThd
      AssemblySwConnector_2274: ecu-extract-reference=CalRegn01CmnDGmFctDiArbnOnCentrHwTqThdDGmFctDiArbnDGmFctDiArbnOnCentrHwTqThd
      AssemblySwConnector_2789: ecu-extract-reference=CalRegn01CmnDGmFctDiArbnOnCentrTiDGmFctDiArbnDGmFctDiArbnOnCentrTi
      AssemblySwConnector_2790: ecu-extract-reference=CalRegn01CmnDGmFctDiArbnSrvTiDGmFctDiArbnDGmFctDiArbnSrvTi
      AssemblySwConnector_2791: ecu-extract-reference=CDD_NxtrTiDGetRefTmr100MicroSec32bitDGmFctDiArbnDGetRefTmr100MicroSec32bit
      AssemblySwConnector_2792: ecu-extract-reference=CDD_NxtrTiDGetTiSpan100MicroSec32bitDGmFctDiArbnDGetTiSpan100MicroSec32bit
      AssemblySwConnector_2793: ecu-extract-reference=EotLrngDHwAgEotCcwDGmFctDiArbnDHwAgEotCcw
      AssemblySwConnector_2794: ecu-extract-reference=EotLrngDHwAgEotCwDGmFctDiArbnDHwAgEotCw
      AssemblySwConnector_2795: ecu-extract-reference=GmFctDiArbnDApaEnaArbnDGmOvrlStMgrDApaEna
      AssemblySwConnector_2796: ecu-extract-reference=GmFctDiArbnDEscEnaArbnDGmOvrlStMgrDEscEna
      AssemblySwConnector_2797: ecu-extract-reference=GmFctDiArbnDLkaEnaArbnDGmOvrlStMgrDLkaEna
      AssemblySwConnector_2799: ecu-extract-reference=GmFctDiArbnDPullCmpActvDiDPullCmpActvDPullCmpActvDi
      AssemblySwConnector_2800: ecu-extract-reference=GmFctDiArbnDTunSetRtDiDTunSelnAuthyDTunSelnRtDi
      AssemblySwConnector_2801: ecu-extract-reference=GmFctDiArbnDWhlImbRejctnDiDWhlImbRejctnDWhlImbRejctnDi
      AssemblySwConnector_2802: ecu-extract-reference=GmMsg180BusChassisExpDEscReqActvDGmFctDiArbnDEscEna
      AssemblySwConnector_2803: ecu-extract-reference=GmMsg180BusHiSpdDLkaReqActvDGmFctDiArbnDLkaEna
      AssemblySwConnector_2804: ecu-extract-reference=GmMsg337BusChassisExpDApaReqActvDGmFctDiArbnDApaEna
      AssemblySwConnector_2805: ecu-extract-reference=HwAgSysArbnDPinionAgDGmFctDiArbnDHwAg
      AssemblySwConnector_2806: ecu-extract-reference=LoaMgrDLoaStDGmFctDiArbnDLoaSt
      AssemblySwConnector_2798: ecu-extract-reference=CDD_GmT1xxMcuCfgDAdc1ScanGroup2Ref0DCDD_AdcDiagcDAdc1ScanGroup2Ref0
      AssemblySwConnector_2808: ecu-extract-reference=CDD_GmT1xxMcuCfgDAdc1ScanGroup2Ref1DCDD_AdcDiagcDAdc1ScanGroup2Ref1
      AssemblySwConnector_2809: ecu-extract-reference=CDD_GmT1xxMcuCfgDAdc1ScanGroup3Ref0DCDD_AdcDiagcDAdc1ScanGroup3Ref0
      AssemblySwConnector_2810: ecu-extract-reference=CDD_GmT1xxMcuCfgDAdc1ScanGroup3Ref1DCDD_AdcDiagcDAdc1ScanGroup3Ref1
      AssemblySwConnector_2811: ecu-extract-reference=CDD_MotCtrlMgrDAdc0ScanGroup2Ref0DCDD_AdcDiagcDAdc0ScanGroup2Ref0
      AssemblySwConnector_2812: ecu-extract-reference=CDD_MotCtrlMgrDAdc0ScanGroup2Ref1DCDD_AdcDiagcDAdc0ScanGroup2Ref1
      AssemblySwConnector_2813: ecu-extract-reference=CDD_MotCtrlMgrDAdc0ScanGroup3Ref0DCDD_AdcDiagcDAdc0ScanGroup3Ref0
      AssemblySwConnector_2814: ecu-extract-reference=CDD_MotCtrlMgrDAdc0ScanGroup3Ref1DCDD_AdcDiagcDAdc0ScanGroup3Ref1
      AssemblySwConnector_2815: ecu-extract-reference=CDD_AdcDiagcDAdcDiagcEndPtrOutpDCDD_MotCtrlMgrDAdcDiagcEndPtrOutp
      AssemblySwConnector_2816: ecu-extract-reference=CDD_AdcDiagcDAdcDiagcStrtPtrOutpDCDD_MotCtrlMgrDAdcDiagcStrtPtrOutp
      AssemblySwConnector_2818: ecu-extract-reference=GmFctDiArbnDInertiaCmpDecelGainDiDInertiaCmpVelDInertiaCmpDecelGainDi
      AssemblySwConnector_2125: ecu-extract-reference=GmFctDiArbnDGmFctDiReqDCustDiagcDGmFctDiReq
      AssemblySwConnector_2819: ecu-extract-reference=GmFctDiArbnDGmFctDiStsDCustDiagcDGmFctDiSts
      AssemblySwConnector_2820: ecu-extract-reference=GmMsg778BusHiSpdDClrTrigStsAryDCustDiagcDClrTrigStsAry
      AssemblySwConnector_2821: ecu-extract-reference=CalRegn02CmnGroupADGmOvrlStMgrLkaMfgEnaDGmMsg184BusHiSpdDGmOvrlStMgrLkaMfgEna
      AssemblySwConnector_2824: ecu-extract-reference=CmnMfgSrvDLoaScaDiDLoaMgrDLoaScaDi
      AssemblySwConnector_2825: ecu-extract-reference=CmnMfgSrvDFricLrngDiDSysFricLrngDFricLrngDi
      AssemblySwConnector_2826: ecu-extract-reference=DiagcMgrDClrSnpshtDataDCmnMfgSrvDClrSnpshtData
      AssemblySwConnector_2827: ecu-extract-reference=DiagcMgrDReadNtcInfoAndDebCntrDCmnMfgSrvDReadNtcInfoAndDebCntr
      AssemblySwConnector_2828: ecu-extract-reference=DiagcMgrDReadSnpshtDataDCmnMfgSrvDReadSnpshtData
      AssemblySwConnector_2829: ecu-extract-reference=DiagcMgrProxyAppl10DGetNtcSts10DCmnMfgSrvDGetNtcSts
      AssemblySwConnector_2830: ecu-extract-reference=EotLrngDRstMaxHwAgCwAndCcwDCmnMfgSrvDRstMaxHwAgCwAndCcw
      AssemblySwConnector_2831: ecu-extract-reference=EotLrngDRtnMaxHwAgCwAndCcwDCmnMfgSrvDRtnMaxHwAgCwAndCcw
      AssemblySwConnector_2832: ecu-extract-reference=HwAgSnsrlsDFSnsrlsHwCentrDCmnMfgSrvDFSnsrlsHwCentr
      AssemblySwConnector_2833: ecu-extract-reference=HwAgSnsrlsDRstSnsrlsHwCentrDCmnMfgSrvDRstSnsrlsHwCentr
      ComponentPrototype_072: upstream-reference=ECU_Composition.GateDrv0Ctrl, ecu-extract-reference=COMPOSITIONTYPE.GateDrv0Ctrl
      AssemblySwConnector_500: ecu-extract-reference=CalRegn01CmnDGateDrv0CtrlNtcNr0x050FailStepDGateDrv0CtrlDGateDrv0CtrlNtcNr0x050FailStep
      AssemblySwConnector_501: ecu-extract-reference=CalRegn01CmnDGateDrv0CtrlNtcNr0x050PassStepDGateDrv0CtrlDGateDrv0CtrlNtcNr0x050PassStep
      AssemblySwConnector_502: ecu-extract-reference=CalRegn01CmnDGateDrv0CtrlNtcNr0x051FailStepDGateDrv0CtrlDGateDrv0CtrlNtcNr0x051FailStep
      AssemblySwConnector_503: ecu-extract-reference=CalRegn01CmnDGateDrv0CtrlNtcNr0x051PassStepDGateDrv0CtrlDGateDrv0CtrlNtcNr0x051PassStep
      AssemblySwConnector_504: ecu-extract-reference=CalRegn01CmnDGateDrv0CtrlNtcNr0x055FailStepDGateDrv0CtrlDGateDrv0CtrlNtcNr0x055FailStep
      AssemblySwConnector_505: ecu-extract-reference=CalRegn01CmnDGateDrv0CtrlNtcNr0x055PassStepDGateDrv0CtrlDGateDrv0CtrlNtcNr0x055PassStep
      AssemblySwConnector_506: ecu-extract-reference=CalRegn01CmnDGateDrv0CtrlUnit0Cfg2WrValDGateDrv0CtrlDGateDrv0CtrlUnit0Cfg2WrVal
      AssemblySwConnector_507: ecu-extract-reference=CalRegn01CmnDGateDrv0CtrlUnit0Cfg3WrValDGateDrv0CtrlDGateDrv0CtrlUnit0Cfg3WrVal
      AssemblySwConnector_508: ecu-extract-reference=CalRegn01CmnDGateDrv0CtrlUnit0Cfg4WrValDGateDrv0CtrlDGateDrv0CtrlUnit0Cfg4WrVal
      AssemblySwConnector_509: ecu-extract-reference=CalRegn01CmnDGateDrv0CtrlUnit0Cfg7WrValDGateDrv0CtrlDGateDrv0CtrlUnit0Cfg7WrVal
      AssemblySwConnector_511: ecu-extract-reference=DiagcMgrDDiagcStsIvtr1InactvDGateDrv0CtrlDDiagcStsIvtr1Inactv
      AssemblySwConnector_512: ecu-extract-reference=DiagcMgrProxyAppl10DSetNtcSts10DGateDrv0CtrlDSetNtcSts
      AssemblySwConnector_513: ecu-extract-reference=IoHwAbDGetGpioMotDrvr0DiagDGateDrv0CtrlDIoHwAb_GetGpioMotDrvr0Diag
      AssemblySwConnector_515: ecu-extract-reference=IoHwAbDSetGpioSysFlt2ADGateDrv0CtrlDIoHwAb_SetGpioSysFlt2A
      AssemblySwConnector_516: ecu-extract-reference=PwrUpSeqDStrtUpStDGateDrv0CtrlDStrtUpSt
      AssemblySwConnector_517: ecu-extract-reference=SysStModDSysStDGateDrv0CtrlDSysSt
      AssemblySwConnector_518: ecu-extract-reference=CalRegn02CmnDInertiaCmpVelDecelGainEnaCalDInertiaCmpVelDInertiaCmpVelDecelGainEnaCal
      AssemblySwConnector_519: ecu-extract-reference=CalRegn02CmnGroupADPullCmpActvEnaDPullCmpActvDPullCmpActvEna
      ComponentPrototype_206: upstream-reference=ECU_Composition.GateDrv1Ctrl, ecu-extract-reference=COMPOSITIONTYPE.GateDrv1Ctrl
      AssemblySwConnector_520: ecu-extract-reference=CalRegn01CmnDGateDrv1CtrlNtcNr0x060FailStepDGateDrv1CtrlDGateDrv1CtrlNtcNr0x060FailStep
      AssemblySwConnector_521: ecu-extract-reference=CalRegn01CmnDGateDrv1CtrlNtcNr0x060PassStepDGateDrv1CtrlDGateDrv1CtrlNtcNr0x060PassStep
      AssemblySwConnector_555: ecu-extract-reference=CalRegn01CmnDGateDrv1CtrlNtcNr0x061FailStepDGateDrv1CtrlDGateDrv1CtrlNtcNr0x061FailStep
      AssemblySwConnector_648: ecu-extract-reference=CalRegn01CmnDGateDrv1CtrlNtcNr0x061PassStepDGateDrv1CtrlDGateDrv1CtrlNtcNr0x061PassStep
      AssemblySwConnector_1060: ecu-extract-reference=CalRegn01CmnDGateDrv1CtrlNtcNr0x065FailStepDGateDrv1CtrlDGateDrv1CtrlNtcNr0x065FailStep
      AssemblySwConnector_1061: ecu-extract-reference=CalRegn01CmnDGateDrv1CtrlNtcNr0x065PassStepDGateDrv1CtrlDGateDrv1CtrlNtcNr0x065PassStep
      AssemblySwConnector_1104: ecu-extract-reference=CalRegn01CmnDGateDrv1CtrlUnit1Cfg2WrValDGateDrv1CtrlDGateDrv1CtrlUnit1Cfg2WrVal
      AssemblySwConnector_1105: ecu-extract-reference=CalRegn01CmnDGateDrv1CtrlUnit1Cfg3WrValDGateDrv1CtrlDGateDrv1CtrlUnit1Cfg3WrVal
      AssemblySwConnector_1187: ecu-extract-reference=CalRegn01CmnDGateDrv1CtrlUnit1Cfg4WrValDGateDrv1CtrlDGateDrv1CtrlUnit1Cfg4WrVal
      AssemblySwConnector_1402: ecu-extract-reference=CalRegn01CmnDGateDrv1CtrlUnit1Cfg7WrValDGateDrv1CtrlDGateDrv1CtrlUnit1Cfg7WrVal
      AssemblySwConnector_1403: ecu-extract-reference=DiagcMgrDDiagcStsIvtr2InactvDGateDrv1CtrlDDiagcStsIvtr2Inactv
      AssemblySwConnector_1404: ecu-extract-reference=DiagcMgrProxyAppl10DSetNtcSts10DGateDrv1CtrlDSetNtcSts
      AssemblySwConnector_1405: ecu-extract-reference=IoHwAbDGetGpioMotDrvr1DiagDGateDrv1CtrlDIoHwAb_GetGpioMotDrvr1Diag
      AssemblySwConnector_1407: ecu-extract-reference=IoHwAbDSetGpioSysFlt2BDGateDrv1CtrlDIoHwAb_SetGpioSysFlt2B
      AssemblySwConnector_1534: ecu-extract-reference=PwrUpSeqDStrtUpStDGateDrv1CtrlDStrtUpSt
      AssemblySwConnector_1640: ecu-extract-reference=SysStModDSysStDGateDrv1CtrlDSysSt
      AssemblySwConnector_2065: ecu-extract-reference=GateDrv0CtrlDMotDrvr0IninTestCmplDPwrUpSeqDMotDrvr0IninTestCmpl
      AssemblySwConnector_2788: ecu-extract-reference=GateDrv1CtrlDMotDrvr1IninTestCmplDPwrUpSeqDMotDrvr1IninTestCmpl
      AssemblySwConnector_2817: ecu-extract-reference=CalRegn01CmnDAdcDiagcNtc0x032FailStepDCDD_AdcDiagcDAdcDiagcNtc0x032FailStep
      AssemblySwConnector_2834: ecu-extract-reference=CalRegn01CmnDAdcDiagcNtc0x032PassStepDCDD_AdcDiagcDAdcDiagcNtc0x032PassStep
      AssemblySwConnector_2835: ecu-extract-reference=CalRegn01CmnDAdcDiagcNtc0x033FailStepDCDD_AdcDiagcDAdcDiagcNtc0x033FailStep
      AssemblySwConnector_2836: ecu-extract-reference=CalRegn01CmnDAdcDiagcNtc0x033PassStepDCDD_AdcDiagcDAdcDiagcNtc0x033PassStep
      AssemblySwConnector_2807: ecu-extract-reference=SwpDHwTqSwpDGmFctDiArbnDHwTq
      AssemblySwConnector_1254: ecu-extract-reference=CalRegn01CmnDSnsrOffsLrngSampleCntForHwTqLrngRstDSnsrOffsLrngDSnsrOffsLrngSampleCntForHwTqLrngRst
      AssemblySwConnector_2728: ecu-extract-reference=CalRegn01CmnDSysGlbPrmVehSpdBilnrSelnDAssiDSysGlbPrmVehSpdBilnrSeln
      AssemblySwConnector_2841: ecu-extract-reference=GmTqArbnDLkaTqCmdCdndDGmOvrlStMgrDLkaTqCmdCdnd
      AssemblySwConnector_438: ecu-extract-reference=CalRegn01CmnDLoaMgrHwTqIdptSigFltThdDGmMsg184BusHiSpdDLoaMgrHwTqIdptSigFltThd
      AssemblySwConnector_960: ecu-extract-reference=CalRegn01CmnDLoaMgrHwTqIdptSigFltThdDGmMsg335BusChassisExpDLoaMgrHwTqIdptSigFltThd
      AssemblySwConnector_961: ecu-extract-reference=GmMsg184BusHiSpdDMsgTxCallBackDSerlComOutpProxyDMsg184TxCallBack
      AssemblySwConnector_962: ecu-extract-reference=GmMsg1CABusChassisExpDMsg1CATxCallBackDSerlComOutpProxyDMsg1CATxCallBack
      AssemblySwConnector_963: ecu-extract-reference=GmMsg1E5BusChassisExpDMsg1E5ChassisExpTxCallBackDSerlComOutpProxyDMsg1E5ChassisExpTxCallBack
      AssemblySwConnector_972: ecu-extract-reference=GmMsg1E5BusHiSpdDMsg1E5HiSpdCallBackDSerlComOutpProxyDMsg1E5HiSpdTxCallBack
      AssemblySwConnector_973: ecu-extract-reference=GmMsg335BusChassisExpDMsg335TxCallBackDSerlComOutpProxyDMsg335TxCallBack
      AssemblySwConnector_1953: ecu-extract-reference=HwTqCorrlnDHwTqIdptSigDGmMsg184BusHiSpdDHwTqIdptSig
      AssemblySwConnector_2822: ecu-extract-reference=HwTqCorrlnDHwTqIdptSigDGmMsg335BusChassisExpDHwTqIdptSig
      AssemblySwConnector_514: ecu-extract-reference=IoHwAbDSetGpioGateDrv0RstDGateDrv0CtrlDIoHwAb_SetGpioGateDrv0Rst
      AssemblySwConnector_1406: ecu-extract-reference=IoHwAbDSetGpioGateDrv1RstDGateDrv1CtrlDIoHwAb_SetGpioGateDrv1Rst
      ComponentPrototype_134: upstream-reference=ECU_Composition.CalRegn03CmnGroupC, ecu-extract-reference=COMPOSITIONTYPE.CalRegn03CmnGroupC
      ComponentPrototype_151: upstream-reference=ECU_Composition.CalRegn02Rt04GroupC, ecu-extract-reference=COMPOSITIONTYPE.CalRegn02Rt04GroupC
      ComponentPrototype_163: upstream-reference=ECU_Composition.CalRegn02Rt03GroupC, ecu-extract-reference=COMPOSITIONTYPE.CalRegn02Rt03GroupC
      ComponentPrototype_169: upstream-reference=ECU_Composition.CalRegn02Rt02GroupC, ecu-extract-reference=COMPOSITIONTYPE.CalRegn02Rt02GroupC
      ComponentPrototype_200: upstream-reference=ECU_Composition.CalRegn02Rt01GroupC, ecu-extract-reference=COMPOSITIONTYPE.CalRegn02Rt01GroupC
      ComponentPrototype_201: upstream-reference=ECU_Composition.CalRegn02Rt00GroupC, ecu-extract-reference=COMPOSITIONTYPE.CalRegn02Rt00GroupC
      ComponentPrototype_202: upstream-reference=ECU_Composition.CalRegn02Inin00GroupC, ecu-extract-reference=COMPOSITIONTYPE.CalRegn02Inin00GroupC
      ComponentPrototype_203: upstream-reference=ECU_Composition.CalRegn02Inin00GroupA, ecu-extract-reference=COMPOSITIONTYPE.CalRegn02Inin00GroupA
      AssemblySwConnector_398: ecu-extract-reference=CalRegn01CmnDPartNrCmpdVehPartnProdtStructDPartNrDPartNrCmpdVehPartnProdtStruct
      AssemblySwConnector_399: ecu-extract-reference=CalRegn01CmnDWhlImbRejctnFrqDiagcLpFilDWhlImbRejctnDWhlImbRejctnFrqDiagcLpFil
      AssemblySwConnector_400: ecu-extract-reference=CalRegn01Inin00DWhlImbRejctnDcTrendFltRcvryThdDWhlImbRejctnDWhlImbRejctnDcTrendFltRcvryThd
      AssemblySwConnector_401: ecu-extract-reference=CalRegn01Inin00GroupBDWhlImbRejctnFrqDiagcAmpThdDWhlImbRejctnDWhlImbRejctnFrqDiagcAmpThd
      AssemblySwConnector_402: ecu-extract-reference=CalRegn01Inin00GroupBDWhlImbRejctnFrqDiagcFltRcvryThdDWhlImbRejctnDWhlImbRejctnFrqDiagcFltRcvryThd
      AssemblySwConnector_403: ecu-extract-reference=CalRegn01Inin00GroupBDWhlImbRejctnFrqDiagcThdDWhlImbRejctnDWhlImbRejctnFrqDiagcThd
      AssemblySwConnector_404: ecu-extract-reference=CalRegn01Inin00GroupBDWhlImbRejctnFrqDiagcToutDWhlImbRejctnDWhlImbRejctnFrqDiagcTout
      AssemblySwConnector_405: ecu-extract-reference=CalRegn01Inin00GroupBDWhlImbRejctnMaxMgnFltRcvryThdDWhlImbRejctnDWhlImbRejctnMaxMgnFltRcvryThd
      AssemblySwConnector_406: ecu-extract-reference=CalRegn01Inin00GroupBDWhlImbRejctnMaxMgnFltThdDWhlImbRejctnDWhlImbRejctnMaxMgnFltThd
      AssemblySwConnector_407: ecu-extract-reference=CalRegn01Inin00GroupBDWhlImbRejctnWhlSpdCorrlnFltRcvryThdDWhlImbRejctnDWhlImbRejctnWhlSpdCorrlnFltRcvryThd
      AssemblySwConnector_408: ecu-extract-reference=CalRegn01Rt00DTunSelnAuthyHwTqYDTunSelnAuthyDTunSelnAuthyHwTqY
      AssemblySwConnector_409: ecu-extract-reference=CalRegn01Rt00DTunSelnAuthyHwVelYDTunSelnAuthyDTunSelnAuthyHwVelY
      AssemblySwConnector_418: ecu-extract-reference=CalRegn02CmnDSnsrOffsCorrnHwAgLrndOffsLimDSnsrOffsCorrnDSnsrOffsCorrnHwAgLrndOffsLim
      AssemblySwConnector_433: ecu-extract-reference=CalRegn02CmnDSnsrOffsCorrnHwTqLrndOffsLimDSnsrOffsCorrnDSnsrOffsCorrnHwTqLrndOffsLim
      AssemblySwConnector_434: ecu-extract-reference=CalRegn02CmnDSnsrOffsCorrnVehYawRateLrndOffsLimDSnsrOffsCorrnDSnsrOffsCorrnVehYawRateLrndOffsLim
      AssemblySwConnector_436: ecu-extract-reference=CalRegn02CmnDSnsrOffsLrngHwAgLrngTiDSnsrOffsLrngDSnsrOffsLrngHwAgLrngTi
      AssemblySwConnector_437: ecu-extract-reference=CalRegn02CmnDSnsrOffsLrngHwTqLrngHwTqZeroOffsThdDSnsrOffsLrngDSnsrOffsLrngHwTqLrngHwTqZeroOffsThd
      AssemblySwConnector_450: ecu-extract-reference=CalRegn02CmnDSnsrOffsLrngHwTqLrngMeasTiDSnsrOffsLrngDSnsrOffsLrngHwTqLrngMeasTi
      AssemblySwConnector_452: ecu-extract-reference=CalRegn02CmnDSnsrOffsLrngHwTqLrngSampleImbThd1DSnsrOffsLrngDSnsrOffsLrngHwTqLrngSampleImbThd1
      AssemblySwConnector_453: ecu-extract-reference=CalRegn02CmnDSnsrOffsLrngHwTqLrngSampleImbThd2DSnsrOffsLrngDSnsrOffsLrngHwTqLrngSampleImbThd2
      AssemblySwConnector_454: ecu-extract-reference=CalRegn02CmnDSnsrOffsLrngHwTqLrngSampleThd1DSnsrOffsLrngDSnsrOffsLrngHwTqLrngSampleThd1
      AssemblySwConnector_455: ecu-extract-reference=CalRegn02CmnDSnsrOffsLrngHwTqLrngSampleThd2DSnsrOffsLrngDSnsrOffsLrngHwTqLrngSampleThd2
      AssemblySwConnector_456: ecu-extract-reference=CalRegn02CmnDSnsrOffsLrngHwTqLrngTiWghtCoeffDSnsrOffsLrngDSnsrOffsLrngHwTqLrngTiWghtCoeff
      AssemblySwConnector_457: ecu-extract-reference=CalRegn02CmnDSnsrOffsLrngYawLrngTiDSnsrOffsLrngDSnsrOffsLrngYawLrngTi
      AssemblySwConnector_458: ecu-extract-reference=CalRegn02CmnGroupADGmOvrlStMgrLkaHwTqThd1DGmOvrlStMgrDGmOvrlStMgrLkaHwTqThd1
      AssemblySwConnector_459: ecu-extract-reference=CalRegn02CmnGroupADGmOvrlStMgrLkaHwTqThd2DGmOvrlStMgrDGmOvrlStMgrLkaHwTqThd2
      AssemblySwConnector_461: ecu-extract-reference=CalRegn02CmnGroupCDGmOvrlStMgrApaHaptcEnaDGmOvrlStMgrDGmOvrlStMgrApaHaptcEna
      AssemblySwConnector_462: ecu-extract-reference=CalRegn02CmnGroupCDGmOvrlStMgrApaHwTqThdDGmOvrlStMgrDGmOvrlStMgrApaHwTqThd
      AssemblySwConnector_463: ecu-extract-reference=CalRegn02CmnGroupCDGmOvrlStMgrApaVehSpdHiLimDGmOvrlStMgrDGmOvrlStMgrApaVehSpdHiLim
      AssemblySwConnector_464: ecu-extract-reference=CalRegn02CmnGroupCDGmOvrlStMgrEscVehSpdHiLimDGmOvrlStMgrDGmOvrlStMgrEscVehSpdHiLim
      AssemblySwConnector_465: ecu-extract-reference=CalRegn02CmnGroupCDGmOvrlStMgrHaptcAmpDGmOvrlStMgrDGmOvrlStMgrHaptcAmp
      AssemblySwConnector_466: ecu-extract-reference=CalRegn02CmnGroupCDGmOvrlStMgrHaptcDurnDGmOvrlStMgrDGmOvrlStMgrHaptcDurn
      AssemblySwConnector_467: ecu-extract-reference=CalRegn02CmnGroupCDGmOvrlStMgrLkaVehSpdHiLimDGmOvrlStMgrDGmOvrlStMgrLkaVehSpdHiLim
      AssemblySwConnector_468: ecu-extract-reference=CalRegn02CmnGroupCDGmOvrlStMgrLkaVehSpdLoLimDGmOvrlStMgrDGmOvrlStMgrLkaVehSpdLoLim
      AssemblySwConnector_469: ecu-extract-reference=CalRegn02CmnGroupCDHowDetnHiFrqGainYDHowDetnDHowDetnHiFrqGainY
      AssemblySwConnector_470: ecu-extract-reference=CalRegn02CmnGroupCDHowDetnHiFrqRateXDHowDetnDHowDetnHiFrqRateX
      AssemblySwConnector_471: ecu-extract-reference=CalRegn02CmnGroupCDHowDetnHiFrqRateYDHowDetnDHowDetnHiFrqRateY
      AssemblySwConnector_472: ecu-extract-reference=CalRegn02CmnGroupCDHowDetnLoFrqRateXDHowDetnDHowDetnLoFrqRateX
      AssemblySwConnector_473: ecu-extract-reference=CalRegn02CmnGroupCDHowDetnLoFrqRateYDHowDetnDHowDetnLoFrqRateY
      AssemblySwConnector_474: ecu-extract-reference=CalRegn02CmnGroupCDHowDetnMinVehSpdDHowDetnDHowDetnMinVehSpd
      AssemblySwConnector_475: ecu-extract-reference=CalRegn02CmnGroupCDHowDetnPercOfPrevHowEstimDHowDetnDHowDetnPercOfPrevHowEstim
      AssemblySwConnector_476: ecu-extract-reference=CalRegn02CmnGroupCDHowDetnSlewRateDHowDetnDHowDetnSlewRate
      AssemblySwConnector_477: ecu-extract-reference=CalRegn02CmnGroupCDHowDetnStThdXDHowDetnDHowDetnStThdX
      AssemblySwConnector_478: ecu-extract-reference=CalRegn02CmnGroupCDHowDetnTqHpFilFrqDHowDetnDHowDetnTqHpFilFrq
      AssemblySwConnector_479: ecu-extract-reference=CalRegn02CmnGroupCDHowDetnVehSpdDHowDetnDHowDetnVehSpd
      AssemblySwConnector_480: ecu-extract-reference=CalRegn02CmnGroupCDSnsrOffsLrngHwAgLrngDrvgDstThdDSnsrOffsLrngDSnsrOffsLrngHwAgLrngDrvgDstThd
      AssemblySwConnector_481: ecu-extract-reference=CalRegn02CmnGroupCDSnsrOffsLrngHwAgLrngHwVelThdDSnsrOffsLrngDSnsrOffsLrngHwAgLrngHwVelThd
      AssemblySwConnector_482: ecu-extract-reference=CalRegn02CmnGroupCDSnsrOffsLrngHwAgLrngSysTqThdDSnsrOffsLrngDSnsrOffsLrngHwAgLrngSysTqThd
      AssemblySwConnector_485: ecu-extract-reference=CalRegn02CmnGroupCDSnsrOffsLrngHwAgLrngSysTqThdMedDSnsrOffsLrngDSnsrOffsLrngHwAgLrngSysTqThdMed
      AssemblySwConnector_489: ecu-extract-reference=CalRegn02CmnGroupCDSnsrOffsLrngHwAgLrngSysTqThdTrustdDSnsrOffsLrngDSnsrOffsLrngHwAgLrngSysTqThdTrustd
      AssemblySwConnector_490: ecu-extract-reference=CalRegn02CmnGroupCDSnsrOffsLrngHwAgLrngSysTqThdWideDSnsrOffsLrngDSnsrOffsLrngHwAgLrngSysTqThdWide
      AssemblySwConnector_491: ecu-extract-reference=CalRegn02CmnGroupCDSnsrOffsLrngHwAgLrngVehSpdThdDSnsrOffsLrngDSnsrOffsLrngHwAgLrngVehSpdThd
      AssemblySwConnector_492: ecu-extract-reference=CalRegn02CmnGroupCDSnsrOffsLrngHwAgLrngYawOffsDbndDSnsrOffsLrngDSnsrOffsLrngHwAgLrngYawOffsDbnd
      AssemblySwConnector_493: ecu-extract-reference=CalRegn02CmnGroupCDSnsrOffsLrngHwAgLrngYawRateThdDSnsrOffsLrngDSnsrOffsLrngHwAgLrngYawRateThd
      AssemblySwConnector_494: ecu-extract-reference=CalRegn02CmnGroupCDSnsrOffsLrngHwAgOffsLimDSnsrOffsLrngDSnsrOffsLrngHwAgOffsLim
      AssemblySwConnector_495: ecu-extract-reference=CalRegn02CmnGroupCDSnsrOffsLrngHwTqLrngEnaTiThdDSnsrOffsLrngDSnsrOffsLrngHwTqLrngEnaTiThd
      AssemblySwConnector_510: ecu-extract-reference=CalRegn02CmnGroupCDSnsrOffsLrngHwTqLrngHwAgDbndDSnsrOffsLrngDSnsrOffsLrngHwTqLrngHwAgDbnd
      AssemblySwConnector_522: ecu-extract-reference=CalRegn02CmnGroupCDSnsrOffsLrngHwTqLrngHwAgThdDSnsrOffsLrngDSnsrOffsLrngHwTqLrngHwAgThd
      AssemblySwConnector_523: ecu-extract-reference=CalRegn02CmnGroupCDSnsrOffsLrngHwTqLrngHwTqThdDSnsrOffsLrngDSnsrOffsLrngHwTqLrngHwTqThd
      AssemblySwConnector_525: ecu-extract-reference=CalRegn02CmnGroupCDSnsrOffsLrngHwTqLrngHwVelThdDSnsrOffsLrngDSnsrOffsLrngHwTqLrngHwVelThd
      AssemblySwConnector_526: ecu-extract-reference=CalRegn02CmnGroupCDSnsrOffsLrngHwTqLrngMeasTiScarDSnsrOffsLrngDSnsrOffsLrngHwTqLrngMeasTiScar
      AssemblySwConnector_552: ecu-extract-reference=CalRegn02CmnGroupCDSnsrOffsLrngHwTqLrngVehSpdThdDSnsrOffsLrngDSnsrOffsLrngHwTqLrngVehSpdThd
      AssemblySwConnector_553: ecu-extract-reference=CalRegn02CmnGroupCDSnsrOffsLrngHwTqOffsLimDSnsrOffsLrngDSnsrOffsLrngHwTqOffsLim
      AssemblySwConnector_554: ecu-extract-reference=CalRegn02CmnGroupCDSnsrOffsLrngTqInpDetnPwrEstimnThdDSnsrOffsLrngDSnsrOffsLrngTqInpDetnPwrEstimnThd
      AssemblySwConnector_556: ecu-extract-reference=CalRegn02CmnGroupCDSnsrOffsLrngTqInpDetnSinGenrAmpDSnsrOffsLrngDSnsrOffsLrngTqInpDetnSinGenrAmp
      AssemblySwConnector_557: ecu-extract-reference=CalRegn02CmnGroupCDSnsrOffsLrngTqInpDetnSinGenrFrqDSnsrOffsLrngDSnsrOffsLrngTqInpDetnSinGenrFrq
      AssemblySwConnector_558: ecu-extract-reference=CalRegn02CmnGroupCDSnsrOffsLrngTqInpDetnStg1FilGainDSnsrOffsLrngDSnsrOffsLrngTqInpDetnStg1FilGain
      AssemblySwConnector_559: ecu-extract-reference=CalRegn02CmnGroupCDSnsrOffsLrngTqInpDetnStg1WinSizeDSnsrOffsLrngDSnsrOffsLrngTqInpDetnStg1WinSize
      AssemblySwConnector_560: ecu-extract-reference=CalRegn02CmnGroupCDSnsrOffsLrngTqInpDetnStg2FilGainCenDSnsrOffsLrngDSnsrOffsLrngTqInpDetnStg2FilGainCen
      AssemblySwConnector_561: ecu-extract-reference=CalRegn02CmnGroupCDSnsrOffsLrngTqInpDetnStg2FilGainDwnDSnsrOffsLrngDSnsrOffsLrngTqInpDetnStg2FilGainDwn
      AssemblySwConnector_562: ecu-extract-reference=CalRegn02CmnGroupCDSnsrOffsLrngTqInpDetnStg2FilGainUpDSnsrOffsLrngDSnsrOffsLrngTqInpDetnStg2FilGainUp
      AssemblySwConnector_563: ecu-extract-reference=CalRegn02CmnGroupCDSnsrOffsLrngTqInpDetnStg2WinSizeDSnsrOffsLrngDSnsrOffsLrngTqInpDetnStg2WinSize
      AssemblySwConnector_564: ecu-extract-reference=CalRegn02CmnGroupCDSnsrOffsLrngYawLrngEnaDSnsrOffsLrngDSnsrOffsLrngYawLrngEna
      AssemblySwConnector_565: ecu-extract-reference=CalRegn02CmnGroupCDSnsrOffsLrngYawLrngHwAgThdDSnsrOffsLrngDSnsrOffsLrngYawLrngHwAgThd
      AssemblySwConnector_567: ecu-extract-reference=CalRegn02CmnGroupCDSnsrOffsLrngYawLrngYawAThdDSnsrOffsLrngDSnsrOffsLrngYawLrngYawAThd
      AssemblySwConnector_584: ecu-extract-reference=CalRegn02CmnGroupCDSnsrOffsLrngYawOffsFrshTiThdDSnsrOffsLrngDSnsrOffsLrngYawOffsFrshTiThd
      AssemblySwConnector_589: ecu-extract-reference=CalRegn02CmnGroupCDSnsrOffsLrngYawRateOffsLimDSnsrOffsLrngDSnsrOffsLrngYawRateOffsLim
      AssemblySwConnector_590: ecu-extract-reference=CalRegn02Inin00DGmOvrlStMgrApaHwTqFilFrqDGmOvrlStMgrDGmOvrlStMgrApaHwTqFilFrq
      AssemblySwConnector_591: ecu-extract-reference=CalRegn02Inin00DGmOvrlStMgrHwTqFilFrqDGmOvrlStMgrDGmOvrlStMgrHwTqFilFrq
      AssemblySwConnector_592: ecu-extract-reference=CalRegn02Inin00DGmOvrlStMgrLkaHwTqFilFrqDGmOvrlStMgrDGmOvrlStMgrLkaHwTqFilFrq
      AssemblySwConnector_593: ecu-extract-reference=CalRegn02Inin00DGmOvrlStMgrLkaHwTqTiThd2DGmOvrlStMgrDGmOvrlStMgrLkaHwTqTiThd2
      AssemblySwConnector_594: ecu-extract-reference=CalRegn02Inin00DGmTqArbnApaAssiScaEnaDGmTqArbnDGmTqArbnApaAssiScaEna
      AssemblySwConnector_595: ecu-extract-reference=CalRegn02Inin00DGmTqArbnApaDampgScaEnaDGmTqArbnDGmTqArbnApaDampgScaEna
      AssemblySwConnector_596: ecu-extract-reference=CalRegn02Inin00DGmTqArbnApaRtnScaEnaDGmTqArbnDGmTqArbnApaRtnScaEna
      AssemblySwConnector_597: ecu-extract-reference=CalRegn02Inin00DGmTqArbnEscMaxTqDGmTqArbnDGmTqArbnEscMaxTq
      AssemblySwConnector_598: ecu-extract-reference=CalRegn02Inin00DHowDetnEstimLpFilFrqDHowDetnDHowDetnEstimLpFilFrq
      AssemblySwConnector_599: ecu-extract-reference=CalRegn02Inin00DHowDetnStLpFilFrqDHowDetnDHowDetnStLpFilFrq
      AssemblySwConnector_600: ecu-extract-reference=CalRegn02Inin00DHowDetnTqFinalLpFilFrqDHowDetnDHowDetnTqFinalLpFilFrq
      AssemblySwConnector_635: ecu-extract-reference=CalRegn02Inin00DHowDetnTqInitLpFilFrqDHowDetnDHowDetnTqInitLpFilFrq
      AssemblySwConnector_636: ecu-extract-reference=CalRegn02Inin00DSnsrOffsLrngHwVelFilFrqDSnsrOffsLrngDSnsrOffsLrngHwVelFilFrq
      AssemblySwConnector_640: ecu-extract-reference=CalRegn02Inin00DSnsrOffsLrngTqAndAgFilFrqDSnsrOffsLrngDSnsrOffsLrngTqAndAgFilFrq
      AssemblySwConnector_641: ecu-extract-reference=CalRegn02Inin00DSnsrOffsLrngTqInpDetnHwTqFilFrqDSnsrOffsLrngDSnsrOffsLrngTqInpDetnHwTqFilFrq
      AssemblySwConnector_642: ecu-extract-reference=CalRegn02Inin00DSnsrOffsLrngYawACdngFilFrqDSnsrOffsLrngDSnsrOffsLrngYawACdngFilFrq
      AssemblySwConnector_643: ecu-extract-reference=CalRegn02Inin00DSnsrOffsLrngYawRateCdngFilFrqDSnsrOffsLrngDSnsrOffsLrngYawRateCdngFilFrq
      AssemblySwConnector_644: ecu-extract-reference=CalRegn02Inin00GroupADGmOvrlStMgrLkaHwTqTiThd1DGmOvrlStMgrDGmOvrlStMgrLkaHwTqTiThd1
      AssemblySwConnector_645: ecu-extract-reference=CalRegn02Inin00GroupCDGmOvrlStMgrApaHwTqTiThdDGmOvrlStMgrDGmOvrlStMgrApaHwTqTiThd
      AssemblySwConnector_646: ecu-extract-reference=CalRegn02Inin00GroupCDGmOvrlStMgrHaptcFrqDGmOvrlStMgrDGmOvrlStMgrHaptcFrq
      AssemblySwConnector_647: ecu-extract-reference=CalRegn02Inin00GroupCDGmOvrlStMgrHaptcReactnTiDGmOvrlStMgrDGmOvrlStMgrHaptcReactnTi
      AssemblySwConnector_649: ecu-extract-reference=CalRegn02Inin00GroupCDGmOvrlStMgrHaptcReqTiThdDGmOvrlStMgrDGmOvrlStMgrHaptcReqTiThd
      AssemblySwConnector_650: ecu-extract-reference=CalRegn02Inin00GroupCDGmStrtStopFltRateLimDGmStrtStopDGmStrtStopFltRateLim
      AssemblySwConnector_651: ecu-extract-reference=CalRegn02Inin00GroupCDGmStrtStopMod1EngTranThdDGmStrtStopDGmStrtStopMod1EngTranThd
      AssemblySwConnector_654: ecu-extract-reference=CalRegn02Inin00GroupCDGmStrtStopMod1ScaDGmStrtStopDGmStrtStopMod1Sca
      AssemblySwConnector_672: ecu-extract-reference=CalRegn02Inin00GroupCDGmStrtStopMod1ToStopRateLimDGmStrtStopDGmStrtStopMod1ToStopRateLim
      AssemblySwConnector_676: ecu-extract-reference=CalRegn02Inin00GroupCDGmStrtStopMod1VehSpdTranThdDGmStrtStopDGmStrtStopMod1VehSpdTranThd
      AssemblySwConnector_677: ecu-extract-reference=CalRegn02Inin00GroupCDGmStrtStopMod2ScaDGmStrtStopDGmStrtStopMod2Sca
      AssemblySwConnector_678: ecu-extract-reference=CalRegn02Inin00GroupCDGmStrtStopNormModEngTranThdDGmStrtStopDGmStrtStopNormModEngTranThd
      AssemblySwConnector_679: ecu-extract-reference=CalRegn02Inin00GroupCDGmStrtStopNormModVehSpdTranThdDGmStrtStopDGmStrtStopNormModVehSpdTranThd
      AssemblySwConnector_680: ecu-extract-reference=CalRegn02Inin00GroupCDGmStrtStopNormRateLimDGmStrtStopDGmStrtStopNormRateLim
      AssemblySwConnector_681: ecu-extract-reference=CalRegn02Inin00GroupCDGmStrtStopNormToMod1RateLimDGmStrtStopDGmStrtStopNormToMod1RateLim
      AssemblySwConnector_682: ecu-extract-reference=CalRegn02Inin00GroupCDGmStrtStopStopAndMod2RateLimDGmStrtStopDGmStrtStopStopAndMod2RateLim
      AssemblySwConnector_683: ecu-extract-reference=CalRegn02Inin00GroupCDGmStrtStopStopMod1HwTqTranThdDGmStrtStopDGmStrtStopStopMod1HwTqTranThd
      AssemblySwConnector_684: ecu-extract-reference=CalRegn02Inin00GroupCDGmStrtStopStopMod1HwVelTranThdDGmStrtStopDGmStrtStopStopMod1HwVelTranThd
      AssemblySwConnector_685: ecu-extract-reference=CalRegn02Inin00GroupCDGmStrtStopStopMod1TmrDGmStrtStopDGmStrtStopStopMod1Tmr
      AssemblySwConnector_686: ecu-extract-reference=CalRegn02Inin00GroupCDGmStrtStopStopMod1VehSpdTranThdDGmStrtStopDGmStrtStopStopMod1VehSpdTranThd
      AssemblySwConnector_687: ecu-extract-reference=CalRegn02Inin00GroupCDGmStrtStopStopMod2HwTqTranThdDGmStrtStopDGmStrtStopStopMod2HwTqTranThd
      AssemblySwConnector_688: ecu-extract-reference=CalRegn02Inin00GroupCDGmStrtStopStopMod2HwVelTranThdDGmStrtStopDGmStrtStopStopMod2HwVelTranThd
      AssemblySwConnector_689: ecu-extract-reference=CalRegn02Inin00GroupCDGmStrtStopStopMod2TmrDGmStrtStopDGmStrtStopStopMod2Tmr
      AssemblySwConnector_690: ecu-extract-reference=CalRegn02Inin00GroupCDGmStrtStopStopMod2VehSpdTranThdDGmStrtStopDGmStrtStopStopMod2VehSpdTranThd
      AssemblySwConnector_691: ecu-extract-reference=CalRegn02Inin00GroupCDGmStrtStopStopModScaDGmStrtStopDGmStrtStopStopModSca
      AssemblySwConnector_692: ecu-extract-reference=CalRegn02Inin00GroupCDGmTqArbnApaDiRateXDGmTqArbnDGmTqArbnApaDiRateX
      AssemblySwConnector_724: ecu-extract-reference=CalRegn02Inin00GroupCDGmTqArbnLkaSlewEnaDGmTqArbnDGmTqArbnLkaSlewEna
      AssemblySwConnector_725: ecu-extract-reference=CalRegn02Rt00GroupCDGmOvrlStMgrHwAgTarLimrDGmOvrlStMgrDGmOvrlStMgrHwAgTarLimr
      AssemblySwConnector_728: ecu-extract-reference=CalRegn02Rt00GroupCDGmOvrlStMgrShiftLvrTiThdDGmOvrlStMgrDGmOvrlStMgrShiftLvrTiThd
      AssemblySwConnector_729: ecu-extract-reference=CalRegn02Rt00GroupCDGmOvrlStMgrStandStillThdDGmOvrlStMgrDGmOvrlStMgrStandStillThd
      AssemblySwConnector_730: ecu-extract-reference=CalRegn02Rt00GroupCDGmOvrlStMgrStandStillTiThdDGmOvrlStMgrDGmOvrlStMgrStandStillTiThd
      AssemblySwConnector_731: ecu-extract-reference=CalRegn02Rt00GroupCDGmTqArbnApaDiRateYDGmTqArbnDGmTqArbnApaDiRateY
      AssemblySwConnector_732: ecu-extract-reference=CalRegn02Rt00GroupCDGmTqArbnApaEnaRateDGmTqArbnDGmTqArbnApaEnaRate
      AssemblySwConnector_733: ecu-extract-reference=CalRegn02Rt00GroupCDGmTqArbnApaSmotngHwTqLpFilFrqDGmTqArbnDGmTqArbnApaSmotngHwTqLpFilFrq
      AssemblySwConnector_749: ecu-extract-reference=CalRegn02Rt00GroupCDGmTqArbnApaSmotngXDGmTqArbnDGmTqArbnApaSmotngX
      AssemblySwConnector_751: ecu-extract-reference=CalRegn02Rt00GroupCDGmTqArbnApaSmotngYDGmTqArbnDGmTqArbnApaSmotngY
      AssemblySwConnector_752: ecu-extract-reference=CalRegn02Rt00GroupCDGmTqArbnLkaSlewXDGmTqArbnDGmTqArbnLkaSlewX
      AssemblySwConnector_759: ecu-extract-reference=CalRegn02Rt00GroupCDGmTqArbnLkaSlewYDGmTqArbnDGmTqArbnLkaSlewY
      AssemblySwConnector_1848: ecu-extract-reference=CalRegn03CmnDEotProtnSoftEndStopAuthyThdDEotProtnDEotProtnSoftEndStopAuthyThd
      AssemblySwConnector_1849: ecu-extract-reference=CalRegn03CmnDTqLoaDrvrTqNomDTqLoaDTqLoaDrvrTqNom
      AssemblySwConnector_1850: ecu-extract-reference=CalRegn03CmnDTqLoaMotTqCmdLimDTqLoaDTqLoaMotTqCmdLim
      AssemblySwConnector_1851: ecu-extract-reference=CalRegn03CmnDTqLoaMotVelAndTqBasdScaFacFallRateDTqLoaDTqLoaMotVelAndTqBasdScaFacFallRate
      AssemblySwConnector_1880: ecu-extract-reference=CalRegn03CmnDTqLoaMotVelAndTqBasdScaFacMaxDTqLoaDTqLoaMotVelAndTqBasdScaFacMax
      AssemblySwConnector_1885: ecu-extract-reference=CalRegn03CmnDTqLoaMotVelAndTqBasdScaFacMinDTqLoaDTqLoaMotVelAndTqBasdScaFacMin
      AssemblySwConnector_1886: ecu-extract-reference=CalRegn03CmnDTqLoaMotVelAndTqBasdScaFacRiseRateDTqLoaDTqLoaMotVelAndTqBasdScaFacRiseRate
      AssemblySwConnector_1889: ecu-extract-reference=CalRegn03CmnDTqLoaMotVelMgnThdDTqLoaDTqLoaMotVelMgnThd
      AssemblySwConnector_1892: ecu-extract-reference=CalRegn03CmnDTqLoaTqCmdLimYDTqLoaDTqLoaTqCmdLimY
      AssemblySwConnector_1893: ecu-extract-reference=CalRegn03CmnDTqLoaTqCmdMgnThdDTqLoaDTqLoaTqCmdMgnThd
      AssemblySwConnector_1947: ecu-extract-reference=CalRegn03CmnDTqLoaVehLatADifScaFacFallRateDTqLoaDTqLoaVehLatADifScaFacFallRate
      AssemblySwConnector_1948: ecu-extract-reference=CalRegn03CmnDTqLoaVehLatADifScaFacRiseRateDTqLoaDTqLoaVehLatADifScaFacRiseRate
      AssemblySwConnector_1949: ecu-extract-reference=CalRegn03CmnDTqLoaVehLatADifScaFacXDTqLoaDTqLoaVehLatADifScaFacX
      AssemblySwConnector_1950: ecu-extract-reference=CalRegn03CmnDTqLoaVehLatADifScaFacYDTqLoaDTqLoaVehLatADifScaFacY
      AssemblySwConnector_1951: ecu-extract-reference=CalRegn03CmnDTqLoaVehLatAEstimnFilFrqDTqLoaDTqLoaVehLatAEstimnFilFrq
      AssemblySwConnector_1952: ecu-extract-reference=CalRegn03CmnDTqLoaVehLatAGainYDTqLoaDTqLoaVehLatAGainY
      AssemblySwConnector_1954: ecu-extract-reference=CalRegn03CmnDTqLoaVehSpdScaFacXDTqLoaDTqLoaVehSpdScaFacX
      AssemblySwConnector_1955: ecu-extract-reference=CalRegn03CmnDTqLoaVehSpdScaFacYDTqLoaDTqLoaVehSpdScaFacY
      AssemblySwConnector_1956: ecu-extract-reference=CalRegn03CmnDTqLoaVehSpdXDTqLoaDTqLoaVehSpdX
      AssemblySwConnector_1957: ecu-extract-reference=CalRegn03CmnDTqLoaVehSteerRatDTqLoaDTqLoaVehSteerRat
      AssemblySwConnector_1958: ecu-extract-reference=CalRegn03CmnDTqLoaVehUnderSteerGrdtDTqLoaDTqLoaVehUnderSteerGrdt
      AssemblySwConnector_1959: ecu-extract-reference=CalRegn03CmnDTqLoaVehWhlBasDTqLoaDTqLoaVehWhlBas
      AssemblySwConnector_1960: ecu-extract-reference=CalRegn03CmnGroupBDEotProtnActvRegnBypMaxThdDEotProtnDEotProtnActvRegnBypMaxThd
      AssemblySwConnector_1961: ecu-extract-reference=CalRegn03CmnGroupBDEotProtnDeltaTqThdDEotProtnDEotProtnDeltaTqThd
      AssemblySwConnector_1962: ecu-extract-reference=CalRegn03CmnGroupBDEotProtnMotSpdIncptYDEotProtnDEotProtnMotSpdIncptY
      AssemblySwConnector_1963: ecu-extract-reference=CalRegn03CmnGroupBDInertiaCmpVelDampgWhlImbRejctnBlndXDInertiaCmpVelDInertiaCmpVelDampgWhlImbRejctnBlndX
      AssemblySwConnector_1964: ecu-extract-reference=CalRegn03CmnGroupBDInertiaCmpVelDampgWhlImbRejctnBlndYDInertiaCmpVelDInertiaCmpVelDampgWhlImbRejctnBlndY
      AssemblySwConnector_1965: ecu-extract-reference=CalRegn03CmnGroupBDPullCmpActvCmpLrnTiDecShoTermDPullCmpActvDPullCmpActvCmpLrnTiDecShoTerm
      AssemblySwConnector_1966: ecu-extract-reference=CalRegn03CmnGroupBDPullCmpActvCmpLrnTiIncShoTermDPullCmpActvDPullCmpActvCmpLrnTiIncShoTerm
      AssemblySwConnector_1967: ecu-extract-reference=CalRegn03CmnGroupBDPullCmpActvCmpLrnTiLongTermDPullCmpActvDPullCmpActvCmpLrnTiLongTerm
      AssemblySwConnector_1968: ecu-extract-reference=CalRegn03CmnGroupBDPullCmpActvCmpShoTermRstHwAgThdDPullCmpActvDPullCmpActvCmpShoTermRstHwAgThd
      AssemblySwConnector_1969: ecu-extract-reference=CalRegn03CmnGroupBDPullCmpActvCmpShoTermRstHwTqThdDPullCmpActvDPullCmpActvCmpShoTermRstHwTqThd
      AssemblySwConnector_1970: ecu-extract-reference=CalRegn03CmnGroupBDPullCmpActvCmpShoTermRstLatAThdDPullCmpActvDPullCmpActvCmpShoTermRstLatAThd
      AssemblySwConnector_1971: ecu-extract-reference=CalRegn03CmnGroupBDPullCmpActvCmpShoTermRstYawRateThdDPullCmpActvDPullCmpActvCmpShoTermRstYawRateThd
      AssemblySwConnector_1972: ecu-extract-reference=CalRegn03CmnGroupBDPullCmpActvHwTqFilFrqLongTermDPullCmpActvDPullCmpActvHwTqFilFrqLongTerm
      AssemblySwConnector_1973: ecu-extract-reference=CalRegn03CmnGroupBDPullCmpActvHwTqFilFrqLrngEnaDPullCmpActvDPullCmpActvHwTqFilFrqLrngEna
      AssemblySwConnector_1974: ecu-extract-reference=CalRegn03CmnGroupBDPullCmpActvHwTqFilFrqShoTermDPullCmpActvDPullCmpActvHwTqFilFrqShoTerm
      AssemblySwConnector_1975: ecu-extract-reference=CalRegn03CmnGroupBDPullCmpActvLongTermLimDPullCmpActvDPullCmpActvLongTermLim
      AssemblySwConnector_1976: ecu-extract-reference=CalRegn03CmnGroupBDPullCmpActvLrngEnaAgConfMinMgnDPullCmpActvDPullCmpActvLrngEnaAgConfMinMgn
      AssemblySwConnector_1977: ecu-extract-reference=CalRegn03CmnGroupBDPullCmpActvLrngEnaHwAgMaxMgnDPullCmpActvDPullCmpActvLrngEnaHwAgMaxMgn
      AssemblySwConnector_1978: ecu-extract-reference=CalRegn03CmnGroupBDPullCmpActvLrngEnaHwTqMaxMgnDPullCmpActvDPullCmpActvLrngEnaHwTqMaxMgn
      AssemblySwConnector_1979: ecu-extract-reference=CalRegn03CmnGroupBDPullCmpActvLrngEnaHwVelMaxMgnDPullCmpActvDPullCmpActvLrngEnaHwVelMaxMgn
      AssemblySwConnector_1980: ecu-extract-reference=CalRegn03CmnGroupBDPullCmpActvLrngEnaLatAMaxMgnDPullCmpActvDPullCmpActvLrngEnaLatAMaxMgn
      AssemblySwConnector_1981: ecu-extract-reference=CalRegn03CmnGroupBDPullCmpActvLrngEnaTiThdDPullCmpActvDPullCmpActvLrngEnaTiThd
      AssemblySwConnector_1982: ecu-extract-reference=CalRegn03CmnGroupBDPullCmpActvLrngEnaVehSpdMaxMgnDPullCmpActvDPullCmpActvLrngEnaVehSpdMaxMgn
      AssemblySwConnector_1983: ecu-extract-reference=CalRegn03CmnGroupBDPullCmpActvLrngEnaVehSpdMinMgnDPullCmpActvDPullCmpActvLrngEnaVehSpdMinMgn
      AssemblySwConnector_1984: ecu-extract-reference=CalRegn03CmnGroupBDPullCmpActvLrngEnaVehSpdRateMaxMgnDPullCmpActvDPullCmpActvLrngEnaVehSpdRateMaxMgn
      AssemblySwConnector_1985: ecu-extract-reference=CalRegn03CmnGroupBDPullCmpActvLrngEnaYawRateMaxMgnDPullCmpActvDPullCmpActvLrngEnaYawRateMaxMgn
      AssemblySwConnector_1986: ecu-extract-reference=CalRegn03CmnGroupBDPullCmpActvOpstSignTiShoTermDPullCmpActvDPullCmpActvOpstSignTiShoTerm
      AssemblySwConnector_1987: ecu-extract-reference=CalRegn03CmnGroupBDPullCmpActvOutpMaxRateDPullCmpActvDPullCmpActvOutpMaxRate
      AssemblySwConnector_1988: ecu-extract-reference=CalRegn03CmnGroupBDPullCmpActvPullCmpShoTermLimDPullCmpActvDPullCmpActvPullCmpShoTermLim
      AssemblySwConnector_1989: ecu-extract-reference=CalRegn03CmnGroupBDPullCmpActvPullCmpTotLimDPullCmpActvDPullCmpActvPullCmpTotLim
      AssemblySwConnector_1990: ecu-extract-reference=CalRegn03CmnGroupBDPullCmpActvPullErrLimLongTermDPullCmpActvDPullCmpActvPullErrLimLongTerm
      AssemblySwConnector_1991: ecu-extract-reference=CalRegn03CmnGroupBDPullCmpActvPullErrMgnThdDPullCmpActvDPullCmpActvPullErrMgnThd
      AssemblySwConnector_1992: ecu-extract-reference=CalRegn03CmnGroupBDPullCmpActvPullErrShoTermLimDPullCmpActvDPullCmpActvPullErrShoTermLim
      AssemblySwConnector_1993: ecu-extract-reference=CalRegn03CmnGroupBDPullCmpActvShoTermRampTiDPullCmpActvDPullCmpActvShoTermRampTi
      AssemblySwConnector_2006: ecu-extract-reference=CalRegn03CmnGroupBDPullCmpActvVehSpdScaTblXDPullCmpActvDPullCmpActvVehSpdScaTblX
      AssemblySwConnector_2022: ecu-extract-reference=CalRegn03CmnGroupBDPullCmpActvVehSpdScaTblYDPullCmpActvDPullCmpActvVehSpdScaTblY
      AssemblySwConnector_2023: ecu-extract-reference=CalRegn03CmnGroupCDGmOvrlStMgrLoaMtgtnHaptcFbOffTiDGmOvrlStMgrDGmOvrlStMgrLoaMtgtnHaptcFbOffTi
      AssemblySwConnector_2024: ecu-extract-reference=CalRegn03CmnGroupCDGmOvrlStMgrLoaMtgtnHaptcFbOnTiDGmOvrlStMgrDGmOvrlStMgrLoaMtgtnHaptcFbOnTi
      AssemblySwConnector_2025: ecu-extract-reference=CalRegn03CmnGroupCDGmOvrlStMgrLoaMtgtnHaptcFbTqMaxDGmOvrlStMgrDGmOvrlStMgrLoaMtgtnHaptcFbTqMax
      AssemblySwConnector_2026: ecu-extract-reference=CalRegn03CmnGroupCDGmOvrlStMgrLoaMtgtnHaptcFbTqMinDGmOvrlStMgrDGmOvrlStMgrLoaMtgtnHaptcFbTqMin
      AssemblySwConnector_2027: ecu-extract-reference=CalRegn03CmnGroupCDGmOvrlStMgrLoaMtgtnHaptcFbVehSpdMaxDGmOvrlStMgrDGmOvrlStMgrLoaMtgtnHaptcFbVehSpdMax
      AssemblySwConnector_2028: ecu-extract-reference=CalRegn03CmnGroupCDGmOvrlStMgrLoaMtgtnHaptcFbVehSpdMinDGmOvrlStMgrDGmOvrlStMgrLoaMtgtnHaptcFbVehSpdMin
      AssemblySwConnector_2029: ecu-extract-reference=CalRegn03CmnGroupCDGmOvrlStMgrLoaMtgtnHaptcFrqDGmOvrlStMgrDGmOvrlStMgrLoaMtgtnHaptcFrq
      AssemblySwConnector_2030: ecu-extract-reference=CalRegn03CmnGroupCDGmOvrlStMgrLoaMtgtnTqOscnAmpYDGmOvrlStMgrDGmOvrlStMgrLoaMtgtnTqOscnAmpY
      AssemblySwConnector_2031: ecu-extract-reference=CalRegn03CmnGroupCDGmOvrlStMgrLoaMtgtnVehSpdXDGmOvrlStMgrDGmOvrlStMgrLoaMtgtnVehSpdX
      AssemblySwConnector_2032: ecu-extract-reference=CalRegn03Inin00DEotLrngRackTrvlMinDCustDiagcDEotLrngRackTrvlMin
      AssemblySwConnector_2037: ecu-extract-reference=CalRegn03Inin00DEotLrngEotLrnTmrDEotLrngDEotLrngEotLrnTmr
      AssemblySwConnector_2038: ecu-extract-reference=CalRegn03Inin00DEotLrngHwTqEotLrnDEotLrngDEotLrngHwTqEotLrn
      AssemblySwConnector_2039: ecu-extract-reference=CalRegn03Inin00DEotLrngMotVelEotLrnDEotLrngDEotLrngMotVelEotLrn
      AssemblySwConnector_2040: ecu-extract-reference=CalRegn03Inin00DEotLrngRackTrvlMaxDEotLrngDEotLrngRackTrvlMax
      AssemblySwConnector_2041: ecu-extract-reference=CalRegn03Inin00DEotLrngRstAuthyMinDEotLrngDEotLrngRstAuthyMin
      AssemblySwConnector_2042: ecu-extract-reference=CalRegn03Inin00DEotProtnDftPosnDEotProtnDEotProtnDftPosn
      AssemblySwConnector_2043: ecu-extract-reference=CalRegn03Inin00DEotProtnEntrStLpFilFrqDEotProtnDEotProtnEntrStLpFilFrq
      AssemblySwConnector_2044: ecu-extract-reference=CalRegn03Inin00DEotProtnExitStLpFilFrqDEotProtnDEotProtnExitStLpFilFrq
      AssemblySwConnector_2045: ecu-extract-reference=CalRegn03Inin00DEotProtnHwAgMaxDEotProtnDEotProtnHwAgMax
      AssemblySwConnector_2048: ecu-extract-reference=CalRegn03Inin00DEotProtnHwTqLpFilFrqDEotProtnDEotProtnHwTqLpFilFrq
      AssemblySwConnector_2049: ecu-extract-reference=CalRegn03Inin00DEotProtnMotSpdIncptScaDEotProtnDEotProtnMotSpdIncptSca
      AssemblySwConnector_2050: ecu-extract-reference=CalRegn03Inin00DEotProtnMotSpdIncptXDEotProtnDEotProtnMotSpdIncptX
      AssemblySwConnector_2051: ecu-extract-reference=CalRegn03Inin00DEotProtnPosnRampStepDEotProtnDEotProtnPosnRampStep
      AssemblySwConnector_2052: ecu-extract-reference=CalRegn03Inin00DEotProtnRackTrvlLimrAuthyThdDEotProtnDEotProtnRackTrvlLimrAuthyThd
      AssemblySwConnector_2053: ecu-extract-reference=CalRegn03Inin00DEotProtnRackTrvlLimrAuthyThdLimdDEotProtnDEotProtnRackTrvlLimrAuthyThdLimd
      AssemblySwConnector_2054: ecu-extract-reference=CalRegn03Inin00DEotProtnRackTrvlLimrEnaDEotProtnDEotProtnRackTrvlLimrEna
      AssemblySwConnector_2055: ecu-extract-reference=CalRegn03Inin00DEotProtnRunEotVelImpctAndSoftEndStopDEotProtnDEotProtnRunEotVelImpctAndSoftEndStop
      AssemblySwConnector_2056: ecu-extract-reference=CalRegn03Inin00DEotProtnSoftEndStopEnaDEotProtnDEotProtnSoftEndStopEna
      AssemblySwConnector_2057: ecu-extract-reference=CalRegn03Inin00DEotProtnHwAgMinDEotProtnFwlDEotProtnHwAgMin
      AssemblySwConnector_2058: ecu-extract-reference=CalRegn03Inin00DGmOvrlStMgrLoaMtgtnHaptcFbStrtOnTiDGmOvrlStMgrDGmOvrlStMgrLoaMtgtnHaptcFbStrtOnTi
      AssemblySwConnector_2059: ecu-extract-reference=CalRegn03Inin00DGmOvrlStMgrLoaMtgtnStrtHaptcAmpDGmOvrlStMgrDGmOvrlStMgrLoaMtgtnStrtHaptcAmp
      AssemblySwConnector_2060: ecu-extract-reference=CalRegn03Inin00DGmOvrlStMgrLoaStIgnCntrThdDGmOvrlStMgrDGmOvrlStMgrLoaStIgnCntrThd
      AssemblySwConnector_2061: ecu-extract-reference=CalRegn03Inin00DSysGlbPrmSysTqRatDHwAgSnsrlsDSysGlbPrmSysTqRat
      AssemblySwConnector_2062: ecu-extract-reference=CalRegn03Inin00DInertiaCmpVelMotInertiaDInertiaCmpVelDInertiaCmpVelMotInertia
      AssemblySwConnector_2063: ecu-extract-reference=CalRegn03Inin00DInertiaCmpVelNotchFilStructDInertiaCmpVelDInertiaCmpVelNotchFilStruct
      AssemblySwConnector_2064: ecu-extract-reference=CalRegn03Inin00DInertiaCmpVelTqSnsrVelFilFrqDInertiaCmpVelDInertiaCmpVelTqSnsrVelFilFrq
      AssemblySwConnector_2066: ecu-extract-reference=CalRegn03Inin00DSysGlbPrmSysKineRatDInertiaCmpVelDSysGlbPrmSysKineRat
      AssemblySwConnector_2067: ecu-extract-reference=CalRegn03Inin00DPullCmpActvYawRateFilFrqDPullCmpActvDPullCmpActvYawRateFilFrq
