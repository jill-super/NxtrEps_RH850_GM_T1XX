[part 4 of 4: package /COM/VECTOR/CFG/WORKFLOW/SYSDESC/SYNC]
AUTOSAR XML (schema 4-0-3)
package /COM/VECTOR/CFG/WORKFLOW/SYSDESC/SYNC  (continued)
  composition sw component type COMPOSITIONTYPE  (continued)
    connect MotTqTranlDampg.MotTqCmdMrfDampd -> PwrLimr.MotTqCmdMrf
    connect PartNr.CustMfgEnSt -> CustDiagc.CustMfgEnaSt
    connect PartNr.PartNrBasMdlPartNrAlphaCodRd -> CustDiagc.PartNrBasMdlPartNrAlphaCodRd
    connect PartNr.PartNrBasMdlPartNrRd -> CustDiagc.PartNrBasMdlPartNrRd
    connect PartNr.PartNrCalProgdStsRd -> CustDiagc.PartNrCalProgdStsRd
    connect PartNr.PartNrCalProgdStsWr -> CustDiagc.PartNrCalProgdStsWr
    connect PartNr.PartNrCcaMfgTrakgRd -> CustDiagc.PartNrCcaMfgTrakgRd
    connect PartNr.PartNrCmpdVehPartnProdtStructRd -> CustDiagc.PartNrCmpdVehPartnProdtStructRd
    connect PartNr.PartNrCtrlPidKeyChk -> CustDiagc.PartNrCtrlPidKeyChk
    connect PartNr.PartNrCtrlPidKeyWr -> CustDiagc.PartNrCtrlPidKeyWr
    connect PartNr.PartNrCtrlPidSeedRd -> CustDiagc.PartNrCtrlPidSeedRd
    connect PartNr.PartNrCustMfgEnaCntrRd -> CustDiagc.PartNrCustMfgEnaCntrRd
    connect PartNr.PartNrCustMfgEnaCntrWr -> CustDiagc.PartNrCustMfgEnaCntrWr
    connect PartNr.PartNrDataUniversalNrSysIdRd -> CustDiagc.PartNrDataUniversalNrSysIdRd
    connect PartNr.PartNrEndMdlPartNrAlphaCodRd -> CustDiagc.PartNrEndMdlPartNrAlphaCodRd
    connect PartNr.PartNrEndMdlPartNrAlphaCodWr -> CustDiagc.PartNrEndMdlPartNrAlphaCodWr
    connect PartNr.PartNrEndMdlPartNrRd -> CustDiagc.PartNrEndMdlPartNrRd
    connect PartNr.PartNrEndMdlPartNrWr -> CustDiagc.PartNrEndMdlPartNrWr
    connect PartNr.PartNrLstRepairShopCodRd -> CustDiagc.PartNrLstRepairShopCodRd
    connect PartNr.PartNrNxtrMfgTrakgRd -> CustDiagc.PartNrNxtrMfgTrakgRd
    connect PartNr.PartNrNxtrMfgTrakgWr -> CustDiagc.PartNrNxtrMfgTrakgWr
    connect PartNr.PartNrProgmDateRd -> CustDiagc.PartNrProgmDateRd
    connect PartNr.PartNrProgmDateWr -> CustDiagc.PartNrProgmDateWr
    connect PartNr.PartNrProgmSessionKeyChk -> CustDiagc.PartNrProgmSessionKeyChk
    connect PartNr.PartNrProgmSessionSeedRd -> CustDiagc.PartNrProgmSessionSeedRd
    connect PartNr.PartNrRepairShopCodRd -> CustDiagc.PartNrRepairShopCodRd
    connect PartNr.PartNrRepairShopCodWr -> CustDiagc.PartNrRepairShopCodWr
    connect PartNr.PartNrSysCodVersNrRd -> CustDiagc.PartNrSysCodVersNrRd
    connect PartNr.PartNrSysCodVersNrWr -> CustDiagc.PartNrSysCodVersNrWr
    connect PartNr.PartNrSysNameRd -> CustDiagc.PartNrSysNameRd
    connect PartNr.PartNrSysNameWr -> CustDiagc.PartNrSysNameWr
    connect PartNr.PartNrVinDataRd -> CustDiagc.PartNrVinDataRd
    connect PartNr.PartNrVinDataWr -> CustDiagc.PartNrVinDataWr
    connect PolarityCfg.HwTq{0..3}Polarity -> CDD_HwTq{0..3}Meas.HwTq{0..3}Polarity
    connect PolarityCfg.AssiMechPolarity -> CDD_MotAgCmp.AssiMechPolarity
    connect PolarityCfg.MotAgMecl0Polarity -> CDD_MotCtrlMgr.MotAgMecl0Polarity
    connect PolarityCfg.MotAgMecl1Polarity -> CDD_MotCtrlMgr.MotAgMecl1Polarity
    connect PolarityCfg.MotElecMeclPolarity -> CDD_MotCtrlMgr.MotElecMeclPolarity
    connect PolarityCfg.AssiMechPolarity -> CDD_MotVel.AssiMechPolarity
    connect PolarityCfg.MotElecMeclPolarity -> CDD_SinVltgGenn.MotElecMeclPolarity
    connect PolarityCfg.PolarityCfgRead -> CmnMfgSrv.PolarityCfgRead
    connect PolarityCfg.PolarityCfgWr -> CmnMfgSrv.PolarityCfgWr
    connect PolarityCfg.HwAg0Polarity -> HwAg0Meas.HwAg0Polarity
    connect PolarityCfg.HwAg1Polarity -> HwAg1Meas.HwAg1Polarity
    connect PolarityCfg.MotAgMecl2Polarity -> MotAg2Meas.MotAgMecl2Polarity
    connect PolarityCfg.AssiMechPolarity -> MotTqTranlDampg.AssiMechPolarity
    connect PullCmpActv.PullCmpCmd -> AssiSumLim.PullCmpCmd
    connect PullCmpActv.GetPullCmpPrm -> CmnMfgSrv.GetPullCmpPrm
    connect PullCmpActv.RstPullCmp -> CmnMfgSrv.RstPullCmp
    connect PullCmpActv.SetPullCmpLongTerm -> CmnMfgSrv.SetPullCmpLongTerm
    connect PullCmpActv.SetPullCmpShoTerm -> CmnMfgSrv.SetPullCmpShoTerm
    connect PwrDiscnct.PwrDiscnctATestCmpl -> PwrUpSeq.PwrDiscnctATestCmpl
    connect PwrDiscnct.PwrDiscnctBTestCmpl -> PwrUpSeq.PwrDiscnctBTestCmpl
    connect PwrLimr.PwrLimrRednFac -> AssiSumLim.PwrLimrRednFac
    connect PwrUpSeq.StrtUpSt -> BattVltgCorrln.StrtUpSt
    connect PwrUpSeq.StrtUpSt -> CDD_CurrMeas.StrtUpSt
    connect PwrUpSeq.StrtUpSt -> PwrDiscnct.StrtUpSt
    connect PwrUpSeq.StrtUpSt -> SysStMod.StrtUpSt
    connect PwrUpSeq.SysStWrmIninCmpl -> SysStMod.SysStWrmIninCmpl
    connect PwrUpSeq.StrtUpSt -> TmplMonr.StrtUpSt
    connect SerlComInpProxy.SerlComInpProxyGmLanIdRd -> CustDiagc.PartNrGmLanIdRd
    connect SerlComInpProxy.EngRunActvRaw -> GmMsg0C9BusHiSpd.EngRunActvRaw
    connect SerlComInpProxy.EngSpdRaw -> GmMsg0C9BusHiSpd.EngSpdRaw
    connect SerlComInpProxy.EngSpdStsRaw -> GmMsg0C9BusHiSpd.EngSpdStsRaw
    connect SerlComInpProxy.LstRxnTiMsg0C9 -> GmMsg0C9BusHiSpd.LstRxnTiMsg0C9
    connect SerlComInpProxy.PtCrkActvRaw -> GmMsg0C9BusHiSpd.PtCrkActvRaw
    connect SerlComInpProxy.LstRxnTiMsg17D -> GmMsg17DBusHiSpd.LstRxnTiMsg17D
    connect SerlComInpProxy.VehStabyEnhmtStsRaw -> GmMsg17DBusHiSpd.VehStabyEnhmtStsRaw
    connect SerlComInpProxy.LstRxnTiMsg180BusChassisExp -> GmMsg180BusChassisExp.LstRxnTiMsg180BusChassisExp
    connect SerlComInpProxy.TqOvrlAlvRollgCntrRaw -> GmMsg180BusChassisExp.TqOvrlAlvRollgCntrRaw
    connect SerlComInpProxy.TqOvrlCmdChksRaw -> GmMsg180BusChassisExp.TqOvrlCmdChksRaw
    connect SerlComInpProxy.TqOvrlDeltaTqCmdActvRaw -> GmMsg180BusChassisExp.TqOvrlDeltaTqCmdActvRaw
    connect SerlComInpProxy.TqOvrlDeltaTqCmdValRaw -> GmMsg180BusChassisExp.TqOvrlDeltaTqCmdValRaw
    connect SerlComInpProxy.LkaCmdProtnValRaw -> GmMsg180BusHiSpd.LkaCmdProtnValRaw
    connect SerlComInpProxy.LkaCmdRollgCntrRaw -> GmMsg180BusHiSpd.LkaCmdRollgCntrRaw
    connect SerlComInpProxy.LkaCmdTqReqActvRaw -> GmMsg180BusHiSpd.LkaCmdTqReqActvRaw
    connect SerlComInpProxy.LkaCmdTqValRaw -> GmMsg180BusHiSpd.LkaCmdTqValRaw
    connect SerlComInpProxy.LstRxnTiMsg180BusHiSpd -> GmMsg180BusHiSpd.LstRxnTiMsg180BusHiSpd
    connect SerlComInpProxy.LstRxnTiMsg182 -> GmMsg182BusChassisExp.LstRxnTiMsg182
    connect SerlComInpProxy.VehDynOverUnderSteerVldRaw -> GmMsg182BusChassisExp.VehDynOverUnderSteerVldRaw
    connect SerlComInpProxy.VehStabyEnhmtLgtALoReslRaw -> GmMsg182BusChassisExp.VehStabyEnhmtLgtALoReslRaw
    connect SerlComInpProxy.VehStabyEnhmtLgtALoReslVldRaw -> GmMsg182BusChassisExp.VehStabyEnhmtLgtALoReslVldRaw
    connect SerlComInpProxy.AbsActvRaw -> GmMsg1E9BusHiSpd.AbsActvRaw
    connect SerlComInpProxy.AbsFaildRaw -> GmMsg1E9BusHiSpd.AbsFaildRaw
    connect SerlComInpProxy.LstRxnTiMsg1E9 -> GmMsg1E9BusHiSpd.LstRxnTiMsg1E9
    connect SerlComInpProxy.TracCtrlSysActvRaw -> GmMsg1E9BusHiSpd.TracCtrlSysActvRaw
    connect SerlComInpProxy.TracCtrlSysEnaRaw -> GmMsg1E9BusHiSpd.TracCtrlSysEnaRaw
    connect SerlComInpProxy.VehDynCtrlSysStRaw -> GmMsg1E9BusHiSpd.VehDynCtrlSysStRaw
    connect SerlComInpProxy.VehDynYawRateRaw -> GmMsg1E9BusHiSpd.VehDynYawRateRaw
    connect SerlComInpProxy.VehDynYawRateVldRaw -> GmMsg1E9BusHiSpd.VehDynYawRateVldRaw
    connect SerlComInpProxy.VehStabyEnhmtActvRaw -> GmMsg1E9BusHiSpd.VehStabyEnhmtActvRaw
    connect SerlComInpProxy.VehStabyEnhmtLatARaw -> GmMsg1E9BusHiSpd.VehStabyEnhmtLatARaw
    connect SerlComInpProxy.VehStabyEnhmtLatAVldRaw -> GmMsg1E9BusHiSpd.VehStabyEnhmtLatAVldRaw
    connect SerlComInpProxy.LstRxnTiMsg1F1 -> GmMsg1F1BusHiSpd.LstRxnTiMsg1F1
    connect SerlComInpProxy.SysBackUpPwrModEnaRaw -> GmMsg1F1BusHiSpd.SysBackUpPwrModEnaRaw
    connect SerlComInpProxy.SysBackUpPwrModRaw -> GmMsg1F1BusHiSpd.SysBackUpPwrModRaw
    connect SerlComInpProxy.SysPwrModRaw -> GmMsg1F1BusHiSpd.SysPwrModRaw
    connect SerlComInpProxy.LstRxnTiMsg1F5 -> GmMsg1F5BusHiSpd.LstRxnTiMsg1F5
    connect SerlComInpProxy.ShiftLvrPosnRaw -> GmMsg1F5BusHiSpd.ShiftLvrPosnRaw
    connect SerlComInpProxy.ShiftLvrPosnVldRaw -> GmMsg1F5BusHiSpd.ShiftLvrPosnVldRaw
    connect SerlComInpProxy.AbsActvProtdProtnValRaw -> GmMsg214BusHiSpd.AbsActvProtdProtnValRaw
    connect SerlComInpProxy.AbsActvProtdRaw -> GmMsg214BusHiSpd.AbsActvProtdRaw
    connect SerlComInpProxy.AbsActvProtdRollgCntrRaw -> GmMsg214BusHiSpd.AbsActvProtdRollgCntrRaw
    connect SerlComInpProxy.LstRxnTiMsg214 -> GmMsg214BusHiSpd.LstRxnTiMsg214
    connect SerlComInpProxy.RdntVehStabyEnhmtSysActvRaw -> GmMsg214BusHiSpd.RdntVehStabyEnhmtSysActvRaw
    connect SerlComInpProxy.RdntVehStabyEnhmtSysActvRollgCntrRaw -> GmMsg214BusHiSpd.RdntVehStabyEnhmtSysActvRollgCntrRaw
    connect SerlComInpProxy.LstRxnTiMsg232 -> GmMsg232BusHiSpd.LstRxnTiMsg232
    connect SerlComInpProxy.SteerSysPrfmncModReqRaw -> GmMsg232BusHiSpd.SteerSysPrfmncModReqRaw
    connect SerlComInpProxy.LstRxnTiMsg337BusChassisExp -> GmMsg337BusChassisExp.LstRxnTiMsg337BusChassisExp
    connect SerlComInpProxy.SteerWhlAgReqActvRaw -> GmMsg337BusChassisExp.SteerWhlAgReqActvRaw
    connect SerlComInpProxy.SteerWhlAgReqActvVldRaw -> GmMsg337BusChassisExp.SteerWhlAgReqActvVldRaw
    connect SerlComInpProxy.SteerWhlAgReqProtnValRaw -> GmMsg337BusChassisExp.SteerWhlAgReqProtnValRaw
    connect SerlComInpProxy.SteerWhlAgReqRollgCntrRaw -> GmMsg337BusChassisExp.SteerWhlAgReqRollgCntrRaw
    connect SerlComInpProxy.SteerWhlAgReqTarAgRaw -> GmMsg337BusChassisExp.SteerWhlAgReqTarAgRaw
    connect SerlComInpProxy.SteerWhlFbReqActvProtnValRaw -> GmMsg337BusChassisExp.SteerWhlFbReqActvProtnValRaw
    connect SerlComInpProxy.SteerWhlFbReqActvRaw -> GmMsg337BusChassisExp.SteerWhlFbReqActvRaw
    connect SerlComInpProxy.SteerWhlFbReqActvRollgCntrRaw -> GmMsg337BusChassisExp.SteerWhlFbReqActvRollgCntrRaw
    connect SerlComInpProxy.LstRxnTiMsg348BusChassisExp -> GmMsg348BusChassisExp.LstRxnTiMsg348BusChassisExp
    connect SerlComInpProxy.WhlGndVelLeDrvnRawBusChassisExp -> GmMsg348BusChassisExp.WhlGndVelLeDrvnRawBusChassisExp
    connect SerlComInpProxy.WhlGndVelLeDrvnVldRawBusChassisExp -> GmMsg348BusChassisExp.WhlGndVelLeDrvnVldRawBusChassisExp
    connect SerlComInpProxy.WhlGndVelRiDrvnRawBusChassisExp -> GmMsg348BusChassisExp.WhlGndVelRiDrvnRawBusChassisExp
    connect SerlComInpProxy.WhlGndVelRiDrvnVldRawBusChassisExp -> GmMsg348BusChassisExp.WhlGndVelRiDrvnVldRawBusChassisExp
    connect SerlComInpProxy.LstRxnTiMsg348BusHiSpd -> GmMsg348BusHiSpd.LstRxnTiMsg348BusHiSpd
    connect SerlComInpProxy.WhlGndVelLeDrvnRawBusHiSpd -> GmMsg348BusHiSpd.WhlGndVelLeDrvnRawBusHiSpd
    connect SerlComInpProxy.WhlGndVelLeDrvnVldRawBusHiSpd -> GmMsg348BusHiSpd.WhlGndVelLeDrvnVldRawBusHiSpd
    connect SerlComInpProxy.WhlGndVelRiDrvnRawBusHiSpd -> GmMsg348BusHiSpd.WhlGndVelRiDrvnRawBusHiSpd
    connect SerlComInpProxy.WhlGndVelRiDrvnVldRawBusHiSpd -> GmMsg348BusHiSpd.WhlGndVelRiDrvnVldRawBusHiSpd
    connect SerlComInpProxy.LstRxnTiMsg34ABusChassisExp -> GmMsg34ABusChassisExp.LstRxnTiMsg34ABusChassisExp
    connect SerlComInpProxy.WhlGndVelLeNonDrvnRawBusChassisExp -> GmMsg34ABusChassisExp.WhlGndVelLeNonDrvnRawBusChassisExp
    connect SerlComInpProxy.WhlGndVelLeNonDrvnVldRawBusChassisExp -> GmMsg34ABusChassisExp.WhlGndVelLeNonDrvnVldRawBusChassisExp
    connect SerlComInpProxy.WhlGndVelRiNonDrvnRawBusChassisExp -> GmMsg34ABusChassisExp.WhlGndVelRiNonDrvnRawBusChassisExp
    connect SerlComInpProxy.WhlGndVelRiNonDrvnVldRawBusChassisExp -> GmMsg34ABusChassisExp.WhlGndVelRiNonDrvnVldRawBusChassisExp
    connect SerlComInpProxy.LstRxnTiMsg34ABusHiSpd -> GmMsg34ABusHiSpd.LstRxnTiMsg34ABusHiSpd
    connect SerlComInpProxy.WhlGndVelLeNonDrvnRawBusHiSpd -> GmMsg34ABusHiSpd.WhlGndVelLeNonDrvnRawBusHiSpd
    connect SerlComInpProxy.WhlGndVelLeNonDrvnVldRawBusHiSpd -> GmMsg34ABusHiSpd.WhlGndVelLeNonDrvnVldRawBusHiSpd
    connect SerlComInpProxy.WhlGndVelRiNonDrvnRawBusHiSpd -> GmMsg34ABusHiSpd.WhlGndVelRiNonDrvnRawBusHiSpd
    connect SerlComInpProxy.WhlGndVelRiNonDrvnVldRawBusHiSpd -> GmMsg34ABusHiSpd.WhlGndVelRiNonDrvnVldRawBusHiSpd
    connect SerlComInpProxy.LstRxnTiMsg3F1 -> GmMsg3F1BusHiSpd.LstRxnTiMsg3F1
    connect SerlComInpProxy.OutdAirTCorrdValMaskRaw -> GmMsg3F1BusHiSpd.OutdAirTCorrdValMaskRaw
    connect SerlComInpProxy.OutdAirTCorrdValRaw -> GmMsg3F1BusHiSpd.OutdAirTCorrdValRaw
    connect SerlComInpProxy.OutdAirTCorrdValVldRaw -> GmMsg3F1BusHiSpd.OutdAirTCorrdValVldRaw
    connect StabyCmp.AssiCmd -> AssiSumLim.AssiCmd
    connect StOutpCtrl.SysMotTqCmdSca -> EotProtn.SysMotTqCmdSca
    connect StOutpCtrl.SysMotTqCmdSca -> LimrCdng.SysMotTqCmdSca
    connect StOutpCtrl.SysStReqDi -> SysStMod.SysStReqDi
    connect SysStMod.SysSt -> BattVltgCorrln.SysSt
    connect SysStMod.SysSt -> CDD_CurrMeas.SysSt
    connect SysStMod.SysSt -> CDD_MotCtrlMgr.SysSt
    connect SysStMod.SysSt -> CDD_TSG31CfgAndUse.SysSt
    connect SysStMod.SysSt -> CmnMfgSrv.SysSt
    connect SysStMod.SysSt -> CurrMeasCorrln.SysSt
    connect SysStMod.SysSt -> DiagcMgr.SysSt
    connect SysStMod.SysSt -> MotDrvDiagc.SysSt
    connect SysStMod.SysSt -> MotTqTranlDampg.SysSt
    connect SysStMod.SysSt -> PwrDiscnct.SysSt
    connect SysStMod.SysSt -> PwrSply.SysSt
    connect SysStMod.SysSt -> PwrUpSeq.SysSt
    connect TEstimn.AssiMechT -> Dampg.AssiMechT
    connect TEstimn.MotFetT -> DutyCycThermProtn.MotFetT
    connect TEstimn.MotMagT -> DutyCycThermProtn.MotMagT
    connect TEstimn.MotWidgT -> DutyCycThermProtn.MotWidgT
    connect TEstimn.AssiMechT -> HysCmp.AssiMechT
    connect TEstimn.MotFetT -> MotCtrlPrmEstimn.MotFetT
    connect TEstimn.MotMagT -> MotCtrlPrmEstimn.MotMagT
    connect TEstimn.MotWidgT -> MotCtrlPrmEstimn.MotWidgT
    connect TEstimn.AssiMechT -> Rtn.AssiMechT
    connect TmplMonr.TmplMonrIninTestCmpl -> PwrUpSeq.TmplMonIninTestCmpl
    connect TqLoa.TqLoaCmd -> AssiSumLim.TqLoaCmd
    connect TqLoa.TqLoaAvl -> LoaMgr.TqLoaAvl
    connect TunSelnAuthy.XcpCalChgReq -> CDD_XcpIf.XcpCalChgReq
    connect TunSelnAuthy.RtCalChgReq -> TunSelnMngt.RtCalChgReq
    connect TunSelnMngt.ActvGroup -> CDD_XcpIf.ActvGroup
    connect TunSelnMngt.ActvIninIdx -> CDD_XcpIf.ActvIninIdx
    connect TunSelnMngt.ActvRtIdx -> CDD_XcpIf.ActvRtIdx
    connect TunSelnMngt.CopyCalPageReq -> CDD_XcpIf.CopyCalPageReq
    connect TunSelnMngt.GetCalPageReq -> CDD_XcpIf.GetCalPageReq
    connect TunSelnMngt.SetCalPageReq -> CDD_XcpIf.SetCalPageReq
    connect VehSigCdng.VehSpd -> Assi.VehSpd
    connect VehSigCdng.VehSpd -> AssiHiFrq.VehSpd
    connect VehSigCdng.VehSpd -> AssiSumLim.VehSpd
    connect VehSigCdng.VehSpd -> CDD_CurrMeas.VehSpd
    connect VehSigCdng.VehSpdVld -> CDD_CurrMeas.VehSpdVld
    connect VehSigCdng.VehSpd -> Dampg.VehSpd
    connect VehSigCdng.VehSpd -> EotProtn.VehSpd
    connect VehSigCdng.VehSpd -> GmMsg0C9BusHiSpd.VehSpd
    connect VehSigCdng.VehSpdVld -> GmMsg0C9BusHiSpd.VehSpdVld
    connect VehSigCdng.VehSpdVld -> GmMsg184BusHiSpd.VehSpdVld
    connect VehSigCdng.VehSpd -> GmStrtStop.VehSpd
    connect VehSigCdng.VehSpdVld -> GmStrtStop.VehSpdVld
    connect VehSigCdng.VehSpd -> HysCmp.VehSpd
    connect VehSigCdng.VehLgtA -> InertiaCmpVel.VehLgtA
    connect VehSigCdng.VehSpd -> InertiaCmpVel.VehSpd
    connect VehSigCdng.VehSpd -> LimrCdng.VehSpd
    connect VehSigCdng.VehSpd -> MotCurrRegCfg.VehSpd
    connect VehSigCdng.VehSpd -> MotTqTranlDampg.VehSpd
    connect VehSigCdng.VehSpd -> PullCmpActv.VehSpd
    connect VehSigCdng.VehSpdVld -> PullCmpActv.VehSpdVld
    connect VehSigCdng.VehSpd -> Rtn.VehSpd
    connect VehSigCdng.VehSpd -> StabyCmp.VehSpd
    connect VehSigCdng.VehLatAVld -> TqLoa.VehLatAVld
    connect VehSigCdng.VehSpd -> TqLoa.VehSpd
    connect VehSigCdng.VehSpdVld -> TqLoa.VehSpdVld
    connect VehSigCdng.VehSpd -> TunSelnAuthy.VehSpd
    connect VehSigCdng.VehSpd -> VehSpdLimr.VehSpd
    connect VehSpdLimr.VehSpdMotTqLim -> LimrCdng.VehSpdMotTqLim
    connect WdgM.SE004_SE_10ms_Appl6_CP001_ChkPt_10ms_Appl6_End -> CDD_ChkPtAppl6.ChkPt_10ms_Appl6_End
    connect WdgM.SE004_SE_10ms_Appl6_CP000_ChkPt_10ms_Appl6_Strt -> CDD_ChkPtAppl6.ChkPt_10ms_Appl6_Strt
    connect WdgM.SE002_SE_2ms_Appl6_CP001_ChkPt_2ms_Appl6_End -> CDD_ChkPtAppl6.ChkPt_2ms_App6_End
    connect WdgM.SE002_SE_2ms_Appl6_CP000_ChkPt_2ms_Appl6_Strt -> CDD_ChkPtAppl6.ChkPt_2ms_Appl6_Strt
    connect WdgM.SE003_SE_100ms_Appl10_CP001_ChkPt_100ms_Appl10_End -> CDD_ChkPtAppl10.ChkPt_100ms_Appl10_End
    connect WdgM.SE003_SE_100ms_Appl10_CP000_ChkPt_100ms_Appl10_Strt -> CDD_ChkPtAppl10.ChkPt_100ms_Appl10_Strt
    connect WdgM.SE006_SE_10ms_Appl10_CP001_ChkPt_10ms_Appl10_End -> CDD_ChkPtAppl10.ChkPt_10ms_Appl10_End
    connect WdgM.SE006_SE_10ms_Appl10_CP000_ChkPt_10ms_Appl10_Strt -> CDD_ChkPtAppl10.ChkPt_10ms_Appl10_Strt
    connect WdgM.SE001_SE_2ms_Appl10_CP001_ChkPt_2ms_Appl10_End -> CDD_ChkPtAppl10.ChkPt_2ms_Appl10_End
    connect WdgM.SE001_SE_2ms_Appl10_CP000_ChkPt_2ms_Appl10_Strt -> CDD_ChkPtAppl10.ChkPt_2ms_Appl10_Strt
    connect WdgM.SE005_SE_4ms_Appl10_CP001_ChkPt_4ms_Appl10_End -> CDD_ChkPtAppl10.ChkPt_4ms_Appl10_End
    connect WdgM.SE005_SE_4ms_Appl10_CP000_ChkPt_4ms_Appl10_Strt -> CDD_ChkPtAppl10.ChkPt_4ms_Appl10_Strt
    connect CalRegn01Cmn.NxtrCalIdsCal0DevlpAuthor -> NxtrCalIds.NxtrCalIdsCal0DevlpAuthor
    connect CalRegn01Cmn.NxtrCalIdsCal0DevlpDesc -> NxtrCalIds.NxtrCalIdsCal0DevlpDescr
    connect CalRegn01Cmn.NxtrCalIdsCal0DevlpRelNr -> NxtrCalIds.NxtrCalIdsCal0DevlpRelNr
    connect CalRegn01Cmn.NxtrCalIdsCal0DevlpRelSt -> NxtrCalIds.NxtrCalIdsCal0DevlpRelSt
    connect CalRegn01Cmn.NxtrCalIdsCal0DevlpTiStamp -> NxtrCalIds.NxtrCalIdsCal0DevlpTiStamp
    connect CalRegn01Cmn.NxtrCalIdsCal0DevlpVers -> NxtrCalIds.NxtrCalIdsCal0DevlpVers
    connect CalRegn02Cmn.NxtrCalIdsCal1DevlpAuthor -> NxtrCalIds.NxtrCalIdsCal1DevlpAuthor
    connect CalRegn02Cmn.NxtrCalIdsCal1DevlpDesc -> NxtrCalIds.NxtrCalIdsCal1DevlpDescr
    connect CalRegn02Cmn.NxtrCalIdsCal1DevlpRelNr -> NxtrCalIds.NxtrCalIdsCal1DevlpRelNr
    connect CalRegn02Cmn.NxtrCalIdsCal1DevlpRelSt -> NxtrCalIds.NxtrCalIdsCal1DevlpRelSt
    connect CalRegn02Cmn.NxtrCalIdsCal1DevlpTiStamp -> NxtrCalIds.NxtrCalIdsCal1DevlpTiStamp
    connect CalRegn02Cmn.NxtrCalIdsCal1DevlpVers -> NxtrCalIds.NxtrCalIdsCal1DevlpVers
    connect CalRegn03Cmn.NxtrCalIdsCal2DevlpAuthor -> NxtrCalIds.NxtrCalIdsCal2DevlpAuthor
    connect CalRegn03Cmn.NxtrCalIdsCal2DevlpDesc -> NxtrCalIds.NxtrCalIdsCal2DevlpDescr
    connect CalRegn03Cmn.NxtrCalIdsCal2DevlpRelNr -> NxtrCalIds.NxtrCalIdsCal2DevlpRelNr
    connect CalRegn03Cmn.NxtrCalIdsCal2DevlpRelSt -> NxtrCalIds.NxtrCalIdsCal2DevlpRelSt
    connect CalRegn03Cmn.NxtrCalIdsCal2DevlpTiStamp -> NxtrCalIds.NxtrCalIdsCal2DevlpTiStamp
    connect CalRegn03Cmn.NxtrCalIdsCal2DevlpVers -> NxtrCalIds.NxtrCalIdsCal2DevlpVers
    connect CmnMfgSrv.DutyCycThermProtnDi -> DutyCycThermProtn.DutyCycThermProtnDi
    connect NxtrCalIds.NxtrCalIdsCalDevlpRd -> CmnMfgSrv.NxtrCalIdsCalDevlpRd
    connect NxtrCalIds.NxtrCalIdsCalRelRd -> CmnMfgSrv.NxtrCalIdsCalRelRd
    connect NxtrSwIds.NxtrSwIdsPsrInfoRd -> CmnMfgSrv.NxtrSwIdsPsrInfoRd
    connect NxtrSwIds.NxtrSwIdsSwBuildDateTiRd -> CmnMfgSrv.NxtrSwIdsSwBuildDateTiRd
    connect NxtrSwIds.NxtrSwIdsSwRelInfoRd -> CmnMfgSrv.NxtrSwIdsSwRelInfoRd
    connect NxtrSwIds.NxtrSwIdsSwRelNrRd -> CmnMfgSrv.NxtrSwIdsSwRelNrRd
    connect NxtrSwIds.NxtrSwIdsSwRelVerRd -> CmnMfgSrv.NxtrSwIdsSwRelVerRd
    connect PartNr.PartNrBasMdlPartNrAlphaCodRd -> ProgMfgSrv.PartNrBasMdlPartNrAlphaCodRd
    connect PartNr.PartNrBasMdlPartNrAlphaCodWr -> ProgMfgSrv.PartNrBasMdlPartNrAlphaCodWr
    connect PartNr.PartNrBasMdlPartNrRd -> ProgMfgSrv.PartNrBasMdlPartNrRd
    connect PartNr.PartNrBasMdlPartNrWr -> ProgMfgSrv.PartNrBasMdlPartNrWr
    connect PartNr.PartNrCcaMfgTrakgRd -> ProgMfgSrv.PartNrCcaMfgTrakgRd
    connect PartNr.PartNrCcaMfgTrakgWr -> ProgMfgSrv.PartNrCcaMfgTrakgWr
    connect PartNr.PartNrCtrlPidSeedKeyWr -> ProgMfgSrv.PartNrCtrlPidSeedKeyWr
    connect PartNr.PartNrCustMfgEnaCntrRd -> ProgMfgSrv.PartNrCustMfgEnaCntrRd
    connect PartNr.PartNrCustMfgEnaCntrWr -> ProgMfgSrv.PartNrCustMfgEnaCntrWr
    connect PartNr.PartNrDataUniversalNrSysIdRd -> ProgMfgSrv.PartNrDataUniversalNrSysIdRd
    connect PartNr.PartNrDataUniversalNrSysIdWr -> ProgMfgSrv.PartNrDataUniversalNrSysIdWr
    connect PartNr.PartNrEndMdlPartNrAlphaCodRd -> ProgMfgSrv.PartNrEndMdlPartNrAlphaCodRd
    connect PartNr.PartNrEndMdlPartNrAlphaCodWr -> ProgMfgSrv.PartNrEndMdlPartNrAlphaCodWr
    connect PartNr.PartNrEndMdlPartNrRd -> ProgMfgSrv.PartNrEndMdlPartNrRd
    connect PartNr.PartNrEndMdlPartNrWr -> ProgMfgSrv.PartNrEndMdlPartNrWr
    connect PartNr.PartNrNxtrMfgTrakgRd -> ProgMfgSrv.PartNrNxtrMfgTrakgRd
    connect PartNr.PartNrNxtrMfgTrakgWr -> ProgMfgSrv.PartNrNxtrMfgTrakgWr
    connect PartNr.PartNrProgmDateRd -> ProgMfgSrv.PartNrProgmDateRd
    connect PartNr.PartNrProgmDateWr -> ProgMfgSrv.PartNrProgmDateWr
    connect PartNr.PartNrProgmSessionSeedKeyWr -> ProgMfgSrv.PartNrProgmSessionSeedKeyWr
    connect PartNr.PartNrRepairShopCodRd -> ProgMfgSrv.PartNrRepairShopCodRd
    connect PartNr.PartNrRepairShopCodWr -> ProgMfgSrv.PartNrRepairShopCodWr
    connect PartNr.PartNrSysCodVersNrRd -> ProgMfgSrv.PartNrSysCodVersNrRd
    connect PartNr.PartNrSysCodVersNrWr -> ProgMfgSrv.PartNrSysCodVersNrWr
    connect PartNr.PartNrSysNameRd -> ProgMfgSrv.PartNrSysNameRd
    connect PartNr.PartNrSysNameWr -> ProgMfgSrv.PartNrSysNameWr
    connect PartNr.PartNrVinDataRd -> ProgMfgSrv.PartNrVinDataRd
    connect PartNr.PartNrVinDataWr -> ProgMfgSrv.PartNrVinDataWr
    connect CDD_FlsMem.CodFlsCrcChkCmpl -> PwrUpSeq.CodFlsCrcChkCmpl
    connect CDD_NxtrTi.GetTiSpan100MicroSec32bit -> CDD_FlsMem.GetTiSpan100MicroSec32bit
    connect CDD_SyncCrc.ResvCrcHwUnit -> CDD_FlsMem.ResvCrcHwUnit
    connect CDD_SyncCrc.Calc32BitCrc_u32 -> TunSelnMngt.Calc32BitCrc_u32
    connect DiagcMgrProxyAppl10.SetNtcSts10 -> CDD_VrfyCritReg.SetNtcSts
    connect CalRegn01Cmn.HwTq2MeasHwTq2PrtclFltFailStep -> CDD_HwTq2Meas.HwTq2MeasHwTq2PrtclFltFailStep
    connect CalRegn01Cmn.HwTq2MeasHwTq2PrtclFltPassStep -> CDD_HwTq2Meas.HwTq2MeasHwTq2PrtclFltPassStep
    connect CalRegn01Cmn.HwTq3MeasHwTq3PrtclFltFailStep -> CDD_HwTq3Meas.HwTq3MeasHwTq3PrtclFltFailStep
    connect CalRegn01Cmn.HwTq3MeasHwTq3PrtclFltPassStep -> CDD_HwTq3Meas.HwTq3MeasHwTq3PrtclFltPassStep
    connect IoHwAb.SetFctPrphlHwTq{0..3} -> CDD_HwTq{0..3}Meas.IoHwAb_SetFctPrphlHwTq{0..3}
    connect IoHwAb.SetFctPrphlHwAg0 -> HwAg0Meas.IoHwAb_SetFctPrphlHwAg0
    connect IoHwAb.SetFctPrphlHwAg1 -> HwAg1Meas.IoHwAb_SetFctPrphlHwAg1
    connect CDD_MotVel.MotVelCrf -> HwAgTrakgServo.MotVelCrf
    connect CmplncErr.CmplncErrMotToPinion -> HwAgSysArbn.CmplncErrMotToPinion
    connect CmplncErr.CmplncErrPinionToHw -> HwAgSysArbn.CmplncErrPinionToHw
    connect GmOvrlStMgr.LkaSt -> GmTqArbn.LkaSt
    connect GmOvrlStMgr.HwAgServoCmd -> HwAgTrakgServo.HwAgTrakgServoCmd
    connect GmOvrlStMgr.HwAgServoEna -> HwAgTrakgServo.HwAgTrakgServoEna
    connect GmTqArbn.EscLimdActv -> GmOvrlStMgr.EscLimdActv
    connect HwAgSysArbn.PinionAg -> HwAgTrakgServo.HwAg
    connect HwAgTrakgServo.MotTqServoCmd -> GmTqArbn.MotTqServoCmd
    connect MotTqTranlDampg.MotTqCmdCrfDampd -> CmplncErr.MotTqCmdCrf
    connect VehSigCdng.VehSpd -> HwAgTrakgServo.VehSpd
    connect CalRegn03Inin00.HwAgTrakgServoDftlTermLpFilFrq -> HwAgTrakgServo.HwAgTrakgServoDftlTermLpFilFrq
    connect CalRegn03Inin00.HwAgTrakgServoHwAgLpFilFrq -> HwAgTrakgServo.HwAgTrakgServoHwAgLpFilFrq
    connect CalRegn03Inin00.HwAgTrakgServoHwTqLpFilFrq -> HwAgTrakgServo.HwAgTrakgServoHwTqLpFilFrq
    connect CalRegn01Cmn.CmplncErrHwAgNonLinCmplncDepTblY -> CmplncErr.CmplncErrHwAgNonLinCmplncDepTblY
    connect CalRegn01Cmn.CmplncErrHwAgNonLinCmplncIndTblX -> CmplncErr.CmplncErrHwAgNonLinCmplncIndTblX
    connect CalRegn01Cmn.CmplncErrMotAgNonLinCmplncDepTblY -> CmplncErr.CmplncErrMotAgNonLinCmplncDepTblY
    connect CalRegn01Cmn.CmplncErrMotAgNonLinCmplncIndTblX -> CmplncErr.CmplncErrMotAgNonLinCmplncIndTblX
    connect CalRegn01Inin00.SnsrMeasStrtTrigDly -> CDD_SnsrMeasStrt.SnsrMeasStrtTrigDly
    connect CalRegn03Cmn.HwAgTrakgServoDiRateX -> HwAgTrakgServo.HwAgTrakgServoDiRateX
    connect CalRegn03Cmn.HwAgTrakgServoDiRateY -> HwAgTrakgServo.HwAgTrakgServoDiRateY
    connect CalRegn03Cmn.HwAgTrakgServoEnaRate -> HwAgTrakgServo.HwAgTrakgServoEnaRate
    connect CalRegn03Cmn.HwAgTrakgServoExecRate -> HwAgTrakgServo.HwAgTrakgServoExecRate
    connect CalRegn03Cmn.HwAgTrakgServoHwAgRateLim -> HwAgTrakgServo.HwAgTrakgServoHwAgRateLim
    connect CalRegn03Cmn.HwAgTrakgServoMaxCmdX -> HwAgTrakgServo.HwAgTrakgServoMaxCmdX
    connect CalRegn03Cmn.HwAgTrakgServoMaxCmdY -> HwAgTrakgServo.HwAgTrakgServoMaxCmdY
    connect CalRegn03Cmn.HwAgTrakgServoMaxRamp -> HwAgTrakgServo.HwAgTrakgServoMaxRamp
    connect CalRegn03Cmn.HwAgTrakgServoMinRamp -> HwAgTrakgServo.HwAgTrakgServoMinRamp
    connect CalRegn03Cmn.HwAgTrakgServoPidLim -> HwAgTrakgServo.HwAgTrakgServoPidLim
    connect CalRegn03Cmn.HwAgTrakgServoRampCmpl -> HwAgTrakgServo.HwAgTrakgServoRampCmpl
    connect CalRegn03Cmn.HwAgTrakgServoVehSpdBasd -> HwAgTrakgServo.HwAgTrakgServoVehSpdBasd
    connect CalRegn01Cmn.MotTqCmdScaMax -> MotTqCmdSca.MotTqCmdScaMax
    connect CalRegn01Cmn.MotTqCmdScaMin -> MotTqCmdSca.MotTqCmdScaMin
    connect DiagcMgrProxyAppl10.SetNtcSts10 -> CDD_NvMProxy.SetNtcSts
    connect MotTqCmdSca.MotTqCmdMrfScad -> MotQuadDetn.MotTqCmd
    connect MotTqCmdSca.MotTqCmdMrfScad -> MotRefMdl.MotTqCmdMrfScad
    connect PwrLimr.MotTqCmdPwrLimd -> MotTqCmdSca.MotTqCmdMrf
    connect NvMProxy.PSProxy_MotPrmNom -> MotCtrlPrmEstimn.MotPrmNom
    connect NvMProxy.PSProxy_PolarityCfgSaved -> PolarityCfg.PolarityCfgSaved
    connect NvMProxy.PSProxy_Rte_NvmBlock_CDD_CurrMeas_CurrMeasEolGainCalSet -> CDD_CurrMeas.CurrMeasEolGainCalSet
    connect NvMProxy.PSProxy_Rte_NvmBlock_CDD_CurrMeas_CurrMeasEolOffsCalSet -> CDD_CurrMeas.CurrMeasEolOffsCalSet
    connect NvMProxy.PSProxy_Rte_NvmBlock_CDD_HwTq{0..3}Meas_HwTq{0..3}Offs -> CDD_HwTq{0..3}Meas.HwTq{0..3}Offs
    connect NvMProxy.PSProxy_Rte_NvmBlock_CDD_MotAg0Meas_MotAg0CoeffTbl -> CDD_MotAg0Meas.MotAg0CoeffTbl
    connect NvMProxy.PSProxy_Rte_NvmBlock_CDD_MotAg1Meas_MotAg1CoeffTbl -> CDD_MotAg1Meas.MotAg1CoeffTbl
    connect NvMProxy.PSProxy_Rte_NvmBlock_CDD_MotAgCmp_MotAgCmpMotAgBackEmf -> CDD_MotAgCmp.MotAgCmpMotAgBackEmf
    connect NvMProxy.PSProxy_Rte_NvmBlock_CmnMfgSrv_CcaHwPartNr -> CmnMfgSrv.NvmCcaHwPartNr
    connect NvMProxy.PSProxy_Rte_NvmBlock_CmnMfgSrv_CcaSerlNr -> CmnMfgSrv.NvmCcaSerlNr
    connect NvMProxy.PSProxy_Rte_NvmBlock_CmnMfgSrv_DiRestore -> CmnMfgSrv.NvmDiRestore
    connect NvMProxy.PSProxy_Rte_NvmBlock_CmnMfgSrv_EpsSysSerlNr -> CmnMfgSrv.NvmEpsSysSerlNr
    connect NvMProxy.PSProxy_Rte_NvmBlock_CmnMfgSrv_IgnCntr -> CmnMfgSrv.NvmIgnCntr
    connect NvMProxy.PSProxy_Rte_NvmBlock_CmnMfgSrv_MfgTmpBuf{0..4} -> CmnMfgSrv.NvmMfgTmpBuf{0..4}
    connect NvMProxy.PSProxy_Rte_NvmBlock_CmnMfgSrv_NxtrMfgEnaCntr -> CmnMfgSrv.NvmMfgEnaCntr
    connect NvMProxy.PSProxy_Rte_NvmBlock_DiagcMgr_DiagcMgrNtcFltAry -> DiagcMgr.DiagcMgrNtcFltAry
    connect NvMProxy.PSProxy_Rte_NvmBlock_DutyCycThermProtn_FilStVal -> DutyCycThermProtn.FilStVal
    connect NvMProxy.PSProxy_Rte_NvmBlock_EotLrng_EotNvmData -> EotLrng.EotNvmData
    connect NvMProxy.PSProxy_Rte_NvmBlock_HwAg0Meas_HwAg0Offs -> HwAg0Meas.HwAg0Offs
    connect NvMProxy.PSProxy_Rte_NvmBlock_HwAg1Meas_HwAg1Offs -> HwAg1Meas.HwAg1Offs
    connect NvMProxy.PSProxy_Rte_NvmBlock_HwTqCorrln_HwTqChACmnModCmpLpFilSt -> HwTqCorrln.HwTqChACmnModCmpLpFilSt
    connect NvMProxy.PSProxy_Rte_NvmBlock_HwTqCorrln_HwTqChBCmnModCmpLpFilSt -> HwTqCorrln.HwTqChBCmnModCmpLpFilSt
    connect NvMProxy.PSProxy_Rte_NvmBlock_PartNr_PartNrBasMdlPartNr -> PartNr.PartNrBasMdlPartNr
    connect NvMProxy.PSProxy_Rte_NvmBlock_PartNr_PartNrCalProgdSts -> PartNr.PartNrCalProgdSts
    connect NvMProxy.PSProxy_Rte_NvmBlock_PartNr_PartNrCcaMfgTrakg -> PartNr.PartNrCcaMfgTrakg
    connect NvMProxy.PSProxy_Rte_NvmBlock_PartNr_PartNrCtrlPidSeedKey -> PartNr.PartNrCtrlPidSeedKey
    connect NvMProxy.PSProxy_Rte_NvmBlock_PartNr_PartNrCustMfgEnaCntr -> PartNr.PartNrCustMfgEnaCntr
    connect NvMProxy.PSProxy_Rte_NvmBlock_PartNr_PartNrDataUniversalNrSysId -> PartNr.PartNrDataUniversalNrSysId
    connect NvMProxy.PSProxy_Rte_NvmBlock_PartNr_PartNrEndMdlPartNr -> PartNr.PartNrEndMdlPartNr
    connect NvMProxy.PSProxy_Rte_NvmBlock_PartNr_PartNrNxtrMfgTrakg -> PartNr.PartNrNxtrMfgTrakg
    connect NvMProxy.PSProxy_Rte_NvmBlock_PartNr_PartNrProgmDate -> PartNr.PartNrProgmDate
    connect NvMProxy.PSProxy_Rte_NvmBlock_PartNr_PartNrProgmSessionSeedKey -> PartNr.PartNrProgmSessionSeedKey
    connect NvMProxy.PSProxy_Rte_NvmBlock_PartNr_PartNrRepairShopCod -> PartNr.PartNrRepairShopCod
    connect NvMProxy.PSProxy_Rte_NvmBlock_PartNr_PartNrSysCodVersNr -> PartNr.PartNrSysCodVersNr
    connect NvMProxy.PSProxy_Rte_NvmBlock_PartNr_PartNrSysName -> PartNr.PartNrSysName
    connect NvMProxy.PSProxy_Rte_NvmBlock_PartNr_PartNrVinData -> PartNr.PartNrVinData
    connect NvMProxy.PSProxy_Rte_NvmBlock_PullCmpActv_PullCmpLongTerm -> PullCmpActv.PullCmpLongTerm
    connect NvMProxy.PSProxy_Rte_NvmBlock_MotTqCmdSca_MotTqScaFac -> MotTqCmdSca.MotTqScaFac
    connect AssiSumLim.MotTqCmd -> CustDiagc.MotTqCmd
    connect CDD_GmT1xxMcuCfg.BattVltg -> CustDiagc.BattVltg
    connect EcuTMeas.EcuTFild -> CustDiagc.EcuTFild
    connect EotLrng.HwAgCcwDetd -> CustDiagc.HwAgCcwDetd
    connect EotLrng.HwAgCwDetd -> CustDiagc.HwAgCwDetd
    connect EotLrng.HwAgEotCcw -> CustDiagc.HwAgEotCcw
    connect EotLrng.HwAgEotCw -> CustDiagc.HwAgEotCw
    connect GmMsg0C9BusHiSpd.EngRunActv -> CustDiagc.EngRunActv
    connect GmMsg0C9BusHiSpd.EngSpd -> CustDiagc.EngSpd
    connect GmMsg180BusHiSpd.LkaCmd -> CustDiagc.LkaCmd
    connect GmMsg232BusHiSpd.DesRtIdx -> CustDiagc.DesRtIdx
    connect GmMsg337BusChassisExp.SteerWhlAgReqTarAg -> CustDiagc.SteerWhlAgReqTarAg
    connect GmOvrlStMgr.ApaSt -> CustDiagc.ApaSt
    connect GmOvrlStMgr.LkaSt -> CustDiagc.LkaSt
    connect GmStrtStop.VehStrtStopSt -> CustDiagc.StrtStopSt
    connect HwAgSysArbn.PinionAg -> CustDiagc.PinionAg
    connect HwAgSysArbn.PinionAgConf -> CustDiagc.PinionAgConf
    connect MotCurrPeakEstimn.MotCurrPeakEstimd -> CustDiagc.MotCurrPeakEstimd
    connect MotRefMdl.MotCurrDaxCmd -> CustDiagc.MotCurrDaxCmd
    connect SysStMod.SysSt -> CustDiagc.SysSt
    connect VehSigCdng.VehSpd -> CustDiagc.VehSpd
    connect VehSigCdng.VehSpdVld -> CustDiagc.VehSpdVld
    connect CDD_NxtrTi.GetRefTmr100MicroSec32bit -> GmMsg4D1BusHiSpd.GetRefTmr100MicroSec32bit
    connect CDD_NxtrTi.GetTiSpan100MicroSec32bit -> GmMsg4D1BusHiSpd.GetTiSpan100MicroSec32bit
    connect DiagcMgrProxyAppl6.SetNtcSts6 -> GmMsg4D1BusHiSpd.SetNtcSts
    connect GmMsg4D1BusHiSpd.EngOilT -> TEstimn.EngOilT
    connect SerlComInpProxy.EngOilTRaw -> GmMsg4D1BusHiSpd.EngOilTRaw
    connect SerlComInpProxy.EngOilVldRaw -> GmMsg4D1BusHiSpd.EngOilVldRaw
    connect SerlComInpProxy.LstRxnTiMsg4D1 -> GmMsg4D1BusHiSpd.LstRxnTiMsg4D1
    connect CalRegn01Cmn.GmMsg0C5BusHiSpdInvldTiOut -> GmMsg0C5BusHiSpd.GmMsg0C5BusHiSpdInvldTiOut
    connect CalRegn01Cmn.GmMsg0C5BusHiSpdMissTiOut -> GmMsg0C5BusHiSpd.GmMsg0C5BusHiSpdMissTiOut
    connect CalRegn01Cmn.GmMsg0C5BusHiSpdRstTiOut -> GmMsg0C5BusHiSpd.GmMsg0C5BusHiSpdRstTiOut
    connect CalRegn01Cmn.GmMsg0C5BusHiSpdSeqNrTiOut -> GmMsg0C5BusHiSpd.GmMsg0C5BusHiSpdSeqNrTiOut
    connect CalRegn01Cmn.GmMsg214BusHiSpdAbsActvProtdInvldTiOut -> GmMsg214BusHiSpd.GmMsg214BusHiSpdAbsActvProtdInvldTiOut
    connect CalRegn01Cmn.GmMsg337BusChassisExpInvldProtnValTiOut -> GmMsg337BusChassisExp.GmMsg337BusChassisExpInvldProtnValTiOut
    connect CalRegn01Cmn.GmMsg337BusChassisExpInvldRollgCntrTiOut -> GmMsg337BusChassisExp.GmMsg337BusChassisExpInvldRollgCntrTiOut
    connect CalRegn01Cmn.GmMsg4D1BusHiSpdEngOilTDft -> GmMsg4D1BusHiSpd.GmMsg4D1BusHiSpdEngOilTDft
    connect CalRegn01Cmn.GmMsg4D1BusHiSpdInvldTiOut -> GmMsg4D1BusHiSpd.GmMsg4D1BusHiSpdInvldTiOut
    connect CalRegn01Cmn.GmMsg4D1BusHiSpdMissTiOut -> GmMsg4D1BusHiSpd.GmMsg4D1BusHiSpdMissTiOut
    connect CalRegn01Cmn.GmMsg500BusHiSpdMissTiOut -> GmMsg500BusHiSpd.GmMsg500BusHiSpdMissTiOut
    connect CalRegn01Cmn.GmMsg500BusHiSpdWhlPlsPerRevDft -> GmMsg500BusHiSpd.GmMsg500BusHiSpdWhlPlsPerRevDft
    connect CalRegn01Cmn.GmMsg500BusHiSpdWhlRotlStsTiStampReslDft -> GmMsg500BusHiSpd.GmMsg500BusHiSpdWhlRotlStsTiStampReslDft
    connect CDD_NxtrTi.GetRefTmr100MicroSec32bit -> GmMsg0C5BusHiSpd.GetRefTmr100MicroSec32bit
    connect CDD_NxtrTi.GetTiSpan100MicroSec32bit -> GmMsg0C5BusHiSpd.GetTiSpan100MicroSec32bit
    connect CDD_NxtrTi.GetRefTmr100MicroSec32bit -> GmMsg500BusHiSpd.GetRefTmr100MicroSec32bit
    connect CDD_NxtrTi.GetTiSpan100MicroSec32bit -> GmMsg500BusHiSpd.GetTiSpan100MicroSec32bit
    connect DiagcMgrProxyAppl6.SetNtcSts6 -> GmMsg0C5BusHiSpd.SetNtcSts
    connect DiagcMgrProxyAppl6.SetNtcSts6 -> GmMsg500BusHiSpd.SetNtcSts
    connect SerlComInpProxy.LeWhlDstPlsCntrRaw -> GmMsg0C5BusHiSpd.LeWhlDstPlsCntrRaw
    connect SerlComInpProxy.LeWhlDstTiStampRaw -> GmMsg0C5BusHiSpd.LeWhlDstTiStampRaw
    connect SerlComInpProxy.LeWhlDstVldRaw -> GmMsg0C5BusHiSpd.LeWhlDstVldRaw
    connect SerlComInpProxy.LeWhlRotlStsRstRaw -> GmMsg0C5BusHiSpd.LeWhlRotlStsRstRaw
    connect SerlComInpProxy.LeWhlSeqNrRaw -> GmMsg0C5BusHiSpd.LeWhlSeqNrRaw
    connect SerlComInpProxy.LstRxnTiMsg0C5 -> GmMsg0C5BusHiSpd.LstRxnTiMsg0C5BusHiSpd
    connect SerlComInpProxy.RiWhlDstPlsCntrRaw -> GmMsg0C5BusHiSpd.RiWhlDstPlsCntrRaw
    connect SerlComInpProxy.RiWhlDstTiStampRaw -> GmMsg0C5BusHiSpd.RiWhlDstTiStampRaw
    connect SerlComInpProxy.RiWhlDstVldRaw -> GmMsg0C5BusHiSpd.RiWhlDstVldRaw
    connect SerlComInpProxy.RiWhlRotlStsRstRaw -> GmMsg0C5BusHiSpd.RiWhlRotlStsRstRaw
    connect SerlComInpProxy.RiWhlSeqNrRaw -> GmMsg0C5BusHiSpd.RiWhlSeqNrRaw
    connect SerlComInpProxy.LstRxnTiMsg500BusHiSpd -> GmMsg500BusHiSpd.LstRxnTiMsg500BusHiSpd
    connect SerlComInpProxy.WhlPlsPerRevRaw -> GmMsg500BusHiSpd.WhlPlsPerRevRaw
    connect SerlComInpProxy.WhlRotlStsTiStampReslRaw -> GmMsg500BusHiSpd.WhlRotlStsTiStampReslRaw
    connect AssiSumLim.MotTqCmd -> Swp.MotTqCmd
    connect CDD_NxtrTi.GetRefTmr100MicroSec32bit -> Swp.GetRefTmr100MicroSec32bit
    connect CDD_NxtrTi.GetTiSpan100MicroSec32bit -> Swp.GetTiSpan100MicroSec32bit
    connect Swp.HwTqSwp -> Assi.HwTq
    connect Swp.HwTqSwp -> AssiHiFrq.HwTq
    connect Swp.HwTqSwp -> CmplncErr.HwTq
    connect Swp.HwTqSwp -> CustDiagc.HwTq
    connect Swp.HwTqSwp -> Dampg.HwTq
    connect Swp.HwTqSwp -> EotLrng.HwTq
    connect Swp.HwTqSwp -> EotProtn.HwTq
    connect Swp.HwTqSwp -> GmMsg184BusHiSpd.HwTq
    connect Swp.HwTqSwp -> GmMsg1CABusChassisExp.HwTq
    connect Swp.HwTqSwp -> GmOvrlStMgr.HwTq
    connect Swp.HwTqSwp -> GmStrtStop.HwTq
    connect Swp.HwTqSwp -> GmTqArbn.HwTq
    connect Swp.HwTqSwp -> GmVehPwrMod.HwTq
    connect Swp.HwTqSwp -> HwAgTrakgServo.HwTq
    connect Swp.HwTqSwp -> HysCmp.HwTq
    connect Swp.HwTqSwp -> InertiaCmpVel.HwTq
    connect Swp.MotTqCmdSwp -> MotTqTranlDampg.MotTqCmdCrf
    connect Swp.HwTqSwp -> PullCmpActv.HwTq
    connect Swp.HwTqSwp -> Rtn.HwTq
    connect Swp.HwTqSwp -> StabyCmp.HwTq
    connect Swp.HwTqSwp -> TunSelnAuthy.HwTq
    connect VehSigCdng.VehSpd -> Swp.VehSpd
    connect VehSigCdng.VehSpdVld -> Swp.VehSpdVld
    connect CDD_GmT1xxMcuCfg.Adc1SelfDiag0 -> CDD_AdcDiagc.Adc1SelfDiag0
    connect CDD_GmT1xxMcuCfg.Adc1SelfDiag2 -> CDD_AdcDiagc.Adc1SelfDiag2
    connect CDD_GmT1xxMcuCfg.Adc1SelfDiag4 -> CDD_AdcDiagc.Adc1SelfDiag4
    connect DiagcMgrProxyAppl10.GetNtcQlfrSts10 -> CDD_AdcDiagc.GetNtcQlfrSts
    connect DiagcMgrProxyAppl10.SetNtcSts10 -> CDD_AdcDiagc.SetNtcSts
    connect CDD_AdcDiagc.Adc0Faild -> CDD_GmT1xxMcuCfg.Adc0Faild
    connect CDD_AdcDiagc.Adc1Faild -> CDD_GmT1xxMcuCfg.Adc1Faild
    connect CDD_MotCtrlMgr.Adc0SelfDiag0 -> CDD_AdcDiagc.Adc0SelfDiag0
    connect CDD_MotCtrlMgr.Adc0SelfDiag2 -> CDD_AdcDiagc.Adc0SelfDiag2
    connect CDD_MotCtrlMgr.Adc0SelfDiag4 -> CDD_AdcDiagc.Adc0SelfDiag4
    connect CDD_NxtrTi.GetRefTmr100MicroSec32bit -> SnsrOffsLrng.GetRefTmr100MicroSec32bit
    connect CDD_NxtrTi.GetTiSpan100MicroSec32bit -> SnsrOffsLrng.GetTiSpan100MicroSec32bit
    connect FltInj.FltInj_f32 -> TqOscn.FltInj_f32
    connect GmOvrlStMgr.HwOscnEna -> TqOscn.HwOscnEna
    connect HwAgSysArbn.PinionAgConf -> SnsrOffsLrng.HwAgAuthy
    connect SnsrOffsLrng.HwAgOffs -> SnsrOffsCorrn.HwAgOffs
    connect SnsrOffsLrng.HwTqOffs -> SnsrOffsCorrn.HwTqOffs
    connect SnsrOffsLrng.VehYawRateOffs -> SnsrOffsCorrn.VehYawRateOffs
    connect TqOscn.HwOscnCmd -> GmTqArbn.HwTqOscCmd
    connect VehSigCdng.VehSpd -> SnsrOffsLrng.VehSpd
    connect VehSigCdng.VehSpdVld -> SnsrOffsLrng.VehSpdVld
    connect NvMProxy.PSProxy_Rte_NvmBlock_SnsrOffsLrng_SnsrOffsLrnd -> SnsrOffsLrng.SnsrOffsLrnd
    connect Assi.AssiCmdBas -> AssiPahFwl.AssiCmdBas
    connect AssiHiFrq.AssiHiFrqCmd -> AssiPahFwl.AssiHiFrqCmd
    connect AssiPahFwl.AssiPahLimrActv -> DampgPahFwl.AssiPahLimrActv
    connect AssiPahFwl.AssiCmdSum -> StabyCmp.AssiCmdSum
    connect AssiPahFwl.AssiPahLimrActv -> StabyCmp.AssiPahLimrActv
    connect CDD_MotVel.MotVelCrf -> DampgPahFwl.MotVelCrf
    connect CDD_MotVel.MotVelCrf -> EotProtnFwl.MotVelCrf
    connect CmnMfgSrv.AssiLnrGainEna -> AssiPahFwl.AssiLnrGainEna
    connect CmnMfgSrv.MfgEnaSt -> AssiPahFwl.MfgEnaSt
    connect CmnMfgSrv.DampgCmdBasDi -> DampgPahFwl.DampgCmdBasDi
    connect CmnMfgSrv.MfgEnaSt -> DampgPahFwl.MfgEnaSt
    connect CmnMfgSrv.EotProtnDi -> EotProtnFwl.EotProtnDi
    connect CmnMfgSrv.MfgEnaSt -> EotProtnFwl.MfgEnaSt
    connect CmnMfgSrv.MfgEnaSt -> RtnPahFwl.MfgEnaSt
    connect CmnMfgSrv.RtnCmdDi -> RtnPahFwl.RtnCmdDi
    connect Dampg.DampgCmdBas -> DampgPahFwl.DampgCmdBas
    connect DampgPahFwl.DampgCmd -> AssiSumLim.DampgCmd
    connect DiagcMgrProxyAppl10.GetNtcQlfrSts10 -> AssiPahFwl.GetNtcQlfrSts
    connect DiagcMgrProxyAppl10.SetNtcSts10 -> AssiPahFwl.SetNtcSts
    connect DiagcMgrProxyAppl10.GetNtcQlfrSts10 -> DampgPahFwl.GetNtcQlfrSts
    connect DiagcMgrProxyAppl10.SetNtcSts10 -> DampgPahFwl.SetNtcSts
    connect DiagcMgrProxyAppl10.SetNtcSts10 -> EotProtnFwl.SetNtcSts
    connect DiagcMgrProxyAppl10.SetNtcSts10 -> GmOvrlStMgr.SetNtcSts
    connect DiagcMgrProxyAppl10.SetNtcSts10 -> RtnPahFwl.SetNtcSts
    connect EotProtn.EotActvCmd -> EotProtnFwl.EotActvCmd
    connect EotProtn.EotDampgCmd -> EotProtnFwl.EotDampgCmd
    connect EotProtnFwl.EotActvCmdLimd -> AssiSumLim.EotActvCmd
    connect EotProtnFwl.EotDampgCmdLimd -> AssiSumLim.EotDampgCmd
    connect GmMsg180BusHiSpd.LkaCmd -> GmTqArbn.LkaTqCmd
    connect GmOvrlStMgr.HwAgServoEna -> GmTqArbn.HwAgServoEna
    connect GmOvrlStMgr.HwOscnFrq -> TqOscn.HwOscnFrq
    connect GmOvrlStMgr.HwOscnMotAmp -> TqOscn.HwOscnMotAmp
    connect GmTqArbn.HwTqOvrl -> AssiPahFwl.HwTqOvrl
    connect GmTqArbn.LkaTqCmdCdnd -> GmMsg184BusHiSpd.LkaTqDlvd
    connect GmTqArbn.EscCmdArbd -> GmMsg1CABusChassisExp.EscTqDlvd
    connect HwAgSysArbn.PinionAgConf -> EotProtnFwl.PinionAgConf
    connect HwAgSysArbn.PinionAg -> HwAgTrajGenn.HwAg
    connect HwAgSysArbn.PinionAg -> RtnPahFwl.HwAg
    connect HysCmp.HysCmpCmd -> AssiPahFwl.HysCmpCmd
    connect InertiaCmpVel.InertiaCmpVelCmd -> DampgPahFwl.InertiaCmpVelCmd
    connect Rtn.RtnCmd -> RtnPahFwl.RtnCmd
    connect RtnPahFwl.RtnCmdLimd -> AssiSumLim.RtnCmd
    connect Swp.HwTqSwp -> AssiPahFwl.HwTq
    connect SysStMod.SysSt -> GmOvrlStMgr.SysSt
    connect VehSigCdng.VehSpd -> AssiPahFwl.VehSpd
    connect VehSigCdng.VehSpd -> DampgPahFwl.VehSpd
    connect VehSigCdng.VehSpd -> EotProtnFwl.VehSpd
    connect VehSigCdng.VehSpd -> GmOvrlStMgr.VehSpd
    connect VehSigCdng.VehSpd -> RtnPahFwl.VehSpd
    connect HwAgTrajGenn.HwAgTrakgServoCmd -> GmOvrlStMgr.HwAgTraj
    connect HwTqArbn.HwTq -> SnsrOffsCorrn.HwTq
    connect HwTqArbn.HwTq -> SnsrOffsLrng.HwTq
    connect SnsrOffsCorrn.HwTqCorrd -> Swp.HwTq
    connect CalRegn01Inin00.AssiPahFwlCmdSplitLpFilFrq -> AssiPahFwl.AssiPahFwlCmdSplitLpFilFrq
    connect CalRegn01Inin00.AssiPahFwlFwlActvLpFilFrq -> AssiPahFwl.AssiPahFwlFwlActvLpFilFrq
    connect CalRegn01Inin00.DampgPahFwlActvFwlLpFilFrq -> DampgPahFwl.DampgPahFwlActvFwlLpFilFrq
    connect CalRegn01Inin00.DampgPahFwlDampgCmdLpFilFrq -> DampgPahFwl.DampgPahFwlDampgCmdLpFilFrq
    connect CalRegn01Inin00.DampgPahFwlInertiaCmpLpFilFrq -> DampgPahFwl.DampgPahFwlInertiaCmpLpFilFrq
    connect GmMsg1E9BusHiSpd.SerlComYawRateVld -> SnsrOffsLrng.VehYawRateVld
    connect GmMsg1E9BusHiSpd.SerlComYawRateVld -> VehSigCdng.VehYawRateVldSerlCom
    connect NvMProxy.PSProxy_Rte_NvmBlock_GmOvrlStMgr_GmLoaIgnCntr -> GmOvrlStMgr.GmLoaIgnCntr
    connect CalRegn01Inin00.SysGlbPrmMotPoleCnt -> MotRplCoggCfg.SysGlbPrmMotPoleCnt
    connect CDD_MotVel.MotVelMrf -> MotRplCoggCfg.MotVelMrf
    connect MotCtrlPrmEstimn.MotBackEmfConEstimd -> MotRplCoggCfg.MotBackEmfConEstimd
    connect MotCtrlPrmEstimn.MotInduDaxEstimd -> MotRplCoggCfg.MotInduDaxEstimd
    connect MotCtrlPrmEstimn.MotInduQaxEstimd -> MotRplCoggCfg.MotInduQaxEstimd
    connect MotRefMdl.MotCurrDaxCmd -> MotRplCoggCfg.MotCurrDaxCmd
    connect MotRefMdl.MotCurrQaxCmd -> MotRplCoggCfg.MotCurrQaxCmd
    connect MotRplCoggCfg.MotAgElecDlyRpl -> CDD_MotCtrlMgr.MotAgElecDlyRpl
    connect MotRplCoggCfg.MotCurrQaxToMotTqGain -> CDD_MotCtrlMgr.MotCurrQaxToMotTqGain
    connect MotRplCoggCfg.MotTqRplCoggOrder1Mgn -> CDD_MotCtrlMgr.MotTqRplCoggOrder1Mgn
    connect MotRplCoggCfg.MotTqRplCoggOrder1Pha -> CDD_MotCtrlMgr.MotTqRplCoggOrder1Pha
    connect MotRplCoggCfg.MotTqRplCoggOrder2Mgn -> CDD_MotCtrlMgr.MotTqRplCoggOrder2Mgn
    connect MotRplCoggCfg.MotTqRplCoggOrder2Pha -> CDD_MotCtrlMgr.MotTqRplCoggOrder2Pha
    connect MotRplCoggCfg.MotTqRplCoggOrder3Mgn -> CDD_MotCtrlMgr.MotTqRplCoggOrder3Mgn
    connect MotRplCoggCfg.MotTqRplCoggOrder3Pha -> CDD_MotCtrlMgr.MotTqRplCoggOrder3Pha
    connect MotTqCmdSca.MotTqCmdMrfScad -> MotRplCoggCfg.MotTqCmdMrfScad
    connect NvMProxy.PSProxy_Rte_NvmBlock_CDD_MotRplCoggCmd_MotCoggCmdY -> CDD_MotRplCoggCmd.MotCoggCmdY
    connect NvMProxy.PSProxy_Rte_NvmBlock_MotRplCoggCfg_MotRplCoggPrm -> MotRplCoggCfg.MotRplCoggPrm
    connect CalRegn01Cmn.EcuTMeasRngDiagcMax -> StHlthSigNormn.EcuTMeasRngDiagcMax
    connect CalRegn01Cmn.EcuTMeasRngDiagcMin -> StHlthSigNormn.EcuTMeasRngDiagcMin
    connect DiagcMgrProxyAppl10.GetNtcQlfrSts10 -> StHlthSigNormn.GetNtcQlfrSts
    connect EcuTMeas.EcuTFild -> StHlthSigNormn.EcuTFild
    connect StHlthSigNormn.CtrlrTStHlth -> StHlthSigStc.CtrlrTStHlth
    connect StHlthSigNormn.OutpAssiStHlth -> StHlthSigStc.OutpAssiStHlth
    connect Swp.HwTqSwp -> HowDetn.HwTq
    connect VehSigCdng.VehSpd -> HowDetn.VehSpd
    connect NvMProxy.PSProxy_Rte_NvmBlock_StHlthSigStc_SigStcHistDataAry -> StHlthSigStc.SigStcHistDataAry
    connect GmMsg0C9BusHiSpd.MissMsg0C9 -> CustDiagc.MissMsg0C9
    connect GmMsg1F1BusHiSpd.MissMsg1F1 -> CustDiagc.MissMsg1F1
    connect HwTqCorrln.HwTqIdptSig -> CustDiagc.HwTqIdptSig
    connect IoHwAb.GetGpioMcuEna -> CustDiagc.GetGpioMcuEna
    connect PartNr.PartNrCtrlPidSeedUpprByteWr -> CustDiagc.PartNrCtrlPidSeedUpprByteWr
    connect StHlthSigNormn.UpdRawSig -> CDD_ChkPtAppl10.UpdRawSig
    connect StHlthSigStc.GetSigStcHlthData -> CustDiagc.GetSigStcHlthData
    connect AssiSumLim.SetManTqCmd -> MotVelCtrl.SetManTqCmd
    connect CalRegn03CmnGroupA.HysCmpEffLossY -> HysCmp.HysCmpEffLossY
    connect CalRegn03CmnGroupA.HysCmpEffOffsY -> HysCmp.HysCmpEffOffsY
    connect CalRegn03CmnGroupA.HysCmpHwTqScaX -> HysCmp.HysCmpHwTqScaX
    connect CalRegn03CmnGroupA.HysCmpHwTqScaY -> HysCmp.HysCmpHwTqScaY
    connect CalRegn03CmnGroupA.HysCmpNegHysCmpScaX -> HysCmp.HysCmpNegHysCmpScaX
    connect CalRegn03CmnGroupA.HysCmpNegHysCmpScaY -> HysCmp.HysCmpNegHysCmpScaY
    connect CalRegn03CmnGroupA.HysCmpNegHysCmpX -> HysCmp.HysCmpNegHysCmpX
    connect CalRegn03CmnGroupA.HysCmpNegHysCmpY -> HysCmp.HysCmpNegHysCmpY
    connect CalRegn03CmnGroupA.HysCmpRevGain -> HysCmp.HysCmpRevGain
    connect CalRegn03CmnGroupA.HysCmpRiseX -> HysCmp.HysCmpRiseX
    connect CalRegn03CmnGroupA.HysCmpRiseY -> HysCmp.HysCmpRiseY
    connect CalRegn03Inin00GroupA.HysCmpFricTScaX -> HysCmp.HysCmpFricTScaX
    connect CalRegn03Inin00GroupA.HysCmpFricTScaY -> HysCmp.HysCmpFricTScaY
    connect CalRegn03Inin00GroupA.RtnTScaX -> Rtn.RtnTScaX
    connect CalRegn03Inin00GroupA.RtnTScaY -> Rtn.RtnTScaY
    connect CDD_MotRplCoggCmd.GetMotCoggCmdPrm -> CmnMfgSrv.GetMotCoggCmdPrm
    connect CDD_MotRplCoggCmd.SetMotCoggCmdPrm -> CmnMfgSrv.SetMotCoggCmdPrm
    connect CDD_NxtrTi.GetRefTmr100MicroSec32bit -> MotVelCtrl.GetRefTmr100MicroSec32bit
    connect CDD_NxtrTi.GetTiSpan100MicroSec32bit -> MotVelCtrl.GetTiSpan100MicroSec32bit
    connect EotLrng.HwAgEotCcw -> HwAgVehCentrTrim.HwAgEotCcw
    connect EotLrng.HwAgCcwDetd -> HwAgVehCentrTrim.HwAgCcwDetd
    connect EotLrng.HwAgEotCw -> HwAgVehCentrTrim.HwAgEotCw
    connect EotLrng.HwAgCwDetd -> HwAgVehCentrTrim.HwAgCwDetd
    connect GmMsg0C9BusHiSpd.EngRunActv -> HwAgVehCentrTrim.EngRunActv
    connect GmOvrlStMgr.GetGmLoaIgnCntr -> ProgMfgSrv.GetGmLoaIgnCntr
    connect GmOvrlStMgr.SetGmLoaIgnCntr -> ProgMfgSrv.SetGmLoaIgnCntr
    connect HwAgArbn.HwAg -> HwAgVehCentrTrim.HwAg
    connect HwAgVehCentrTrim.ClrHwAgTrimVal -> CmnMfgSrv.ClrHwAgTrimVal
    connect HwAgVehCentrTrim.UpdHwAgTrimVal -> CmnMfgSrv.UpdHwAgTrimVal
    connect MotRplCoggCfg.GetMotRplCoggPrm -> CmnMfgSrv.GetMotRplCoggPrm
    connect MotRplCoggCfg.SetMotRplCoggPrm -> CmnMfgSrv.SetMotRplCoggPrm
    connect MotVelCtrl.GetCtrlPrm -> CmnMfgSrv.GetCtrlPrm
    connect MotVelCtrl.SetCtrlPrm -> CmnMfgSrv.SetCtrlPrm
    connect MotVelCtrl.StopCtrl -> CmnMfgSrv.StopCtrl
    connect MotVelCtrl.StrtCtrl -> CmnMfgSrv.StrtCtrl
    connect VehSigCdng.VehSpd -> HwAgVehCentrTrim.VehSpd
    connect CalRegn01CmnGroupC.HwAgVehCentrTrimHwAgLim -> HwAgVehCentrTrim.HwAgVehCentrTrimHwAgLim
    connect HwAgVehCentrTrim.ClrHwAgTrimVal -> CustDiagc.ClrHwAgTrimVal
    connect HwAgVehCentrTrim.UpdHwAgTrimVal -> CustDiagc.UpdHwAgTrimVal
    connect StHlthSigStc.UpdStHlthStcData -> CDD_ChkPtAppl10.UpdStHlthStcData
    connect StHlthSigNormn.CtrlrTRng -> CustDiagc.CtrlrTRng
    connect StHlthSigNormn.VltgRng -> CustDiagc.VltgRng
    connect FltInj.FltInj_u08 -> HwAgCorrln.FltInj_u08
    connect DiagcMgrStub.GetDiagcDataStub -> DiagcMgr.GetDiagcDataAppl{0..5}
    connect DiagcMgrStub.GetDiagcDataStub -> DiagcMgr.GetDiagcDataAppl{7..9}
    connect DiagcMgrStub.GetNtcInfoStub -> DiagcMgr.GetNtcInfoAppl{0..5}
    connect DiagcMgrStub.GetNtcInfoStub -> DiagcMgr.GetNtcInfoAppl{7..9}
    connect HwAgSysArbn.PinionAg -> PullCmpActv.HwAg
    connect MotTqTranlDampg.MotTqCmdCrfDampd -> SnsrOffsLrng.MotTqCmdCrf
    connect CDD_CurrMeas.MotCurrQlfr1 -> CDD_MotCtrlMgr.MotCurrQlfr1
    connect CDD_CurrMeas.MotCurrQlfr2 -> CDD_MotCtrlMgr.MotCurrQlfr2
    connect CDD_CurrMeas.MotCurrQlfr1 -> CurrMeasCorrln.MotCurrQlfr1
    connect CDD_CurrMeas.MotCurrQlfr2 -> CurrMeasCorrln.MotCurrQlfr2
    connect GmMsg1E9BusHiSpd.SerlComYawRate -> VehSigCdng.VehYawRateSerlCom
    connect SnsrOffsCorrn.VehYawRateCorrd -> PullCmpActv.VehYawRate
    connect VehSigCdng.VehYawRate -> SnsrOffsCorrn.VehYawRate
    connect VehSigCdng.VehYawRate -> SnsrOffsLrng.VehYawRate
    connect CalRegn01Cmn.AssiPahFwlDiRcvr -> AssiPahFwl.AssiPahFwlDiRcvr
    connect CalRegn01Cmn.AssiPahFwlVehSpd -> AssiPahFwl.AssiPahFwlVehSpd
    connect CalRegn01Cmn.BasAssiPahFwlOverLimDiagcFailStep -> AssiPahFwl.BasAssiPahFwlOverLimDiagcFailStep
    connect CalRegn01Cmn.BasAssiPahFwlOverLimDiagcPassStep -> AssiPahFwl.BasAssiPahFwlOverLimDiagcPassStep
    connect CalRegn01Cmn.HiFrqAssiPahFwlOverLimDiagcFailStep -> AssiPahFwl.HiFrqAssiPahFwlOverLimDiagcFailStep
    connect CalRegn01Cmn.HiFrqAssiPahFwlOverLimDiagcPassStep -> AssiPahFwl.HiFrqAssiPahFwlOverLimDiagcPassStep
    connect CalRegn01Cmn.MotRplCoggCmdHrmncOrder{1..3}Elec -> CDD_MotRplCoggCmd.MotRplCoggCmdHrmncOrder{1..3}Elec
    connect CalRegn01Cmn.DampgPahFwlAssiAddlDampgX -> DampgPahFwl.DampgPahFwlAssiAddlDampgX
    connect CalRegn01Cmn.DampgPahFwlAssiAddlDampgY -> DampgPahFwl.DampgPahFwlAssiAddlDampgY
    connect CalRegn01Cmn.DampgPahFwlDampgCmdAddlDampgX -> DampgPahFwl.DampgPahFwlDampgCmdAddlDampgX
    connect CalRegn01Cmn.DampgPahFwlDampgCmdAddlDampgY -> DampgPahFwl.DampgPahFwlDampgCmdAddlDampgY
    connect CalRegn01Cmn.DampgPahFwlDampgCmdFwlOverLimDiagcFailStep -> DampgPahFwl.DampgPahFwlDampgCmdFwlOverLimDiagcFailStep
    connect CalRegn01Cmn.DampgPahFwlDampgCmdFwlOverLimDiagcPassStep -> DampgPahFwl.DampgPahFwlDampgCmdFwlOverLimDiagcPassStep
    connect CalRegn01Cmn.DampgPahFwlDftDampgX -> DampgPahFwl.DampgPahFwlDftDampgX
    connect CalRegn01Cmn.DampgPahFwlInertiaCmpCmdFwlOverLimDiagcFailStep -> DampgPahFwl.DampgPahFwlInertiaCmpCmdFwlOverLimDiagcFailStep
    connect CalRegn01Cmn.DampgPahFwlInertiaCmpCmdFwlOverLimDiagcPassStep -> DampgPahFwl.DampgPahFwlInertiaCmpCmdFwlOverLimDiagcPassStep
    connect CalRegn01Cmn.DampgPahFwlVehSpd -> DampgPahFwl.DampgPahFwlVehSpd
    connect CalRegn01Cmn.EotProtnFwlEotDampgActvBndX -> EotProtnFwl.EotProtnFwlEotDampgActvBndX
    connect CalRegn01Cmn.EotProtnFwlInactvLim -> EotProtnFwl.EotProtnFwlInactvLim
    connect CalRegn01Cmn.EotProtnFwlVehSpd -> EotProtnFwl.EotProtnFwlVehSpd
    connect CalRegn01Cmn.HwAgTrajGennAgMax -> HwAgTrajGenn.HwAgTrajGennAgMax
    connect CalRegn01Cmn.HwAgTrajGennAMax -> HwAgTrajGenn.HwAgTrajGennAMax
    connect CalRegn01Cmn.HwAgTrajGennVelMax -> HwAgTrajGenn.HwAgTrajGennVelMax
    connect CalRegn01Cmn.MotRplCoggCfgMotAgTiDly -> MotRplCoggCfg.MotRplCoggCfgMotAgTiDly
    connect CalRegn01Cmn.MotRplCoggCfgMotCurrDaxRplBilnrSeln -> MotRplCoggCfg.MotRplCoggCfgMotCurrDaxRplBilnrSeln
    connect CalRegn01Cmn.MotRplCoggCfgMotCurrQaxRpl -> MotRplCoggCfg.MotRplCoggCfgMotCurrQaxRpl
    connect CalRegn01Cmn.MotRplCoggCfgMotTqCmdCurrRgltrBwCmpMgnY -> MotRplCoggCfg.MotRplCoggCfgMotTqCmdCurrRgltrBwCmpMgnY
    connect CalRegn01Cmn.MotRplCoggCfgMotTqCmdCurrRgltrBwCmpPhaY -> MotRplCoggCfg.MotRplCoggCfgMotTqCmdCurrRgltrBwCmpPhaY
    connect CalRegn01Cmn.MotRplCoggCfgMotTqCmdCurrRgltrBwCmpX -> MotRplCoggCfg.MotRplCoggCfgMotTqCmdCurrRgltrBwCmpX
    connect CalRegn01Cmn.MotRplCoggCfgMotTqRplOrder1X -> MotRplCoggCfg.MotRplCoggCfgMotTqRplOrder1X
    connect CalRegn01Cmn.MotRplCoggCfgMotTqRplOrder1Y -> MotRplCoggCfg.MotRplCoggCfgMotTqRplOrder1Y
    connect CalRegn01Cmn.MotRplCoggCfgMotTqRplOrder2X -> MotRplCoggCfg.MotRplCoggCfgMotTqRplOrder2X
    connect CalRegn01Cmn.MotRplCoggCfgMotTqRplOrder2Y -> MotRplCoggCfg.MotRplCoggCfgMotTqRplOrder2Y
    connect CalRegn01Cmn.MotRplCoggCfgMotTqRplOrder3X -> MotRplCoggCfg.MotRplCoggCfgMotTqRplOrder3X
    connect CalRegn01Cmn.MotRplCoggCfgMotTqRplOrder3Y -> MotRplCoggCfg.MotRplCoggCfgMotTqRplOrder3Y
    connect CalRegn01Cmn.MotRplCoggCfgMotVelBilnrSeln -> MotRplCoggCfg.MotRplCoggCfgMotVelBilnrSeln
    connect CalRegn01Cmn.MotRplCoggCmdHrmncOrder{1..3}Elec -> MotRplCoggCfg.MotRplCoggCmdHrmncOrder{1..3}Elec
    connect CalRegn01Cmn.TqOscnFallRampRateCal -> TqOscn.TqOscnFallRampRateCal
    connect CalRegn01Cmn.TqOscnRisngRampRateCal -> TqOscn.TqOscnRisngRampRateCal
    connect CalRegn01Cmn.TqOscnUseRampRateCal -> TqOscn.TqOscnUseRampRateCal
    connect CalRegn01Inin00.AssiPahFwlDftAssiX -> AssiPahFwl.AssiPahFwlDftAssiX
    connect CalRegn01Inin00.AssiPahFwlDftAssiY -> AssiPahFwl.AssiPahFwlDftAssiY
    connect CalRegn01Inin00.AssiPahFwlHiFrqUpprLimY -> AssiPahFwl.AssiPahFwlHiFrqUpprLimY
    connect CalRegn01Inin00.AssiPahFwlHysCmpLim -> AssiPahFwl.AssiPahFwlHysCmpLim
    connect CalRegn01Inin00.AssiPahFwlRestoreThd -> AssiPahFwl.AssiPahFwlRestoreThd
    connect CalRegn01Inin00.AssiPahFwlUpprLimX -> AssiPahFwl.AssiPahFwlUpprLimX
    connect CalRegn01Inin00.AssiPahFwlUpprLimY -> AssiPahFwl.AssiPahFwlUpprLimY
    connect CalRegn01Inin00.DampgPahFwlDampgCmdUpprLimX -> DampgPahFwl.DampgPahFwlDampgCmdUpprLimX
    connect CalRegn01Inin00.DampgPahFwlDampgCmdUpprLimY -> DampgPahFwl.DampgPahFwlDampgCmdUpprLimY
    connect CalRegn01Inin00.DampgPahFwlDftDampgY -> DampgPahFwl.DampgPahFwlDftDampgY
    connect CalRegn01Inin00.DampgPahFwlInertiaCmpUpprLimX -> DampgPahFwl.DampgPahFwlInertiaCmpUpprLimX
    connect CalRegn01Inin00.DampgPahFwlInertiaCmpUpprLimY -> DampgPahFwl.DampgPahFwlInertiaCmpUpprLimY
    connect CalRegn01Inin00.EotProtnFwlActvCmdLowrBnd -> EotProtnFwl.EotProtnFwlActvCmdLowrBnd
    connect CalRegn01Inin00.EotProtnFwlActvCmdUpprBnd -> EotProtnFwl.EotProtnFwlActvCmdUpprBnd
    connect CalRegn01Inin00.RtnPahFwlUpprBndTblX -> RtnPahFwl.RtnPahFwlUpprBndTblX
    connect CalRegn01Inin00.RtnPahFwlUpprBndTblY -> RtnPahFwl.RtnPahFwlUpprBndTblY
    connect CalRegn01Inin00.RtnPahFwlVehSpd -> RtnPahFwl.RtnPahFwlVehSpd
    connect CalRegn01Inin00.StHlthSigNormnHiCtrlrT -> StHlthSigNormn.StHlthSigNormnHiCtrlrT
    connect CalRegn01Inin00.StHlthSigNormnLoCtrlrT -> StHlthSigNormn.StHlthSigNormnLoCtrlrT
    connect CalRegn01Inin00GroupC.EotProtnFwlEotDampgActvBndY -> EotProtnFwl.EotProtnFwlEotDampgActvBndY
    connect CalRegn02Cmn.SnsrOffsCorrnOffsEna -> SnsrOffsCorrn.SnsrOffsCorrnOffsEna
    connect CalRegn02CmnGroupC.SnsrOffsLrngFctEna -> SnsrOffsLrng.SnsrOffsLrngFctEna
    connect CalRegn02CmnGroupC.SnsrOffsLrngHwAgLrngEna -> SnsrOffsLrng.SnsrOffsLrngHwAgLrngEna
    connect CalRegn02CmnGroupC.SnsrOffsLrngHwTqLrngEna -> SnsrOffsLrng.SnsrOffsLrngHwTqLrngEna
    connect CalRegn02Inin00.GmStrtStopEna -> GmStrtStop.GmStrtStopEna
    connect CalRegn03CmnGroupA.AssiThermScaX -> Assi.AssiThermScaX
    connect CalRegn03CmnGroupA.AssiThermScaY -> Assi.AssiThermScaY
    connect CalRegn03Inin00.HwAgTrakgServoSmotngY -> HwAgTrakgServo.HwAgTrakgServoSmotngY
    connect CalRegn03Inin00GroupC.HwAgTrakgServoDampgTqX -> HwAgTrakgServo.HwAgTrakgServoDampgTqX
    connect CalRegn03Inin00GroupC.HwAgTrakgServoDampgTqY -> HwAgTrakgServo.HwAgTrakgServoDampgTqY
    connect CalRegn03Inin00GroupC.HwAgTrakgServoDftlGainY -> HwAgTrakgServo.HwAgTrakgServoDftlGainY
    connect CalRegn03Inin00GroupC.HwAgTrakgServoIntglGainY -> HwAgTrakgServo.HwAgTrakgServoIntglGainY
    connect CalRegn03Inin00GroupC.HwAgTrakgServoIntglTermAntiWdupLimY -> HwAgTrakgServo.HwAgTrakgServoIntglTermAntiWdupLimY
    connect CalRegn03Inin00GroupC.HwAgTrakgServoPropGainX -> HwAgTrakgServo.HwAgTrakgServoPropGainX
    connect CalRegn03Inin00GroupC.HwAgTrakgServoPropGainY -> HwAgTrakgServo.HwAgTrakgServoPropGainY
    connect CalRegn03Inin00GroupC.HwAgTrakgServoSmotngX -> HwAgTrakgServo.HwAgTrakgServoSmotngX
    connect CalRegn01Inin00GroupB.GmRoadWhlInQlfrMaxAllwblFrq -> GmRoadWhlInQlfr.GmRoadWhlInQlfrMaxAllwblFrq
    connect CalRegn01Inin00GroupB.GmRoadWhlInQlfrMaxFrqChg -> GmRoadWhlInQlfr.GmRoadWhlInQlfrMaxFrqChg
    connect CDD_NxtrTi.GetRefTmr100MicroSec32bit -> GmRoadWhlInQlfr.GetRefTmr100MicroSec32bit
    connect CDD_NxtrTi.GetTiSpan100MicroSec32bit -> GmRoadWhlInQlfr.GetTiSpan100MicroSec32bit
    connect DiagcMgrProxyAppl10.SetNtcSts10 -> GmRoadWhlInQlfr.SetNtcSts
    connect GmMsg0C5BusHiSpd.LeWhlDstPlsCntr -> GmRoadWhlInQlfr.WhlLeDstPlsCntr
    connect GmMsg0C5BusHiSpd.LeWhlDstTiStamp -> GmRoadWhlInQlfr.WhlLeDstTiStamp
    connect GmMsg0C5BusHiSpd.LeWhlDstVld -> GmRoadWhlInQlfr.WhlLeDstVld
    connect GmMsg0C5BusHiSpd.RiWhlDstPlsCntr -> GmRoadWhlInQlfr.WhlRiDstPlsCntr
    connect GmMsg0C5BusHiSpd.RiWhlDstTiStamp -> GmRoadWhlInQlfr.WhlRiDstTiStamp
    connect GmMsg0C5BusHiSpd.RiWhlDstVld -> GmRoadWhlInQlfr.WhlRiDstVld
    connect GmMsg500BusHiSpd.WhlPlsPerRev -> GmRoadWhlInQlfr.WhlPlsPerRev
    connect GmMsg500BusHiSpd.WhlRotlStsTiStampResl -> GmRoadWhlInQlfr.WhlRotlStsTiStampResl
    connect CDD_NxtrTi.GetRefTmr100MicroSec32bit -> GmVehSpdArbn.GetRefTmr100MicroSec32bit
    connect CDD_NxtrTi.GetTiSpan100MicroSec32bit -> GmVehSpdArbn.GetTiSpan100MicroSec32bit
    connect CDD_GmT1xxMcuCfg.BattVltgSwd1AdcFaild -> BattVltgCorrln.BattVltgSwd1AdcFaild
    connect CDD_GmT1xxMcuCfg.BattVltgSwd2AdcFaild -> BattVltgCorrln.BattVltgSwd2AdcFaild
    connect CalRegn01Cmn.SinVltgGennDthrLpFilCoeff -> CDD_SinVltgGenn.SinVltgGennDthrLpFilCoeff
    connect CalRegn01Cmn.MotRefMdlCurrItrnTolr -> MotRefMdl.MotRefMdlCurrItrnTolr
    connect CalRegn01Cmn.MotRefMdlMinCurrItrnLim -> MotRefMdl.MotRefMdlMinCurrItrnLim
    connect CalRegn01Cmn.MotRefMdlQuad13VltgSdlX -> MotRefMdl.MotRefMdlQuad13VltgSdlX
    connect CalRegn01Cmn.MotRefMdlQuad13VltgSdlY -> MotRefMdl.MotRefMdlQuad13VltgSdlY
    connect CalRegn01Cmn.MotRefMdlQuad24VltgSdlX -> MotRefMdl.MotRefMdlQuad24VltgSdlX
    connect CalRegn01Cmn.MotRefMdlQuad24VltgSdlY -> MotRefMdl.MotRefMdlQuad24VltgSdlY
    connect CalRegn01Cmn.MotRefMdlRefLocnItrnLim -> MotRefMdl.MotRefMdlRefLocnItrnLim
    connect CalRegn01Cmn.MotRefMdlTqItrnLim -> MotRefMdl.MotRefMdlTqItrnLim
    connect CalRegn01Cmn.MotRefMdlTqItrnTolr -> MotRefMdl.MotRefMdlTqItrnTolr
    connect CalRegn01Cmn.MotRefMdlVltgOverRThdSca -> MotRefMdl.MotRefMdlVltgOverRThdSca
    connect CalRegn01Cmn.MotCurrRegCfgCurrLoopSecOrderTrfFctEna -> MotCurrRegCfg.MotCurrRegCfgCurrLoopSecOrderTrfFctEna
    connect CalRegn01Cmn.MotCurrRegCfgIntglGainSampleTi -> MotCurrRegCfg.MotCurrRegCfgIntglGainSampleTi
    connect CalRegn01Cmn.MotCurrRegCfgMotCtrlPrmSelnX -> MotCurrRegCfg.MotCurrRegCfgMotCtrlPrmSelnX
    connect CDD_GmT1xxMcuCfg.MotAg2CosAdcFaild -> MotAg2Meas.MotAg2CosAdcFaild
    connect CDD_GmT1xxMcuCfg.MotAg2SinAdcFaild -> MotAg2Meas.MotAg2SinAdcFaild
    connect CmnMfgSrv.SysMotTqCmdRampRateDi -> StOutpCtrl.SysMotTqCmdRampRateDi
    connect MotTqCmdSca.GetMotTqCmdSca -> CmnMfgSrv.GetMotTqCmdSca
    connect MotTqCmdSca.SetMotTqCmdSca -> CmnMfgSrv.SetMotTqCmdSca
    connect SnsrOffsLrng.GetHwAgOffs -> CmnMfgSrv.GetHwAgOffs
    connect SnsrOffsLrng.GetHwTqOffs -> CmnMfgSrv.GetHwTqOffs
    connect SnsrOffsLrng.GetYawRateOffs -> CmnMfgSrv.GetYawRateOffs
    connect SnsrOffsLrng.RstHwTq -> CmnMfgSrv.RstHwTq
    connect SnsrOffsLrng.RstYawAndAg -> CmnMfgSrv.RstYawAndAg
    connect SnsrOffsLrng.SetHwAgOffs -> CmnMfgSrv.SetHwAgOffs
    connect SnsrOffsLrng.SetHwTqOffs -> CmnMfgSrv.SetHwTqOffs
    connect SnsrOffsLrng.SetYawRateOffs -> CmnMfgSrv.SetYawRateOffs
    connect NvMProxy.PSProxy_Rte_NvmBlock_MotAg2Meas_MotAg2EolPrm -> MotAg2Meas.MotAg2EolPrm
    connect CDD_GmT1xxMcuCfg.EcuTAdcFaild -> EcuTMeas.EcuTAdcFaild
    connect CalRegn01CmnGroupB.WhlImbRejctnDcTrendFltRcvryDly -> WhlImbRejctn.WhlImbRejctnDcTrendFltRcvryDly
    connect CalRegn01CmnGroupB.WhlImbRejctnFrqDiagcFltRcvryDly -> WhlImbRejctn.WhlImbRejctnFrqDiagcFltRcvryDly
    connect CalRegn01CmnGroupB.WhlImbRejctnMaxMgnFltRcvryDly -> WhlImbRejctn.WhlImbRejctnMaxMgnFltRcvryDly
    connect CalRegn01CmnGroupB.WhlImbRejctnWhlSpdCorrlnFltRcvryDly -> WhlImbRejctn.WhlImbRejctnWhlSpdCorrlnFltRcvryDly
    connect CalRegn01Inin00GroupB.WhlImbRejctnDcTrendFltRcvryNegStep -> WhlImbRejctn.WhlImbRejctnDcTrendFltRcvryNegStep
    connect CalRegn01Inin00GroupB.WhlImbRejctnDcTrendFltRcvryPosStep -> WhlImbRejctn.WhlImbRejctnDcTrendFltRcvryPosStep
    connect CalRegn01Inin00GroupB.WhlImbRejctnFrqDiagcFltRcvryNegStep -> WhlImbRejctn.WhlImbRejctnFrqDiagcFltRcvryNegStep
    connect CalRegn01Inin00GroupB.WhlImbRejctnFrqDiagcFltRcvryPosStep -> WhlImbRejctn.WhlImbRejctnFrqDiagcFltRcvryPosStep
    connect CalRegn01Inin00GroupB.WhlImbRejctnMaxMgnFltNegStep -> WhlImbRejctn.WhlImbRejctnMaxMgnFltNegStep
    connect CalRegn01Inin00GroupB.WhlImbRejctnMaxMgnFltPosStep -> WhlImbRejctn.WhlImbRejctnMaxMgnFltPosStep
    connect CalRegn01Inin00GroupB.WhlImbRejctnMaxMgnFltRcvryNegStep -> WhlImbRejctn.WhlImbRejctnMaxMgnFltRcvryNegStep
    connect CalRegn01Inin00GroupB.WhlImbRejctnMaxMgnFltRcvryPosStep -> WhlImbRejctn.WhlImbRejctnMaxMgnFltRcvryPosStep
    connect CalRegn01Inin00GroupB.WhlImbRejctnWhlSpdCorrlnFltRcvryNegStep -> WhlImbRejctn.WhlImbRejctnWhlSpdCorrlnFltRcvryNegStep
    connect CalRegn01Inin00GroupB.WhlImbRejctnWhlSpdCorrlnFltRcvryPosStep -> WhlImbRejctn.WhlImbRejctnWhlSpdCorrlnFltRcvryPosStep
    connect CalRegn03Cmn.WhlImbRejctnCmdMgnLp1FilFrq -> WhlImbRejctn.WhlImbRejctnCmdMgnLp1FilFrq
    connect CalRegn03Cmn.WhlImbRejctnCmdMgnLp2FilFrq -> WhlImbRejctn.WhlImbRejctnCmdMgnLp2FilFrq
    connect CalRegn03Cmn.WhlImbRejctnDcTrendLpFil -> WhlImbRejctn.WhlImbRejctnDcTrendLpFil
    connect CalRegn03CmnGroupB.WhlImbRejctnAutScaTar -> WhlImbRejctn.WhlImbRejctnAutScaTar
    connect CalRegn03CmnGroupB.WhlImbRejctnRampDwnTi -> WhlImbRejctn.WhlImbRejctnRampDwnTi
    connect CalRegn03CmnGroupB.WhlImbRejctnScaCncl -> WhlImbRejctn.WhlImbRejctnScaCncl
    connect CalRegn03CmnGroupB.WhlImbRejctnUgrPoleMgn -> WhlImbRejctn.WhlImbRejctnUgrPoleMgn
    connect CalRegn03Inin00.WhlImbRejctnBlndCmdMgnLp1FilFrq -> WhlImbRejctn.WhlImbRejctnBlndCmdMgnLp1FilFrq
    connect CalRegn03Inin00.WhlImbRejctnBlndCmdMgnLp2FilFrq -> WhlImbRejctn.WhlImbRejctnBlndCmdMgnLp2FilFrq
    connect CalRegn03Inin00.WhlImbRejctnDistbnMgnLpFil -> WhlImbRejctn.WhlImbRejctnDistbnMgnLpFil
    connect CalRegn03Inin00.WhlImbRejctnWhlSpdLpFil -> WhlImbRejctn.WhlImbRejctnWhlSpdLpFil
    connect CalRegn03Inin00GroupB.WhlImbRejctnAdpvFac -> WhlImbRejctn.WhlImbRejctnAdpvFac
    connect CalRegn03Inin00GroupB.WhlImbRejctnCurrMgnSlewPerLoop -> WhlImbRejctn.WhlImbRejctnCurrMgnSlewPerLoop
    connect CalRegn03Inin00GroupB.WhlImbRejctnDcTrendTh2Tq -> WhlImbRejctn.WhlImbRejctnDcTrendTh2Tq
    connect CalRegn03Inin00GroupB.WhlImbRejctnDcTrendThTq -> WhlImbRejctn.WhlImbRejctnDcTrendThTq
    connect CalRegn03Inin00GroupB.WhlImbRejctnDcTrendTi2Sec -> WhlImbRejctn.WhlImbRejctnDcTrendTi2Sec
    connect CalRegn03Inin00GroupB.WhlImbRejctnDcTrendTiSec -> WhlImbRejctn.WhlImbRejctnDcTrendTiSec
    connect CalRegn03Inin00GroupB.WhlImbRejctnMaxMgn -> WhlImbRejctn.WhlImbRejctnMaxMgn
    connect CalRegn03Inin00GroupB.WhlImbRejctnMgnEstimnDeltaSca -> WhlImbRejctn.WhlImbRejctnMgnEstimnDeltaSca
    connect CalRegn03Inin00GroupB.WhlImbRejctnMgnEstimnDiThd -> WhlImbRejctn.WhlImbRejctnMgnEstimnDiThd
    connect CalRegn03Inin00GroupB.WhlImbRejctnMgnEstimnEnaThd -> WhlImbRejctn.WhlImbRejctnMgnEstimnEnaThd
    connect CalRegn03Inin00GroupB.WhlImbRejctnMgnEstimnFrq -> WhlImbRejctn.WhlImbRejctnMgnEstimnFrq
    connect CalRegn03Inin00GroupB.WhlImbRejctnMgnEstimnFrqDelta -> WhlImbRejctn.WhlImbRejctnMgnEstimnFrqDelta
    connect CalRegn03Inin00GroupB.WhlImbRejctnMgnEstimnLeak -> WhlImbRejctn.WhlImbRejctnMgnEstimnLeak
    connect CalRegn03Inin00GroupB.WhlImbRejctnPhaAdjX -> WhlImbRejctn.WhlImbRejctnPhaAdjX
    connect CalRegn03Inin00GroupB.WhlImbRejctnPhaAdjY -> WhlImbRejctn.WhlImbRejctnPhaAdjY
    connect CalRegn03Inin00GroupB.WhlImbRejctnWhlSpdCorrlnThd -> WhlImbRejctn.WhlImbRejctnWhlSpdCorrlnThd
    connect CalRegn03Inin00GroupB.WhlImbRejctnWhlSpdCorrlnTi -> WhlImbRejctn.WhlImbRejctnWhlSpdCorrlnTi
    connect CDD_NxtrTi.GetRefTmr100MicroSec32bit -> WhlImbRejctn.GetRefTmr100MicroSec32bit
    connect CDD_NxtrTi.GetTiSpan100MicroSec32bit -> WhlImbRejctn.GetTiSpan100MicroSec32bit
    connect DiagcMgrProxyAppl10.SetNtcSts10 -> WhlImbRejctn.SetNtcSts
    connect GmRoadWhlInQlfr.WhlFrqVld -> WhlImbRejctn.WhlFrqVld
    connect GmRoadWhlInQlfr.WhlLeFrq -> WhlImbRejctn.WhlLeFrq
    connect GmRoadWhlInQlfr.WhlRiFrq -> WhlImbRejctn.WhlRiFrq
    connect Swp.HwTqSwp -> WhlImbRejctn.HwTq
    connect SysStMod.SysSt -> WhlImbRejctn.SysSt
    connect VehSigCdng.VehSpd -> WhlImbRejctn.VehSpd
    connect VehSigCdng.VehSpdVld -> WhlImbRejctn.VehSpdVld
    connect WhlImbRejctn.WhlImbRejctnCmd -> AssiSumLim.WhlImbRejctnCmd
    connect WhlImbRejctn.WhlImbRejctnAmp -> HysCmp.WhlImbRejctnAmp
    connect WhlImbRejctn.WhlImbRejctnAmp -> Assi.WhlImbRejctnAmp
    connect WhlImbRejctn.WhlImbRejctnAmp -> AssiHiFrq.WhlImbRejctnAmp
    connect WhlImbRejctn.WhlImbRejctnAmp -> InertiaCmpVel.WhlImbRejctnAmp
    connect CalRegn01Cmn.MotCurrRegVltgLimrMotCurrQaxRefMdfnRplEna -> CDD_MotCurrRegVltgLimr.MotCurrRegVltgLimrMotCurrQaxRefMdfnRplEna
    connect CalRegn01Cmn.MotCurrRegVltgLimrMotVltgBrdgFilEna -> CDD_MotCurrRegVltgLimr.MotCurrRegVltgLimrMotVltgBrdgFilEna
    connect CalRegn01Cmn.MotCurrRegVltgLimrMotVltgBrdgLpFilFrq -> CDD_MotCurrRegVltgLimr.MotCurrRegVltgLimrMotVltgBrdgLpFilFrq
    connect CalRegn01Cmn.MotCurrRegVltgLimrMotVltgDaxIntglHiLim -> CDD_MotCurrRegVltgLimr.MotCurrRegVltgLimrMotVltgDaxIntglHiLim
    connect CalRegn01Cmn.MotCurrRegVltgLimrMotVltgDaxIntglLoLim -> CDD_MotCurrRegVltgLimr.MotCurrRegVltgLimrMotVltgDaxIntglLoLim
    connect CalRegn01Cmn.MotCurrRegVltgLimrMotVltgQaxFfFilEna -> CDD_MotCurrRegVltgLimr.MotCurrRegVltgLimrMotVltgQaxFfFilEna
    connect CalRegn01Cmn.MotCurrRegVltgLimrMotVltgQaxFfLpFilFrq -> CDD_MotCurrRegVltgLimr.MotCurrRegVltgLimrMotVltgQaxFfLpFilFrq
    connect CalRegn01Cmn.MotCurrRegVltgLimrMotVltgQaxIntglHiLim -> CDD_MotCurrRegVltgLimr.MotCurrRegVltgLimrMotVltgQaxIntglHiLim
    connect CalRegn01Cmn.MotCurrRegVltgLimrMotVltgQaxIntglLoLim -> CDD_MotCurrRegVltgLimr.MotCurrRegVltgLimrMotVltgQaxIntglLoLim
    connect CalRegn01Cmn.MotCtrlPrmEstimnMotBackEmfConNom -> MotRplCoggCfg.MotCtrlPrmEstimnMotBackEmfConNom
    connect CalRegn01Cmn.MotCtrlPrmEstimnMotBackEmfConSatnScaIvtrLoaMtgtn -> MotCtrlPrmEstimn.MotCtrlPrmEstimnMotBackEmfConSatnScaIvtrLoaMtgtn
    connect CalRegn01Cmn.MotCtrlPrmEstimnMotInduDaxIvtrLoaMtgtn -> MotCtrlPrmEstimn.MotCtrlPrmEstimnMotInduDaxIvtrLoaMtgtn
    connect CalRegn01Cmn.MotCtrlPrmEstimnMotInduQaxIvtrLoaMtgtn -> MotCtrlPrmEstimn.MotCtrlPrmEstimnMotInduQaxIvtrLoaMtgtn
    connect LoaMgr.IvtrLoaMtgtnEna -> MotCtrlPrmEstimn.IvtrLoaMtgtnEna
    connect CDD_GmT1xxMcuCfg.MotCurrAdcVlyAAdcFaild -> CDD_MotCtrlMgr.MotCurrAdcVlyAAdcFaild
    connect CDD_GmT1xxMcuCfg.MotCurrAdcVlyBAdcFaild -> CDD_MotCtrlMgr.MotCurrAdcVlyBAdcFaild
    connect CDD_GmT1xxMcuCfg.MotCurrAdcVlyCAdcFaild -> CDD_MotCtrlMgr.MotCurrAdcVlyCAdcFaild
    connect CDD_GmT1xxMcuCfg.MotCurrAdcVlyDAdcFaild -> CDD_MotCtrlMgr.MotCurrAdcVlyDAdcFaild
    connect CDD_GmT1xxMcuCfg.MotCurrAdcVlyEAdcFaild -> CDD_MotCtrlMgr.MotCurrAdcVlyEAdcFaild
    connect CDD_GmT1xxMcuCfg.MotCurrAdcVlyFAdcFaild -> CDD_MotCtrlMgr.MotCurrAdcVlyFAdcFaild
    connect GmOvrlStMgr.HwOscnEna -> GmTqArbn.HwOscnEna
    connect IoHwAb.GetGpioMcuEna -> GmVehPwrMod.GetGpioMcuEna
    connect HwAgVehCentrTrim.HwAgVehTrimOffs -> SnsrOffsCorrn.HwAg
    connect HwAgVehCentrTrim.HwAgVehTrimOffs -> SnsrOffsLrng.HwAg
    connect DiagcMgr.SysStFltOutpReqDi -> StOutpCtrl.SysStFltOutpReqDi
    connect CDD_GmT1xxMcuCfg.BattVltgAdcFaild -> BattVltgCorrln.BattVltgAdcFaild
    connect CalRegn01Inin00.SysFricLrngAvrgFricFrq -> SysFricLrng.SysFricLrngAvrgFricFrq
    connect CalRegn01Inin00.SysFricLrngBasLineEolFric -> SysFricLrng.SysFricLrngBasLineEolFric
    connect CalRegn01Inin00.SysFricLrngBasLineFric -> SysFricLrng.SysFricLrngBasLineFric
    connect CalRegn01Inin00.SysFricLrngBasLineHys -> SysFricLrng.SysFricLrngBasLineHys
    connect CalRegn01Inin00.SysFricLrngBasLineRngCntr -> SysFricLrng.SysFricLrngBasLineRngCntr
    connect CalRegn01Inin00.SysFricLrngDataPrepLpFilFrq -> SysFricLrng.SysFricLrngDataPrepLpFilFrq
    connect CalRegn01Inin00.SysFricLrngEolFricDifHiLim -> SysFricLrng.SysFricLrngEolFricDifHiLim
    connect CalRegn01Inin00.SysFricLrngEolFricDifLoLim -> SysFricLrng.SysFricLrngEolFricDifLoLim
    connect CalRegn01Inin00.SysFricLrngEolFricDifScagFac -> SysFricLrng.SysFricLrngEolFricDifScagFac
    connect CalRegn01Inin00.SysFricLrngFricChgWght -> SysFricLrng.SysFricLrngFricChgWght
    connect CalRegn01Inin00.SysFricLrngFricDiagcThd -> SysFricLrng.SysFricLrngFricDiagcThd
    connect CalRegn01Inin00.SysFricLrngFricDiagcTiThd -> SysFricLrng.SysFricLrngFricDiagcTiThd
    connect CalRegn01Inin00.SysFricLrngFricHysHwAgPt -> SysFricLrng.SysFricLrngFricHysHwAgPt
    connect CalRegn01Inin00.SysFricLrngFricOffsHiLim -> SysFricLrng.SysFricLrngFricOffsHiLim
    connect CalRegn01Inin00.SysFricLrngFricOffsLoLim -> SysFricLrng.SysFricLrngFricOffsLoLim
    connect CalRegn01Inin00.SysFricLrngFricOffsLpFilFrq -> SysFricLrng.SysFricLrngFricOffsLpFilFrq
    connect CalRegn01Inin00.SysFricLrngGain -> SysFricLrng.SysFricLrngGain
    connect CalRegn01Inin00.SysFricLrngHwPosnAuthyThd -> SysFricLrng.SysFricLrngHwPosnAuthyThd
    connect CalRegn01Inin00.SysFricLrngHwVelConstrLim -> SysFricLrng.SysFricLrngHwVelConstrLim
    connect CalRegn01Inin00.SysFricLrngHwVelHiLim -> SysFricLrng.SysFricLrngHwVelHiLim
    connect CalRegn01Inin00.SysFricLrngHwVelLoLim -> SysFricLrng.SysFricLrngHwVelLoLim
    connect CalRegn01Inin00.SysFricLrngIgnCycFricChgLim -> SysFricLrng.SysFricLrngIgnCycFricChgLim
    connect CalRegn01Inin00.SysFricLrngIvsTrsmRatX -> SysFricLrng.SysFricLrngIvsTrsmRatX
    connect CalRegn01Inin00.SysFricLrngIvsTrsmRatY -> SysFricLrng.SysFricLrngIvsTrsmRatY
    connect CalRegn01Inin00.SysFricLrngLatAHiLim -> SysFricLrng.SysFricLrngLatAHiLim
    connect CalRegn01Inin00.SysFricLrngLatALoLim -> SysFricLrng.SysFricLrngLatALoLim
    connect CalRegn01Inin00.SysFricLrngMaskVehSpd -> SysFricLrng.SysFricLrngMaskVehSpd
    connect CalRegn01Inin00.SysFricLrngRngCntrThd -> SysFricLrng.SysFricLrngRngCntrThd
    connect CalRegn01Inin00.SysFricLrngThd -> SysFricLrng.SysFricLrngThd
    connect CalRegn01Inin00.SysFricLrngTHiLim -> SysFricLrng.SysFricLrngTHiLim
    connect CalRegn01Inin00.SysFricLrngTLoLim -> SysFricLrng.SysFricLrngTLoLim
    connect CalRegn01Inin00.SysFricLrngVehSpd -> SysFricLrng.SysFricLrngVehSpd
    connect CDD_NxtrTi.GetRefTmr100MicroSec32bit -> SysFricLrng.GetRefTmr100MicroSec32bit
    connect CDD_NxtrTi.GetTiSpan100MicroSec32bit -> SysFricLrng.GetTiSpan100MicroSec32bit
    connect DiagcMgrProxyAppl10.SetNtcSts10 -> SysFricLrng.SetNtcSts
    connect FltInj.FltInj_f32 -> SysFricLrng.FltInj_f32
    connect HwAgSysArbn.PinionAg -> SysFricLrng.HwAg
    connect HwAgSysArbn.PinionAgConf -> SysFricLrng.HwAgAuthy
    connect MotTqTranlDampg.MotTqCmdCrfDampd -> SysFricLrng.MotTqCmdCrf
    connect Swp.HwTqSwp -> SysFricLrng.HwTq
    connect SysFricLrng.SysFricOffs -> HysCmp.SysFricOffs
    connect TEstimn.AssiMechT -> SysFricLrng.AssiMechT
    connect VehSigCdng.VehSpd -> SysFricLrng.VehSpd
    connect VehSigCdng.VehSpdVld -> SysFricLrng.VehSpdVld
    connect CalRegn01Inin00.SysFricLrngFricOffs -> SysFricLrng.SysFricLrngFricOffs
    connect GmMsg1E9BusHiSpd.VehLatAVldSerlCom -> VehSigCdng.VehLatAVldSerlCom
    connect HwAgVehCentrTrim.HwAgTrimPrfmd -> GmMsg1E5BusChassisExp.HwAgTrimPrfmd
    connect HwAgVehCentrTrim.HwAgTrimPrfmd -> GmMsg1E5BusHiSpd.HwAgTrimPrfmd
    connect NvMProxy.PSProxy_Rte_NvmBlock_HwAgVehCentrTrim_HwAgTrimData -> HwAgVehCentrTrim.HwAgTrimData
    connect CmnMfgSrv.MfgEnaSt -> CDD_XcpIf.MfgEnaSt
    connect TunSelnMngt.CalCopySts -> CDD_XcpIf.CalCopySts
    connect TunSelnMngt.GetSegInfoReq -> CDD_XcpIf.GetSegInfoReq
    connect TunSelnMngt.OnlineTunRamAdrMpg -> CDD_XcpIf.OnlineTunRamAdrMpg
    connect DiagcMgr.ClrDiagcFlgProxy -> DiagcMgrProxyAppl10.ClrDiagcFlgProxy
    connect DiagcMgr.ClrDiagcFlgProxy -> DiagcMgrProxyAppl6.ClrDiagcFlgProxy
    connect CDD_MotVel.MotVelCrf -> MotVelCtrl.MotVelCrf
    connect CDD_HwTq2Meas.GearIdn1 -> PwrpkCmpbltyChk.GearIdn1
    connect CDD_HwTq2Meas.GearIdn1Vld -> PwrpkCmpbltyChk.GearIdn1Vld
    connect CDD_HwTq3Meas.GearIdn2 -> PwrpkCmpbltyChk.GearIdn2
    connect CDD_HwTq3Meas.GearIdn2Vld -> PwrpkCmpbltyChk.GearIdn2Vld
    connect CDD_NxtrTi.GetRefTmr100MicroSec32bit -> PwrpkCmpbltyChk.GetRefTmr100MicroSec32bit
    connect CDD_NxtrTi.GetTiSpan100MicroSec32bit -> PwrpkCmpbltyChk.GetTiSpan100MicroSec32bit
    connect DiagcMgrProxyAppl10.GetNtcQlfrSts10 -> PwrpkCmpbltyChk.GetNtcQlfrSts
    connect DiagcMgrProxyAppl10.SetNtcSts10 -> PwrpkCmpbltyChk.SetNtcSts
    connect CDD_MotCtrlMgr.FastLoopCntr -> CDD_McuDiagc.FastLoopCntr
    connect DiagcMgrProxyAppl10.SetNtcSts10 -> CDD_McuDiagc.SetNtcSts
    connect CalRegn01Cmn.CurrMeasCorrlnMaxErrCurr -> StHlthSigNormn.CurrMeasCorrlnMaxErrCurr
    connect CalRegn01Cmn.DutyCycThermProtnDutyCycFildThd -> StHlthSigNormn.DutyCycThermProtnDutyCycFildThd
    connect CalRegn01Cmn.HwTqCorrlnChATraSumSetFltThd -> StHlthSigNormn.HwTqCorrlnChATraSumSetFltThd
    connect CalRegn01Cmn.HwTqCorrlnChBTraSumSetFltThd -> StHlthSigNormn.HwTqCorrlnChBTraSumSetFltThd
    connect CalRegn01Cmn.MotDrvDiagcErrThd -> StHlthSigNormn.MotDrvDiagcErrThd
    connect CalRegn01Cmn.StHlthSigNormnAbsltMotPosDifStHlthDiagThd -> StHlthSigNormn.StHlthSigNormnAbsltMotPosDifStHlthDiagThd
    connect CalRegn01Cmn.StHlthSigNormnCurrMotSumStHlthDiagThd -> StHlthSigNormn.StHlthSigNormnCurrMotSumStHlthDiagThd
    connect CalRegn01Cmn.StHlthSigNormnDigTqStHlthDiagThd -> StHlthSigNormn.StHlthSigNormnDigTqStHlthDiagThd
    connect CalRegn01Cmn.StHlthSigNormnDutyCycFltLimThd -> StHlthSigNormn.StHlthSigNormnDutyCycFltLimThd
    connect CalRegn01Cmn.StHlthSigNormnIdptSigStHlthSca -> StHlthSigNormn.StHlthSigNormnIdptSigStHlthSca
    connect CalRegn01Cmn.StHlthSigNormnMinRackTrvlLim -> StHlthSigNormn.StHlthSigNormnMinRackTrvlLim
    connect CalRegn01Cmn.StHlthSigNormnMotPosStHlthDiagThd -> StHlthSigNormn.StHlthSigNormnMotPosStHlthDiagThd
    connect CalRegn01Cmn.StHlthSigNormnMotVelCal -> StHlthSigNormn.StHlthSigNormnMotVelCal
    connect CalRegn01Cmn.StHlthSigNormnPhaInfoStHlthDiagThd -> StHlthSigNormn.StHlthSigNormnPhaInfoStHlthDiagThd
    connect CalRegn01Cmn.StHlthSigNormnStHlthCorrlnErr -> StHlthSigNormn.StHlthSigNormnStHlthCorrlnErr
    connect CalRegn01Cmn.StHlthSigNormnStHlthCurrMotSum -> StHlthSigNormn.StHlthSigNormnStHlthCurrMotSum
    connect CalRegn01Cmn.StHlthSigNormnStHlthPhaInfo -> StHlthSigNormn.StHlthSigNormnStHlthPhaInfo
    connect CalRegn01Cmn.StHlthSigNormnValMaxStHlthErr -> StHlthSigNormn.StHlthSigNormnValMaxStHlthErr
    connect CalRegn01Cmn.StHlthSigNormnValMinStHlthErr -> StHlthSigNormn.StHlthSigNormnValMinStHlthErr
    connect CalRegn01Inin00.SysGlbPrmMotPoleCnt -> StHlthSigNormn.SysGlbPrmMotPoleCnt
    connect CDD_HwTq0Meas.RackLimrEotSig0Avl -> StHlthSigNormn.RackLimrEotSig0Avl
    connect CDD_HwTq1Meas.RackLimrEotSig1Avl -> StHlthSigNormn.RackLimrEotSig1Avl
    connect CDD_MotVel.MotVelCrf -> StHlthSigNormn.MotVelCrf
    connect CDD_RamMem.LclRamEccSngBitCntrOutp -> StHlthSigNormn.LclRamEccSngBitCntrOutp
    connect CurrMeasCorrln.CurrMotSumABC -> StHlthSigNormn.CurrMotSumABC
    connect CurrMeasCorrln.CurrMotSumDEF -> StHlthSigNormn.CurrMotSumDEF
    connect DiagcMgrProxyAppl10.SetNtcSts10 -> StHlthSigNormn.SetNtcSts
    connect DutyCycThermProtn.DutyCycThermProtnMaxOutp -> StHlthSigNormn.DutyCycThermProtnMaxOutp
    connect EotLrng.HwAgEotCcw -> StHlthSigNormn.HwAgEotCcw
    connect EotLrng.HwAgEotCw -> StHlthSigNormn.HwAgEotCw
    connect HwAgSysArbn.PinionAg -> StHlthSigNormn.HwAg
    connect HwAgSysArbn.PinionAgConf -> StHlthSigNormn.HwAuthy
    connect HwTqCorrln.HwTqChACorrlnTraErr -> StHlthSigNormn.HwTqChACorrlnTraErr
    connect HwTqCorrln.HwTqChBCorrlnTraErr -> StHlthSigNormn.HwTqChBCorrlnTraErr
    connect HwTqCorrln.HwTqIdptSig -> StHlthSigNormn.HwTqIdptSig
    connect MotAg2Meas.MotAg2VltgSqd -> StHlthSigNormn.MotAg2VltgSqd
    connect MotAgCorrln.MotAgABErrTerm -> StHlthSigNormn.MotAgABErrTerm
    connect MotAgCorrln.MotAgACErrTerm -> StHlthSigNormn.MotAgACErrTerm
    connect MotAgCorrln.MotAgBCErrTerm -> StHlthSigNormn.MotAgBCErrTerm
    connect MotDrvDiagc.MotDrvErrA -> StHlthSigNormn.MotDrvErrA
    connect MotDrvDiagc.MotDrvErrB -> StHlthSigNormn.MotDrvErrB
    connect MotDrvDiagc.MotDrvErrC -> StHlthSigNormn.MotDrvErrC
    connect MotDrvDiagc.MotDrvErrD -> StHlthSigNormn.MotDrvErrD
    connect MotDrvDiagc.MotDrvErrE -> StHlthSigNormn.MotDrvErrE
    connect MotDrvDiagc.MotDrvErrF -> StHlthSigNormn.MotDrvErrF
    connect StHlthSigNormn.AbsltMotPosABDifStHlth -> StHlthSigStc.AbsltMotPosABDifStHlth
    connect StHlthSigNormn.AbsltMotPosACDifStHlth -> StHlthSigStc.AbsltMotPosACDifStHlth
    connect StHlthSigNormn.AbsltMotPosBCDifStHlth -> StHlthSigStc.AbsltMotPosBCDifStHlth
    connect StHlthSigNormn.CurrMotSumABCStHlth -> StHlthSigStc.CurrMotSumABCStHlth
    connect StHlthSigNormn.CurrMotSumDEFStHlth -> StHlthSigStc.CurrMotSumDEFStHlth
    connect StHlthSigNormn.DigTqIdptSigStHlth -> StHlthSigStc.DigTqIdptSigStHlth
    connect StHlthSigNormn.DigTqSnsrAStHlth -> StHlthSigStc.DigTqSnsrAStHlth
    connect StHlthSigNormn.DigTqSnsrBStHlth -> StHlthSigStc.DigTqSnsrBStHlth
    connect StHlthSigNormn.DutyCycStHlth -> StHlthSigStc.DutyCycStHlth
    connect StHlthSigNormn.EotImpctStHlth -> StHlthSigStc.EotImpctStHlth
    connect StHlthSigNormn.MotPosStHlth -> StHlthSigStc.MotPosStHlth
    connect StHlthSigNormn.PhaAStHlth -> StHlthSigStc.PhaAStHlth
    connect StHlthSigNormn.PhaBStHlth -> StHlthSigStc.PhaBStHlth
    connect StHlthSigNormn.PhaCStHlth -> StHlthSigStc.PhaCStHlth
    connect StHlthSigNormn.PhaDStHlth -> StHlthSigStc.PhaDStHlth
    connect StHlthSigNormn.PhaEStHlth -> StHlthSigStc.PhaEStHlth
    connect StHlthSigNormn.PhaFStHlth -> StHlthSigStc.PhaFStHlth
    connect StHlthSigNormn.RamEccSngBitCorrnStHlth -> StHlthSigStc.RamEccSngBitCorrnStHlth
    connect CDD_CurrMeas.CurrMeasEolGainStsReq -> CmnMfgSrv.CurrMeasEolGainStReq
    connect CDD_CurrMeas.CurrMeasEolOffsStsReq -> CmnMfgSrv.CurrMeasEolOffsStReq
    connect CDD_CurrMeas.CurrMeasGainWrReq -> CmnMfgSrv.CurrMeasGainWrReq
    connect CDD_CurrMeas.CurrMeasOffsWrReq -> CmnMfgSrv.CurrMeasOffsWrReq
    connect DiagcMgr.ClrAllDiagc -> CmnMfgSrv.ClrAllDiagc
    connect HwAgVehCentrTrim.GetHwAgTrimVal -> CmnMfgSrv.GetHwAgTrimVal
    connect HwAgVehCentrTrim.SetHwAgTrimVal -> CmnMfgSrv.SetHwAgTrimVal
    connect SysFricLrng.ClrFricLrngOperMod -> CmnMfgSrv.ClrFricLrngOperMod
    connect SysFricLrng.GetFricLrngData -> CmnMfgSrv.GetFricLrngData
    connect SysFricLrng.GetFricOffsOutpDi -> CmnMfgSrv.GetFricOffsOutpDi
    connect SysFricLrng.InitFricLrngTbl -> CmnMfgSrv.InitFricLrngTbl
    connect SysFricLrng.SetFricLrngData -> CmnMfgSrv.SetFricLrngData
    connect SysFricLrng.SetFricOffsOutpDi -> CmnMfgSrv.SetFricOffsOutpDi
    connect GmMsg1F1BusHiSpd.SysPwrMod -> CustDiagc.SysPwrMod
    connect PartNr.PartNrEcuIdRd -> CustDiagc.PartNrEcuIdRd
    connect PartNr.PartNrSecuBypAuthnRd -> CustDiagc.PartNrSecuBypAuthnRd
    connect PartNr.PartNrSecuBypAuthnWr -> CustDiagc.PartNrSecuBypAuthnWr
    connect PartNr.PartNrEcuIdRd -> ProgMfgSrv.PartNrEcuIdRd
    connect PartNr.PartNrEcuIdWr -> ProgMfgSrv.PartNrEcuIdWr
    connect PartNr.PartNrSecuBypAuthnRd -> ProgMfgSrv.PartNrSecuBypAuthnRd
    connect PartNr.PartNrSecuBypAuthnWr -> ProgMfgSrv.PartNrSecuBypAuthnWr
    connect NvMProxy.PSProxy_Rte_NvmBlock_Bootloader_EcuId -> PartNr.PartNrEcuId
    connect CalRegn02Cmn.DiagcMgrFltResp -> CustDiagc.DiagcMgrFltResp
    connect GmMsg1F1BusHiSpd.SysPwrMod -> CustDiagc.GmSysPwrMod
    connect GmMsg1F1BusHiSpd.SysPwrMod -> PartNr.GmSysPwrMod
    connect DiagcMgrProxyAppl6.GetNtcActv6 -> CustDiagc.GetNtcActv
    connect DiagcMgrProxyAppl6.GetNtcSts6 -> CustDiagc.GetNtcSts
    connect CalRegn02Inin00.GmStrtStopEna -> CustDiagc.GmStrtStopEna
    connect DiagcMgrProxyAppl6.SetNtcSts6 -> SerlComOutpProxy.SetNtcSts
    connect SerlComOutpProxy.BusOffHiSpd -> GmVehPwrMod.BusOffHiSpd
    connect HwAgVehCentrTrim.HwAgTrimPrfmd -> CustDiagc.HwAgTrimPrfmd
    connect DiagcMgr.ClrAllDiagc -> CustDiagc.ClrAllDiagc
    connect CmnMfgSrv.SysStReqEnaOvrd -> CustDiagc.SysStReqEnaOvrdNxtr
    connect CustDiagc.SysStReqEnaOvrdCombd -> GmVehPwrMod.SysStEnaReqOvrd
    connect CustDiagc.CSDataServices_IgnCycCntr -> Dem.CBReadData_IgnCycCntr
    connect CustDiagc.CSDataServices_EcuIntT -> Dem.CBReadData_EcuIntT
    connect CustDiagc.CSDataServices_SteerWhlAg -> Dem.CBReadData_SteerWhlAg
    connect CustDiagc.CSDataServices_SteerInpTq -> Dem.CBReadData_SteerInpTq
    connect CustDiagc.CSDataServices_EpdMotOvldProtnCntr -> Dem.CBReadData_EpdMotOvldProtnCntr
    connect CustDiagc.CSDataServices_EngSpd -> Dem.CBReadData_EngSpd
    connect CustDiagc.CSDataServices_VehSpd -> Dem.CBReadData_VehSpd
    connect CustDiagc.CSDataServices_EpsMotCurr -> Dem.CBReadData_EpsMotCurr
    connect CustDiagc.CSDataServices_EpsMotCurrFb -> Dem.CBReadData_EpsMotCurrFb
    connect CustDiagc.CSDataServices_EpsTqOvrlSts -> Dem.CBReadData_EpsTqOvrlSts
    connect CustDiagc.CSDataServices_EpsAgOvrlSts -> Dem.CBReadData_EpsAgOvrlSts
    connect CustDiagc.CSDataServices_EpsTqOvrlReq -> Dem.CBReadData_EpsTqOvrlReq
    connect CustDiagc.CSDataServices_SteerOutpTq -> Dem.CBReadData_SteerOutpTq
    connect CustDiagc.CSDataServices_EpsStopStrtSts -> Dem.CBReadData_EpsStopStrtSts
    connect CustDiagc.CSDataServices_EpsApaAgOvrlReq -> Dem.CBReadData_EpsApaAgOvrlReq
    connect CustDiagc.CSDataServices_SysPwrMod -> Dem.CBReadData_SysPwrMod
    connect CustDiagc.CSDataServices_BattVltgEcu -> Dem.CBReadData_BattVltgEcu
    connect CustDiagc.CSDataServices_SplrIntDtcInfo -> Dem.CBReadData_SplrIntDtcInfo
    connect CustDiagc.CSDataServices_TiIgnOn -> Dem.CBReadData_TiIgnOn
    connect NvMProxy.PSProxy_Rte_NvmBlock_CustDiagc_GmIgnCntr -> CustDiagc.CustDiagcGmIgnCntr
    connect NvMProxy.PSProxy_Rte_NvmBlock_SysFricLrng_FricLrngData -> SysFricLrng.FricLrngData
    connect NvMProxy.PSProxy_Rte_NvmBlock_SysFricLrng_FricNonLrngData -> SysFricLrng.FricNonLrngData
    connect NvMProxy.PSProxy_Rte_NvmBlock_Bootloader_SBAT -> PartNr.PartNrSecuBypAuthn
    connect NvMProxy.PSProxy_Rte_NvmBlock_NvMProxy_ShtdwnClsChk -> CDD_NvMProxy.ClsChkBlk
    connect CDD_NxtrTi.GetRefTmr100MicroSec32bit -> GmMsg778BusHiSpd.GetRefTmr100MicroSec32bit
    connect CDD_NxtrTi.GetTiSpan100MicroSec32bit -> GmMsg778BusHiSpd.GetTiSpan100MicroSec32bit
    connect GmMsg148BusHiSpd.PwrSteerIndcr -> SerlComOutpProxy.PwrSteerIndcr
    connect GmMsg148BusHiSpd.SteerAssiLimd -> SerlComOutpProxy.SteerAssiLimd
    connect GmMsg148BusHiSpd.SteerAssiLimdLvl2 -> SerlComOutpProxy.SteerAssiLimdLvl2
    connect GmMsg148BusHiSpd.SteerAssiLimdLvl3 -> SerlComOutpProxy.SteerAssiLimdLvl3
    connect GmMsg778BusHiSpd.CodSupported -> SerlComOutpProxy.CodSupported
    connect GmMsg778BusHiSpd.CurrSts -> SerlComOutpProxy.CurrSts
    connect GmMsg778BusHiSpd.DtcFailrTyp -> SerlComOutpProxy.DtcFailrTyp
    connect GmMsg778BusHiSpd.DtcFltTyp -> SerlComOutpProxy.DtcFltTyp
    connect GmMsg778BusHiSpd.DtcNr -> SerlComOutpProxy.DtcNr
    connect GmMsg778BusHiSpd.DtcSrc -> SerlComOutpProxy.DtcSrc
    connect GmMsg778BusHiSpd.DtcTrig -> SerlComOutpProxy.DtcTrig
    connect GmMsg778BusHiSpd.HistSts -> SerlComOutpProxy.HistSts
    connect GmMsg778BusHiSpd.TstFaildCodClrdSts -> SerlComOutpProxy.TstFaildCodClrdSts
    connect GmMsg778BusHiSpd.TstFaildPwrUpSts -> SerlComOutpProxy.TstFaildPwrUpSts
    connect GmMsg778BusHiSpd.TstNotPassdCodClrdSts -> SerlComOutpProxy.TstNotPassdCodClrdSts
    connect GmMsg778BusHiSpd.TstNotPassdPwrUpSts -> SerlComOutpProxy.TstNotPassdPwrUpSts
    connect GmMsg778BusHiSpd.WarnIndcrReqdSts -> SerlComOutpProxy.WarnIndcrReqdSts
    connect GmMsg778BusHiSpd.CallBackDtcStsChgd -> Dem.CBStatusDTC_1
    connect NvMProxy.PSProxy_Rte_NvmBlock_GmMsg778BusHiSpd_DtcTrigStsAry -> GmMsg778BusHiSpd.DtcTrigStsAry
    connect SysStMod.SysSt -> GmMsg148BusHiSpd.SysSt
    connect SysStMod.SysSt -> GmMsg778BusHiSpd.SysSt
    connect DiagcMgrProxyAppl10.GetNtcDebCntrAppl10 -> DiagcMgr.GetNtcDebCntrAppl10
    connect DiagcMgrProxyAppl6.GetNtcDebCntrAppl6 -> DiagcMgr.GetNtcDebCntrAppl6
    connect DiagcMgrStub.GetNtcDebCntrStub -> DiagcMgr.GetNtcDebCntrAppl{0..5}
    connect DiagcMgrStub.GetNtcDebCntrStub -> DiagcMgr.GetNtcDebCntrAppl{7..9}
    connect BattVltg.BrdgVltg -> DiagcMgr.BrdgVltg
    connect CmnMfgSrv.IgnCntr -> DiagcMgr.IgnCntr
    connect EcuTMeas.EcuTFild -> DiagcMgr.EcuTFild
    connect FltInj.FltInj_logl -> DiagcMgr.FltInj_logl
    connect MotTqCmdSca.MotTqCmdMrfScad -> DiagcMgr.MotTqCmdMrfScad
    connect Swp.HwTqSwp -> DiagcMgr.HwTq
    connect VehSigCdng.VehSpd -> DiagcMgr.VehSpd
    connect CalRegn01Inin00.McuDiagc2MilliSecCntrCompThd -> CDD_McuDiagc.McuDiagc2MilliSecCntrCompThd
    connect CalRegn01Inin00.McuDiagcFltFailStep -> CDD_McuDiagc.McuDiagcFltFailStep
    connect CalRegn01Inin00.McuDiagcFltPassStep -> CDD_McuDiagc.McuDiagcFltPassStep
    connect CDD_McuDiagc.LoopCntr2MilliSec -> CDD_MotCtrlMgr.LoopCntr2MilliSec
    connect CDD_MotCtrlMgr.SlowLoopCntr -> CDD_McuDiagc.SlowLoopCntr
    connect CmnMfgSrv.VehSpdOvrd -> VehSigCdng.VehSpdOvrd
    connect CmnMfgSrv.VehSpdOvrdEna -> VehSigCdng.VehSpdOvrdEna
    connect Swp.HwTqSwp -> VehSigCdng.HwTq
    connect CDD_AdcDiagc.AdcDiagcEndPtrOutp -> CDD_Adc1CfgAndUse.AdcDiagcEndPtrOutp
    connect CDD_AdcDiagc.AdcDiagcStrtPtrOutp -> CDD_Adc1CfgAndUse.AdcDiagcStrtPtrOutp
    connect GmVehSpdArbn.VehSpdMaxSecurVld -> GmOvrlStMgr.VehSpdSecurMaxVld
    connect GmVehSpdArbn.VehSpdMinSecurVld -> GmOvrlStMgr.VehSpdSecurMinVld
    connect CalRegn01Cmn.SysGlbPrmVehSpdBilnrSeln -> AssiHiFrq.SysGlbPrmVehSpdBilnrSeln
    connect CalRegn01Cmn.BrdgVltgMax -> BattVltg.BrdgVltgMax
    connect CalRegn01Cmn.SysGlbPrmVehSpdBilnrSeln -> Dampg.SysGlbPrmVehSpdBilnrSeln
    connect CalRegn01Cmn.SysGlbPrmVehSpdBilnrSeln -> HysCmp.SysGlbPrmVehSpdBilnrSeln
    connect CalRegn01Cmn.SysGlbPrmVehSpdBilnrSeln -> InertiaCmpVel.SysGlbPrmVehSpdBilnrSeln
    connect CalRegn01Inin00GroupC.GmVehPwrModHwTqMinKeepAssi -> GmVehPwrMod.GmVehPwrModHwTqMinKeepAssi
    connect CalRegn01Inin00GroupC.GmVehPwrModHwTqMinKeepTmr -> GmVehPwrMod.GmVehPwrModHwTqMinKeepTmr
    connect CalRegn01Inin00GroupC.GmVehPwrModVehSpdAssiOnMin -> GmVehPwrMod.GmVehPwrModVehSpdAssiOnMin
    connect CalRegn01Inin00GroupC.GmVehPwrModVehSpdMinKeepAssi -> GmVehPwrMod.GmVehPwrModVehSpdMinKeepAssi
    connect CalRegn02CmnGroupA.GmOvrlStMgrApaMfgEna -> CustDiagc.GmOvrlStMgrApaMfgEna
    connect CalRegn02CmnGroupA.GmOvrlStMgrEscMfgEna -> CustDiagc.GmOvrlStMgrEscMfgEna
    connect CalRegn02CmnGroupA.GmOvrlStMgrLkaMfgEna -> CustDiagc.GmOvrlStMgrLkaMfgEna
    connect CalRegn02CmnGroupA.GmOvrlStMgrApaMfgEna -> GmOvrlStMgr.GmOvrlStMgrApaMfgEna
    connect CalRegn02CmnGroupA.GmOvrlStMgrEscMfgEna -> GmOvrlStMgr.GmOvrlStMgrEscMfgEna
    connect CalRegn02CmnGroupA.GmOvrlStMgrLkaMfgEna -> GmOvrlStMgr.GmOvrlStMgrLkaMfgEna
    connect CalRegn02CmnGroupA.GmOvrlStMgrApaMfgEna -> SerlComOutpProxy.GmOvrlStMgrApaMfgEna
    connect CalRegn02CmnGroupA.GmOvrlStMgrEscMfgEna -> SerlComOutpProxy.GmOvrlStMgrEscMfgEna
    connect CalRegn02CmnGroupA.GmOvrlStMgrLkaMfgEna -> SerlComOutpProxy.GmOvrlStMgrLkaMfgEna
    connect CalRegn02CmnGroupB.WhlImbRejctnFctEna -> WhlImbRejctn.WhlImbRejctnFctEna
    connect CalRegn03Cmn.AssiHiFrqHpFilFrqY -> AssiHiFrq.AssiHiFrqHpFilFrqY
    connect CalRegn03CmnGroupA.HysCmpHysSatnY -> HysCmp.HysCmpHysSatnY
    connect CalRegn03CmnGroupA.HysCmpOutpLim -> HysCmp.HysCmpOutpLim
    connect CalRegn03CmnGroupB.WhlImbRejctnAutScaEna -> WhlImbRejctn.WhlImbRejctnAutScaEna
    connect CalRegn03CmnGroupB.WhlImbRejctnVehSpdEna -> WhlImbRejctn.WhlImbRejctnVehSpdEna
    connect CalRegn03Inin00GroupA.HysCmpAssiInpLim -> HysCmp.HysCmpAssiInpLim
    connect CalRegn03Inin00GroupB.WhlImbRejctnEnaSlewPerLoop -> WhlImbRejctn.WhlImbRejctnEnaSlewPerLoop
    connect CalRegn03Inin00GroupB.WhlImbRejctnFrqScaTblX -> WhlImbRejctn.WhlImbRejctnFrqScaTblX
    connect CalRegn03Inin00GroupB.WhlImbRejctnFrqScaTblY -> WhlImbRejctn.WhlImbRejctnFrqScaTblY
    connect CalRegn03Inin00GroupB.WhlImbRejctnMaxDurn -> WhlImbRejctn.WhlImbRejctnMaxDurn
    connect CalRegn03Rt00GroupA.HysCmpFricWhlImbRejctnBlndX -> HysCmp.HysCmpFricWhlImbRejctnBlndX
    connect CalRegn03Rt00GroupA.HysCmpFricWhlImbRejctnBlndY -> HysCmp.HysCmpFricWhlImbRejctnBlndY
    connect CalRegn03Rt00GroupA.HysCmpFricWhlImbRejctnOffY -> HysCmp.HysCmpFricWhlImbRejctnOffY
    connect CalRegn03Rt00GroupA.HysCmpFricWhlImbRejctnOnY -> HysCmp.HysCmpFricWhlImbRejctnOnY
    connect CalRegn03Rt00GroupA.RtnHwAgOffsCalcdX -> Rtn.RtnHwAgOffsCalcdX
    connect CalRegn03Rt00GroupA.RtnHwAgOffsCalcdY -> Rtn.RtnHwAgOffsCalcdY
    connect CalRegn03Rt00GroupA.RtnScaTqX -> Rtn.RtnScaTqX
    connect CalRegn03Rt00GroupA.RtnScaTqY -> Rtn.RtnScaTqY
    connect CalRegn03Rt00GroupA.RtnScaVelX -> Rtn.RtnScaVelX
    connect CalRegn03Rt00GroupA.RtnScaVelY -> Rtn.RtnScaVelY
    connect CalRegn01Cmn.SysGlbPrmVehSpdBilnrSeln -> Assi.SysGlbPrmVehSpd
    connect CalRegn01Cmn.BattVltgCorrlnSysMinVltg -> BattVltg.BattVltgCorrlnSysMinVltg
    connect CalRegn01Cmn.BattVltgCorrlnNtc0x03DFailStep -> BattVltgCorrln.BattVltgCorrlnNtc0x03DFailStep
    connect CalRegn01Cmn.BattVltgCorrlnNtc0x03DPassStep -> BattVltgCorrln.BattVltgCorrlnNtc0x03DPassStep
    connect CalRegn01Cmn.BattVltgCorrlnSysMinVltg -> BattVltgCorrln.BattVltgCorrlnSysMinVltg
    connect CalRegn01Cmn.TunSelnAuthyTunSelnRtDiCmd -> TunSelnAuthy.TunSelnAuthyTunSelnRtDiCmd
    connect CalRegn01Inin00.TunSelnAuthyVehSpdX -> TunSelnAuthy.TunSelnAuthyVehSpdX
    connect CalRegn01Cmn.HwAgSysArbnHwAgConf1Snsr -> HwAgSysArbn.HwAgSysArbnHwAgConf1Snsr
    connect CalRegn01Cmn.HwAgSysArbnHwAgConf2Snsr -> HwAgSysArbn.HwAgSysArbnHwAgConf2Snsr
    connect CalRegn01Cmn.HwAgSysArbnHwAgConfNoSnsr -> HwAgSysArbn.HwAgSysArbnHwAgConfNoSnsr
    connect CalRegn01Cmn.HwAgSysArbnHwAgCorrdCorrlnThd -> HwAgSysArbn.HwAgSysArbnHwAgCorrdCorrlnThd
    connect CalRegn01Cmn.HwAgSysArbnHwAgCorrlnFailDebStep -> HwAgSysArbn.HwAgSysArbnHwAgCorrlnFailDebStep
    connect CalRegn01Cmn.HwAgSysArbnHwAgCorrlnPassDebStep -> HwAgSysArbn.HwAgSysArbnHwAgCorrlnPassDebStep
    connect CalRegn01Cmn.HwAgSysArbnHwAgCorrlnRng -> HwAgSysArbn.HwAgSysArbnHwAgCorrlnRng
    connect CalRegn01Cmn.HwAgSysArbnHwAgSnsrlsCorrlnThd -> HwAgSysArbn.HwAgSysArbnHwAgSnsrlsCorrlnThd
    connect CalRegn01Cmn.HwAgSysArbnHwAgSnsrlsKineThd -> HwAgSysArbn.HwAgSysArbnHwAgSnsrlsKineThd
    connect CalRegn01Cmn.HwAgSysArbnHwAgToMotAgCorrlnElpdTiLim -> HwAgSysArbn.HwAgSysArbnHwAgToMotAgCorrlnElpdTiLim
    connect CalRegn01Cmn.HwAgSysArbnSerlComHwAgCorrdConf -> HwAgSysArbn.HwAgSysArbnSerlComHwAgCorrdConf
    connect CalRegn01Cmn.HwAgSysArbnSerlComHwAgSnsrlsConf -> HwAgSysArbn.HwAgSysArbnSerlComHwAgSnsrlsConf
    connect DiagcMgrProxyAppl10.SetNtcSts10 -> HwAgSysArbn.SetNtcSts
    connect HwAgArbn.HwAg -> HwAgSysArbn.HwAg
    connect SnsrOffsCorrn.HwAgCorrd -> HwAgSysArbn.HwAgCorrd
    connect CalRegn01Cmn.HwAgSnsrlsFCentrHwConf -> HwAgSnsrls.HwAgSnsrlsFCentrHwConf
    connect CalRegn01Cmn.HwAgSnsrlsPinionTqFilFrq -> HwAgSnsrls.HwAgSnsrlsPinionTqFilFrq
    connect CalRegn01Cmn.HwAgSnsrlsRelHwAgFil1Frq -> HwAgSnsrls.HwAgSnsrlsRelHwAgFil1Frq
    connect CalRegn01Cmn.HwAgSnsrlsRelHwAgFil2Frq -> HwAgSnsrls.HwAgSnsrlsRelHwAgFil2Frq
    connect CalRegn01Cmn.HwAgSnsrlsSmotngCoeff -> HwAgSnsrls.HwAgSnsrlsSmotngCoeff
    connect CalRegn01Cmn.HwAgSnsrlsSmotngStepThd -> HwAgSnsrls.HwAgSnsrlsSmotngStepThd
    connect CalRegn01Cmn.HwAgSnsrlsStordPinionConf -> HwAgSnsrls.HwAgSnsrlsStordPinionConf
    connect CalRegn01Cmn.HwAgSnsrlsStordPinionConfThd -> HwAgSnsrls.HwAgSnsrlsStordPinionConfThd
    connect CalRegn01Cmn.HwAgSnsrlsVehDynDifThd -> HwAgSnsrls.HwAgSnsrlsVehDynDifThd
    connect CalRegn01Cmn.HwAgSnsrlsVehDynHwConf -> HwAgSnsrls.HwAgSnsrlsVehDynHwConf
    connect CalRegn01Cmn.HwAgSnsrlsVehDynMotVelThd -> HwAgSnsrls.HwAgSnsrlsVehDynMotVelThd
    connect CalRegn01Cmn.HwAgSnsrlsVehDynPinionTqThd -> HwAgSnsrls.HwAgSnsrlsVehDynPinionTqThd
    connect CalRegn01Cmn.HwAgSnsrlsVehDynTmr1Thd -> HwAgSnsrls.HwAgSnsrlsVehDynTmr1Thd
    connect CalRegn01Cmn.HwAgSnsrlsVehDynTmr2Thd -> HwAgSnsrls.HwAgSnsrlsVehDynTmr2Thd
    connect CalRegn01Cmn.HwAgSnsrlsWhlFrqThd -> HwAgSnsrls.HwAgSnsrlsWhlFrqThd
    connect CalRegn01Cmn.HwAgSnsrlsWhlSpdHwAgCoeff1 -> HwAgSnsrls.HwAgSnsrlsWhlSpdHwAgCoeff1
    connect CalRegn01Cmn.HwAgSnsrlsWhlSpdHwAgCoeff2 -> HwAgSnsrls.HwAgSnsrlsWhlSpdHwAgCoeff2
    connect CalRegn01Cmn.HwAgSnsrlsWhlSpdHwAgThd -> HwAgSnsrls.HwAgSnsrlsWhlSpdHwAgThd
    connect CalRegn01Cmn.HwAgSnsrlsWhlSpdHwConf -> HwAgSnsrls.HwAgSnsrlsWhlSpdHwConf
    connect CalRegn01Cmn.HwAgSnsrlsWhlSpdRatThd -> HwAgSnsrls.HwAgSnsrlsWhlSpdRatThd
    connect CalRegn01Cmn.HwAgSnsrlsWhlSpdTmrThd -> HwAgSnsrls.HwAgSnsrlsWhlSpdTmrThd
    connect CalRegn01Cmn.HwAgSnsrlsWhlSpdVehSpdThd -> HwAgSnsrls.HwAgSnsrlsWhlSpdVehSpdThd
    connect CalRegn01Inin00.HwAgSnsrlsVehDynVehSpdThd -> HwAgSnsrls.HwAgSnsrlsVehDynVehSpdThd
    connect CalRegn01Inin00.HwAgSnsrlsVehDynYawRateThd -> HwAgSnsrls.HwAgSnsrlsVehDynYawRateThd
    connect CalRegn01Inin00.HwAgSnsrlsYawRateFilFrq -> HwAgSnsrls.HwAgSnsrlsYawRateFilFrq
    connect CDD_MotAgCmp.MotAgCumvAlgndCrf -> HwAgSnsrls.MotAgCumvAlgndCrf
    connect CDD_MotVel.MotVelCrf -> HwAgSnsrls.MotVelCrf
    connect CDD_NxtrTi.GetRefTmr100MicroSec32bit -> HwAgSnsrls.GetRefTmr100MicroSec32bit
    connect CDD_NxtrTi.GetTiSpan100MicroSec32bit -> HwAgSnsrls.GetTiSpan100MicroSec32bit
    connect CmplncErr.CmplncErrMotToPinion -> HwAgSnsrls.CmplncErrMotToPinion
    connect DiagcMgrProxyAppl10.GetNtcQlfrSts10 -> HwAgSnsrls.GetNtcQlfrSts
    connect GmRoadWhlInQlfr.WhlFrqVld -> HwAgSnsrls.WhlFrqVld
    connect GmRoadWhlInQlfr.WhlLeFrq -> HwAgSnsrls.WhlLeFrq
    connect GmRoadWhlInQlfr.WhlRiFrq -> HwAgSnsrls.WhlRiFrq
    connect HwAgSnsrls.HwAgSnsrls -> HwAgSysArbn.HwAgSnsrls
    connect HwAgSnsrls.HwAgSnsrlsConf -> HwAgSysArbn.HwAgSnsrlsConf
    connect HwAgSysArbn.PinionAg -> HwAgSnsrls.PinionAg
    connect HwAgSysArbn.PinionAgConf -> HwAgSnsrls.PinionAgConf
    connect MotTqTranlDampg.MotTqCmdCrfDampd -> HwAgSnsrls.MotTqCmdCrf
    connect Swp.HwTqSwp -> HwAgSnsrls.HwTq
    connect VehSigCdng.VehSpd -> HwAgSnsrls.VehSpd
    connect VehSigCdng.VehSpdVld -> HwAgSnsrls.VehSpdVld
    connect VehSigCdng.VehYawRate -> HwAgSnsrls.VehYawRate
    connect NvMProxy.PSProxy_Rte_NvmBlock_HwAgSnsrls_StordLstPrm -> HwAgSnsrls.NvmStordLstPrm
    connect CalRegn01Cmn.EotLrngHwAgOverTrvlCnt -> EotLrng.EotLrngHwAgOverTrvlCnt
    connect HwAgSysArbn.HwAgNotCorrd -> EotLrng.HwAg
    connect HwAgSysArbn.HwAgNotCorrd -> EotProtn.HwAg
    connect HwAgSysArbn.HwAgNotCorrd -> EotProtnFwl.HwAg
    connect NvMProxy.PSProxy_Rte_NvmBlock_EotLrng_MaxHwAgCwAndCcw -> EotLrng.MaxHwAgCwAndCcw
    connect DiagcMgrProxyAppl10.SetNtcSts10 -> HwAgVehCentrTrim.SetNtcSts
    connect CalRegn01Cmn.GmFctDiArbnEotHwAgThd -> GmFctDiArbn.GmFctDiArbnEotHwAgThd
    connect CalRegn01Cmn.GmFctDiArbnEotTi -> GmFctDiArbn.GmFctDiArbnEotTi
    connect CalRegn01Cmn.GmFctDiArbnOnCentrHwAgThd -> GmFctDiArbn.GmFctDiArbnOnCentrHwAgThd
    connect CalRegn01Cmn.GmFctDiArbnOnCentrHwTqThd -> GmFctDiArbn.GmFctDiArbnOnCentrHwTqThd
    connect CalRegn01Cmn.GmFctDiArbnOnCentrTi -> GmFctDiArbn.GmFctDiArbnOnCentrTi
    connect CalRegn01Cmn.GmFctDiArbnSrvTi -> GmFctDiArbn.GmFctDiArbnSrvTi
    connect CDD_NxtrTi.GetRefTmr100MicroSec32bit -> GmFctDiArbn.GetRefTmr100MicroSec32bit
    connect CDD_NxtrTi.GetTiSpan100MicroSec32bit -> GmFctDiArbn.GetTiSpan100MicroSec32bit
    connect EotLrng.HwAgEotCcw -> GmFctDiArbn.HwAgEotCcw
    connect EotLrng.HwAgEotCw -> GmFctDiArbn.HwAgEotCw
    connect GmFctDiArbn.ApaEnaArbn -> GmOvrlStMgr.ApaEna
    connect GmFctDiArbn.EscEnaArbn -> GmOvrlStMgr.EscEna
    connect GmFctDiArbn.LkaEnaArbn -> GmOvrlStMgr.LkaEna
    connect GmFctDiArbn.PullCmpActvDi -> PullCmpActv.PullCmpActvDi
    connect GmFctDiArbn.TunSetRtDi -> TunSelnAuthy.TunSelnRtDi
    connect GmFctDiArbn.WhlImbRejctnDi -> WhlImbRejctn.WhlImbRejctnDi
    connect GmMsg180BusChassisExp.EscReqActv -> GmFctDiArbn.EscEna
    connect GmMsg180BusHiSpd.LkaReqActv -> GmFctDiArbn.LkaEna
    connect GmMsg337BusChassisExp.ApaReqActv -> GmFctDiArbn.ApaEna
    connect HwAgSysArbn.PinionAg -> GmFctDiArbn.HwAg
    connect LoaMgr.LoaSt -> GmFctDiArbn.LoaSt
    connect CDD_GmT1xxMcuCfg.Adc1ScanGroup2Ref0 -> CDD_AdcDiagc.Adc1ScanGroup2Ref0
    connect CDD_GmT1xxMcuCfg.Adc1ScanGroup2Ref1 -> CDD_AdcDiagc.Adc1ScanGroup2Ref1
    connect CDD_GmT1xxMcuCfg.Adc1ScanGroup3Ref0 -> CDD_AdcDiagc.Adc1ScanGroup3Ref0
    connect CDD_GmT1xxMcuCfg.Adc1ScanGroup3Ref1 -> CDD_AdcDiagc.Adc1ScanGroup3Ref1
    connect CDD_MotCtrlMgr.Adc0ScanGroup2Ref0 -> CDD_AdcDiagc.Adc0ScanGroup2Ref0
    connect CDD_MotCtrlMgr.Adc0ScanGroup2Ref1 -> CDD_AdcDiagc.Adc0ScanGroup2Ref1
    connect CDD_MotCtrlMgr.Adc0ScanGroup3Ref0 -> CDD_AdcDiagc.Adc0ScanGroup3Ref0
    connect CDD_MotCtrlMgr.Adc0ScanGroup3Ref1 -> CDD_AdcDiagc.Adc0ScanGroup3Ref1
    connect CDD_AdcDiagc.AdcDiagcEndPtrOutp -> CDD_MotCtrlMgr.AdcDiagcEndPtrOutp
    connect CDD_AdcDiagc.AdcDiagcStrtPtrOutp -> CDD_MotCtrlMgr.AdcDiagcStrtPtrOutp
    connect GmFctDiArbn.InertiaCmpDecelGainDi -> InertiaCmpVel.InertiaCmpDecelGainDi
    connect GmFctDiArbn.GmFctDiReq -> CustDiagc.GmFctDiReq
    connect GmFctDiArbn.GmFctDiSts -> CustDiagc.GmFctDiSts
    connect GmMsg778BusHiSpd.ClrTrigStsAry -> CustDiagc.ClrTrigStsAry
    connect CalRegn02CmnGroupA.GmOvrlStMgrLkaMfgEna -> GmMsg184BusHiSpd.GmOvrlStMgrLkaMfgEna
    connect CmnMfgSrv.LoaScaDi -> LoaMgr.LoaScaDi
    connect CmnMfgSrv.FricLrngDi -> SysFricLrng.FricLrngDi
    connect DiagcMgr.ClrSnpshtData -> CmnMfgSrv.ClrSnpshtData
    connect DiagcMgr.ReadNtcInfoAndDebCntr -> CmnMfgSrv.ReadNtcInfoAndDebCntr
    connect DiagcMgr.ReadSnpshtData -> CmnMfgSrv.ReadSnpshtData
    connect DiagcMgrProxyAppl10.GetNtcSts10 -> CmnMfgSrv.GetNtcSts
    connect EotLrng.RstMaxHwAgCwAndCcw -> CmnMfgSrv.RstMaxHwAgCwAndCcw
    connect EotLrng.RtnMaxHwAgCwAndCcw -> CmnMfgSrv.RtnMaxHwAgCwAndCcw
    connect HwAgSnsrls.FSnsrlsHwCentr -> CmnMfgSrv.FSnsrlsHwCentr
    connect HwAgSnsrls.RstSnsrlsHwCentr -> CmnMfgSrv.RstSnsrlsHwCentr
    connect NvMProxy.PSProxy_Rte_NvmBlock_CmnMfgSrv_SeedKey -> CmnMfgSrv.NvmSeedKey
    connect CalRegn01Cmn.GateDrv0CtrlNtcNr0x050FailStep -> GateDrv0Ctrl.GateDrv0CtrlNtcNr0x050FailStep
    connect CalRegn01Cmn.GateDrv0CtrlNtcNr0x050PassStep -> GateDrv0Ctrl.GateDrv0CtrlNtcNr0x050PassStep
    connect CalRegn01Cmn.GateDrv0CtrlNtcNr0x051FailStep -> GateDrv0Ctrl.GateDrv0CtrlNtcNr0x051FailStep
    connect CalRegn01Cmn.GateDrv0CtrlNtcNr0x051PassStep -> GateDrv0Ctrl.GateDrv0CtrlNtcNr0x051PassStep
    connect CalRegn01Cmn.GateDrv0CtrlNtcNr0x055FailStep -> GateDrv0Ctrl.GateDrv0CtrlNtcNr0x055FailStep
    connect CalRegn01Cmn.GateDrv0CtrlNtcNr0x055PassStep -> GateDrv0Ctrl.GateDrv0CtrlNtcNr0x055PassStep
    connect CalRegn01Cmn.GateDrv0CtrlUnit0Cfg{2..4}WrVal -> GateDrv0Ctrl.GateDrv0CtrlUnit0Cfg{2..4}WrVal
    connect CalRegn01Cmn.GateDrv0CtrlUnit0Cfg7WrVal -> GateDrv0Ctrl.GateDrv0CtrlUnit0Cfg7WrVal
    connect DiagcMgr.DiagcStsIvtr1Inactv -> GateDrv0Ctrl.DiagcStsIvtr1Inactv
    connect DiagcMgrProxyAppl10.SetNtcSts10 -> GateDrv0Ctrl.SetNtcSts
    connect IoHwAb.GetGpioMotDrvr0Diag -> GateDrv0Ctrl.IoHwAb_GetGpioMotDrvr0Diag
    connect IoHwAb.SetGpioSysFlt2A -> GateDrv0Ctrl.IoHwAb_SetGpioSysFlt2A
    connect PwrUpSeq.StrtUpSt -> GateDrv0Ctrl.StrtUpSt
    connect SysStMod.SysSt -> GateDrv0Ctrl.SysSt
    connect CalRegn02Cmn.InertiaCmpVelDecelGainEnaCal -> InertiaCmpVel.InertiaCmpVelDecelGainEnaCal
    connect CalRegn02CmnGroupA.PullCmpActvEna -> PullCmpActv.PullCmpActvEna
    connect CalRegn01Cmn.GateDrv1CtrlNtcNr0x060FailStep -> GateDrv1Ctrl.GateDrv1CtrlNtcNr0x060FailStep
    connect CalRegn01Cmn.GateDrv1CtrlNtcNr0x060PassStep -> GateDrv1Ctrl.GateDrv1CtrlNtcNr0x060PassStep
    connect CalRegn01Cmn.GateDrv1CtrlNtcNr0x061FailStep -> GateDrv1Ctrl.GateDrv1CtrlNtcNr0x061FailStep
    connect CalRegn01Cmn.GateDrv1CtrlNtcNr0x061PassStep -> GateDrv1Ctrl.GateDrv1CtrlNtcNr0x061PassStep
    connect CalRegn01Cmn.GateDrv1CtrlNtcNr0x065FailStep -> GateDrv1Ctrl.GateDrv1CtrlNtcNr0x065FailStep
    connect CalRegn01Cmn.GateDrv1CtrlNtcNr0x065PassStep -> GateDrv1Ctrl.GateDrv1CtrlNtcNr0x065PassStep
    connect CalRegn01Cmn.GateDrv1CtrlUnit1Cfg{2..4}WrVal -> GateDrv1Ctrl.GateDrv1CtrlUnit1Cfg{2..4}WrVal
    connect CalRegn01Cmn.GateDrv1CtrlUnit1Cfg7WrVal -> GateDrv1Ctrl.GateDrv1CtrlUnit1Cfg7WrVal
    connect DiagcMgr.DiagcStsIvtr2Inactv -> GateDrv1Ctrl.DiagcStsIvtr2Inactv
    connect DiagcMgrProxyAppl10.SetNtcSts10 -> GateDrv1Ctrl.SetNtcSts
    connect IoHwAb.GetGpioMotDrvr1Diag -> GateDrv1Ctrl.IoHwAb_GetGpioMotDrvr1Diag
    connect IoHwAb.SetGpioSysFlt2B -> GateDrv1Ctrl.IoHwAb_SetGpioSysFlt2B
    connect PwrUpSeq.StrtUpSt -> GateDrv1Ctrl.StrtUpSt
    connect SysStMod.SysSt -> GateDrv1Ctrl.SysSt
    connect GateDrv0Ctrl.MotDrvr0IninTestCmpl -> PwrUpSeq.MotDrvr0IninTestCmpl
    connect GateDrv1Ctrl.MotDrvr1IninTestCmpl -> PwrUpSeq.MotDrvr1IninTestCmpl
    connect CalRegn01Cmn.AdcDiagcNtc0x032FailStep -> CDD_AdcDiagc.AdcDiagcNtc0x032FailStep
    connect CalRegn01Cmn.AdcDiagcNtc0x032PassStep -> CDD_AdcDiagc.AdcDiagcNtc0x032PassStep
    connect CalRegn01Cmn.AdcDiagcNtc0x033FailStep -> CDD_AdcDiagc.AdcDiagcNtc0x033FailStep
    connect CalRegn01Cmn.AdcDiagcNtc0x033PassStep -> CDD_AdcDiagc.AdcDiagcNtc0x033PassStep
    connect Swp.HwTqSwp -> GmFctDiArbn.HwTq
    connect CalRegn01Cmn.SnsrOffsLrngSampleCntForHwTqLrngRst -> SnsrOffsLrng.SnsrOffsLrngSampleCntForHwTqLrngRst
    connect CalRegn01Cmn.SysGlbPrmVehSpdBilnrSeln -> Assi.SysGlbPrmVehSpdBilnrSeln
    connect GmTqArbn.LkaTqCmdCdnd -> GmOvrlStMgr.LkaTqCmdCdnd
    connect CalRegn01Cmn.LoaMgrHwTqIdptSigFltThd -> GmMsg184BusHiSpd.LoaMgrHwTqIdptSigFltThd
    connect CalRegn01Cmn.LoaMgrHwTqIdptSigFltThd -> GmMsg335BusChassisExp.LoaMgrHwTqIdptSigFltThd
    connect GmMsg184BusHiSpd.MsgTxCallBack -> SerlComOutpProxy.Msg184TxCallBack
    connect GmMsg1CABusChassisExp.Msg1CATxCallBack -> SerlComOutpProxy.Msg1CATxCallBack
    connect GmMsg1E5BusChassisExp.Msg1E5ChassisExpTxCallBack -> SerlComOutpProxy.Msg1E5ChassisExpTxCallBack
    connect GmMsg1E5BusHiSpd.Msg1E5HiSpdCallBack -> SerlComOutpProxy.Msg1E5HiSpdTxCallBack
    connect GmMsg335BusChassisExp.Msg335TxCallBack -> SerlComOutpProxy.Msg335TxCallBack
    connect HwTqCorrln.HwTqIdptSig -> GmMsg184BusHiSpd.HwTqIdptSig
    connect HwTqCorrln.HwTqIdptSig -> GmMsg335BusChassisExp.HwTqIdptSig
    connect IoHwAb.SetGpioGateDrv0Rst -> GateDrv0Ctrl.IoHwAb_SetGpioGateDrv0Rst
    connect IoHwAb.SetGpioGateDrv1Rst -> GateDrv1Ctrl.IoHwAb_SetGpioGateDrv1Rst
    connect CalRegn01Cmn.PartNrCmpdVehPartnProdtStruct -> PartNr.PartNrCmpdVehPartnProdtStruct
    connect CalRegn01Cmn.WhlImbRejctnFrqDiagcLpFil -> WhlImbRejctn.WhlImbRejctnFrqDiagcLpFil
    connect CalRegn01Inin00.WhlImbRejctnDcTrendFltRcvryThd -> WhlImbRejctn.WhlImbRejctnDcTrendFltRcvryThd
    connect CalRegn01Inin00GroupB.WhlImbRejctnFrqDiagcAmpThd -> WhlImbRejctn.WhlImbRejctnFrqDiagcAmpThd
    connect CalRegn01Inin00GroupB.WhlImbRejctnFrqDiagcFltRcvryThd -> WhlImbRejctn.WhlImbRejctnFrqDiagcFltRcvryThd
    connect CalRegn01Inin00GroupB.WhlImbRejctnFrqDiagcThd -> WhlImbRejctn.WhlImbRejctnFrqDiagcThd
    connect CalRegn01Inin00GroupB.WhlImbRejctnFrqDiagcTout -> WhlImbRejctn.WhlImbRejctnFrqDiagcTout
    connect CalRegn01Inin00GroupB.WhlImbRejctnMaxMgnFltRcvryThd -> WhlImbRejctn.WhlImbRejctnMaxMgnFltRcvryThd
    connect CalRegn01Inin00GroupB.WhlImbRejctnMaxMgnFltThd -> WhlImbRejctn.WhlImbRejctnMaxMgnFltThd
    connect CalRegn01Inin00GroupB.WhlImbRejctnWhlSpdCorrlnFltRcvryThd -> WhlImbRejctn.WhlImbRejctnWhlSpdCorrlnFltRcvryThd
    connect CalRegn01Rt00.TunSelnAuthyHwTqY -> TunSelnAuthy.TunSelnAuthyHwTqY
    connect CalRegn01Rt00.TunSelnAuthyHwVelY -> TunSelnAuthy.TunSelnAuthyHwVelY
    connect CalRegn02Cmn.SnsrOffsCorrnHwAgLrndOffsLim -> SnsrOffsCorrn.SnsrOffsCorrnHwAgLrndOffsLim
    connect CalRegn02Cmn.SnsrOffsCorrnHwTqLrndOffsLim -> SnsrOffsCorrn.SnsrOffsCorrnHwTqLrndOffsLim
    connect CalRegn02Cmn.SnsrOffsCorrnVehYawRateLrndOffsLim -> SnsrOffsCorrn.SnsrOffsCorrnVehYawRateLrndOffsLim
    connect CalRegn02Cmn.SnsrOffsLrngHwAgLrngTi -> SnsrOffsLrng.SnsrOffsLrngHwAgLrngTi
    connect CalRegn02Cmn.SnsrOffsLrngHwTqLrngHwTqZeroOffsThd -> SnsrOffsLrng.SnsrOffsLrngHwTqLrngHwTqZeroOffsThd
    connect CalRegn02Cmn.SnsrOffsLrngHwTqLrngMeasTi -> SnsrOffsLrng.SnsrOffsLrngHwTqLrngMeasTi
    connect CalRegn02Cmn.SnsrOffsLrngHwTqLrngSampleImbThd1 -> SnsrOffsLrng.SnsrOffsLrngHwTqLrngSampleImbThd1
    connect CalRegn02Cmn.SnsrOffsLrngHwTqLrngSampleImbThd2 -> SnsrOffsLrng.SnsrOffsLrngHwTqLrngSampleImbThd2
    connect CalRegn02Cmn.SnsrOffsLrngHwTqLrngSampleThd1 -> SnsrOffsLrng.SnsrOffsLrngHwTqLrngSampleThd1
    connect CalRegn02Cmn.SnsrOffsLrngHwTqLrngSampleThd2 -> SnsrOffsLrng.SnsrOffsLrngHwTqLrngSampleThd2
    connect CalRegn02Cmn.SnsrOffsLrngHwTqLrngTiWghtCoeff -> SnsrOffsLrng.SnsrOffsLrngHwTqLrngTiWghtCoeff
    connect CalRegn02Cmn.SnsrOffsLrngYawLrngTi -> SnsrOffsLrng.SnsrOffsLrngYawLrngTi
    connect CalRegn02CmnGroupA.GmOvrlStMgrLkaHwTqThd1 -> GmOvrlStMgr.GmOvrlStMgrLkaHwTqThd1
    connect CalRegn02CmnGroupA.GmOvrlStMgrLkaHwTqThd2 -> GmOvrlStMgr.GmOvrlStMgrLkaHwTqThd2
    connect CalRegn02CmnGroupC.GmOvrlStMgrApaHaptcEna -> GmOvrlStMgr.GmOvrlStMgrApaHaptcEna
    connect CalRegn02CmnGroupC.GmOvrlStMgrApaHwTqThd -> GmOvrlStMgr.GmOvrlStMgrApaHwTqThd
    connect CalRegn02CmnGroupC.GmOvrlStMgrApaVehSpdHiLim -> GmOvrlStMgr.GmOvrlStMgrApaVehSpdHiLim
    connect CalRegn02CmnGroupC.GmOvrlStMgrEscVehSpdHiLim -> GmOvrlStMgr.GmOvrlStMgrEscVehSpdHiLim
    connect CalRegn02CmnGroupC.GmOvrlStMgrHaptcAmp -> GmOvrlStMgr.GmOvrlStMgrHaptcAmp
    connect CalRegn02CmnGroupC.GmOvrlStMgrHaptcDurn -> GmOvrlStMgr.GmOvrlStMgrHaptcDurn
    connect CalRegn02CmnGroupC.GmOvrlStMgrLkaVehSpdHiLim -> GmOvrlStMgr.GmOvrlStMgrLkaVehSpdHiLim
    connect CalRegn02CmnGroupC.GmOvrlStMgrLkaVehSpdLoLim -> GmOvrlStMgr.GmOvrlStMgrLkaVehSpdLoLim
    connect CalRegn02CmnGroupC.HowDetnHiFrqGainY -> HowDetn.HowDetnHiFrqGainY
    connect CalRegn02CmnGroupC.HowDetnHiFrqRateX -> HowDetn.HowDetnHiFrqRateX
    connect CalRegn02CmnGroupC.HowDetnHiFrqRateY -> HowDetn.HowDetnHiFrqRateY
    connect CalRegn02CmnGroupC.HowDetnLoFrqRateX -> HowDetn.HowDetnLoFrqRateX
    connect CalRegn02CmnGroupC.HowDetnLoFrqRateY -> HowDetn.HowDetnLoFrqRateY
    connect CalRegn02CmnGroupC.HowDetnMinVehSpd -> HowDetn.HowDetnMinVehSpd
    connect CalRegn02CmnGroupC.HowDetnPercOfPrevHowEstim -> HowDetn.HowDetnPercOfPrevHowEstim
    connect CalRegn02CmnGroupC.HowDetnSlewRate -> HowDetn.HowDetnSlewRate
    connect CalRegn02CmnGroupC.HowDetnStThdX -> HowDetn.HowDetnStThdX
    connect CalRegn02CmnGroupC.HowDetnTqHpFilFrq -> HowDetn.HowDetnTqHpFilFrq
    connect CalRegn02CmnGroupC.HowDetnVehSpd -> HowDetn.HowDetnVehSpd
    connect CalRegn02CmnGroupC.SnsrOffsLrngHwAgLrngDrvgDstThd -> SnsrOffsLrng.SnsrOffsLrngHwAgLrngDrvgDstThd
    connect CalRegn02CmnGroupC.SnsrOffsLrngHwAgLrngHwVelThd -> SnsrOffsLrng.SnsrOffsLrngHwAgLrngHwVelThd
    connect CalRegn02CmnGroupC.SnsrOffsLrngHwAgLrngSysTqThd -> SnsrOffsLrng.SnsrOffsLrngHwAgLrngSysTqThd
    connect CalRegn02CmnGroupC.SnsrOffsLrngHwAgLrngSysTqThdMed -> SnsrOffsLrng.SnsrOffsLrngHwAgLrngSysTqThdMed
    connect CalRegn02CmnGroupC.SnsrOffsLrngHwAgLrngSysTqThdTrustd -> SnsrOffsLrng.SnsrOffsLrngHwAgLrngSysTqThdTrustd
    connect CalRegn02CmnGroupC.SnsrOffsLrngHwAgLrngSysTqThdWide -> SnsrOffsLrng.SnsrOffsLrngHwAgLrngSysTqThdWide
    connect CalRegn02CmnGroupC.SnsrOffsLrngHwAgLrngVehSpdThd -> SnsrOffsLrng.SnsrOffsLrngHwAgLrngVehSpdThd
    connect CalRegn02CmnGroupC.SnsrOffsLrngHwAgLrngYawOffsDbnd -> SnsrOffsLrng.SnsrOffsLrngHwAgLrngYawOffsDbnd
    connect CalRegn02CmnGroupC.SnsrOffsLrngHwAgLrngYawRateThd -> SnsrOffsLrng.SnsrOffsLrngHwAgLrngYawRateThd
    connect CalRegn02CmnGroupC.SnsrOffsLrngHwAgOffsLim -> SnsrOffsLrng.SnsrOffsLrngHwAgOffsLim
    connect CalRegn02CmnGroupC.SnsrOffsLrngHwTqLrngEnaTiThd -> SnsrOffsLrng.SnsrOffsLrngHwTqLrngEnaTiThd
    connect CalRegn02CmnGroupC.SnsrOffsLrngHwTqLrngHwAgDbnd -> SnsrOffsLrng.SnsrOffsLrngHwTqLrngHwAgDbnd
    connect CalRegn02CmnGroupC.SnsrOffsLrngHwTqLrngHwAgThd -> SnsrOffsLrng.SnsrOffsLrngHwTqLrngHwAgThd
    connect CalRegn02CmnGroupC.SnsrOffsLrngHwTqLrngHwTqThd -> SnsrOffsLrng.SnsrOffsLrngHwTqLrngHwTqThd
    connect CalRegn02CmnGroupC.SnsrOffsLrngHwTqLrngHwVelThd -> SnsrOffsLrng.SnsrOffsLrngHwTqLrngHwVelThd
    connect CalRegn02CmnGroupC.SnsrOffsLrngHwTqLrngMeasTiScar -> SnsrOffsLrng.SnsrOffsLrngHwTqLrngMeasTiScar
    connect CalRegn02CmnGroupC.SnsrOffsLrngHwTqLrngVehSpdThd -> SnsrOffsLrng.SnsrOffsLrngHwTqLrngVehSpdThd
    connect CalRegn02CmnGroupC.SnsrOffsLrngHwTqOffsLim -> SnsrOffsLrng.SnsrOffsLrngHwTqOffsLim
    connect CalRegn02CmnGroupC.SnsrOffsLrngTqInpDetnPwrEstimnThd -> SnsrOffsLrng.SnsrOffsLrngTqInpDetnPwrEstimnThd
    connect CalRegn02CmnGroupC.SnsrOffsLrngTqInpDetnSinGenrAmp -> SnsrOffsLrng.SnsrOffsLrngTqInpDetnSinGenrAmp
    connect CalRegn02CmnGroupC.SnsrOffsLrngTqInpDetnSinGenrFrq -> SnsrOffsLrng.SnsrOffsLrngTqInpDetnSinGenrFrq
    connect CalRegn02CmnGroupC.SnsrOffsLrngTqInpDetnStg1FilGain -> SnsrOffsLrng.SnsrOffsLrngTqInpDetnStg1FilGain
    connect CalRegn02CmnGroupC.SnsrOffsLrngTqInpDetnStg1WinSize -> SnsrOffsLrng.SnsrOffsLrngTqInpDetnStg1WinSize
    connect CalRegn02CmnGroupC.SnsrOffsLrngTqInpDetnStg2FilGainCen -> SnsrOffsLrng.SnsrOffsLrngTqInpDetnStg2FilGainCen
    connect CalRegn02CmnGroupC.SnsrOffsLrngTqInpDetnStg2FilGainDwn -> SnsrOffsLrng.SnsrOffsLrngTqInpDetnStg2FilGainDwn
    connect CalRegn02CmnGroupC.SnsrOffsLrngTqInpDetnStg2FilGainUp -> SnsrOffsLrng.SnsrOffsLrngTqInpDetnStg2FilGainUp
    connect CalRegn02CmnGroupC.SnsrOffsLrngTqInpDetnStg2WinSize -> SnsrOffsLrng.SnsrOffsLrngTqInpDetnStg2WinSize
    connect CalRegn02CmnGroupC.SnsrOffsLrngYawLrngEna -> SnsrOffsLrng.SnsrOffsLrngYawLrngEna
    connect CalRegn02CmnGroupC.SnsrOffsLrngYawLrngHwAgThd -> SnsrOffsLrng.SnsrOffsLrngYawLrngHwAgThd
    connect CalRegn02CmnGroupC.SnsrOffsLrngYawLrngYawAThd -> SnsrOffsLrng.SnsrOffsLrngYawLrngYawAThd
    connect CalRegn02CmnGroupC.SnsrOffsLrngYawOffsFrshTiThd -> SnsrOffsLrng.SnsrOffsLrngYawOffsFrshTiThd
    connect CalRegn02CmnGroupC.SnsrOffsLrngYawRateOffsLim -> SnsrOffsLrng.SnsrOffsLrngYawRateOffsLim
    connect CalRegn02Inin00.GmOvrlStMgrApaHwTqFilFrq -> GmOvrlStMgr.GmOvrlStMgrApaHwTqFilFrq
    connect CalRegn02Inin00.GmOvrlStMgrHwTqFilFrq -> GmOvrlStMgr.GmOvrlStMgrHwTqFilFrq
    connect CalRegn02Inin00.GmOvrlStMgrLkaHwTqFilFrq -> GmOvrlStMgr.GmOvrlStMgrLkaHwTqFilFrq
    connect CalRegn02Inin00.GmOvrlStMgrLkaHwTqTiThd2 -> GmOvrlStMgr.GmOvrlStMgrLkaHwTqTiThd2
    connect CalRegn02Inin00.GmTqArbnApaAssiScaEna -> GmTqArbn.GmTqArbnApaAssiScaEna
    connect CalRegn02Inin00.GmTqArbnApaDampgScaEna -> GmTqArbn.GmTqArbnApaDampgScaEna
    connect CalRegn02Inin00.GmTqArbnApaRtnScaEna -> GmTqArbn.GmTqArbnApaRtnScaEna
    connect CalRegn02Inin00.GmTqArbnEscMaxTq -> GmTqArbn.GmTqArbnEscMaxTq
    connect CalRegn02Inin00.HowDetnEstimLpFilFrq -> HowDetn.HowDetnEstimLpFilFrq
    connect CalRegn02Inin00.HowDetnStLpFilFrq -> HowDetn.HowDetnStLpFilFrq
    connect CalRegn02Inin00.HowDetnTqFinalLpFilFrq -> HowDetn.HowDetnTqFinalLpFilFrq
    connect CalRegn02Inin00.HowDetnTqInitLpFilFrq -> HowDetn.HowDetnTqInitLpFilFrq
    connect CalRegn02Inin00.SnsrOffsLrngHwVelFilFrq -> SnsrOffsLrng.SnsrOffsLrngHwVelFilFrq
    connect CalRegn02Inin00.SnsrOffsLrngTqAndAgFilFrq -> SnsrOffsLrng.SnsrOffsLrngTqAndAgFilFrq
    connect CalRegn02Inin00.SnsrOffsLrngTqInpDetnHwTqFilFrq -> SnsrOffsLrng.SnsrOffsLrngTqInpDetnHwTqFilFrq
    connect CalRegn02Inin00.SnsrOffsLrngYawACdngFilFrq -> SnsrOffsLrng.SnsrOffsLrngYawACdngFilFrq
    connect CalRegn02Inin00.SnsrOffsLrngYawRateCdngFilFrq -> SnsrOffsLrng.SnsrOffsLrngYawRateCdngFilFrq
    connect CalRegn02Inin00GroupA.GmOvrlStMgrLkaHwTqTiThd1 -> GmOvrlStMgr.GmOvrlStMgrLkaHwTqTiThd1
    connect CalRegn02Inin00GroupC.GmOvrlStMgrApaHwTqTiThd -> GmOvrlStMgr.GmOvrlStMgrApaHwTqTiThd
    connect CalRegn02Inin00GroupC.GmOvrlStMgrHaptcFrq -> GmOvrlStMgr.GmOvrlStMgrHaptcFrq
    connect CalRegn02Inin00GroupC.GmOvrlStMgrHaptcReactnTi -> GmOvrlStMgr.GmOvrlStMgrHaptcReactnTi
    connect CalRegn02Inin00GroupC.GmOvrlStMgrHaptcReqTiThd -> GmOvrlStMgr.GmOvrlStMgrHaptcReqTiThd
    connect CalRegn02Inin00GroupC.GmStrtStopFltRateLim -> GmStrtStop.GmStrtStopFltRateLim
    connect CalRegn02Inin00GroupC.GmStrtStopMod1EngTranThd -> GmStrtStop.GmStrtStopMod1EngTranThd
    connect CalRegn02Inin00GroupC.GmStrtStopMod1Sca -> GmStrtStop.GmStrtStopMod1Sca
    connect CalRegn02Inin00GroupC.GmStrtStopMod1ToStopRateLim -> GmStrtStop.GmStrtStopMod1ToStopRateLim
    connect CalRegn02Inin00GroupC.GmStrtStopMod1VehSpdTranThd -> GmStrtStop.GmStrtStopMod1VehSpdTranThd
    connect CalRegn02Inin00GroupC.GmStrtStopMod2Sca -> GmStrtStop.GmStrtStopMod2Sca
    connect CalRegn02Inin00GroupC.GmStrtStopNormModEngTranThd -> GmStrtStop.GmStrtStopNormModEngTranThd
    connect CalRegn02Inin00GroupC.GmStrtStopNormModVehSpdTranThd -> GmStrtStop.GmStrtStopNormModVehSpdTranThd
    connect CalRegn02Inin00GroupC.GmStrtStopNormRateLim -> GmStrtStop.GmStrtStopNormRateLim
    connect CalRegn02Inin00GroupC.GmStrtStopNormToMod1RateLim -> GmStrtStop.GmStrtStopNormToMod1RateLim
    connect CalRegn02Inin00GroupC.GmStrtStopStopAndMod2RateLim -> GmStrtStop.GmStrtStopStopAndMod2RateLim
    connect CalRegn02Inin00GroupC.GmStrtStopStopMod1HwTqTranThd -> GmStrtStop.GmStrtStopStopMod1HwTqTranThd
    connect CalRegn02Inin00GroupC.GmStrtStopStopMod1HwVelTranThd -> GmStrtStop.GmStrtStopStopMod1HwVelTranThd
    connect CalRegn02Inin00GroupC.GmStrtStopStopMod1Tmr -> GmStrtStop.GmStrtStopStopMod1Tmr
    connect CalRegn02Inin00GroupC.GmStrtStopStopMod1VehSpdTranThd -> GmStrtStop.GmStrtStopStopMod1VehSpdTranThd
    connect CalRegn02Inin00GroupC.GmStrtStopStopMod2HwTqTranThd -> GmStrtStop.GmStrtStopStopMod2HwTqTranThd
    connect CalRegn02Inin00GroupC.GmStrtStopStopMod2HwVelTranThd -> GmStrtStop.GmStrtStopStopMod2HwVelTranThd
    connect CalRegn02Inin00GroupC.GmStrtStopStopMod2Tmr -> GmStrtStop.GmStrtStopStopMod2Tmr
    connect CalRegn02Inin00GroupC.GmStrtStopStopMod2VehSpdTranThd -> GmStrtStop.GmStrtStopStopMod2VehSpdTranThd
    connect CalRegn02Inin00GroupC.GmStrtStopStopModSca -> GmStrtStop.GmStrtStopStopModSca
    connect CalRegn02Inin00GroupC.GmTqArbnApaDiRateX -> GmTqArbn.GmTqArbnApaDiRateX
    connect CalRegn02Inin00GroupC.GmTqArbnLkaSlewEna -> GmTqArbn.GmTqArbnLkaSlewEna
    connect CalRegn02Rt00GroupC.GmOvrlStMgrHwAgTarLimr -> GmOvrlStMgr.GmOvrlStMgrHwAgTarLimr
    connect CalRegn02Rt00GroupC.GmOvrlStMgrShiftLvrTiThd -> GmOvrlStMgr.GmOvrlStMgrShiftLvrTiThd
    connect CalRegn02Rt00GroupC.GmOvrlStMgrStandStillThd -> GmOvrlStMgr.GmOvrlStMgrStandStillThd
    connect CalRegn02Rt00GroupC.GmOvrlStMgrStandStillTiThd -> GmOvrlStMgr.GmOvrlStMgrStandStillTiThd
    connect CalRegn02Rt00GroupC.GmTqArbnApaDiRateY -> GmTqArbn.GmTqArbnApaDiRateY
    connect CalRegn02Rt00GroupC.GmTqArbnApaEnaRate -> GmTqArbn.GmTqArbnApaEnaRate
    connect CalRegn02Rt00GroupC.GmTqArbnApaSmotngHwTqLpFilFrq -> GmTqArbn.GmTqArbnApaSmotngHwTqLpFilFrq
    connect CalRegn02Rt00GroupC.GmTqArbnApaSmotngX -> GmTqArbn.GmTqArbnApaSmotngX
    connect CalRegn02Rt00GroupC.GmTqArbnApaSmotngY -> GmTqArbn.GmTqArbnApaSmotngY
    connect CalRegn02Rt00GroupC.GmTqArbnLkaSlewX -> GmTqArbn.GmTqArbnLkaSlewX
    connect CalRegn02Rt00GroupC.GmTqArbnLkaSlewY -> GmTqArbn.GmTqArbnLkaSlewY
    connect CalRegn03Cmn.EotProtnSoftEndStopAuthyThd -> EotProtn.EotProtnSoftEndStopAuthyThd
    connect CalRegn03Cmn.TqLoaDrvrTqNom -> TqLoa.TqLoaDrvrTqNom
    connect CalRegn03Cmn.TqLoaMotTqCmdLim -> TqLoa.TqLoaMotTqCmdLim
    connect CalRegn03Cmn.TqLoaMotVelAndTqBasdScaFacFallRate -> TqLoa.TqLoaMotVelAndTqBasdScaFacFallRate
    connect CalRegn03Cmn.TqLoaMotVelAndTqBasdScaFacMax -> TqLoa.TqLoaMotVelAndTqBasdScaFacMax
    connect CalRegn03Cmn.TqLoaMotVelAndTqBasdScaFacMin -> TqLoa.TqLoaMotVelAndTqBasdScaFacMin
    connect CalRegn03Cmn.TqLoaMotVelAndTqBasdScaFacRiseRate -> TqLoa.TqLoaMotVelAndTqBasdScaFacRiseRate
    connect CalRegn03Cmn.TqLoaMotVelMgnThd -> TqLoa.TqLoaMotVelMgnThd
    connect CalRegn03Cmn.TqLoaTqCmdLimY -> TqLoa.TqLoaTqCmdLimY
    connect CalRegn03Cmn.TqLoaTqCmdMgnThd -> TqLoa.TqLoaTqCmdMgnThd
    connect CalRegn03Cmn.TqLoaVehLatADifScaFacFallRate -> TqLoa.TqLoaVehLatADifScaFacFallRate
    connect CalRegn03Cmn.TqLoaVehLatADifScaFacRiseRate -> TqLoa.TqLoaVehLatADifScaFacRiseRate
    connect CalRegn03Cmn.TqLoaVehLatADifScaFacX -> TqLoa.TqLoaVehLatADifScaFacX
    connect CalRegn03Cmn.TqLoaVehLatADifScaFacY -> TqLoa.TqLoaVehLatADifScaFacY
    connect CalRegn03Cmn.TqLoaVehLatAEstimnFilFrq -> TqLoa.TqLoaVehLatAEstimnFilFrq
    connect CalRegn03Cmn.TqLoaVehLatAGainY -> TqLoa.TqLoaVehLatAGainY
    connect CalRegn03Cmn.TqLoaVehSpdScaFacX -> TqLoa.TqLoaVehSpdScaFacX
    connect CalRegn03Cmn.TqLoaVehSpdScaFacY -> TqLoa.TqLoaVehSpdScaFacY
    connect CalRegn03Cmn.TqLoaVehSpdX -> TqLoa.TqLoaVehSpdX
    connect CalRegn03Cmn.TqLoaVehSteerRat -> TqLoa.TqLoaVehSteerRat
    connect CalRegn03Cmn.TqLoaVehUnderSteerGrdt -> TqLoa.TqLoaVehUnderSteerGrdt
    connect CalRegn03Cmn.TqLoaVehWhlBas -> TqLoa.TqLoaVehWhlBas
    connect CalRegn03CmnGroupB.EotProtnActvRegnBypMaxThd -> EotProtn.EotProtnActvRegnBypMaxThd
    connect CalRegn03CmnGroupB.EotProtnDeltaTqThd -> EotProtn.EotProtnDeltaTqThd
    connect CalRegn03CmnGroupB.EotProtnMotSpdIncptY -> EotProtn.EotProtnMotSpdIncptY
    connect CalRegn03CmnGroupB.InertiaCmpVelDampgWhlImbRejctnBlndX -> InertiaCmpVel.InertiaCmpVelDampgWhlImbRejctnBlndX
    connect CalRegn03CmnGroupB.InertiaCmpVelDampgWhlImbRejctnBlndY -> InertiaCmpVel.InertiaCmpVelDampgWhlImbRejctnBlndY
    connect CalRegn03CmnGroupB.PullCmpActvCmpLrnTiDecShoTerm -> PullCmpActv.PullCmpActvCmpLrnTiDecShoTerm
    connect CalRegn03CmnGroupB.PullCmpActvCmpLrnTiIncShoTerm -> PullCmpActv.PullCmpActvCmpLrnTiIncShoTerm
    connect CalRegn03CmnGroupB.PullCmpActvCmpLrnTiLongTerm -> PullCmpActv.PullCmpActvCmpLrnTiLongTerm
    connect CalRegn03CmnGroupB.PullCmpActvCmpShoTermRstHwAgThd -> PullCmpActv.PullCmpActvCmpShoTermRstHwAgThd
    connect CalRegn03CmnGroupB.PullCmpActvCmpShoTermRstHwTqThd -> PullCmpActv.PullCmpActvCmpShoTermRstHwTqThd
    connect CalRegn03CmnGroupB.PullCmpActvCmpShoTermRstLatAThd -> PullCmpActv.PullCmpActvCmpShoTermRstLatAThd
    connect CalRegn03CmnGroupB.PullCmpActvCmpShoTermRstYawRateThd -> PullCmpActv.PullCmpActvCmpShoTermRstYawRateThd
    connect CalRegn03CmnGroupB.PullCmpActvHwTqFilFrqLongTerm -> PullCmpActv.PullCmpActvHwTqFilFrqLongTerm
    connect CalRegn03CmnGroupB.PullCmpActvHwTqFilFrqLrngEna -> PullCmpActv.PullCmpActvHwTqFilFrqLrngEna
    connect CalRegn03CmnGroupB.PullCmpActvHwTqFilFrqShoTerm -> PullCmpActv.PullCmpActvHwTqFilFrqShoTerm
    connect CalRegn03CmnGroupB.PullCmpActvLongTermLim -> PullCmpActv.PullCmpActvLongTermLim
    connect CalRegn03CmnGroupB.PullCmpActvLrngEnaAgConfMinMgn -> PullCmpActv.PullCmpActvLrngEnaAgConfMinMgn
    connect CalRegn03CmnGroupB.PullCmpActvLrngEnaHwAgMaxMgn -> PullCmpActv.PullCmpActvLrngEnaHwAgMaxMgn
    connect CalRegn03CmnGroupB.PullCmpActvLrngEnaHwTqMaxMgn -> PullCmpActv.PullCmpActvLrngEnaHwTqMaxMgn
    connect CalRegn03CmnGroupB.PullCmpActvLrngEnaHwVelMaxMgn -> PullCmpActv.PullCmpActvLrngEnaHwVelMaxMgn
    connect CalRegn03CmnGroupB.PullCmpActvLrngEnaLatAMaxMgn -> PullCmpActv.PullCmpActvLrngEnaLatAMaxMgn
    connect CalRegn03CmnGroupB.PullCmpActvLrngEnaTiThd -> PullCmpActv.PullCmpActvLrngEnaTiThd
    connect CalRegn03CmnGroupB.PullCmpActvLrngEnaVehSpdMaxMgn -> PullCmpActv.PullCmpActvLrngEnaVehSpdMaxMgn
    connect CalRegn03CmnGroupB.PullCmpActvLrngEnaVehSpdMinMgn -> PullCmpActv.PullCmpActvLrngEnaVehSpdMinMgn
    connect CalRegn03CmnGroupB.PullCmpActvLrngEnaVehSpdRateMaxMgn -> PullCmpActv.PullCmpActvLrngEnaVehSpdRateMaxMgn
    connect CalRegn03CmnGroupB.PullCmpActvLrngEnaYawRateMaxMgn -> PullCmpActv.PullCmpActvLrngEnaYawRateMaxMgn
    connect CalRegn03CmnGroupB.PullCmpActvOpstSignTiShoTerm -> PullCmpActv.PullCmpActvOpstSignTiShoTerm
    connect CalRegn03CmnGroupB.PullCmpActvOutpMaxRate -> PullCmpActv.PullCmpActvOutpMaxRate
    connect CalRegn03CmnGroupB.PullCmpActvPullCmpShoTermLim -> PullCmpActv.PullCmpActvPullCmpShoTermLim
    connect CalRegn03CmnGroupB.PullCmpActvPullCmpTotLim -> PullCmpActv.PullCmpActvPullCmpTotLim
    connect CalRegn03CmnGroupB.PullCmpActvPullErrLimLongTerm -> PullCmpActv.PullCmpActvPullErrLimLongTerm
    connect CalRegn03CmnGroupB.PullCmpActvPullErrMgnThd -> PullCmpActv.PullCmpActvPullErrMgnThd
    connect CalRegn03CmnGroupB.PullCmpActvPullErrShoTermLim -> PullCmpActv.PullCmpActvPullErrShoTermLim
    connect CalRegn03CmnGroupB.PullCmpActvShoTermRampTi -> PullCmpActv.PullCmpActvShoTermRampTi
    connect CalRegn03CmnGroupB.PullCmpActvVehSpdScaTblX -> PullCmpActv.PullCmpActvVehSpdScaTblX
    connect CalRegn03CmnGroupB.PullCmpActvVehSpdScaTblY -> PullCmpActv.PullCmpActvVehSpdScaTblY
    connect CalRegn03CmnGroupC.GmOvrlStMgrLoaMtgtnHaptcFbOffTi -> GmOvrlStMgr.GmOvrlStMgrLoaMtgtnHaptcFbOffTi
    connect CalRegn03CmnGroupC.GmOvrlStMgrLoaMtgtnHaptcFbOnTi -> GmOvrlStMgr.GmOvrlStMgrLoaMtgtnHaptcFbOnTi
    connect CalRegn03CmnGroupC.GmOvrlStMgrLoaMtgtnHaptcFbTqMax -> GmOvrlStMgr.GmOvrlStMgrLoaMtgtnHaptcFbTqMax
    connect CalRegn03CmnGroupC.GmOvrlStMgrLoaMtgtnHaptcFbTqMin -> GmOvrlStMgr.GmOvrlStMgrLoaMtgtnHaptcFbTqMin
    connect CalRegn03CmnGroupC.GmOvrlStMgrLoaMtgtnHaptcFbVehSpdMax -> GmOvrlStMgr.GmOvrlStMgrLoaMtgtnHaptcFbVehSpdMax
    connect CalRegn03CmnGroupC.GmOvrlStMgrLoaMtgtnHaptcFbVehSpdMin -> GmOvrlStMgr.GmOvrlStMgrLoaMtgtnHaptcFbVehSpdMin
    connect CalRegn03CmnGroupC.GmOvrlStMgrLoaMtgtnHaptcFrq -> GmOvrlStMgr.GmOvrlStMgrLoaMtgtnHaptcFrq
    connect CalRegn03CmnGroupC.GmOvrlStMgrLoaMtgtnTqOscnAmpY -> GmOvrlStMgr.GmOvrlStMgrLoaMtgtnTqOscnAmpY
    connect CalRegn03CmnGroupC.GmOvrlStMgrLoaMtgtnVehSpdX -> GmOvrlStMgr.GmOvrlStMgrLoaMtgtnVehSpdX
    connect CalRegn03Inin00.EotLrngRackTrvlMin -> CustDiagc.EotLrngRackTrvlMin
    connect CalRegn03Inin00.EotLrngEotLrnTmr -> EotLrng.EotLrngEotLrnTmr
    connect CalRegn03Inin00.EotLrngHwTqEotLrn -> EotLrng.EotLrngHwTqEotLrn
    connect CalRegn03Inin00.EotLrngMotVelEotLrn -> EotLrng.EotLrngMotVelEotLrn
    connect CalRegn03Inin00.EotLrngRackTrvlMax -> EotLrng.EotLrngRackTrvlMax
    connect CalRegn03Inin00.EotLrngRstAuthyMin -> EotLrng.EotLrngRstAuthyMin
    connect CalRegn03Inin00.EotProtnDftPosn -> EotProtn.EotProtnDftPosn
    connect CalRegn03Inin00.EotProtnEntrStLpFilFrq -> EotProtn.EotProtnEntrStLpFilFrq
    connect CalRegn03Inin00.EotProtnExitStLpFilFrq -> EotProtn.EotProtnExitStLpFilFrq
    connect CalRegn03Inin00.EotProtnHwAgMax -> EotProtn.EotProtnHwAgMax
    connect CalRegn03Inin00.EotProtnHwTqLpFilFrq -> EotProtn.EotProtnHwTqLpFilFrq
    connect CalRegn03Inin00.EotProtnMotSpdIncptSca -> EotProtn.EotProtnMotSpdIncptSca
    connect CalRegn03Inin00.EotProtnMotSpdIncptX -> EotProtn.EotProtnMotSpdIncptX
    connect CalRegn03Inin00.EotProtnPosnRampStep -> EotProtn.EotProtnPosnRampStep
    connect CalRegn03Inin00.EotProtnRackTrvlLimrAuthyThd -> EotProtn.EotProtnRackTrvlLimrAuthyThd
    connect CalRegn03Inin00.EotProtnRackTrvlLimrAuthyThdLimd -> EotProtn.EotProtnRackTrvlLimrAuthyThdLimd
    connect CalRegn03Inin00.EotProtnRackTrvlLimrEna -> EotProtn.EotProtnRackTrvlLimrEna
    connect CalRegn03Inin00.EotProtnRunEotVelImpctAndSoftEndStop -> EotProtn.EotProtnRunEotVelImpctAndSoftEndStop
    connect CalRegn03Inin00.EotProtnSoftEndStopEna -> EotProtn.EotProtnSoftEndStopEna
    connect CalRegn03Inin00.EotProtnHwAgMin -> EotProtnFwl.EotProtnHwAgMin
    connect CalRegn03Inin00.GmOvrlStMgrLoaMtgtnHaptcFbStrtOnTi -> GmOvrlStMgr.GmOvrlStMgrLoaMtgtnHaptcFbStrtOnTi
    connect CalRegn03Inin00.GmOvrlStMgrLoaMtgtnStrtHaptcAmp -> GmOvrlStMgr.GmOvrlStMgrLoaMtgtnStrtHaptcAmp
    connect CalRegn03Inin00.GmOvrlStMgrLoaStIgnCntrThd -> GmOvrlStMgr.GmOvrlStMgrLoaStIgnCntrThd
    connect CalRegn03Inin00.SysGlbPrmSysTqRat -> HwAgSnsrls.SysGlbPrmSysTqRat
    connect CalRegn03Inin00.InertiaCmpVelMotInertia -> InertiaCmpVel.InertiaCmpVelMotInertia
    connect CalRegn03Inin00.InertiaCmpVelNotchFilStruct -> InertiaCmpVel.InertiaCmpVelNotchFilStruct
    connect CalRegn03Inin00.InertiaCmpVelTqSnsrVelFilFrq -> InertiaCmpVel.InertiaCmpVelTqSnsrVelFilFrq
    connect CalRegn03Inin00.SysGlbPrmSysKineRat -> InertiaCmpVel.SysGlbPrmSysKineRat
    connect CalRegn03Inin00.PullCmpActvYawRateFilFrq -> PullCmpActv.PullCmpActvYawRateFilFrq
    connect CalRegn03Inin00.PwrpkCmpbltyChkGearId -> PwrpkCmpbltyChk.PwrpkCmpbltyChkGearId
    connect CalRegn03Inin00.StabyCmpAssiScaBlndX -> StabyCmp.StabyCmpAssiScaBlndX
    connect CalRegn03Inin00.StabyCmpAssiScaBlndY -> StabyCmp.StabyCmpAssiScaBlndY
    connect CalRegn03Inin00.StabyCmpHwTqLpFilFrq -> StabyCmp.StabyCmpHwTqLpFilFrq
    connect CalRegn03Inin00.StabyCmpNotchFil{1..4}Struct -> StabyCmp.StabyCmpNotchFil{1..4}Struct
    connect CalRegn03Inin00.StabyCmpNotchFilBlnd04Y -> StabyCmp.StabyCmpNotchFilBlnd04Y
    connect CalRegn03Inin00.StabyCmpNotchFilBlnd34Y -> StabyCmp.StabyCmpNotchFilBlnd34Y
    connect CalRegn03Inin00.EotLrngAuthyStrtLrn -> StHlthSigNormn.EotLrngAuthyStrtLrn
    connect CalRegn03Inin00GroupA.InertiaCmpVelCmdScaY -> InertiaCmpVel.InertiaCmpVelCmdScaY
    connect CalRegn03Inin00GroupA.InertiaCmpVelDampgDecelGain -> InertiaCmpVel.InertiaCmpVelDampgDecelGain
    connect CalRegn03Inin00GroupA.InertiaCmpVelDampgDecelGainFallSlew -> InertiaCmpVel.InertiaCmpVelDampgDecelGainFallSlew
    connect CalRegn03Inin00GroupA.InertiaCmpVelDampgDecelGainRisngSlewX -> InertiaCmpVel.InertiaCmpVelDampgDecelGainRisngSlewX
    connect CalRegn03Inin00GroupA.InertiaCmpVelDampgDecelGainRisngSlewY -> InertiaCmpVel.InertiaCmpVelDampgDecelGainRisngSlewY
    connect CalRegn03Inin00GroupA.InertiaCmpVelDampgGainOffThd -> InertiaCmpVel.InertiaCmpVelDampgGainOffThd
    connect CalRegn03Inin00GroupA.InertiaCmpVelDampgGainOnThd -> InertiaCmpVel.InertiaCmpVelDampgGainOnThd
    connect CalRegn03Inin00GroupA.InertiaCmpVelMotVelBasdOutpScagX -> InertiaCmpVel.InertiaCmpVelMotVelBasdOutpScagX
    connect CalRegn03Inin00GroupA.InertiaCmpVelMotVelBasdOutpScagY -> InertiaCmpVel.InertiaCmpVelMotVelBasdOutpScagY
    connect CalRegn03Inin00GroupA.InertiaCmpVelTqSnsrVelSca -> InertiaCmpVel.InertiaCmpVelTqSnsrVelSca
    connect CalRegn03Inin00GroupA.StabyCmpNotchFilBilnrBlndVehSpd -> StabyCmp.StabyCmpNotchFilBilnrBlndVehSpd
    connect CalRegn03Inin00GroupA.StabyCmpNotchFilBlnd02Y -> StabyCmp.StabyCmpNotchFilBlnd02Y
    connect CalRegn03Inin00GroupA.StabyCmpNotchFilBlnd12Y -> StabyCmp.StabyCmpNotchFilBlnd12Y
    connect CalRegn03Inin00GroupB.EotProtnDampgSlew -> EotProtn.EotProtnDampgSlew
    connect CalRegn03Inin00GroupB.EotProtnHwAgGain -> EotProtn.EotProtnHwAgGain
    connect CalRegn03Inin00GroupB.EotProtnHwTqScaX -> EotProtn.EotProtnHwTqScaX
    connect CalRegn03Inin00GroupB.EotProtnMotVelGain -> EotProtn.EotProtnMotVelGain
    connect CalRegn03Inin00GroupB.EotProtnRackTrvlLimrRngLimd -> EotProtn.EotProtnRackTrvlLimrRngLimd
    connect CalRegn03Inin00GroupB.EotProtnRackTrvlLimrVehSpdThd -> EotProtn.EotProtnRackTrvlLimrVehSpdThd
    connect CalRegn03Inin00GroupB.EotProtnSoftEndStopVehSpdThd -> EotProtn.EotProtnSoftEndStopVehSpdThd
    connect CalRegn03Inin00GroupB.EotProtnRackTrvlLimrRng -> EotProtnFwl.EotProtnRackTrvlLimrRng
    connect CalRegn03Rt00GroupA.InertiaCmpVelAssiBasdDampgCoeffX -> InertiaCmpVel.InertiaCmpVelAssiBasdDampgCoeffX
    connect CalRegn03Rt00GroupA.InertiaCmpVelAssiBasdDampgRollgY -> InertiaCmpVel.InertiaCmpVelAssiBasdDampgRollgY
    connect CalRegn03Rt00GroupA.InertiaCmpVelAssiBasdDampgStatY -> InertiaCmpVel.InertiaCmpVelAssiBasdDampgStatY
    connect CalRegn03Rt00GroupA.InertiaCmpVelDampgSpdBlndY -> InertiaCmpVel.InertiaCmpVelDampgSpdBlndY
    connect CalRegn03Rt00GroupA.InertiaCmpVelNotchBlndY -> InertiaCmpVel.InertiaCmpVelNotchBlndY
    connect CalRegn03Rt00GroupB.EotProtnDampgVehSpdTbl -> EotProtn.EotProtnDampgVehSpdTbl
    connect CalRegn03Rt00GroupB.EotProtnEntrGainVehSpdTbl -> EotProtn.EotProtnEntrGainVehSpdTbl
    connect CalRegn03Rt00GroupB.EotProtnEntrGainX -> EotProtn.EotProtnEntrGainX
    connect CalRegn03Rt00GroupB.EotProtnEntrGainY -> EotProtn.EotProtnEntrGainY
    connect CalRegn03Rt00GroupB.EotProtnExitDampgY -> EotProtn.EotProtnExitDampgY
    connect CalRegn03Rt00GroupB.EotProtnNormDampgY -> EotProtn.EotProtnNormDampgY
    connect CalRegn03Rt00GroupB.EotProtnHwDegDampgX -> EotProtnFwl.EotProtnHwDegDampgX
    connect CalRegn03Rt00GroupB.InertiaCmpVelAssiBasdDampgRollgWhlImbRejctnOnY -> InertiaCmpVel.InertiaCmpVelAssiBasdDampgRollgWhlImbRejctnOnY
    connect CalRegn03Rt00.InertiaCmpVelDampgFilFrq -> InertiaCmpVel.InertiaCmpVelDampgFilFrq
    connect CalRegn03Rt00.InertiaCmpVelDampgFilFrqWhlImbRejctnOn -> InertiaCmpVel.InertiaCmpVelDampgFilFrqWhlImbRejctnOn
    connect CalRegn01CmnGroupB.WhlImbRejctnFrqDiagcEna -> WhlImbRejctn.WhlImbRejctnFrqDiagcEna
    connect CalRegn01CmnGroupB.WhlImbRejctnFrqDiagcUgrPoleMgn -> WhlImbRejctn.WhlImbRejctnFrqDiagcUgrPoleMgn
    connect CalRegn03Cmn.EotProtnSoftEndStopAuthyThd -> EotProtnFwl.EotProtnSoftEndStopAuthyThd
    connect CalRegn03CmnGroupB.PullCmpActvCmpShoTermRstYawRateThd -> PullCmpActv.PullCmpActvCmpShoTermRstYawRate
    connect CalRegn03Inin00.EotLrngAuthyStrtLrn -> EotLrng.EotLrngAuthyStrtLrn
    connect CalRegn03Inin00.EotLrngRackTrvlMin -> EotLrng.EotLrngRackTrvlMin
    connect CalRegn03Inin00.EotProtnRackTrvlLimrEna -> EotLrng.EotProtnRackTrvlLimrEna
    connect CalRegn03Inin00.EotProtnHwAgMin -> EotProtn.EotProtnHwAgMin
    connect CalRegn03Inin00.SysGlbPrmSysKineRat -> HwAgSnsrls.SysGlbPrmSysKineRat
    connect CalRegn03Inin00.SysGlbPrmSysTqRat -> HysCmp.SysGlbPrmSysTqRat
    connect CalRegn03Inin00.SysGlbPrmSysTqRat -> PullCmpActv.SysGlbPrmSysTqRat
    connect CalRegn03Inin00.SysGlbPrmSysTqRat -> SnsrOffsLrng.SysGlbPrmSysTqRat
    connect CalRegn03Inin00GroupB.EotProtnRackTrvlLimrRng -> EotProtn.EotProtnRackTrvlLimrRng
    connect FltInj.FltInj_u08 -> CurrMeasCorrln.FltInj_u08
    connect CalRegn01Cmn.StHlthSigNormnMaxFricThd -> StHlthSigNormn.StHlthSigNormnMaxFricThd
    connect CalRegn01Cmn.StHlthSigNormnWhlImbRejctnThd -> StHlthSigNormn.StHlthSigNormnWhlImbRejctnThd
    connect SysFricLrng.GetFricLrngData -> StHlthSigNormn.GetFricLrngData
    connect SysFricLrng.MaxLrndFric -> StHlthSigNormn.MaxLrndFric
    connect WhlImbRejctn.WhlImbRejctnCmd -> StHlthSigNormn.WhlImbRejctnCmd
    connect StHlthSigNormn.FricEstimnStHlth -> StHlthSigStc.FricEstimnStHlth
    connect StHlthSigNormn.WhlImbMaxCmpStHlth -> StHlthSigStc.WhlImbMaxCmpStHlth
    connect CalRegn03Rt00GroupB.EotProtnHwDegDampgX -> EotProtn.EotProtnHwDegDampgX
    connect GmMsg232BusHiSpd.DesRtIdx -> TunSelnMngt.DesRtIdx
    connect CalRegn01Rt00.TEstimnMagAmbMplr -> AAACalRegn01Rt01_Dummy.TEstimnMagAmbMplr
    connect CalRegn01Rt00.TunSelnAuthyHwTqY -> AAACalRegn01Rt01_Dummy.TunSelnAuthyHwTqY
    connect CalRegn01Rt00.TunSelnAuthyHwVelY -> AAACalRegn01Rt01_Dummy.TunSelnAuthyHwVelY
    connect CalRegn01Rt01.TEstimnMagAmbMplr -> AAACalRegn01Rt01_Dummy_1.TEstimnMagAmbMplr
    connect CalRegn01Rt01.TunSelnAuthyHwTqY -> AAACalRegn01Rt01_Dummy_1.TunSelnAuthyHwTqY
    connect CalRegn01Rt01.TunSelnAuthyHwVelY -> AAACalRegn01Rt01_Dummy_1.TunSelnAuthyHwVelY
    connect CalRegn01Rt02.TEstimnMagAmbMplr -> AAACalRegn01Rt01_Dummy_2.TEstimnMagAmbMplr
    connect CalRegn01Rt02.TunSelnAuthyHwTqY -> AAACalRegn01Rt01_Dummy_2.TunSelnAuthyHwTqY
    connect CalRegn01Rt02.TunSelnAuthyHwVelY -> AAACalRegn01Rt01_Dummy_2.TunSelnAuthyHwVelY
    connect CalRegn01Rt03.TEstimnMagAmbMplr -> AAACalRegn01Rt01_Dummy_3.TEstimnMagAmbMplr
    connect CalRegn01Rt03.TunSelnAuthyHwTqY -> AAACalRegn01Rt01_Dummy_3.TunSelnAuthyHwTqY
    connect CalRegn01Rt03.TunSelnAuthyHwVelY -> AAACalRegn01Rt01_Dummy_3.TunSelnAuthyHwVelY
    connect CalRegn01Rt04.TEstimnMagAmbMplr -> AAACalRegn01Rt01_Dummy_4.TEstimnMagAmbMplr
    connect CalRegn01Rt04.TunSelnAuthyHwTqY -> AAACalRegn01Rt01_Dummy_4.TunSelnAuthyHwTqY
    connect CalRegn01Rt04.TunSelnAuthyHwVelY -> AAACalRegn01Rt01_Dummy_4.TunSelnAuthyHwVelY
    connect CalRegn02Rt00GroupC.GmOvrlStMgrHwAgTarLimr -> AAACalRegn02Rt01GroupC_Dummy.GmOvrlStMgrHwAgTarLimr
    connect CalRegn02Rt00GroupC.GmOvrlStMgrShiftLvrTiThd -> AAACalRegn02Rt01GroupC_Dummy.GmOvrlStMgrShiftLvrTiThd
    connect CalRegn02Rt00GroupC.GmOvrlStMgrStandStillThd -> AAACalRegn02Rt01GroupC_Dummy.GmOvrlStMgrStandStillThd
    connect CalRegn02Rt00GroupC.GmOvrlStMgrStandStillTiThd -> AAACalRegn02Rt01GroupC_Dummy.GmOvrlStMgrStandStillTiThd
    connect CalRegn02Rt00GroupC.GmTqArbnApaDiRateY -> AAACalRegn02Rt01GroupC_Dummy.GmTqArbnApaDiRateY
    connect CalRegn02Rt00GroupC.GmTqArbnApaEnaRate -> AAACalRegn02Rt01GroupC_Dummy.GmTqArbnApaEnaRate
    connect CalRegn02Rt00GroupC.GmTqArbnApaSmotngHwTqLpFilFrq -> AAACalRegn02Rt01GroupC_Dummy.GmTqArbnApaSmotngHwTqLpFilFrq
    connect CalRegn02Rt00GroupC.GmTqArbnApaSmotngX -> AAACalRegn02Rt01GroupC_Dummy.GmTqArbnApaSmotngX
    connect CalRegn02Rt00GroupC.GmTqArbnApaSmotngY -> AAACalRegn02Rt01GroupC_Dummy.GmTqArbnApaSmotngY
    connect CalRegn02Rt00GroupC.GmTqArbnLkaSlewX -> AAACalRegn02Rt01GroupC_Dummy.GmTqArbnLkaSlewX
    connect CalRegn02Rt00GroupC.GmTqArbnLkaSlewY -> AAACalRegn02Rt01GroupC_Dummy.GmTqArbnLkaSlewY
    connect CalRegn02Rt01GroupC.GmOvrlStMgrHwAgTarLimr -> AAACalRegn02Rt01GroupC_Dummy_1.GmOvrlStMgrHwAgTarLimr
    connect CalRegn02Rt01GroupC.GmOvrlStMgrShiftLvrTiThd -> AAACalRegn02Rt01GroupC_Dummy_1.GmOvrlStMgrShiftLvrTiThd
    connect CalRegn02Rt01GroupC.GmOvrlStMgrStandStillThd -> AAACalRegn02Rt01GroupC_Dummy_1.GmOvrlStMgrStandStillThd
    connect CalRegn02Rt01GroupC.GmOvrlStMgrStandStillTiThd -> AAACalRegn02Rt01GroupC_Dummy_1.GmOvrlStMgrStandStillTiThd
    connect CalRegn02Rt01GroupC.GmTqArbnApaDiRateY -> AAACalRegn02Rt01GroupC_Dummy_1.GmTqArbnApaDiRateY
    connect CalRegn02Rt01GroupC.GmTqArbnApaEnaRate -> AAACalRegn02Rt01GroupC_Dummy_1.GmTqArbnApaEnaRate
    connect CalRegn02Rt01GroupC.GmTqArbnApaSmotngHwTqLpFilFrq -> AAACalRegn02Rt01GroupC_Dummy_1.GmTqArbnApaSmotngHwTqLpFilFrq
    connect CalRegn02Rt01GroupC.GmTqArbnApaSmotngX -> AAACalRegn02Rt01GroupC_Dummy_1.GmTqArbnApaSmotngX
    connect CalRegn02Rt01GroupC.GmTqArbnApaSmotngY -> AAACalRegn02Rt01GroupC_Dummy_1.GmTqArbnApaSmotngY
    connect CalRegn02Rt01GroupC.GmTqArbnLkaSlewX -> AAACalRegn02Rt01GroupC_Dummy_1.GmTqArbnLkaSlewX
    connect CalRegn02Rt01GroupC.GmTqArbnLkaSlewY -> AAACalRegn02Rt01GroupC_Dummy_1.GmTqArbnLkaSlewY
    connect CalRegn02Rt02GroupC.GmOvrlStMgrHwAgTarLimr -> AAACalRegn02Rt01GroupC_Dummy_2.GmOvrlStMgrHwAgTarLimr
    connect CalRegn02Rt02GroupC.GmOvrlStMgrShiftLvrTiThd -> AAACalRegn02Rt01GroupC_Dummy_2.GmOvrlStMgrShiftLvrTiThd
    connect CalRegn02Rt02GroupC.GmOvrlStMgrStandStillThd -> AAACalRegn02Rt01GroupC_Dummy_2.GmOvrlStMgrStandStillThd
    connect CalRegn02Rt02GroupC.GmOvrlStMgrStandStillTiThd -> AAACalRegn02Rt01GroupC_Dummy_2.GmOvrlStMgrStandStillTiThd
    connect CalRegn02Rt02GroupC.GmTqArbnApaDiRateY -> AAACalRegn02Rt01GroupC_Dummy_2.GmTqArbnApaDiRateY
    connect CalRegn02Rt02GroupC.GmTqArbnApaEnaRate -> AAACalRegn02Rt01GroupC_Dummy_2.GmTqArbnApaEnaRate
    connect CalRegn02Rt02GroupC.GmTqArbnApaSmotngHwTqLpFilFrq -> AAACalRegn02Rt01GroupC_Dummy_2.GmTqArbnApaSmotngHwTqLpFilFrq
    connect CalRegn02Rt02GroupC.GmTqArbnApaSmotngX -> AAACalRegn02Rt01GroupC_Dummy_2.GmTqArbnApaSmotngX
    connect CalRegn02Rt02GroupC.GmTqArbnApaSmotngY -> AAACalRegn02Rt01GroupC_Dummy_2.GmTqArbnApaSmotngY
    connect CalRegn02Rt02GroupC.GmTqArbnLkaSlewX -> AAACalRegn02Rt01GroupC_Dummy_2.GmTqArbnLkaSlewX
    connect CalRegn02Rt02GroupC.GmTqArbnLkaSlewY -> AAACalRegn02Rt01GroupC_Dummy_2.GmTqArbnLkaSlewY
    connect CalRegn02Rt03GroupC.GmOvrlStMgrHwAgTarLimr -> AAACalRegn02Rt01GroupC_Dummy_3.GmOvrlStMgrHwAgTarLimr
    connect CalRegn02Rt03GroupC.GmOvrlStMgrShiftLvrTiThd -> AAACalRegn02Rt01GroupC_Dummy_3.GmOvrlStMgrShiftLvrTiThd
    connect CalRegn02Rt03GroupC.GmOvrlStMgrStandStillThd -> AAACalRegn02Rt01GroupC_Dummy_3.GmOvrlStMgrStandStillThd
    connect CalRegn02Rt03GroupC.GmOvrlStMgrStandStillTiThd -> AAACalRegn02Rt01GroupC_Dummy_3.GmOvrlStMgrStandStillTiThd
    connect CalRegn02Rt03GroupC.GmTqArbnApaDiRateY -> AAACalRegn02Rt01GroupC_Dummy_3.GmTqArbnApaDiRateY
    connect CalRegn02Rt03GroupC.GmTqArbnApaEnaRate -> AAACalRegn02Rt01GroupC_Dummy_3.GmTqArbnApaEnaRate
    connect CalRegn02Rt03GroupC.GmTqArbnApaSmotngHwTqLpFilFrq -> AAACalRegn02Rt01GroupC_Dummy_3.GmTqArbnApaSmotngHwTqLpFilFrq
    connect CalRegn02Rt03GroupC.GmTqArbnApaSmotngX -> AAACalRegn02Rt01GroupC_Dummy_3.GmTqArbnApaSmotngX
    connect CalRegn02Rt03GroupC.GmTqArbnApaSmotngY -> AAACalRegn02Rt01GroupC_Dummy_3.GmTqArbnApaSmotngY
    connect CalRegn02Rt03GroupC.GmTqArbnLkaSlewX -> AAACalRegn02Rt01GroupC_Dummy_3.GmTqArbnLkaSlewX
    connect CalRegn02Rt03GroupC.GmTqArbnLkaSlewY -> AAACalRegn02Rt01GroupC_Dummy_3.GmTqArbnLkaSlewY
    connect CalRegn02Rt04GroupC.GmOvrlStMgrHwAgTarLimr -> AAACalRegn02Rt01GroupC_Dummy_4.GmOvrlStMgrHwAgTarLimr
    connect CalRegn02Rt04GroupC.GmOvrlStMgrShiftLvrTiThd -> AAACalRegn02Rt01GroupC_Dummy_4.GmOvrlStMgrShiftLvrTiThd
    connect CalRegn02Rt04GroupC.GmOvrlStMgrStandStillThd -> AAACalRegn02Rt01GroupC_Dummy_4.GmOvrlStMgrStandStillThd
    connect CalRegn02Rt04GroupC.GmOvrlStMgrStandStillTiThd -> AAACalRegn02Rt01GroupC_Dummy_4.GmOvrlStMgrStandStillTiThd
    connect CalRegn02Rt04GroupC.GmTqArbnApaDiRateY -> AAACalRegn02Rt01GroupC_Dummy_4.GmTqArbnApaDiRateY
    connect CalRegn02Rt04GroupC.GmTqArbnApaEnaRate -> AAACalRegn02Rt01GroupC_Dummy_4.GmTqArbnApaEnaRate
    connect CalRegn02Rt04GroupC.GmTqArbnApaSmotngHwTqLpFilFrq -> AAACalRegn02Rt01GroupC_Dummy_4.GmTqArbnApaSmotngHwTqLpFilFrq
    connect CalRegn02Rt04GroupC.GmTqArbnApaSmotngX -> AAACalRegn02Rt01GroupC_Dummy_4.GmTqArbnApaSmotngX
    connect CalRegn02Rt04GroupC.GmTqArbnApaSmotngY -> AAACalRegn02Rt01GroupC_Dummy_4.GmTqArbnApaSmotngY
    connect CalRegn02Rt04GroupC.GmTqArbnLkaSlewX -> AAACalRegn02Rt01GroupC_Dummy_4.GmTqArbnLkaSlewX
    connect CalRegn02Rt04GroupC.GmTqArbnLkaSlewY -> AAACalRegn02Rt01GroupC_Dummy_4.GmTqArbnLkaSlewY
    connect CalRegn03Rt00.InertiaCmpVelDampgFilFrq -> AAACalRegn03Rt01_Dummy.InertiaCmpVelDampgFilFrq
    connect CalRegn03Rt00.InertiaCmpVelDampgFilFrqWhlImbRejctnOn -> AAACalRegn03Rt01_Dummy.InertiaCmpVelDampgFilFrqWhlImbRejctnOn
    connect CalRegn03Rt00GroupA.AssiHiFrqGainY -> AAACalRegn03Rt01GroupA_Dummy_4.AssiHiFrqGainY
    connect CalRegn03Rt00GroupA.AssiHiFrqTqX -> AAACalRegn03Rt01GroupA_Dummy_4.AssiHiFrqTqX
    connect CalRegn03Rt00GroupA.AssiMotTqWhlImbRejctnMinX -> AAACalRegn03Rt01GroupA_Dummy_4.AssiMotTqWhlImbRejctnMinX
    connect CalRegn03Rt00GroupA.AssiMotTqWhlImbRejctnMinY -> AAACalRegn03Rt01GroupA_Dummy_4.AssiMotTqWhlImbRejctnMinY
    connect CalRegn03Rt00GroupA.DampgHydCoeff{1..4}ScaY -> AAACalRegn03Rt01GroupA_Dummy_4.DampgHydCoeff{1..4}ScaY
    connect CalRegn03Rt00GroupA.DampgMotVelX -> AAACalRegn03Rt01GroupA_Dummy_4.DampgMotVelX
    connect CalRegn03Rt00GroupA.DampgMotVelY -> AAACalRegn03Rt01GroupA_Dummy_4.DampgMotVelY
    connect CalRegn03Rt00GroupA.HysCmpFricWhlImbRejctnBlndX -> AAACalRegn03Rt01GroupA_Dummy_4.HysCmpFricWhlImbRejctnBlndX
    connect CalRegn03Rt00GroupA.HysCmpFricWhlImbRejctnBlndY -> AAACalRegn03Rt01GroupA_Dummy_4.HysCmpFricWhlImbRejctnBlndY
    connect CalRegn03Rt00GroupA.HysCmpFricWhlImbRejctnOffY -> AAACalRegn03Rt01GroupA_Dummy_4.HysCmpFricWhlImbRejctnOffY
    connect CalRegn03Rt00GroupA.HysCmpFricWhlImbRejctnOnY -> AAACalRegn03Rt01GroupA_Dummy_4.HysCmpFricWhlImbRejctnOnY
    connect CalRegn03Rt00GroupA.InertiaCmpVelAssiBasdDampgCoeffX -> AAACalRegn03Rt01GroupA_Dummy_4.InertiaCmpVelAssiBasdDampgCoeffX
    connect CalRegn03Rt00GroupA.InertiaCmpVelAssiBasdDampgRollgY -> AAACalRegn03Rt01GroupA_Dummy_4.InertiaCmpVelAssiBasdDampgRollgY
    connect CalRegn03Rt00GroupA.InertiaCmpVelAssiBasdDampgStatY -> AAACalRegn03Rt01GroupA_Dummy_4.InertiaCmpVelAssiBasdDampgStatY
    connect CalRegn03Rt00GroupA.InertiaCmpVelDampgSpdBlndY -> AAACalRegn03Rt01GroupA_Dummy_4.InertiaCmpVelDampgSpdBlndY
    connect CalRegn03Rt00GroupA.InertiaCmpVelNotchBlndY -> AAACalRegn03Rt01GroupA_Dummy_4.InertiaCmpVelNotchBlndY
    connect CalRegn03Rt00GroupA.RtnHwAgOffsCalcdX -> AAACalRegn03Rt01GroupA_Dummy_4.RtnHwAgOffsCalcdX
    connect CalRegn03Rt00GroupA.RtnHwAgOffsCalcdY -> AAACalRegn03Rt01GroupA_Dummy_4.RtnHwAgOffsCalcdY
    connect CalRegn03Rt00GroupA.RtnScaTqX -> AAACalRegn03Rt01GroupA_Dummy_4.RtnScaTqX
    connect CalRegn03Rt00GroupA.RtnScaTqY -> AAACalRegn03Rt01GroupA_Dummy_4.RtnScaTqY
    connect CalRegn03Rt00GroupA.RtnScaVelX -> AAACalRegn03Rt01GroupA_Dummy_4.RtnScaVelX
    connect CalRegn03Rt00GroupA.RtnScaVelY -> AAACalRegn03Rt01GroupA_Dummy_4.RtnScaVelY
    connect CalRegn03Rt01.InertiaCmpVelDampgFilFrq -> AAACalRegn03Rt01_Dummy_1.InertiaCmpVelDampgFilFrq
    connect CalRegn03Rt01.InertiaCmpVelDampgFilFrqWhlImbRejctnOn -> AAACalRegn03Rt01_Dummy_1.InertiaCmpVelDampgFilFrqWhlImbRejctnOn
    connect CalRegn03Rt01GroupA.AssiHiFrqGainY -> AAACalRegn03Rt01GroupA_Dummy.AssiHiFrqGainY
    connect CalRegn03Rt01GroupA.AssiHiFrqTqX -> AAACalRegn03Rt01GroupA_Dummy.AssiHiFrqTqX
    connect CalRegn03Rt01GroupA.AssiMotTqWhlImbRejctnMinX -> AAACalRegn03Rt01GroupA_Dummy.AssiMotTqWhlImbRejctnMinX
    connect CalRegn03Rt01GroupA.AssiMotTqWhlImbRejctnMinY -> AAACalRegn03Rt01GroupA_Dummy.AssiMotTqWhlImbRejctnMinY
    connect CalRegn03Rt01GroupA.DampgHydCoeff{1..4}ScaY -> AAACalRegn03Rt01GroupA_Dummy.DampgHydCoeff{1..4}ScaY
    connect CalRegn03Rt01GroupA.DampgMotVelX -> AAACalRegn03Rt01GroupA_Dummy.DampgMotVelX
    connect CalRegn03Rt01GroupA.DampgMotVelY -> AAACalRegn03Rt01GroupA_Dummy.DampgMotVelY
    connect CalRegn03Rt01GroupA.HysCmpFricWhlImbRejctnBlndX -> AAACalRegn03Rt01GroupA_Dummy.HysCmpFricWhlImbRejctnBlndX
    connect CalRegn03Rt01GroupA.HysCmpFricWhlImbRejctnBlndY -> AAACalRegn03Rt01GroupA_Dummy.HysCmpFricWhlImbRejctnBlndY
    connect CalRegn03Rt01GroupA.HysCmpFricWhlImbRejctnOffY -> AAACalRegn03Rt01GroupA_Dummy.HysCmpFricWhlImbRejctnOffY
    connect CalRegn03Rt01GroupA.HysCmpFricWhlImbRejctnOnY -> AAACalRegn03Rt01GroupA_Dummy.HysCmpFricWhlImbRejctnOnY
    connect CalRegn03Rt01GroupA.InertiaCmpVelAssiBasdDampgCoeffX -> AAACalRegn03Rt01GroupA_Dummy.InertiaCmpVelAssiBasdDampgCoeffX
    connect CalRegn03Rt01GroupA.InertiaCmpVelAssiBasdDampgRollgY -> AAACalRegn03Rt01GroupA_Dummy.InertiaCmpVelAssiBasdDampgRollgY
    connect CalRegn03Rt01GroupA.InertiaCmpVelAssiBasdDampgStatY -> AAACalRegn03Rt01GroupA_Dummy.InertiaCmpVelAssiBasdDampgStatY
    connect CalRegn03Rt01GroupA.InertiaCmpVelDampgSpdBlndY -> AAACalRegn03Rt01GroupA_Dummy.InertiaCmpVelDampgSpdBlndY
    connect CalRegn03Rt01GroupA.InertiaCmpVelNotchBlndY -> AAACalRegn03Rt01GroupA_Dummy.InertiaCmpVelNotchBlndY
    connect CalRegn03Rt01GroupA.RtnHwAgOffsCalcdX -> AAACalRegn03Rt01GroupA_Dummy.RtnHwAgOffsCalcdX
    connect CalRegn03Rt01GroupA.RtnHwAgOffsCalcdY -> AAACalRegn03Rt01GroupA_Dummy.RtnHwAgOffsCalcdY
    connect CalRegn03Rt01GroupA.RtnScaTqX -> AAACalRegn03Rt01GroupA_Dummy.RtnScaTqX
    connect CalRegn03Rt01GroupA.RtnScaTqY -> AAACalRegn03Rt01GroupA_Dummy.RtnScaTqY
    connect CalRegn03Rt01GroupA.RtnScaVelX -> AAACalRegn03Rt01GroupA_Dummy.RtnScaVelX
    connect CalRegn03Rt01GroupA.RtnScaVelY -> AAACalRegn03Rt01GroupA_Dummy.RtnScaVelY
    connect CalRegn03Rt02.InertiaCmpVelDampgFilFrq -> AAACalRegn03Rt01_Dummy_2.InertiaCmpVelDampgFilFrq
    connect CalRegn03Rt02.InertiaCmpVelDampgFilFrqWhlImbRejctnOn -> AAACalRegn03Rt01_Dummy_2.InertiaCmpVelDampgFilFrqWhlImbRejctnOn
    connect CalRegn03Rt02GroupA.AssiHiFrqGainY -> AAACalRegn03Rt01GroupA_Dummy_1.AssiHiFrqGainY
    connect CalRegn03Rt02GroupA.AssiHiFrqTqX -> AAACalRegn03Rt01GroupA_Dummy_1.AssiHiFrqTqX
    connect CalRegn03Rt02GroupA.AssiMotTqWhlImbRejctnMinX -> AAACalRegn03Rt01GroupA_Dummy_1.AssiMotTqWhlImbRejctnMinX
    connect CalRegn03Rt02GroupA.AssiMotTqWhlImbRejctnMinY -> AAACalRegn03Rt01GroupA_Dummy_1.AssiMotTqWhlImbRejctnMinY
    connect CalRegn03Rt02GroupA.DampgHydCoeff{1..4}ScaY -> AAACalRegn03Rt01GroupA_Dummy_1.DampgHydCoeff{1..4}ScaY
    connect CalRegn03Rt02GroupA.DampgMotVelX -> AAACalRegn03Rt01GroupA_Dummy_1.DampgMotVelX
    connect CalRegn03Rt02GroupA.DampgMotVelY -> AAACalRegn03Rt01GroupA_Dummy_1.DampgMotVelY
    connect CalRegn03Rt02GroupA.HysCmpFricWhlImbRejctnBlndX -> AAACalRegn03Rt01GroupA_Dummy_1.HysCmpFricWhlImbRejctnBlndX
    connect CalRegn03Rt02GroupA.HysCmpFricWhlImbRejctnBlndY -> AAACalRegn03Rt01GroupA_Dummy_1.HysCmpFricWhlImbRejctnBlndY
    connect CalRegn03Rt02GroupA.HysCmpFricWhlImbRejctnOffY -> AAACalRegn03Rt01GroupA_Dummy_1.HysCmpFricWhlImbRejctnOffY
    connect CalRegn03Rt02GroupA.HysCmpFricWhlImbRejctnOnY -> AAACalRegn03Rt01GroupA_Dummy_1.HysCmpFricWhlImbRejctnOnY
    connect CalRegn03Rt02GroupA.InertiaCmpVelAssiBasdDampgCoeffX -> AAACalRegn03Rt01GroupA_Dummy_1.InertiaCmpVelAssiBasdDampgCoeffX
    connect CalRegn03Rt02GroupA.InertiaCmpVelAssiBasdDampgRollgY -> AAACalRegn03Rt01GroupA_Dummy_1.InertiaCmpVelAssiBasdDampgRollgY
    connect CalRegn03Rt02GroupA.InertiaCmpVelAssiBasdDampgStatY -> AAACalRegn03Rt01GroupA_Dummy_1.InertiaCmpVelAssiBasdDampgStatY
    connect CalRegn03Rt02GroupA.InertiaCmpVelDampgSpdBlndY -> AAACalRegn03Rt01GroupA_Dummy_1.InertiaCmpVelDampgSpdBlndY
    connect CalRegn03Rt02GroupA.InertiaCmpVelNotchBlndY -> AAACalRegn03Rt01GroupA_Dummy_1.InertiaCmpVelNotchBlndY
    connect CalRegn03Rt02GroupA.RtnHwAgOffsCalcdX -> AAACalRegn03Rt01GroupA_Dummy_1.RtnHwAgOffsCalcdX
    connect CalRegn03Rt02GroupA.RtnHwAgOffsCalcdY -> AAACalRegn03Rt01GroupA_Dummy_1.RtnHwAgOffsCalcdY
    connect CalRegn03Rt02GroupA.RtnScaTqX -> AAACalRegn03Rt01GroupA_Dummy_1.RtnScaTqX
    connect CalRegn03Rt02GroupA.RtnScaTqY -> AAACalRegn03Rt01GroupA_Dummy_1.RtnScaTqY
    connect CalRegn03Rt02GroupA.RtnScaVelX -> AAACalRegn03Rt01GroupA_Dummy_1.RtnScaVelX
    connect CalRegn03Rt02GroupA.RtnScaVelY -> AAACalRegn03Rt01GroupA_Dummy_1.RtnScaVelY
    connect CalRegn03Rt03.InertiaCmpVelDampgFilFrq -> AAACalRegn03Rt01_Dummy_3.InertiaCmpVelDampgFilFrq
    connect CalRegn03Rt03.InertiaCmpVelDampgFilFrqWhlImbRejctnOn -> AAACalRegn03Rt01_Dummy_3.InertiaCmpVelDampgFilFrqWhlImbRejctnOn
    connect CalRegn03Rt03GroupA.AssiHiFrqGainY -> AAACalRegn03Rt01GroupA_Dummy_2.AssiHiFrqGainY
    connect CalRegn03Rt03GroupA.AssiHiFrqTqX -> AAACalRegn03Rt01GroupA_Dummy_2.AssiHiFrqTqX
    connect CalRegn03Rt03GroupA.AssiMotTqWhlImbRejctnMinX -> AAACalRegn03Rt01GroupA_Dummy_2.AssiMotTqWhlImbRejctnMinX
    connect CalRegn03Rt03GroupA.AssiMotTqWhlImbRejctnMinY -> AAACalRegn03Rt01GroupA_Dummy_2.AssiMotTqWhlImbRejctnMinY
    connect CalRegn03Rt03GroupA.DampgHydCoeff{1..4}ScaY -> AAACalRegn03Rt01GroupA_Dummy_2.DampgHydCoeff{1..4}ScaY
    connect CalRegn03Rt03GroupA.DampgMotVelX -> AAACalRegn03Rt01GroupA_Dummy_2.DampgMotVelX
    connect CalRegn03Rt03GroupA.DampgMotVelY -> AAACalRegn03Rt01GroupA_Dummy_2.DampgMotVelY
    connect CalRegn03Rt03GroupA.HysCmpFricWhlImbRejctnBlndX -> AAACalRegn03Rt01GroupA_Dummy_2.HysCmpFricWhlImbRejctnBlndX
    connect CalRegn03Rt03GroupA.HysCmpFricWhlImbRejctnBlndY -> AAACalRegn03Rt01GroupA_Dummy_2.HysCmpFricWhlImbRejctnBlndY
    connect CalRegn03Rt03GroupA.HysCmpFricWhlImbRejctnOffY -> AAACalRegn03Rt01GroupA_Dummy_2.HysCmpFricWhlImbRejctnOffY
    connect CalRegn03Rt03GroupA.HysCmpFricWhlImbRejctnOnY -> AAACalRegn03Rt01GroupA_Dummy_2.HysCmpFricWhlImbRejctnOnY
    connect CalRegn03Rt03GroupA.InertiaCmpVelAssiBasdDampgCoeffX -> AAACalRegn03Rt01GroupA_Dummy_2.InertiaCmpVelAssiBasdDampgCoeffX
    connect CalRegn03Rt03GroupA.InertiaCmpVelAssiBasdDampgRollgY -> AAACalRegn03Rt01GroupA_Dummy_2.InertiaCmpVelAssiBasdDampgRollgY
    connect CalRegn03Rt03GroupA.InertiaCmpVelAssiBasdDampgStatY -> AAACalRegn03Rt01GroupA_Dummy_2.InertiaCmpVelAssiBasdDampgStatY
    connect CalRegn03Rt03GroupA.InertiaCmpVelDampgSpdBlndY -> AAACalRegn03Rt01GroupA_Dummy_2.InertiaCmpVelDampgSpdBlndY
    connect CalRegn03Rt03GroupA.InertiaCmpVelNotchBlndY -> AAACalRegn03Rt01GroupA_Dummy_2.InertiaCmpVelNotchBlndY
    connect CalRegn03Rt03GroupA.RtnHwAgOffsCalcdX -> AAACalRegn03Rt01GroupA_Dummy_2.RtnHwAgOffsCalcdX
    connect CalRegn03Rt03GroupA.RtnHwAgOffsCalcdY -> AAACalRegn03Rt01GroupA_Dummy_2.RtnHwAgOffsCalcdY
    connect CalRegn03Rt03GroupA.RtnScaTqX -> AAACalRegn03Rt01GroupA_Dummy_2.RtnScaTqX
    connect CalRegn03Rt03GroupA.RtnScaTqY -> AAACalRegn03Rt01GroupA_Dummy_2.RtnScaTqY
    connect CalRegn03Rt03GroupA.RtnScaVelX -> AAACalRegn03Rt01GroupA_Dummy_2.RtnScaVelX
    connect CalRegn03Rt03GroupA.RtnScaVelY -> AAACalRegn03Rt01GroupA_Dummy_2.RtnScaVelY
    connect CalRegn03Rt04.InertiaCmpVelDampgFilFrq -> AAACalRegn03Rt01_Dummy_4.InertiaCmpVelDampgFilFrq
    connect CalRegn03Rt04.InertiaCmpVelDampgFilFrqWhlImbRejctnOn -> AAACalRegn03Rt01_Dummy_4.InertiaCmpVelDampgFilFrqWhlImbRejctnOn
    connect CalRegn03Rt04GroupA.AssiHiFrqGainY -> AAACalRegn03Rt01GroupA_Dummy_3.AssiHiFrqGainY
    connect CalRegn03Rt04GroupA.AssiHiFrqTqX -> AAACalRegn03Rt01GroupA_Dummy_3.AssiHiFrqTqX
    connect CalRegn03Rt04GroupA.AssiMotTqWhlImbRejctnMinX -> AAACalRegn03Rt01GroupA_Dummy_3.AssiMotTqWhlImbRejctnMinX
    connect CalRegn03Rt04GroupA.AssiMotTqWhlImbRejctnMinY -> AAACalRegn03Rt01GroupA_Dummy_3.AssiMotTqWhlImbRejctnMinY
    connect CalRegn03Rt04GroupA.DampgHydCoeff{1..4}ScaY -> AAACalRegn03Rt01GroupA_Dummy_3.DampgHydCoeff{1..4}ScaY
    connect CalRegn03Rt04GroupA.DampgMotVelX -> AAACalRegn03Rt01GroupA_Dummy_3.DampgMotVelX
    connect CalRegn03Rt04GroupA.DampgMotVelY -> AAACalRegn03Rt01GroupA_Dummy_3.DampgMotVelY
    connect CalRegn03Rt04GroupA.HysCmpFricWhlImbRejctnBlndX -> AAACalRegn03Rt01GroupA_Dummy_3.HysCmpFricWhlImbRejctnBlndX
    connect CalRegn03Rt04GroupA.HysCmpFricWhlImbRejctnBlndY -> AAACalRegn03Rt01GroupA_Dummy_3.HysCmpFricWhlImbRejctnBlndY
    connect CalRegn03Rt04GroupA.HysCmpFricWhlImbRejctnOffY -> AAACalRegn03Rt01GroupA_Dummy_3.HysCmpFricWhlImbRejctnOffY
    connect CalRegn03Rt04GroupA.HysCmpFricWhlImbRejctnOnY -> AAACalRegn03Rt01GroupA_Dummy_3.HysCmpFricWhlImbRejctnOnY
    connect CalRegn03Rt04GroupA.InertiaCmpVelAssiBasdDampgCoeffX -> AAACalRegn03Rt01GroupA_Dummy_3.InertiaCmpVelAssiBasdDampgCoeffX
    connect CalRegn03Rt04GroupA.InertiaCmpVelAssiBasdDampgRollgY -> AAACalRegn03Rt01GroupA_Dummy_3.InertiaCmpVelAssiBasdDampgRollgY
    connect CalRegn03Rt04GroupA.InertiaCmpVelAssiBasdDampgStatY -> AAACalRegn03Rt01GroupA_Dummy_3.InertiaCmpVelAssiBasdDampgStatY
    connect CalRegn03Rt04GroupA.InertiaCmpVelDampgSpdBlndY -> AAACalRegn03Rt01GroupA_Dummy_3.InertiaCmpVelDampgSpdBlndY
    connect CalRegn03Rt04GroupA.InertiaCmpVelNotchBlndY -> AAACalRegn03Rt01GroupA_Dummy_3.InertiaCmpVelNotchBlndY
    connect CalRegn03Rt04GroupA.RtnHwAgOffsCalcdX -> AAACalRegn03Rt01GroupA_Dummy_3.RtnHwAgOffsCalcdX
    connect CalRegn03Rt04GroupA.RtnHwAgOffsCalcdY -> AAACalRegn03Rt01GroupA_Dummy_3.RtnHwAgOffsCalcdY
    connect CalRegn03Rt04GroupA.RtnScaTqX -> AAACalRegn03Rt01GroupA_Dummy_3.RtnScaTqX
    connect CalRegn03Rt04GroupA.RtnScaTqY -> AAACalRegn03Rt01GroupA_Dummy_3.RtnScaTqY
    connect CalRegn03Rt04GroupA.RtnScaVelX -> AAACalRegn03Rt01GroupA_Dummy_3.RtnScaVelX
    connect CalRegn03Rt04GroupA.RtnScaVelY -> AAACalRegn03Rt01GroupA_Dummy_3.RtnScaVelY
    connect CalRegn03Rt00GroupB.AssiHiFrqTqWhlImbRejctnTqX -> AAACalRegn03Rt01GroupB_Dummy.AssiHiFrqTqWhlImbRejctnTqX
    connect CalRegn03Rt00GroupB.AssiHiFrqWhlImbRejctnGainY -> AAACalRegn03Rt01GroupB_Dummy.AssiHiFrqWhlImbRejctnGainY
    connect CalRegn03Rt00GroupB.AssiMotTqWhlImbRejctnMaxX -> AAACalRegn03Rt01GroupB_Dummy.AssiMotTqWhlImbRejctnMaxX
    connect CalRegn03Rt00GroupB.AssiMotTqWhlImbRejctnMaxY -> AAACalRegn03Rt01GroupB_Dummy.AssiMotTqWhlImbRejctnMaxY
    connect CalRegn03Rt00GroupB.AssiWhlImbRejctnBlndScaX -> AAACalRegn03Rt01GroupB_Dummy.AssiWhlImbRejctnBlndScaX
    connect CalRegn03Rt00GroupB.AssiWhlImbRejctnBlndScaY -> AAACalRegn03Rt01GroupB_Dummy.AssiWhlImbRejctnBlndScaY
    connect CalRegn03Rt00GroupB.EotProtnDampgVehSpdTbl -> AAACalRegn03Rt01GroupB_Dummy.EotProtnDampgVehSpdTbl
    connect CalRegn03Rt00GroupB.EotProtnEntrGainVehSpdTbl -> AAACalRegn03Rt01GroupB_Dummy.EotProtnEntrGainVehSpdTbl
    connect CalRegn03Rt00GroupB.EotProtnEntrGainX -> AAACalRegn03Rt01GroupB_Dummy.EotProtnEntrGainX
    connect CalRegn03Rt00GroupB.EotProtnEntrGainY -> AAACalRegn03Rt01GroupB_Dummy.EotProtnEntrGainY
    connect CalRegn03Rt00GroupB.EotProtnExitDampgY -> AAACalRegn03Rt01GroupB_Dummy.EotProtnExitDampgY
    connect CalRegn03Rt00GroupB.EotProtnHwDegDampgX -> AAACalRegn03Rt01GroupB_Dummy.EotProtnHwDegDampgX
    connect CalRegn03Rt00GroupB.EotProtnNormDampgY -> AAACalRegn03Rt01GroupB_Dummy.EotProtnNormDampgY
    connect CalRegn03Rt00GroupB.InertiaCmpVelAssiBasdDampgRollgWhlImbRejctnOnY -> AAACalRegn03Rt01GroupB_Dummy.InertiaCmpVelAssiBasdDampgRollgWhlImbRejctnOnY
    connect CalRegn03Rt01GroupB.AssiHiFrqTqWhlImbRejctnTqX -> AAACalRegn03Rt01GroupB_Dummy_1.AssiHiFrqTqWhlImbRejctnTqX
    connect CalRegn03Rt01GroupB.AssiHiFrqWhlImbRejctnGainY -> AAACalRegn03Rt01GroupB_Dummy_1.AssiHiFrqWhlImbRejctnGainY
    connect CalRegn03Rt01GroupB.AssiMotTqWhlImbRejctnMaxX -> AAACalRegn03Rt01GroupB_Dummy_1.AssiMotTqWhlImbRejctnMaxX
    connect CalRegn03Rt01GroupB.AssiMotTqWhlImbRejctnMaxY -> AAACalRegn03Rt01GroupB_Dummy_1.AssiMotTqWhlImbRejctnMaxY
    connect CalRegn03Rt01GroupB.AssiWhlImbRejctnBlndScaX -> AAACalRegn03Rt01GroupB_Dummy_1.AssiWhlImbRejctnBlndScaX
    connect CalRegn03Rt01GroupB.AssiWhlImbRejctnBlndScaY -> AAACalRegn03Rt01GroupB_Dummy_1.AssiWhlImbRejctnBlndScaY
    connect CalRegn03Rt01GroupB.EotProtnDampgVehSpdTbl -> AAACalRegn03Rt01GroupB_Dummy_1.EotProtnDampgVehSpdTbl
    connect CalRegn03Rt01GroupB.EotProtnEntrGainVehSpdTbl -> AAACalRegn03Rt01GroupB_Dummy_1.EotProtnEntrGainVehSpdTbl
    connect CalRegn03Rt01GroupB.EotProtnEntrGainX -> AAACalRegn03Rt01GroupB_Dummy_1.EotProtnEntrGainX
    connect CalRegn03Rt01GroupB.EotProtnEntrGainY -> AAACalRegn03Rt01GroupB_Dummy_1.EotProtnEntrGainY
    connect CalRegn03Rt01GroupB.EotProtnExitDampgY -> AAACalRegn03Rt01GroupB_Dummy_1.EotProtnExitDampgY
    connect CalRegn03Rt01GroupB.EotProtnHwDegDampgX -> AAACalRegn03Rt01GroupB_Dummy_1.EotProtnHwDegDampgX
    connect CalRegn03Rt01GroupB.EotProtnNormDampgY -> AAACalRegn03Rt01GroupB_Dummy_1.EotProtnNormDampgY
    connect CalRegn03Rt01GroupB.InertiaCmpVelAssiBasdDampgRollgWhlImbRejctnOnY -> AAACalRegn03Rt01GroupB_Dummy_1.InertiaCmpVelAssiBasdDampgRollgWhlImbRejctnOnY
    connect CalRegn03Rt02GroupB.AssiHiFrqTqWhlImbRejctnTqX -> AAACalRegn03Rt01GroupB_Dummy_2.AssiHiFrqTqWhlImbRejctnTqX
    connect CalRegn03Rt02GroupB.AssiHiFrqWhlImbRejctnGainY -> AAACalRegn03Rt01GroupB_Dummy_2.AssiHiFrqWhlImbRejctnGainY
    connect CalRegn03Rt02GroupB.AssiMotTqWhlImbRejctnMaxX -> AAACalRegn03Rt01GroupB_Dummy_2.AssiMotTqWhlImbRejctnMaxX
    connect CalRegn03Rt02GroupB.AssiMotTqWhlImbRejctnMaxY -> AAACalRegn03Rt01GroupB_Dummy_2.AssiMotTqWhlImbRejctnMaxY
    connect CalRegn03Rt02GroupB.AssiWhlImbRejctnBlndScaX -> AAACalRegn03Rt01GroupB_Dummy_2.AssiWhlImbRejctnBlndScaX
    connect CalRegn03Rt02GroupB.AssiWhlImbRejctnBlndScaY -> AAACalRegn03Rt01GroupB_Dummy_2.AssiWhlImbRejctnBlndScaY
    connect CalRegn03Rt02GroupB.EotProtnDampgVehSpdTbl -> AAACalRegn03Rt01GroupB_Dummy_2.EotProtnDampgVehSpdTbl
    connect CalRegn03Rt02GroupB.EotProtnEntrGainVehSpdTbl -> AAACalRegn03Rt01GroupB_Dummy_2.EotProtnEntrGainVehSpdTbl
    connect CalRegn03Rt02GroupB.EotProtnEntrGainX -> AAACalRegn03Rt01GroupB_Dummy_2.EotProtnEntrGainX
    connect CalRegn03Rt02GroupB.EotProtnEntrGainY -> AAACalRegn03Rt01GroupB_Dummy_2.EotProtnEntrGainY
    connect CalRegn03Rt02GroupB.EotProtnExitDampgY -> AAACalRegn03Rt01GroupB_Dummy_2.EotProtnExitDampgY
    connect CalRegn03Rt02GroupB.EotProtnHwDegDampgX -> AAACalRegn03Rt01GroupB_Dummy_2.EotProtnHwDegDampgX
    connect CalRegn03Rt02GroupB.EotProtnNormDampgY -> AAACalRegn03Rt01GroupB_Dummy_2.EotProtnNormDampgY
    connect CalRegn03Rt02GroupB.InertiaCmpVelAssiBasdDampgRollgWhlImbRejctnOnY -> AAACalRegn03Rt01GroupB_Dummy_2.InertiaCmpVelAssiBasdDampgRollgWhlImbRejctnOnY
    connect CalRegn03Rt03GroupB.AssiHiFrqTqWhlImbRejctnTqX -> AAACalRegn03Rt01GroupB_Dummy_3.AssiHiFrqTqWhlImbRejctnTqX
    connect CalRegn03Rt03GroupB.AssiHiFrqWhlImbRejctnGainY -> AAACalRegn03Rt01GroupB_Dummy_3.AssiHiFrqWhlImbRejctnGainY
    connect CalRegn03Rt03GroupB.AssiMotTqWhlImbRejctnMaxX -> AAACalRegn03Rt01GroupB_Dummy_3.AssiMotTqWhlImbRejctnMaxX
    connect CalRegn03Rt03GroupB.AssiMotTqWhlImbRejctnMaxY -> AAACalRegn03Rt01GroupB_Dummy_3.AssiMotTqWhlImbRejctnMaxY
    connect CalRegn03Rt03GroupB.AssiWhlImbRejctnBlndScaX -> AAACalRegn03Rt01GroupB_Dummy_3.AssiWhlImbRejctnBlndScaX
    connect CalRegn03Rt03GroupB.AssiWhlImbRejctnBlndScaY -> AAACalRegn03Rt01GroupB_Dummy_3.AssiWhlImbRejctnBlndScaY
    connect CalRegn03Rt03GroupB.EotProtnDampgVehSpdTbl -> AAACalRegn03Rt01GroupB_Dummy_3.EotProtnDampgVehSpdTbl
    connect CalRegn03Rt03GroupB.EotProtnEntrGainVehSpdTbl -> AAACalRegn03Rt01GroupB_Dummy_3.EotProtnEntrGainVehSpdTbl
    connect CalRegn03Rt03GroupB.EotProtnEntrGainX -> AAACalRegn03Rt01GroupB_Dummy_3.EotProtnEntrGainX
    connect CalRegn03Rt03GroupB.EotProtnEntrGainY -> AAACalRegn03Rt01GroupB_Dummy_3.EotProtnEntrGainY
    connect CalRegn03Rt03GroupB.EotProtnExitDampgY -> AAACalRegn03Rt01GroupB_Dummy_3.EotProtnExitDampgY
    connect CalRegn03Rt03GroupB.EotProtnHwDegDampgX -> AAACalRegn03Rt01GroupB_Dummy_3.EotProtnHwDegDampgX
    connect CalRegn03Rt03GroupB.EotProtnNormDampgY -> AAACalRegn03Rt01GroupB_Dummy_3.EotProtnNormDampgY
    connect CalRegn03Rt03GroupB.InertiaCmpVelAssiBasdDampgRollgWhlImbRejctnOnY -> AAACalRegn03Rt01GroupB_Dummy_3.InertiaCmpVelAssiBasdDampgRollgWhlImbRejctnOnY
    connect CalRegn03Rt04GroupB.AssiHiFrqTqWhlImbRejctnTqX -> AAACalRegn03Rt01GroupB_Dummy_4.AssiHiFrqTqWhlImbRejctnTqX
    connect CalRegn03Rt04GroupB.AssiHiFrqWhlImbRejctnGainY -> AAACalRegn03Rt01GroupB_Dummy_4.AssiHiFrqWhlImbRejctnGainY
    connect CalRegn03Rt04GroupB.AssiMotTqWhlImbRejctnMaxX -> AAACalRegn03Rt01GroupB_Dummy_4.AssiMotTqWhlImbRejctnMaxX
    connect CalRegn03Rt04GroupB.AssiMotTqWhlImbRejctnMaxY -> AAACalRegn03Rt01GroupB_Dummy_4.AssiMotTqWhlImbRejctnMaxY
    connect CalRegn03Rt04GroupB.AssiWhlImbRejctnBlndScaX -> AAACalRegn03Rt01GroupB_Dummy_4.AssiWhlImbRejctnBlndScaX
    connect CalRegn03Rt04GroupB.AssiWhlImbRejctnBlndScaY -> AAACalRegn03Rt01GroupB_Dummy_4.AssiWhlImbRejctnBlndScaY
    connect CalRegn03Rt04GroupB.EotProtnDampgVehSpdTbl -> AAACalRegn03Rt01GroupB_Dummy_4.EotProtnDampgVehSpdTbl
    connect CalRegn03Rt04GroupB.EotProtnEntrGainVehSpdTbl -> AAACalRegn03Rt01GroupB_Dummy_4.EotProtnEntrGainVehSpdTbl
    connect CalRegn03Rt04GroupB.EotProtnEntrGainX -> AAACalRegn03Rt01GroupB_Dummy_4.EotProtnEntrGainX
    connect CalRegn03Rt04GroupB.EotProtnEntrGainY -> AAACalRegn03Rt01GroupB_Dummy_4.EotProtnEntrGainY
    connect CalRegn03Rt04GroupB.EotProtnExitDampgY -> AAACalRegn03Rt01GroupB_Dummy_4.EotProtnExitDampgY
    connect CalRegn03Rt04GroupB.EotProtnHwDegDampgX -> AAACalRegn03Rt01GroupB_Dummy_4.EotProtnHwDegDampgX
    connect CalRegn03Rt04GroupB.EotProtnNormDampgY -> AAACalRegn03Rt01GroupB_Dummy_4.EotProtnNormDampgY
    connect CalRegn03Rt04GroupB.InertiaCmpVelAssiBasdDampgRollgWhlImbRejctnOnY -> AAACalRegn03Rt01GroupB_Dummy_4.InertiaCmpVelAssiBasdDampgRollgWhlImbRejctnOnY
    connect CDD_MotCtrlMgr.MotAgCumvInid -> CDD_MotAgCmp.MotAgCumvInid
    connect CDD_MotAgCmp.MotAgCumvAlgndVld -> HwAgSnsrls.MotAgCumvAlgndVld
    connect CalRegn03Inin00.SysGlbPrmSysKineRat -> CDD_MotAgCmp.SysGlbPrmSysKineRat
    connect VehSigCdng.VehSpdVld -> Rtn.VehSpdVld
    connect VehSigCdng.VehLatAEstimd -> PullCmpActv.VehLatA
    connect VehSigCdng.VehLatAEstimd -> SysFricLrng.VehLatA
    connect VehSigCdng.VehLatAEstimd -> TqLoa.VehLatA
    connect CalRegn01Cmn.HwAgSnsrlsCorrdPinionAgHwConf -> HwAgSnsrls.HwAgSnsrlsCorrdPinionAgHwConf
    connect CDD_NxtrTi.GetRefTmr100MicroSec32bit -> HowDetn.GetRefTmr100MicroSec32bit
    connect CDD_NxtrTi.GetTiSpan100MicroSec32bit -> HowDetn.GetTiSpan100MicroSec32bit
    connect CalRegn02Inin00GroupC.HowDetnOffThd -> HowDetn.HowDetnOffThd
    connect CalRegn02Inin00GroupC.HowDetnOffTi -> HowDetn.HowDetnOffTi
    connect NvMProxy.PSProxy_SnpshtDataAry -> DiagcMgr.SnpshtDataAry
    connect DiagcMgr.DiagcStsCtrldShtDwnFltPrsnt -> StOutpCtrl.DiagcStsCtrldShtDwnFltPrsnt
    connect MotTqTranlDampg.MotTqTranlDampgCmpl -> StOutpCtrl.MotTqTranlDampgCmpl
    connect HowDetn.HowDetnFlg -> GmMsg184BusHiSpd.HowDetnFlg
    connect MotAgCorrln.MotAgMeclIdptSig -> CDD_MotVel.MotAgMeclIdptSig
    connect CalRegn01Inin00.HwAgSysArbnTqSnsrVelFilFrq -> HwAgSysArbn.HwAgSysArbnTqSnsrVelFilFrq
    connect CalRegn01Inin00.SysGlbPrmTorsBarStfn -> HwAgSysArbn.SysGlbPrmTorsBarStfn
    connect CalRegn03Inin00.SysGlbPrmSysKineRat -> HwAgSysArbn.SysGlbPrmSysKineRat
    connect CDD_MotVel.MotVelCrf -> HwAgSysArbn.MotVelCrf
    connect CDD_MotVel.MotVelVld -> HwAgSysArbn.MotVelVld
    connect HwAgSysArbn.HwVel -> FltInj.HwVel
    connect HwAgSysArbn.HwVelToSerlCom -> GmMsg1E5BusChassisExp.HwVel
    connect HwAgSysArbn.HwVel -> GmStrtStop.HwVel
    connect HwAgSysArbn.HwVel -> PullCmpActv.HwVel
    connect HwAgSysArbn.HwVel -> Rtn.HwVel
    connect HwAgSysArbn.HwVel -> SnsrOffsLrng.HwVel
    connect HwAgSysArbn.HwVel -> SysFricLrng.HwVel
    connect HwAgSysArbn.HwVel -> TEstimn.HwVel
    connect HwAgSysArbn.HwVel -> TunSelnAuthy.HwVel
    connect HwTqArbn.HwTq -> HwAgSysArbn.HwTq
    connect HwAgSysArbn.HwVelToSerlCom -> GmMsg1E5BusHiSpd.HwVel
    connect DiagcMgr.DiagcStsIvtr1Inactv -> TmplMonr.DiagcStsIvtr1Inactv
    connect DiagcMgr.DiagcStsIvtr2Inactv -> TmplMonr.DiagcStsIvtr2Inactv
    connect CalRegn03Cmn.EotLrngHwAgOverTrvlEntr -> EotLrng.EotLrngHwAgOverTrvlEntr
    connect CalRegn03Cmn.EotLrngHwAgOverTrvlExit -> EotLrng.EotLrngHwAgOverTrvlExit
    connect CustDiagc.MfgOvrlDi -> GmOvrlStMgr.MfgOvrlDi
    connect CalRegn01CmnGroupC.HwAgVehCentrTrimVehSpdMaxThd -> HwAgVehCentrTrim.HwAgVehCentrTrimVehSpdMaxThd
    connect CmnMfgSrv.SysStImdtTranReqOff -> SysStMod.SysStImdtTranReqOff
    connect EotLrng.GetHwAgOverTrvlCnt -> CmnMfgSrv.GetHwAgOverTrvlCnt
    connect EotLrng.RstHwAgOverTrvlCnt -> CmnMfgSrv.RstHwAgOverTrvlCnt
    connect EotLrng.SetHwAgOverTrvlCnt -> CmnMfgSrv.SetHwAgOverTrvlCnt
    connect SysFricLrng.GetFricData -> CmnMfgSrv.GetFricData
    connect SysFricLrng.SetFricData -> CmnMfgSrv.SetFricData
    connect CmnMfgSrv.MfgEnaSt -> CmnMfgSrvIf.MfgEnaSt
    connect DiagcMgr.SysStFltOutpReqDi -> GmVehPwrMod.SysStFltOutpReqDi
    connect CustDiagc.SerlComDi -> SerlComInpProxy.SerlComDi
    connect HwAgSysArbn.HwAgVldToSerlCom -> GmMsg1E5BusChassisExp.HwAgVldToSerlCom
    connect HwAgSysArbn.HwAgVldToSerlCom -> GmMsg1E5BusHiSpd.HwAgVldToSerlCom
    connect IoHwAb.SetGpioPwrTurnOffCtrl -> PwrUpSeq.IoHwAb_SetGpioPwrTurnOffCtrl
    connect GmTqArbn.HwTqOvrl -> HysCmp.HwTqOvrl
    connect CalRegn01Cmn.TqOscnAmpLimY -> TqOscn.TqOscnAmpLimY
    connect CalRegn01Cmn.TqOscnFrqIn -> TqOscn.TqOscnFrqIn
    connect CalRegn01Cmn.MotCurrRegCfgCurrLoopSecOrderTrfFctEna -> CDD_MotCurrRegVltgLimr.MotCurrRegCfgCurrLoopSecOrderTrfFctEna
    connect CalRegn01Cmn.MotCurrRegVltgLimrDualEcuLoaScarSlewRate -> CDD_MotCurrRegVltgLimr.MotCurrRegVltgLimrDualEcuLoaScarSlewRate
    connect CalRegn01Cmn.MotCurrRegVltgLimrMotCurrPredEna -> CDD_MotCurrRegVltgLimr.MotCurrRegVltgLimrMotCurrPredEna
    connect CalRegn01Cmn.MotCurrRegVltgLimrMotCurrPredTi -> CDD_MotCurrRegVltgLimr.MotCurrRegVltgLimrMotCurrPredTi
    connect MotCtrlPrmEstimn.MotREstimd -> CDD_MotCtrlMgr.MotREstimd
    connect VehSigCdng.VehYawRateVld -> PullCmpActv.VehYawRateVld
    connect CalRegn03Inin00.StabyCmpNotchFilBlnd34TqX -> StabyCmp.StabyCmpNotchFilBlnd34TqX
    connect CalRegn03Inin00GroupA.StabyCmpNotchFilBlnd12TqX -> StabyCmp.StabyCmpNotchFilBlnd12TqX
    connect EotLrng.RtnMaxHwAgCwAndCcw -> CustDiagc.RtnMaxHwAgCwAndCcw
    connect CalRegn03Inin00.AssiHiFrqHpFilFrq -> AssiHiFrq.AssiHiFrqHpFilFrq
    connect CalRegn03Rt00GroupB.AssiHiFrqWhlImbRejctnBlndX -> AAACalRegn03Rt01GroupB_Dummy.AssiHiFrqWhlImbRejctnBlndX
    connect CalRegn03Rt00GroupB.AssiHiFrqWhlImbRejctnBlndY -> AAACalRegn03Rt01GroupB_Dummy.AssiHiFrqWhlImbRejctnBlndY
    connect CalRegn03Rt00GroupB.AssiHiFrqWhlImbRejctnBlndX -> AssiHiFrq.AssiHiFrqWhlImbRejctnBlndX
    connect CalRegn03Rt00GroupB.AssiHiFrqWhlImbRejctnBlndY -> AssiHiFrq.AssiHiFrqWhlImbRejctnBlndY
    connect CalRegn03Rt01GroupB.AssiHiFrqWhlImbRejctnBlndX -> AAACalRegn03Rt01GroupB_Dummy_1.AssiHiFrqWhlImbRejctnBlndX
    connect CalRegn03Rt01GroupB.AssiHiFrqWhlImbRejctnBlndY -> AAACalRegn03Rt01GroupB_Dummy_1.AssiHiFrqWhlImbRejctnBlndY
    connect CalRegn03Rt02GroupB.AssiHiFrqWhlImbRejctnBlndX -> AAACalRegn03Rt01GroupB_Dummy_2.AssiHiFrqWhlImbRejctnBlndX
    connect CalRegn03Rt02GroupB.AssiHiFrqWhlImbRejctnBlndY -> AAACalRegn03Rt01GroupB_Dummy_2.AssiHiFrqWhlImbRejctnBlndY
    connect CalRegn03Rt03GroupB.AssiHiFrqWhlImbRejctnBlndX -> AAACalRegn03Rt01GroupB_Dummy_3.AssiHiFrqWhlImbRejctnBlndX
    connect CalRegn03Rt03GroupB.AssiHiFrqWhlImbRejctnBlndY -> AAACalRegn03Rt01GroupB_Dummy_3.AssiHiFrqWhlImbRejctnBlndY
    connect CalRegn03Rt04GroupB.AssiHiFrqWhlImbRejctnBlndX -> AAACalRegn03Rt01GroupB_Dummy_4.AssiHiFrqWhlImbRejctnBlndX
    connect CalRegn03Rt04GroupB.AssiHiFrqWhlImbRejctnBlndY -> AAACalRegn03Rt01GroupB_Dummy_4.AssiHiFrqWhlImbRejctnBlndY
    connect NvMProxy.PSProxy_Rte_NvmBlock_WhlImbRejctn_CmpPeakData -> WhlImbRejctn.CmpPeakData
    connect CalRegn01Cmn.SysGlbPrmVehSpdBilnrSeln -> GmTqArbn.SysGlbPrmVehSpdBilnrSeln
    connect CalRegn02Inin00.GmTqArbnLkaOutpOvrlUpprLim -> GmTqArbn.GmTqArbnLkaOutpOvrlUpprLim
    connect CalRegn02Rt00GroupC.GmTqArbnLkaOutpOvrlX -> AAACalRegn02Rt01GroupC_Dummy.GmTqArbnLkaOutpOvrlX
    connect CalRegn02Rt00GroupC.GmTqArbnLkaOutpOvrlY -> AAACalRegn02Rt01GroupC_Dummy.GmTqArbnLkaOutpOvrlY
    connect CalRegn02Rt00GroupC.GmTqArbnLkaOutpOvrlX -> GmTqArbn.GmTqArbnLkaOutpOvrlX
    connect CalRegn02Rt00GroupC.GmTqArbnLkaOutpOvrlY -> GmTqArbn.GmTqArbnLkaOutpOvrlY
    connect CalRegn02Rt01GroupC.GmTqArbnLkaOutpOvrlX -> AAACalRegn02Rt01GroupC_Dummy_1.GmTqArbnLkaOutpOvrlX
    connect CalRegn02Rt01GroupC.GmTqArbnLkaOutpOvrlY -> AAACalRegn02Rt01GroupC_Dummy_1.GmTqArbnLkaOutpOvrlY
    connect CalRegn02Rt02GroupC.GmTqArbnLkaOutpOvrlX -> AAACalRegn02Rt01GroupC_Dummy_2.GmTqArbnLkaOutpOvrlX
    connect CalRegn02Rt02GroupC.GmTqArbnLkaOutpOvrlY -> AAACalRegn02Rt01GroupC_Dummy_2.GmTqArbnLkaOutpOvrlY
    connect CalRegn02Rt03GroupC.GmTqArbnLkaOutpOvrlX -> AAACalRegn02Rt01GroupC_Dummy_3.GmTqArbnLkaOutpOvrlX
    connect CalRegn02Rt03GroupC.GmTqArbnLkaOutpOvrlY -> AAACalRegn02Rt01GroupC_Dummy_3.GmTqArbnLkaOutpOvrlY
    connect CalRegn02Rt04GroupC.GmTqArbnLkaOutpOvrlX -> AAACalRegn02Rt01GroupC_Dummy_4.GmTqArbnLkaOutpOvrlX
    connect CalRegn02Rt04GroupC.GmTqArbnLkaOutpOvrlY -> AAACalRegn02Rt01GroupC_Dummy_4.GmTqArbnLkaOutpOvrlY
    connect GmTqArbn.PullCmpCustLrngDi -> PullCmpActv.PullCmpCustLrngDi
    connect CalRegn02Cmn.InertiaCmpVelDecelGainEnaCal -> CustDiagc.InertiaCmpVelDecelGainEnaCal
    connect CalRegn02CmnGroupA.PullCmpActvEna -> CustDiagc.PullCmpActvEna
    connect CalRegn02CmnGroupB.WhlImbRejctnFctEna -> CustDiagc.WhlImbRejctnFctEna
  end to end protection set E2EPROTECTIONSET
  port interface mapping set PORTINTERFACEMAPPINGSET
