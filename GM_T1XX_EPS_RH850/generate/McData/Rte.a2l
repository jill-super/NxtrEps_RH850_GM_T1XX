/begin CHARACTERISTIC CalRegn01Cmn.SysGlbPrmVehSpdBilnrSeln.Ary1D "MICROSAR RTE" VAL_BLK 0x0 RTE_RL_UWORD 0 RTE_CM_Spd2 0 511 MATRIX_DIM 12 1 1 SYMBOL_LINK "Rte_CalprmRom_CalRegn01Cmn_DEFAULT_RTE_CALPRM_GROUP.SysGlbPrmVehSpdBilnrSeln_Ary1D" 0 DISPLAY_IDENTIFIER CalRegn01Cmn.CalibrationPorts.SysGlbPrmVehSpdBilnrSeln.Ary1D /end CHARACTERISTIC
/begin CHARACTERISTIC CalRegn01Cmn.TSG31CfgAndUseAdcStrtOfCnvn2Offs.Val "MICROSAR RTE" VALUE 0x0 RTE_RL_ULONG 0 NO_COMPU_METHOD 0 25000 SYMBOL_LINK "Rte_CalprmRom_CalRegn01Cmn_DEFAULT_RTE_CALPRM_GROUP.TSG31CfgAndUseAdcStrtOfCnvn2Offs_Val" 0 DISPLAY_IDENTIFIER CalRegn01Cmn.CalibrationPorts.TSG31CfgAndUseAdcStrtOfCnvn2Offs.Val /end CHARACTERISTIC
/begin CHARACTERISTIC CalRegn01Cmn.TSG31CfgAndUseAdcStrtOfCnvnMotCtrlPeakOffs.Val "MICROSAR RTE" VALUE 0x0 RTE_RL_ULONG 0 NO_COMPU_METHOD 0 25000 SYMBOL_LINK "Rte_CalprmRom_CalRegn01Cmn_DEFAULT_RTE_CALPRM_GROUP.TSG31CfgAndUseAdcStrtOfCnvnMotCtrlPeakOffs_Val" 0 DISPLAY_IDENTIFIER CalRegn01Cmn.CalibrationPorts.TSG31CfgAndUseAdcStrtOfCnvnMotCtrlPeakOffs.Val /end CHARACTERISTIC
/begin CHARACTERISTIC CalRegn01Cmn.TSG31CfgAndUseAdcStrtOfCnvnMotCtrlVlyOffs.Val "MICROSAR RTE" VALUE 0x0 RTE_RL_ULONG 0 NO_COMPU_METHOD 0 25000 SYMBOL_LINK "Rte_CalprmRom_CalRegn01Cmn_DEFAULT_RTE_CALPRM_GROUP.TSG31CfgAndUseAdcStrtOfCnvnMotCtrlVlyOffs_Val" 0 DISPLAY_IDENTIFIER CalRegn01Cmn.CalibrationPorts.TSG31CfgAndUseAdcStrtOfCnvnMotCtrlVlyOffs.Val /end CHARACTERISTIC
/begin CHARACTERISTIC CalRegn01Cmn.TSG31CfgAndUseMtrAg0SPIStart.Val "MICROSAR RTE" VALUE 0x0 RTE_RL_ULONG 0 NO_COMPU_METHOD 0 71429 SYMBOL_LINK "Rte_CalprmRom_CalRegn01Cmn_DEFAULT_RTE_CALPRM_GROUP.TSG31CfgAndUseMtrAg0SPIStart_Val" 0 DISPLAY_IDENTIFIER CalRegn01Cmn.CalibrationPorts.TSG31CfgAndUseMtrAg0SPIStart.Val /end CHARACTERISTIC
/begin CHARACTERISTIC CalRegn01Cmn.TSG31CfgAndUsePwmDbnd.Val "MICROSAR RTE" VALUE 0x0 RTE_RL_ULONG 0 NO_COMPU_METHOD 1 1000 SYMBOL_LINK "Rte_CalprmRom_CalRegn01Cmn_DEFAULT_RTE_CALPRM_GROUP.TSG31CfgAndUsePwmDbnd_Val" 0 DISPLAY_IDENTIFIER CalRegn01Cmn.CalibrationPorts.TSG31CfgAndUsePwmDbnd.Val /end CHARACTERISTIC
/begin CHARACTERISTIC CalRegn01Cmn.TqOscnAmpLimY.Ary1D "MICROSAR RTE" VAL_BLK 0x0 RTE_RL_UWORD 0 NO_COMPU_METHOD 0 65535 MATRIX_DIM 11 1 1 SYMBOL_LINK "Rte_CalprmRom_CalRegn01Cmn_DEFAULT_RTE_CALPRM_GROUP.TqOscnAmpLimY_Ary1D" 0 DISPLAY_IDENTIFIER CalRegn01Cmn.CalibrationPorts.TqOscnAmpLimY.Ary1D /end CHARACTERISTIC
/begin CHARACTERISTIC CalRegn01Cmn.TqOscnFallRampRateCal.Val "MICROSAR RTE" VALUE 0x0 RTE_RL_FLOAT32_IEEE 0 NO_COMPU_METHOD -3.402823466e+38 3.402823466e+38 SYMBOL_LINK "Rte_CalprmRom_CalRegn01Cmn_DEFAULT_RTE_CALPRM_GROUP.TqOscnFallRampRateCal_Val" 0 DISPLAY_IDENTIFIER CalRegn01Cmn.CalibrationPorts.TqOscnFallRampRateCal.Val /end CHARACTERISTIC
/begin CHARACTERISTIC CalRegn01Cmn.TqOscnFrqIn.Ary1D "MICROSAR RTE" VAL_BLK 0x0 RTE_RL_UWORD 0 NO_COMPU_METHOD 0 65535 MATRIX_DIM 11 1 1 SYMBOL_LINK "Rte_CalprmRom_CalRegn01Cmn_DEFAULT_RTE_CALPRM_GROUP.TqOscnFrqIn_Ary1D" 0 DISPLAY_IDENTIFIER CalRegn01Cmn.CalibrationPorts.TqOscnFrqIn.Ary1D /end CHARACTERISTIC
/begin CHARACTERISTIC CalRegn01Cmn.TqOscnRisngRampRateCal.Val "MICROSAR RTE" VALUE 0x0 RTE_RL_FLOAT32_IEEE 0 NO_COMPU_METHOD -3.402823466e+38 3.402823466e+38 SYMBOL_LINK "Rte_CalprmRom_CalRegn01Cmn_DEFAULT_RTE_CALPRM_GROUP.TqOscnRisngRampRateCal_Val" 0 DISPLAY_IDENTIFIER CalRegn01Cmn.CalibrationPorts.TqOscnRisngRampRateCal.Val /end CHARACTERISTIC
/begin CHARACTERISTIC CalRegn01Cmn.TqOscnUseRampRateCal.Logl "MICROSAR RTE" VALUE 0x0 RTE_RL_BOOLEAN 0 RTE_CM_BOOLEAN 0 255 SYMBOL_LINK "Rte_CalprmRom_CalRegn01Cmn_DEFAULT_RTE_CALPRM_GROUP.TqOscnUseRampRateCal_Logl" 0 DISPLAY_IDENTIFIER CalRegn01Cmn.CalibrationPorts.TqOscnUseRampRateCal.Logl /end CHARACTERISTIC
/begin CHARACTERISTIC CalRegn01Cmn.TunSelnAuthyTunSelnRtDiCmd.Logl "MICROSAR RTE" VALUE 0x0 RTE_RL_BOOLEAN 0 RTE_CM_BOOLEAN 0 255 SYMBOL_LINK "Rte_CalprmRom_CalRegn01Cmn_DEFAULT_RTE_CALPRM_GROUP.TunSelnAuthyTunSelnRtDiCmd_Logl" 0 DISPLAY_IDENTIFIER CalRegn01Cmn.CalibrationPorts.TunSelnAuthyTunSelnRtDiCmd.Logl /end CHARACTERISTIC
/begin CHARACTERISTIC CalRegn01Cmn.VehSigCdngDftLatA.Val "MICROSAR RTE" VALUE 0x0 RTE_RL_FLOAT32_IEEE 0 NO_COMPU_METHOD -10.0 10.0 SYMBOL_LINK "Rte_CalprmRom_CalRegn01Cmn_DEFAULT_RTE_CALPRM_GROUP.VehSigCdngDftLatA_Val" 0 DISPLAY_IDENTIFIER CalRegn01Cmn.CalibrationPorts.VehSigCdngDftLatA.Val /end CHARACTERISTIC
/begin CHARACTERISTIC CalRegn01Cmn.VehSigCdngDftLgtA.Val "MICROSAR RTE" VALUE 0x0 RTE_RL_FLOAT32_IEEE 0 NO_COMPU_METHOD -50.0 50.0 SYMBOL_LINK "Rte_CalprmRom_CalRegn01Cmn_DEFAULT_RTE_CALPRM_GROUP.VehSigCdngDftLgtA_Val" 0 DISPLAY_IDENTIFIER CalRegn01Cmn.CalibrationPorts.VehSigCdngDftLgtA.Val /end CHARACTERISTIC
/begin CHARACTERISTIC CalRegn01Cmn.VehSigCdngDftVehSpd.Val "MICROSAR RTE" VALUE 0x0 RTE_RL_FLOAT32_IEEE 0 NO_COMPU_METHOD 0.0 511.0 SYMBOL_LINK "Rte_CalprmRom_CalRegn01Cmn_DEFAULT_RTE_CALPRM_GROUP.VehSigCdngDftVehSpd_Val" 0 DISPLAY_IDENTIFIER CalRegn01Cmn.CalibrationPorts.VehSigCdngDftVehSpd.Val /end CHARACTERISTIC
/begin CHARACTERISTIC CalRegn01Cmn.VehSigCdngDftYawRate.Val "MICROSAR RTE" VALUE 0x0 RTE_RL_FLOAT32_IEEE 0 NO_COMPU_METHOD -120.0 120.0 SYMBOL_LINK "Rte_CalprmRom_CalRegn01Cmn_DEFAULT_RTE_CALPRM_GROUP.VehSigCdngDftYawRate_Val" 0 DISPLAY_IDENTIFIER CalRegn01Cmn.CalibrationPorts.VehSigCdngDftYawRate.Val /end CHARACTERISTIC
/begin CHARACTERISTIC CalRegn01Cmn.VehSigCdngLatADifThd.Val "MICROSAR RTE" VALUE 0x0 RTE_RL_FLOAT32_IEEE 0 NO_COMPU_METHOD 0.1 10.0 SYMBOL_LINK "Rte_CalprmRom_CalRegn01Cmn_DEFAULT_RTE_CALPRM_GROUP.VehSigCdngLatADifThd_Val" 0 DISPLAY_IDENTIFIER CalRegn01Cmn.CalibrationPorts.VehSigCdngLatADifThd.Val /end CHARACTERISTIC
/begin CHARACTERISTIC CalRegn01Cmn.VehSigCdngLatAFilFrq.Val "MICROSAR RTE" VALUE 0x0 RTE_RL_FLOAT32_IEEE 0 NO_COMPU_METHOD 1.0 100.0 SYMBOL_LINK "Rte_CalprmRom_CalRegn01Cmn_DEFAULT_RTE_CALPRM_GROUP.VehSigCdngLatAFilFrq_Val" 0 DISPLAY_IDENTIFIER CalRegn01Cmn.CalibrationPorts.VehSigCdngLatAFilFrq.Val /end CHARACTERISTIC
/begin CHARACTERISTIC CalRegn01Cmn.VehSigCdngLtgADifThd.Val "MICROSAR RTE" VALUE 0x0 RTE_RL_FLOAT32_IEEE 0 NO_COMPU_METHOD 0.1 10.0 SYMBOL_LINK "Rte_CalprmRom_CalRegn01Cmn_DEFAULT_RTE_CALPRM_GROUP.VehSigCdngLtgADifThd_Val" 0 DISPLAY_IDENTIFIER CalRegn01Cmn.CalibrationPorts.VehSigCdngLtgADifThd.Val /end CHARACTERISTIC
/begin CHARACTERISTIC CalRegn01Cmn.VehSigCdngVehSpdDifThd.Val "MICROSAR RTE" VALUE 0x0 RTE_RL_FLOAT32_IEEE 0 NO_COMPU_METHOD 0.1 511.0 SYMBOL_LINK "Rte_CalprmRom_CalRegn01Cmn_DEFAULT_RTE_CALPRM_GROUP.VehSigCdngVehSpdDifThd_Val" 0 DISPLAY_IDENTIFIER CalRegn01Cmn.CalibrationPorts.VehSigCdngVehSpdDifThd.Val /end CHARACTERISTIC
/begin CHARACTERISTIC CalRegn01Cmn.VehSigCdngVehYawSlewRate.Val "MICROSAR RTE" VALUE 0x0 RTE_RL_FLOAT32_IEEE 0 NO_COMPU_METHOD 1.0 1200.0 SYMBOL_LINK "Rte_CalprmRom_CalRegn01Cmn_DEFAULT_RTE_CALPRM_GROUP.VehSigCdngVehYawSlewRate_Val" 0 DISPLAY_IDENTIFIER CalRegn01Cmn.CalibrationPorts.VehSigCdngVehYawSlewRate.Val /end CHARACTERISTIC
/begin CHARACTERISTIC CalRegn01Cmn.VehSigCdngYawRateDifThd.Val "MICROSAR RTE" VALUE 0x0 RTE_RL_FLOAT32_IEEE 0 NO_COMPU_METHOD 0.1 120.0 SYMBOL_LINK "Rte_CalprmRom_CalRegn01Cmn_DEFAULT_RTE_CALPRM_GROUP.VehSigCdngYawRateDifThd_Val" 0 DISPLAY_IDENTIFIER CalRegn01Cmn.CalibrationPorts.VehSigCdngYawRateDifThd.Val /end CHARACTERISTIC
/begin CHARACTERISTIC CalRegn01Cmn.VehSpdLimrMaxAssiX.Ary1D "MICROSAR RTE" VAL_BLK 0x0 RTE_RL_UWORD 0 NO_COMPU_METHOD 0 65535 MATRIX_DIM 5 1 1 SYMBOL_LINK "Rte_CalprmRom_CalRegn01Cmn_DEFAULT_RTE_CALPRM_GROUP.VehSpdLimrMaxAssiX_Ary1D" 0 DISPLAY_IDENTIFIER CalRegn01Cmn.CalibrationPorts.VehSpdLimrMaxAssiX.Ary1D /end CHARACTERISTIC
/begin CHARACTERISTIC CalRegn01Cmn.VehSpdLimrMaxAssiY.Ary1D "MICROSAR RTE" VAL_BLK 0x0 RTE_RL_UWORD 0 NO_COMPU_METHOD 0 65535 MATRIX_DIM 5 1 1 SYMBOL_LINK "Rte_CalprmRom_CalRegn01Cmn_DEFAULT_RTE_CALPRM_GROUP.VehSpdLimrMaxAssiY_Ary1D" 0 DISPLAY_IDENTIFIER CalRegn01Cmn.CalibrationPorts.VehSpdLimrMaxAssiY.Ary1D /end CHARACTERISTIC
/begin CHARACTERISTIC CalRegn01Cmn.VehSpdLimrPosMaxOffs1.Val "MICROSAR RTE" VALUE 0x0 RTE_RL_FLOAT32_IEEE 0 NO_COMPU_METHOD -3.402823466e+38 3.402823466e+38 SYMBOL_LINK "Rte_CalprmRom_CalRegn01Cmn_DEFAULT_RTE_CALPRM_GROUP.VehSpdLimrPosMaxOffs1_Val" 0 DISPLAY_IDENTIFIER CalRegn01Cmn.CalibrationPorts.VehSpdLimrPosMaxOffs1.Val /end CHARACTERISTIC
/begin CHARACTERISTIC CalRegn01Cmn.VehSpdLimrPosMaxOffs2.Val "MICROSAR RTE" VALUE 0x0 RTE_RL_FLOAT32_IEEE 0 NO_COMPU_METHOD -3.402823466e+38 3.402823466e+38 SYMBOL_LINK "Rte_CalprmRom_CalRegn01Cmn_DEFAULT_RTE_CALPRM_GROUP.VehSpdLimrPosMaxOffs2_Val" 0 DISPLAY_IDENTIFIER CalRegn01Cmn.CalibrationPorts.VehSpdLimrPosMaxOffs2.Val /end CHARACTERISTIC
/begin CHARACTERISTIC CalRegn01Cmn.WhlImbRejctnFrqDiagcLpFil.Val "MICROSAR RTE" VALUE 0x0 RTE_RL_FLOAT32_IEEE 0 NO_COMPU_METHOD -3.402823466e+38 3.402823466e+38 SYMBOL_LINK "Rte_CalprmRom_CalRegn01Cmn_DEFAULT_RTE_CALPRM_GROUP.WhlImbRejctnFrqDiagcLpFil_Val" 0 DISPLAY_IDENTIFIER CalRegn01Cmn.CalibrationPorts.WhlImbRejctnFrqDiagcLpFil.Val /end CHARACTERISTIC
/begin CHARACTERISTIC CalRegn01CmnGroupB.WhlImbRejctnDcTrendFltRcvryDly.Val "MICROSAR RTE" VALUE 0x0 RTE_RL_FLOAT32_IEEE 0 NO_COMPU_METHOD -3.402823466e+38 3.402823466e+38 SYMBOL_LINK "Rte_CalprmRom_CalRegn01CmnGroupB_DEFAULT_RTE_CALPRM_GROUP.WhlImbRejctnDcTrendFltRcvryDly_Val" 0 DISPLAY_IDENTIFIER CalRegn01CmnGroupB.CalibrationPorts.WhlImbRejctnDcTrendFltRcvryDly.Val /end CHARACTERISTIC
/begin CHARACTERISTIC CalRegn01CmnGroupB.WhlImbRejctnFrqDiagcEna.Logl "MICROSAR RTE" VALUE 0x0 RTE_RL_BOOLEAN 0 RTE_CM_BOOLEAN 0 255 SYMBOL_LINK "Rte_CalprmRom_CalRegn01CmnGroupB_DEFAULT_RTE_CALPRM_GROUP.WhlImbRejctnFrqDiagcEna_Logl" 0 DISPLAY_IDENTIFIER CalRegn01CmnGroupB.CalibrationPorts.WhlImbRejctnFrqDiagcEna.Logl /end CHARACTERISTIC
/begin CHARACTERISTIC CalRegn01CmnGroupB.WhlImbRejctnFrqDiagcFltRcvryDly.Val "MICROSAR RTE" VALUE 0x0 RTE_RL_FLOAT32_IEEE 0 NO_COMPU_METHOD -3.402823466e+38 3.402823466e+38 SYMBOL_LINK "Rte_CalprmRom_CalRegn01CmnGroupB_DEFAULT_RTE_CALPRM_GROUP.WhlImbRejctnFrqDiagcFltRcvryDly_Val" 0 DISPLAY_IDENTIFIER CalRegn01CmnGroupB.CalibrationPorts.WhlImbRejctnFrqDiagcFltRcvryDly.Val /end CHARACTERISTIC
/begin CHARACTERISTIC CalRegn01CmnGroupB.WhlImbRejctnFrqDiagcUgrPoleMgn.Val "MICROSAR RTE" VALUE 0x0 RTE_RL_FLOAT32_IEEE 0 NO_COMPU_METHOD -3.402823466e+38 3.402823466e+38 SYMBOL_LINK "Rte_CalprmRom_CalRegn01CmnGroupB_DEFAULT_RTE_CALPRM_GROUP.WhlImbRejctnFrqDiagcUgrPoleMgn_Val" 0 DISPLAY_IDENTIFIER CalRegn01CmnGroupB.CalibrationPorts.WhlImbRejctnFrqDiagcUgrPoleMgn.Val /end CHARACTERISTIC
/begin CHARACTERISTIC CalRegn01CmnGroupB.WhlImbRejctnMaxMgnFltRcvryDly.Val "MICROSAR RTE" VALUE 0x0 RTE_RL_FLOAT32_IEEE 0 NO_COMPU_METHOD -3.402823466e+38 3.402823466e+38 SYMBOL_LINK "Rte_CalprmRom_CalRegn01CmnGroupB_DEFAULT_RTE_CALPRM_GROUP.WhlImbRejctnMaxMgnFltRcvryDly_Val" 0 DISPLAY_IDENTIFIER CalRegn01CmnGroupB.CalibrationPorts.WhlImbRejctnMaxMgnFltRcvryDly.Val /end CHARACTERISTIC
/begin CHARACTERISTIC CalRegn01CmnGroupB.WhlImbRejctnWhlSpdCorrlnFltRcvryDly.Val "MICROSAR RTE" VALUE 0x0 RTE_RL_FLOAT32_IEEE 0 NO_COMPU_METHOD -3.402823466e+38 3.402823466e+38 SYMBOL_LINK "Rte_CalprmRom_CalRegn01CmnGroupB_DEFAULT_RTE_CALPRM_GROUP.WhlImbRejctnWhlSpdCorrlnFltRcvryDly_Val" 0 DISPLAY_IDENTIFIER CalRegn01CmnGroupB.CalibrationPorts.WhlImbRejctnWhlSpdCorrlnFltRcvryDly.Val /end CHARACTERISTIC
/begin CHARACTERISTIC CalRegn01CmnGroupC.HwAgVehCentrTrimHwAgLim.Val "MICROSAR RTE" VALUE 0x0 RTE_RL_FLOAT32_IEEE 0 NO_COMPU_METHOD -3.402823466e+38 3.402823466e+38 SYMBOL_LINK "Rte_CalprmRom_CalRegn01CmnGroupC_DEFAULT_RTE_CALPRM_GROUP.HwAgVehCentrTrimHwAgLim_Val" 0 DISPLAY_IDENTIFIER CalRegn01CmnGroupC.CalibrationPorts.HwAgVehCentrTrimHwAgLim.Val /end CHARACTERISTIC
/begin CHARACTERISTIC CalRegn01CmnGroupC.HwAgVehCentrTrimVehSpdMaxThd.Val "MICROSAR RTE" VALUE 0x0 RTE_RL_FLOAT32_IEEE 0 NO_COMPU_METHOD -3.402823466e+38 3.402823466e+38 SYMBOL_LINK "Rte_CalprmRom_CalRegn01CmnGroupC_DEFAULT_RTE_CALPRM_GROUP.HwAgVehCentrTrimVehSpdMaxThd_Val" 0 DISPLAY_IDENTIFIER CalRegn01CmnGroupC.CalibrationPorts.HwAgVehCentrTrimVehSpdMaxThd.Val /end CHARACTERISTIC
/begin CHARACTERISTIC CalRegn01Inin00.AssiPahFwlCmdSplitLpFilFrq.Val "MICROSAR RTE" VALUE 0x0 RTE_RL_FLOAT32_IEEE 0 NO_COMPU_METHOD -3.402823466e+38 3.402823466e+38 SYMBOL_LINK "Rte_CalprmRom_CalRegn01Inin00_DEFAULT_RTE_CALPRM_GROUP.AssiPahFwlCmdSplitLpFilFrq_Val" 0 DISPLAY_IDENTIFIER CalRegn01Inin00.CalibrationPorts.AssiPahFwlCmdSplitLpFilFrq.Val /end CHARACTERISTIC
/begin CHARACTERISTIC CalRegn01Inin00.AssiPahFwlDftAssiX.Ary1D "MICROSAR RTE" VAL_BLK 0x0 RTE_RL_UWORD 0 NO_COMPU_METHOD 0 65535 MATRIX_DIM 20 1 1 SYMBOL_LINK "Rte_CalprmRom_CalRegn01Inin00_DEFAULT_RTE_CALPRM_GROUP.AssiPahFwlDftAssiX_Ary1D" 0 DISPLAY_IDENTIFIER CalRegn01Inin00.CalibrationPorts.AssiPahFwlDftAssiX.Ary1D /end CHARACTERISTIC
/begin CHARACTERISTIC CalRegn01Inin00.AssiPahFwlDftAssiY.Ary1D "MICROSAR RTE" VAL_BLK 0x0 RTE_RL_SWORD 0 NO_COMPU_METHOD -32768 32767 MATRIX_DIM 20 1 1 SYMBOL_LINK "Rte_CalprmRom_CalRegn01Inin00_DEFAULT_RTE_CALPRM_GROUP.AssiPahFwlDftAssiY_Ary1D" 0 DISPLAY_IDENTIFIER CalRegn01Inin00.CalibrationPorts.AssiPahFwlDftAssiY.Ary1D /end CHARACTERISTIC
/begin CHARACTERISTIC CalRegn01Inin00.AssiPahFwlFwlActvLpFilFrq.Val "MICROSAR RTE" VALUE 0x0 RTE_RL_FLOAT32_IEEE 0 NO_COMPU_METHOD -3.402823466e+38 3.402823466e+38 SYMBOL_LINK "Rte_CalprmRom_CalRegn01Inin00_DEFAULT_RTE_CALPRM_GROUP.AssiPahFwlFwlActvLpFilFrq_Val" 0 DISPLAY_IDENTIFIER CalRegn01Inin00.CalibrationPorts.AssiPahFwlFwlActvLpFilFrq.Val /end CHARACTERISTIC
/begin CHARACTERISTIC CalRegn01Inin00.AssiPahFwlHiFrqUpprLimY.Ary2D "MICROSAR RTE" VAL_BLK 0x0 RTE_RL_SWORD 0 NO_COMPU_METHOD -32768 32767 MATRIX_DIM 11 12 1 SYMBOL_LINK "Rte_CalprmRom_CalRegn01Inin00_DEFAULT_RTE_CALPRM_GROUP.AssiPahFwlHiFrqUpprLimY_Ary2D" 0 DISPLAY_IDENTIFIER CalRegn01Inin00.CalibrationPorts.AssiPahFwlHiFrqUpprLimY.Ary2D /end CHARACTERISTIC
/begin CHARACTERISTIC CalRegn01Inin00.AssiPahFwlHysCmpLim.Val "MICROSAR RTE" VALUE 0x0 RTE_RL_FLOAT32_IEEE 0 NO_COMPU_METHOD -3.402823466e+38 3.402823466e+38 SYMBOL_LINK "Rte_CalprmRom_CalRegn01Inin00_DEFAULT_RTE_CALPRM_GROUP.AssiPahFwlHysCmpLim_Val" 0 DISPLAY_IDENTIFIER CalRegn01Inin00.CalibrationPorts.AssiPahFwlHysCmpLim.Val /end CHARACTERISTIC
/begin CHARACTERISTIC CalRegn01Inin00.AssiPahFwlRestoreThd.Val "MICROSAR RTE" VALUE 0x0 RTE_RL_FLOAT32_IEEE 0 NO_COMPU_METHOD -3.402823466e+38 3.402823466e+38 SYMBOL_LINK "Rte_CalprmRom_CalRegn01Inin00_DEFAULT_RTE_CALPRM_GROUP.AssiPahFwlRestoreThd_Val" 0 DISPLAY_IDENTIFIER CalRegn01Inin00.CalibrationPorts.AssiPahFwlRestoreThd.Val /end CHARACTERISTIC
/begin CHARACTERISTIC CalRegn01Inin00.AssiPahFwlUpprLimX.Ary2D "MICROSAR RTE" VAL_BLK 0x0 RTE_RL_SWORD 0 NO_COMPU_METHOD -32768 32767 MATRIX_DIM 11 12 1 SYMBOL_LINK "Rte_CalprmRom_CalRegn01Inin00_DEFAULT_RTE_CALPRM_GROUP.AssiPahFwlUpprLimX_Ary2D" 0 DISPLAY_IDENTIFIER CalRegn01Inin00.CalibrationPorts.AssiPahFwlUpprLimX.Ary2D /end CHARACTERISTIC
/begin CHARACTERISTIC CalRegn01Inin00.AssiPahFwlUpprLimY.Ary2D "MICROSAR RTE" VAL_BLK 0x0 RTE_RL_SWORD 0 NO_COMPU_METHOD -32768 32767 MATRIX_DIM 11 12 1 SYMBOL_LINK "Rte_CalprmRom_CalRegn01Inin00_DEFAULT_RTE_CALPRM_GROUP.AssiPahFwlUpprLimY_Ary2D" 0 DISPLAY_IDENTIFIER CalRegn01Inin00.CalibrationPorts.AssiPahFwlUpprLimY.Ary2D /end CHARACTERISTIC
/begin CHARACTERISTIC CalRegn01Inin00.DampgPahFwlActvFwlLpFilFrq.Val "MICROSAR RTE" VALUE 0x0 RTE_RL_FLOAT32_IEEE 0 NO_COMPU_METHOD -3.402823466e+38 3.402823466e+38 SYMBOL_LINK "Rte_CalprmRom_CalRegn01Inin00_DEFAULT_RTE_CALPRM_GROUP.DampgPahFwlActvFwlLpFilFrq_Val" 0 DISPLAY_IDENTIFIER CalRegn01Inin00.CalibrationPorts.DampgPahFwlActvFwlLpFilFrq.Val /end CHARACTERISTIC
/begin CHARACTERISTIC CalRegn01Inin00.DampgPahFwlDampgCmdLpFilFrq.Val "MICROSAR RTE" VALUE 0x0 RTE_RL_FLOAT32_IEEE 0 NO_COMPU_METHOD -3.402823466e+38 3.402823466e+38 SYMBOL_LINK "Rte_CalprmRom_CalRegn01Inin00_DEFAULT_RTE_CALPRM_GROUP.DampgPahFwlDampgCmdLpFilFrq_Val" 0 DISPLAY_IDENTIFIER CalRegn01Inin00.CalibrationPorts.DampgPahFwlDampgCmdLpFilFrq.Val /end CHARACTERISTIC
/begin CHARACTERISTIC CalRegn01Inin00.DampgPahFwlDampgCmdUpprLimX.Ary1D "MICROSAR RTE" VAL_BLK 0x0 RTE_RL_SWORD 0 NO_COMPU_METHOD -32768 32767 MATRIX_DIM 11 1 1 SYMBOL_LINK "Rte_CalprmRom_CalRegn01Inin00_DEFAULT_RTE_CALPRM_GROUP.DampgPahFwlDampgCmdUpprLimX_Ary1D" 0 DISPLAY_IDENTIFIER CalRegn01Inin00.CalibrationPorts.DampgPahFwlDampgCmdUpprLimX.Ary1D /end CHARACTERISTIC
/begin CHARACTERISTIC CalRegn01Inin00.DampgPahFwlDampgCmdUpprLimY.Ary2D "MICROSAR RTE" VAL_BLK 0x0 RTE_RL_SWORD 0 NO_COMPU_METHOD -32768 32767 MATRIX_DIM 11 12 1 SYMBOL_LINK "Rte_CalprmRom_CalRegn01Inin00_DEFAULT_RTE_CALPRM_GROUP.DampgPahFwlDampgCmdUpprLimY_Ary2D" 0 DISPLAY_IDENTIFIER CalRegn01Inin00.CalibrationPorts.DampgPahFwlDampgCmdUpprLimY.Ary2D /end CHARACTERISTIC
/begin CHARACTERISTIC CalRegn01Inin00.DampgPahFwlDftDampgY.Ary1D "MICROSAR RTE" VAL_BLK 0x0 RTE_RL_UWORD 0 NO_COMPU_METHOD 0 65535 MATRIX_DIM 11 1 1 SYMBOL_LINK "Rte_CalprmRom_CalRegn01Inin00_DEFAULT_RTE_CALPRM_GROUP.DampgPahFwlDftDampgY_Ary1D" 0 DISPLAY_IDENTIFIER CalRegn01Inin00.CalibrationPorts.DampgPahFwlDftDampgY.Ary1D /end CHARACTERISTIC
/begin CHARACTERISTIC CalRegn01Inin00.DampgPahFwlInertiaCmpLpFilFrq.Val "MICROSAR RTE" VALUE 0x0 RTE_RL_FLOAT32_IEEE 0 NO_COMPU_METHOD -3.402823466e+38 3.402823466e+38 SYMBOL_LINK "Rte_CalprmRom_CalRegn01Inin00_DEFAULT_RTE_CALPRM_GROUP.DampgPahFwlInertiaCmpLpFilFrq_Val" 0 DISPLAY_IDENTIFIER CalRegn01Inin00.CalibrationPorts.DampgPahFwlInertiaCmpLpFilFrq.Val /end CHARACTERISTIC
/begin CHARACTERISTIC CalRegn01Inin00.DampgPahFwlInertiaCmpUpprLimX.Ary1D "MICROSAR RTE" VAL_BLK 0x0 RTE_RL_SWORD 0 NO_COMPU_METHOD -32768 32767 MATRIX_DIM 11 1 1 SYMBOL_LINK "Rte_CalprmRom_CalRegn01Inin00_DEFAULT_RTE_CALPRM_GROUP.DampgPahFwlInertiaCmpUpprLimX_Ary1D" 0 DISPLAY_IDENTIFIER CalRegn01Inin00.CalibrationPorts.DampgPahFwlInertiaCmpUpprLimX.Ary1D /end CHARACTERISTIC
/begin CHARACTERISTIC CalRegn01Inin00.DampgPahFwlInertiaCmpUpprLimY.Ary2D "MICROSAR RTE" VAL_BLK 0x0 RTE_RL_SWORD 0 NO_COMPU_METHOD -32768 32767 MATRIX_DIM 11 12 1 SYMBOL_LINK "Rte_CalprmRom_CalRegn01Inin00_DEFAULT_RTE_CALPRM_GROUP.DampgPahFwlInertiaCmpUpprLimY_Ary2D" 0 DISPLAY_IDENTIFIER CalRegn01Inin00.CalibrationPorts.DampgPahFwlInertiaCmpUpprLimY.Ary2D /end CHARACTERISTIC
/begin CHARACTERISTIC CalRegn01Inin00.EotProtnFwlActvCmdLowrBnd.Ary1D "MICROSAR RTE" VAL_BLK 0x0 RTE_RL_SWORD 0 NO_COMPU_METHOD -32768 32767 MATRIX_DIM 5 1 1 SYMBOL_LINK "Rte_CalprmRom_CalRegn01Inin00_DEFAULT_RTE_CALPRM_GROUP.EotProtnFwlActvCmdLowrBnd_Ary1D" 0 DISPLAY_IDENTIFIER CalRegn01Inin00.CalibrationPorts.EotProtnFwlActvCmdLowrBnd.Ary1D /end CHARACTERISTIC
/begin CHARACTERISTIC CalRegn01Inin00.EotProtnFwlActvCmdUpprBnd.Ary1D "MICROSAR RTE" VAL_BLK 0x0 RTE_RL_SWORD 0 NO_COMPU_METHOD -32768 32767 MATRIX_DIM 5 1 1 SYMBOL_LINK "Rte_CalprmRom_CalRegn01Inin00_DEFAULT_RTE_CALPRM_GROUP.EotProtnFwlActvCmdUpprBnd_Ary1D" 0 DISPLAY_IDENTIFIER CalRegn01Inin00.CalibrationPorts.EotProtnFwlActvCmdUpprBnd.Ary1D /end CHARACTERISTIC
/begin CHARACTERISTIC CalRegn01Inin00.GmVehPwrModOperRampRate.Val "MICROSAR RTE" VALUE 0x0 RTE_RL_FLOAT32_IEEE 0 NO_COMPU_METHOD -3.402823466e+38 3.402823466e+38 SYMBOL_LINK "Rte_CalprmRom_CalRegn01Inin00_DEFAULT_RTE_CALPRM_GROUP.GmVehPwrModOperRampRate_Val" 0 DISPLAY_IDENTIFIER CalRegn01Inin00.CalibrationPorts.GmVehPwrModOperRampRate.Val /end CHARACTERISTIC
/begin CHARACTERISTIC CalRegn01Inin00.HiLoadStallLimrMotTqCmdFilFrq.Val "MICROSAR RTE" VALUE 0x0 RTE_RL_FLOAT32_IEEE 0 NO_COMPU_METHOD -3.402823466e+38 3.402823466e+38 SYMBOL_LINK "Rte_CalprmRom_CalRegn01Inin00_DEFAULT_RTE_CALPRM_GROUP.HiLoadStallLimrMotTqCmdFilFrq_Val" 0 DISPLAY_IDENTIFIER CalRegn01Inin00.CalibrationPorts.HiLoadStallLimrMotTqCmdFilFrq.Val /end CHARACTERISTIC
/begin CHARACTERISTIC CalRegn01Inin00.HiLoadStallLimrMotVelMgnThd.Val "MICROSAR RTE" VALUE 0x0 RTE_RL_FLOAT32_IEEE 0 NO_COMPU_METHOD -3.402823466e+38 3.402823466e+38 SYMBOL_LINK "Rte_CalprmRom_CalRegn01Inin00_DEFAULT_RTE_CALPRM_GROUP.HiLoadStallLimrMotVelMgnThd_Val" 0 DISPLAY_IDENTIFIER CalRegn01Inin00.CalibrationPorts.HiLoadStallLimrMotVelMgnThd.Val /end CHARACTERISTIC
/begin CHARACTERISTIC CalRegn01Inin00.HiLoadStallLimrStallMotTqCmdLimX.Ary1D "MICROSAR RTE" VAL_BLK 0x0 RTE_RL_UWORD 0 NO_COMPU_METHOD 0 65535 MATRIX_DIM 6 1 1 SYMBOL_LINK "Rte_CalprmRom_CalRegn01Inin00_DEFAULT_RTE_CALPRM_GROUP.HiLoadStallLimrStallMotTqCmdLimX_Ary1D" 0 DISPLAY_IDENTIFIER CalRegn01Inin00.CalibrationPorts.HiLoadStallLimrStallMotTqCmdLimX.Ary1D /end CHARACTERISTIC
/begin CHARACTERISTIC CalRegn01Inin00.HiLoadStallLimrStallMotTqCmdLimY.Ary1D "MICROSAR RTE" VAL_BLK 0x0 RTE_RL_UWORD 0 NO_COMPU_METHOD 0 65535 MATRIX_DIM 6 1 1 SYMBOL_LINK "Rte_CalprmRom_CalRegn01Inin00_DEFAULT_RTE_CALPRM_GROUP.HiLoadStallLimrStallMotTqCmdLimY_Ary1D" 0 DISPLAY_IDENTIFIER CalRegn01Inin00.CalibrationPorts.HiLoadStallLimrStallMotTqCmdLimY.Ary1D /end CHARACTERISTIC
/begin CHARACTERISTIC CalRegn01Inin00.HiLoadStallLimrStallMotTqLimSlewRate.Val "MICROSAR RTE" VALUE 0x0 RTE_RL_FLOAT32_IEEE 0 NO_COMPU_METHOD -3.402823466e+38 3.402823466e+38 SYMBOL_LINK "Rte_CalprmRom_CalRegn01Inin00_DEFAULT_RTE_CALPRM_GROUP.HiLoadStallLimrStallMotTqLimSlewRate_Val" 0 DISPLAY_IDENTIFIER CalRegn01Inin00.CalibrationPorts.HiLoadStallLimrStallMotTqLimSlewRate.Val /end CHARACTERISTIC
/begin CHARACTERISTIC CalRegn01Inin00.HwAg0MeasHwAg0IfFltFailStep.Val "MICROSAR RTE" VALUE 0x0 RTE_RL_UWORD 0 NO_COMPU_METHOD 0 65535 SYMBOL_LINK "Rte_CalprmRom_CalRegn01Inin00_DEFAULT_RTE_CALPRM_GROUP.HwAg0MeasHwAg0IfFltFailStep_Val" 0 DISPLAY_IDENTIFIER CalRegn01Inin00.CalibrationPorts.HwAg0MeasHwAg0IfFltFailStep.Val /end CHARACTERISTIC
/begin CHARACTERISTIC CalRegn01Inin00.HwAg0MeasHwAg0IfFltPassStep.Val "MICROSAR RTE" VALUE 0x0 RTE_RL_UWORD 0 NO_COMPU_METHOD 0 65535 SYMBOL_LINK "Rte_CalprmRom_CalRegn01Inin00_DEFAULT_RTE_CALPRM_GROUP.HwAg0MeasHwAg0IfFltPassStep_Val" 0 DISPLAY_IDENTIFIER CalRegn01Inin00.CalibrationPorts.HwAg0MeasHwAg0IfFltPassStep.Val /end CHARACTERISTIC
/begin CHARACTERISTIC CalRegn01Inin00.HwAg0MeasHwAg0Snsr0PrtclFltFailStep.Val "MICROSAR RTE" VALUE 0x0 RTE_RL_UWORD 0 NO_COMPU_METHOD 0 65535 SYMBOL_LINK "Rte_CalprmRom_CalRegn01Inin00_DEFAULT_RTE_CALPRM_GROUP.HwAg0MeasHwAg0Snsr0PrtclFltFailStep_Val" 0 DISPLAY_IDENTIFIER CalRegn01Inin00.CalibrationPorts.HwAg0MeasHwAg0Snsr0PrtclFltFailStep.Val /end CHARACTERISTIC
/begin CHARACTERISTIC CalRegn01Inin00.HwAg0MeasHwAg0Snsr0PrtclFltPassStep.Val "MICROSAR RTE" VALUE 0x0 RTE_RL_UWORD 0 NO_COMPU_METHOD 0 65535 SYMBOL_LINK "Rte_CalprmRom_CalRegn01Inin00_DEFAULT_RTE_CALPRM_GROUP.HwAg0MeasHwAg0Snsr0PrtclFltPassStep_Val" 0 DISPLAY_IDENTIFIER CalRegn01Inin00.CalibrationPorts.HwAg0MeasHwAg0Snsr0PrtclFltPassStep.Val /end CHARACTERISTIC
/begin CHARACTERISTIC CalRegn01Inin00.HwAg0MeasHwAg0Snsr1PrtclFltFailStep.Val "MICROSAR RTE" VALUE 0x0 RTE_RL_UWORD 0 NO_COMPU_METHOD 0 65535 SYMBOL_LINK "Rte_CalprmRom_CalRegn01Inin00_DEFAULT_RTE_CALPRM_GROUP.HwAg0MeasHwAg0Snsr1PrtclFltFailStep_Val" 0 DISPLAY_IDENTIFIER CalRegn01Inin00.CalibrationPorts.HwAg0MeasHwAg0Snsr1PrtclFltFailStep.Val /end CHARACTERISTIC
/begin CHARACTERISTIC CalRegn01Inin00.HwAg0MeasHwAg0Snsr1PrtclFltPassStep.Val "MICROSAR RTE" VALUE 0x0 RTE_RL_UWORD 0 NO_COMPU_METHOD 0 65535 SYMBOL_LINK "Rte_CalprmRom_CalRegn01Inin00_DEFAULT_RTE_CALPRM_GROUP.HwAg0MeasHwAg0Snsr1PrtclFltPassStep_Val" 0 DISPLAY_IDENTIFIER CalRegn01Inin00.CalibrationPorts.HwAg0MeasHwAg0Snsr1PrtclFltPassStep.Val /end CHARACTERISTIC
/begin CHARACTERISTIC CalRegn01Inin00.HwAg0MeasSnsr0Rev.Ary1D "MICROSAR RTE" VAL_BLK 0x0 RTE_RL_UBYTE 0 NO_COMPU_METHOD 0.0 255.0 MATRIX_DIM 22 1 1 SYMBOL_LINK "Rte_CalprmRom_CalRegn01Inin00_DEFAULT_RTE_CALPRM_GROUP.HwAg0MeasSnsr0Rev_Ary1D" 0 DISPLAY_IDENTIFIER CalRegn01Inin00.CalibrationPorts.HwAg0MeasSnsr0Rev.Ary1D /end CHARACTERISTIC
/begin CHARACTERISTIC CalRegn01Inin00.HwAg0MeasSnsr1Rev.Ary1D "MICROSAR RTE" VAL_BLK 0x0 RTE_RL_UBYTE 0 NO_COMPU_METHOD 0.0 255.0 MATRIX_DIM 22 1 1 SYMBOL_LINK "Rte_CalprmRom_CalRegn01Inin00_DEFAULT_RTE_CALPRM_GROUP.HwAg0MeasSnsr1Rev_Ary1D" 0 DISPLAY_IDENTIFIER CalRegn01Inin00.CalibrationPorts.HwAg0MeasSnsr1Rev.Ary1D /end CHARACTERISTIC
/begin CHARACTERISTIC CalRegn01Inin00.HwAg0MeasStep.Ary1D "MICROSAR RTE" VAL_BLK 0x0 RTE_RL_SWORD 0 NO_COMPU_METHOD -500.0 500.0 MATRIX_DIM 22 1 1 SYMBOL_LINK "Rte_CalprmRom_CalRegn01Inin00_DEFAULT_RTE_CALPRM_GROUP.HwAg0MeasStep_Ary1D" 0 DISPLAY_IDENTIFIER CalRegn01Inin00.CalibrationPorts.HwAg0MeasStep.Ary1D /end CHARACTERISTIC
/begin CHARACTERISTIC CalRegn01Inin00.HwAg0MeasVrnrErrThd.Val "MICROSAR RTE" VALUE 0x0 RTE_RL_UBYTE 0 NO_COMPU_METHOD 0.0 20.0 SYMBOL_LINK "Rte_CalprmRom_CalRegn01Inin00_DEFAULT_RTE_CALPRM_GROUP.HwAg0MeasVrnrErrThd_Val" 0 DISPLAY_IDENTIFIER CalRegn01Inin00.CalibrationPorts.HwAg0MeasVrnrErrThd.Val /end CHARACTERISTIC
/begin CHARACTERISTIC CalRegn01Inin00.HwAg1MeasHwAg1IfFltFailStep.Val "MICROSAR RTE" VALUE 0x0 RTE_RL_UWORD 0 NO_COMPU_METHOD 0 65535 SYMBOL_LINK "Rte_CalprmRom_CalRegn01Inin00_DEFAULT_RTE_CALPRM_GROUP.HwAg1MeasHwAg1IfFltFailStep_Val" 0 DISPLAY_IDENTIFIER CalRegn01Inin00.CalibrationPorts.HwAg1MeasHwAg1IfFltFailStep.Val /end CHARACTERISTIC
/begin CHARACTERISTIC CalRegn01Inin00.HwAg1MeasHwAg1IfFltPassStep.Val "MICROSAR RTE" VALUE 0x0 RTE_RL_UWORD 0 NO_COMPU_METHOD 0 65535 SYMBOL_LINK "Rte_CalprmRom_CalRegn01Inin00_DEFAULT_RTE_CALPRM_GROUP.HwAg1MeasHwAg1IfFltPassStep_Val" 0 DISPLAY_IDENTIFIER CalRegn01Inin00.CalibrationPorts.HwAg1MeasHwAg1IfFltPassStep.Val /end CHARACTERISTIC
/begin CHARACTERISTIC CalRegn01Inin00.HwAg1MeasHwAg1Snsr0PrtclFltFailStep.Val "MICROSAR RTE" VALUE 0x0 RTE_RL_UWORD 0 NO_COMPU_METHOD 0 65535 SYMBOL_LINK "Rte_CalprmRom_CalRegn01Inin00_DEFAULT_RTE_CALPRM_GROUP.HwAg1MeasHwAg1Snsr0PrtclFltFailStep_Val" 0 DISPLAY_IDENTIFIER CalRegn01Inin00.CalibrationPorts.HwAg1MeasHwAg1Snsr0PrtclFltFailStep.Val /end CHARACTERISTIC
/begin CHARACTERISTIC CalRegn01Inin00.HwAg1MeasHwAg1Snsr0PrtclFltPassStep.Val "MICROSAR RTE" VALUE 0x0 RTE_RL_UWORD 0 NO_COMPU_METHOD 0 65535 SYMBOL_LINK "Rte_CalprmRom_CalRegn01Inin00_DEFAULT_RTE_CALPRM_GROUP.HwAg1MeasHwAg1Snsr0PrtclFltPassStep_Val" 0 DISPLAY_IDENTIFIER CalRegn01Inin00.CalibrationPorts.HwAg1MeasHwAg1Snsr0PrtclFltPassStep.Val /end CHARACTERISTIC
/begin CHARACTERISTIC CalRegn01Inin00.HwAg1MeasHwAg1Snsr1PrtclFltFailStep.Val "MICROSAR RTE" VALUE 0x0 RTE_RL_UWORD 0 NO_COMPU_METHOD 0 65535 SYMBOL_LINK "Rte_CalprmRom_CalRegn01Inin00_DEFAULT_RTE_CALPRM_GROUP.HwAg1MeasHwAg1Snsr1PrtclFltFailStep_Val" 0 DISPLAY_IDENTIFIER CalRegn01Inin00.CalibrationPorts.HwAg1MeasHwAg1Snsr1PrtclFltFailStep.Val /end CHARACTERISTIC
/begin CHARACTERISTIC CalRegn01Inin00.HwAg1MeasHwAg1Snsr1PrtclFltPassStep.Val "MICROSAR RTE" VALUE 0x0 RTE_RL_UWORD 0 NO_COMPU_METHOD 0 65535 SYMBOL_LINK "Rte_CalprmRom_CalRegn01Inin00_DEFAULT_RTE_CALPRM_GROUP.HwAg1MeasHwAg1Snsr1PrtclFltPassStep_Val" 0 DISPLAY_IDENTIFIER CalRegn01Inin00.CalibrationPorts.HwAg1MeasHwAg1Snsr1PrtclFltPassStep.Val /end CHARACTERISTIC
/begin CHARACTERISTIC CalRegn01Inin00.HwAg1MeasSnsr0Rev.Ary1D "MICROSAR RTE" VAL_BLK 0x0 RTE_RL_UBYTE 0 NO_COMPU_METHOD 0.0 255.0 MATRIX_DIM 22 1 1 SYMBOL_LINK "Rte_CalprmRom_CalRegn01Inin00_DEFAULT_RTE_CALPRM_GROUP.HwAg1MeasSnsr0Rev_Ary1D" 0 DISPLAY_IDENTIFIER CalRegn01Inin00.CalibrationPorts.HwAg1MeasSnsr0Rev.Ary1D /end CHARACTERISTIC
/begin CHARACTERISTIC CalRegn01Inin00.HwAg1MeasSnsr1Rev.Ary1D "MICROSAR RTE" VAL_BLK 0x0 RTE_RL_UBYTE 0 NO_COMPU_METHOD 0.0 255.0 MATRIX_DIM 22 1 1 SYMBOL_LINK "Rte_CalprmRom_CalRegn01Inin00_DEFAULT_RTE_CALPRM_GROUP.HwAg1MeasSnsr1Rev_Ary1D" 0 DISPLAY_IDENTIFIER CalRegn01Inin00.CalibrationPorts.HwAg1MeasSnsr1Rev.Ary1D /end CHARACTERISTIC
/begin CHARACTERISTIC CalRegn01Inin00.HwAg1MeasStep.Ary1D "MICROSAR RTE" VAL_BLK 0x0 RTE_RL_SWORD 0 NO_COMPU_METHOD -500.0 500.0 MATRIX_DIM 22 1 1 SYMBOL_LINK "Rte_CalprmRom_CalRegn01Inin00_DEFAULT_RTE_CALPRM_GROUP.HwAg1MeasStep_Ary1D" 0 DISPLAY_IDENTIFIER CalRegn01Inin00.CalibrationPorts.HwAg1MeasStep.Ary1D /end CHARACTERISTIC
/begin CHARACTERISTIC CalRegn01Inin00.HwAg1MeasVrnrErrThd.Val "MICROSAR RTE" VALUE 0x0 RTE_RL_UBYTE 0 NO_COMPU_METHOD 0.0 20.0 SYMBOL_LINK "Rte_CalprmRom_CalRegn01Inin00_DEFAULT_RTE_CALPRM_GROUP.HwAg1MeasVrnrErrThd_Val" 0 DISPLAY_IDENTIFIER CalRegn01Inin00.CalibrationPorts.HwAg1MeasVrnrErrThd.Val /end CHARACTERISTIC
/begin CHARACTERISTIC CalRegn01Inin00.HwAgSnsrlsVehDynVehSpdThd.Val "MICROSAR RTE" VALUE 0x0 RTE_RL_FLOAT32_IEEE 0 NO_COMPU_METHOD -3.402823466e+38 3.402823466e+38 SYMBOL_LINK "Rte_CalprmRom_CalRegn01Inin00_DEFAULT_RTE_CALPRM_GROUP.HwAgSnsrlsVehDynVehSpdThd_Val" 0 DISPLAY_IDENTIFIER CalRegn01Inin00.CalibrationPorts.HwAgSnsrlsVehDynVehSpdThd.Val /end CHARACTERISTIC
/begin CHARACTERISTIC CalRegn01Inin00.HwAgSnsrlsVehDynYawRateThd.Val "MICROSAR RTE" VALUE 0x0 RTE_RL_FLOAT32_IEEE 0 NO_COMPU_METHOD -3.402823466e+38 3.402823466e+38 SYMBOL_LINK "Rte_CalprmRom_CalRegn01Inin00_DEFAULT_RTE_CALPRM_GROUP.HwAgSnsrlsVehDynYawRateThd_Val" 0 DISPLAY_IDENTIFIER CalRegn01Inin00.CalibrationPorts.HwAgSnsrlsVehDynYawRateThd.Val /end CHARACTERISTIC
/begin CHARACTERISTIC CalRegn01Inin00.HwAgSnsrlsYawRateFilFrq.Val "MICROSAR RTE" VALUE 0x0 RTE_RL_FLOAT32_IEEE 0 NO_COMPU_METHOD -3.402823466e+38 3.402823466e+38 SYMBOL_LINK "Rte_CalprmRom_CalRegn01Inin00_DEFAULT_RTE_CALPRM_GROUP.HwAgSnsrlsYawRateFilFrq_Val" 0 DISPLAY_IDENTIFIER CalRegn01Inin00.CalibrationPorts.HwAgSnsrlsYawRateFilFrq.Val /end CHARACTERISTIC
/begin CHARACTERISTIC CalRegn01Inin00.HwAgSysArbnTqSnsrVelFilFrq.Val "MICROSAR RTE" VALUE 0x0 RTE_RL_FLOAT32_IEEE 0 NO_COMPU_METHOD -3.402823466e+38 3.402823466e+38 SYMBOL_LINK "Rte_CalprmRom_CalRegn01Inin00_DEFAULT_RTE_CALPRM_GROUP.HwAgSysArbnTqSnsrVelFilFrq_Val" 0 DISPLAY_IDENTIFIER CalRegn01Inin00.CalibrationPorts.HwAgSysArbnTqSnsrVelFilFrq.Val /end CHARACTERISTIC
/begin CHARACTERISTIC CalRegn01Inin00.HwTq0MeasHwTq0PrtclFltFailStep.Val "MICROSAR RTE" VALUE 0x0 RTE_RL_UWORD 0 NO_COMPU_METHOD 0 65535 SYMBOL_LINK "Rte_CalprmRom_CalRegn01Inin00_DEFAULT_RTE_CALPRM_GROUP.HwTq0MeasHwTq0PrtclFltFailStep_Val" 0 DISPLAY_IDENTIFIER CalRegn01Inin00.CalibrationPorts.HwTq0MeasHwTq0PrtclFltFailStep.Val /end CHARACTERISTIC
/begin CHARACTERISTIC CalRegn01Inin00.HwTq0MeasHwTq0PrtclFltPassStep.Val "MICROSAR RTE" VALUE 0x0 RTE_RL_UWORD 0 NO_COMPU_METHOD 0 65535 SYMBOL_LINK "Rte_CalprmRom_CalRegn01Inin00_DEFAULT_RTE_CALPRM_GROUP.HwTq0MeasHwTq0PrtclFltPassStep_Val" 0 DISPLAY_IDENTIFIER CalRegn01Inin00.CalibrationPorts.HwTq0MeasHwTq0PrtclFltPassStep.Val /end CHARACTERISTIC
/begin CHARACTERISTIC CalRegn01Inin00.HwTq1MeasHwTq1PrtclFltFailStep.Val "MICROSAR RTE" VALUE 0x0 RTE_RL_UWORD 0 NO_COMPU_METHOD 0 65535 SYMBOL_LINK "Rte_CalprmRom_CalRegn01Inin00_DEFAULT_RTE_CALPRM_GROUP.HwTq1MeasHwTq1PrtclFltFailStep_Val" 0 DISPLAY_IDENTIFIER CalRegn01Inin00.CalibrationPorts.HwTq1MeasHwTq1PrtclFltFailStep.Val /end CHARACTERISTIC
/begin CHARACTERISTIC CalRegn01Inin00.HwTq1MeasHwTq1PrtclFltPassStep.Val "MICROSAR RTE" VALUE 0x0 RTE_RL_UWORD 0 NO_COMPU_METHOD 0 65535 SYMBOL_LINK "Rte_CalprmRom_CalRegn01Inin00_DEFAULT_RTE_CALPRM_GROUP.HwTq1MeasHwTq1PrtclFltPassStep_Val" 0 DISPLAY_IDENTIFIER CalRegn01Inin00.CalibrationPorts.HwTq1MeasHwTq1PrtclFltPassStep.Val /end CHARACTERISTIC
/begin CHARACTERISTIC CalRegn01Inin00.LimrCdngGainDecSlew.Val "MICROSAR RTE" VALUE 0x0 RTE_RL_FLOAT32_IEEE 0 NO_COMPU_METHOD -3.402823466e+38 3.402823466e+38 SYMBOL_LINK "Rte_CalprmRom_CalRegn01Inin00_DEFAULT_RTE_CALPRM_GROUP.LimrCdngGainDecSlew_Val" 0 DISPLAY_IDENTIFIER CalRegn01Inin00.CalibrationPorts.LimrCdngGainDecSlew.Val /end CHARACTERISTIC
/begin CHARACTERISTIC CalRegn01Inin00.LimrCdngGainIncSlewX.Ary1D "MICROSAR RTE" VAL_BLK 0x0 RTE_RL_UWORD 0 NO_COMPU_METHOD 0 65535 MATRIX_DIM 2 1 1 SYMBOL_LINK "Rte_CalprmRom_CalRegn01Inin00_DEFAULT_RTE_CALPRM_GROUP.LimrCdngGainIncSlewX_Ary1D" 0 DISPLAY_IDENTIFIER CalRegn01Inin00.CalibrationPorts.LimrCdngGainIncSlewX.Ary1D /end CHARACTERISTIC
/begin CHARACTERISTIC CalRegn01Inin00.LimrCdngGainIncSlewY.Ary1D "MICROSAR RTE" VAL_BLK 0x0 RTE_RL_UWORD 0 NO_COMPU_METHOD 0 65535 MATRIX_DIM 2 1 1 SYMBOL_LINK "Rte_CalprmRom_CalRegn01Inin00_DEFAULT_RTE_CALPRM_GROUP.LimrCdngGainIncSlewY_Ary1D" 0 DISPLAY_IDENTIFIER CalRegn01Inin00.CalibrationPorts.LimrCdngGainIncSlewY.Ary1D /end CHARACTERISTIC
/begin CHARACTERISTIC CalRegn01Inin00.LimrCdngTqDecSlew.Val "MICROSAR RTE" VALUE 0x0 RTE_RL_FLOAT32_IEEE 0 NO_COMPU_METHOD -3.402823466e+38 3.402823466e+38 SYMBOL_LINK "Rte_CalprmRom_CalRegn01Inin00_DEFAULT_RTE_CALPRM_GROUP.LimrCdngTqDecSlew_Val" 0 DISPLAY_IDENTIFIER CalRegn01Inin00.CalibrationPorts.LimrCdngTqDecSlew.Val /end CHARACTERISTIC
/begin CHARACTERISTIC CalRegn01Inin00.LimrCdngTqIncSlewX.Ary1D "MICROSAR RTE" VAL_BLK 0x0 RTE_RL_UWORD 0 NO_COMPU_METHOD 0 65535 MATRIX_DIM 2 1 1 SYMBOL_LINK "Rte_CalprmRom_CalRegn01Inin00_DEFAULT_RTE_CALPRM_GROUP.LimrCdngTqIncSlewX_Ary1D" 0 DISPLAY_IDENTIFIER CalRegn01Inin00.CalibrationPorts.LimrCdngTqIncSlewX.Ary1D /end CHARACTERISTIC
/begin CHARACTERISTIC CalRegn01Inin00.LimrCdngTqIncSlewY.Ary1D "MICROSAR RTE" VAL_BLK 0x0 RTE_RL_UWORD 0 NO_COMPU_METHOD 0 65535 MATRIX_DIM 2 1 1 SYMBOL_LINK "Rte_CalprmRom_CalRegn01Inin00_DEFAULT_RTE_CALPRM_GROUP.LimrCdngTqIncSlewY_Ary1D" 0 DISPLAY_IDENTIFIER CalRegn01Inin00.CalibrationPorts.LimrCdngTqIncSlewY.Ary1D /end CHARACTERISTIC
/begin CHARACTERISTIC CalRegn01Inin00.McuDiagc2MilliSecCntrCompThd.Val "MICROSAR RTE" VALUE 0x0 RTE_RL_UWORD 0 NO_COMPU_METHOD 0 65535 SYMBOL_LINK "Rte_CalprmRom_CalRegn01Inin00_DEFAULT_RTE_CALPRM_GROUP.McuDiagc2MilliSecCntrCompThd_Val" 0 DISPLAY_IDENTIFIER CalRegn01Inin00.CalibrationPorts.McuDiagc2MilliSecCntrCompThd.Val /end CHARACTERISTIC
/begin CHARACTERISTIC CalRegn01Inin00.McuDiagcFltFailStep.Val "MICROSAR RTE" VALUE 0x0 RTE_RL_UWORD 0 NO_COMPU_METHOD 0 65535 SYMBOL_LINK "Rte_CalprmRom_CalRegn01Inin00_DEFAULT_RTE_CALPRM_GROUP.McuDiagcFltFailStep_Val" 0 DISPLAY_IDENTIFIER CalRegn01Inin00.CalibrationPorts.McuDiagcFltFailStep.Val /end CHARACTERISTIC
/begin CHARACTERISTIC CalRegn01Inin00.McuDiagcFltPassStep.Val "MICROSAR RTE" VALUE 0x0 RTE_RL_UWORD 0 NO_COMPU_METHOD 0 65535 SYMBOL_LINK "Rte_CalprmRom_CalRegn01Inin00_DEFAULT_RTE_CALPRM_GROUP.McuDiagcFltPassStep_Val" 0 DISPLAY_IDENTIFIER CalRegn01Inin00.CalibrationPorts.McuDiagcFltPassStep.Val /end CHARACTERISTIC
/begin CHARACTERISTIC CalRegn01Inin00.MotTqTranlDampgCmdLim.Val "MICROSAR RTE" VALUE 0x0 RTE_RL_FLOAT32_IEEE 0 NO_COMPU_METHOD -3.402823466e+38 3.402823466e+38 SYMBOL_LINK "Rte_CalprmRom_CalRegn01Inin00_DEFAULT_RTE_CALPRM_GROUP.MotTqTranlDampgCmdLim_Val" 0 DISPLAY_IDENTIFIER CalRegn01Inin00.CalibrationPorts.MotTqTranlDampgCmdLim.Val /end CHARACTERISTIC
/begin CHARACTERISTIC CalRegn01Inin00.MotTqTranlDampgDampgCoeff.Val "MICROSAR RTE" VALUE 0x0 RTE_RL_FLOAT32_IEEE 0 NO_COMPU_METHOD -3.402823466e+38 3.402823466e+38 SYMBOL_LINK "Rte_CalprmRom_CalRegn01Inin00_DEFAULT_RTE_CALPRM_GROUP.MotTqTranlDampgDampgCoeff_Val" 0 DISPLAY_IDENTIFIER CalRegn01Inin00.CalibrationPorts.MotTqTranlDampgDampgCoeff.Val /end CHARACTERISTIC
/begin CHARACTERISTIC CalRegn01Inin00.MotTqTranlDampgRampEnd.Val "MICROSAR RTE" VALUE 0x0 RTE_RL_UWORD 0 NO_COMPU_METHOD 0 65535 SYMBOL_LINK "Rte_CalprmRom_CalRegn01Inin00_DEFAULT_RTE_CALPRM_GROUP.MotTqTranlDampgRampEnd_Val" 0 DISPLAY_IDENTIFIER CalRegn01Inin00.CalibrationPorts.MotTqTranlDampgRampEnd.Val /end CHARACTERISTIC
/begin CHARACTERISTIC CalRegn01Inin00.MotTqTranlDampgTmrPt1.Val "MICROSAR RTE" VALUE 0x0 RTE_RL_FLOAT32_IEEE 0 NO_COMPU_METHOD -3.402823466e+38 3.402823466e+38 SYMBOL_LINK "Rte_CalprmRom_CalRegn01Inin00_DEFAULT_RTE_CALPRM_GROUP.MotTqTranlDampgTmrPt1_Val" 0 DISPLAY_IDENTIFIER CalRegn01Inin00.CalibrationPorts.MotTqTranlDampgTmrPt1.Val /end CHARACTERISTIC
/begin CHARACTERISTIC CalRegn01Inin00.MotTqTranlDampgTmrPt2.Val "MICROSAR RTE" VALUE 0x0 RTE_RL_FLOAT32_IEEE 0 NO_COMPU_METHOD -3.402823466e+38 3.402823466e+38 SYMBOL_LINK "Rte_CalprmRom_CalRegn01Inin00_DEFAULT_RTE_CALPRM_GROUP.MotTqTranlDampgTmrPt2_Val" 0 DISPLAY_IDENTIFIER CalRegn01Inin00.CalibrationPorts.MotTqTranlDampgTmrPt2.Val /end CHARACTERISTIC
/begin CHARACTERISTIC CalRegn01Inin00.MotTqTranlDampgVehSpdBlndX.Ary1D "MICROSAR RTE" VAL_BLK 0x0 RTE_RL_UWORD 0 NO_COMPU_METHOD 0 65535 MATRIX_DIM 4 1 1 SYMBOL_LINK "Rte_CalprmRom_CalRegn01Inin00_DEFAULT_RTE_CALPRM_GROUP.MotTqTranlDampgVehSpdBlndX_Ary1D" 0 DISPLAY_IDENTIFIER CalRegn01Inin00.CalibrationPorts.MotTqTranlDampgVehSpdBlndX.Ary1D /end CHARACTERISTIC
/begin CHARACTERISTIC CalRegn01Inin00.MotTqTranlDampgVelThd.Val "MICROSAR RTE" VALUE 0x0 RTE_RL_FLOAT32_IEEE 0 NO_COMPU_METHOD -3.402823466e+38 3.402823466e+38 SYMBOL_LINK "Rte_CalprmRom_CalRegn01Inin00_DEFAULT_RTE_CALPRM_GROUP.MotTqTranlDampgVelThd_Val" 0 DISPLAY_IDENTIFIER CalRegn01Inin00.CalibrationPorts.MotTqTranlDampgVelThd.Val /end CHARACTERISTIC
/begin CHARACTERISTIC CalRegn01Inin00.PwrDiscnctNtc0x042FailStep.Val "MICROSAR RTE" VALUE 0x0 RTE_RL_UWORD 0 NO_COMPU_METHOD 0 65535 SYMBOL_LINK "Rte_CalprmRom_CalRegn01Inin00_DEFAULT_RTE_CALPRM_GROUP.PwrDiscnctNtc0x042FailStep_Val" 0 DISPLAY_IDENTIFIER CalRegn01Inin00.CalibrationPorts.PwrDiscnctNtc0x042FailStep.Val /end CHARACTERISTIC
/begin CHARACTERISTIC CalRegn01Inin00.PwrDiscnctNtc0x042PassStep.Val "MICROSAR RTE" VALUE 0x0 RTE_RL_UWORD 0 NO_COMPU_METHOD 0 65535 SYMBOL_LINK "Rte_CalprmRom_CalRegn01Inin00_DEFAULT_RTE_CALPRM_GROUP.PwrDiscnctNtc0x042PassStep_Val" 0 DISPLAY_IDENTIFIER CalRegn01Inin00.CalibrationPorts.PwrDiscnctNtc0x042PassStep.Val /end CHARACTERISTIC
/begin CHARACTERISTIC CalRegn01Inin00.PwrDiscnctNtc0x04AFailStep.Val "MICROSAR RTE" VALUE 0x0 RTE_RL_UWORD 0 NO_COMPU_METHOD 0 65535 SYMBOL_LINK "Rte_CalprmRom_CalRegn01Inin00_DEFAULT_RTE_CALPRM_GROUP.PwrDiscnctNtc0x04AFailStep_Val" 0 DISPLAY_IDENTIFIER CalRegn01Inin00.CalibrationPorts.PwrDiscnctNtc0x04AFailStep.Val /end CHARACTERISTIC
/begin CHARACTERISTIC CalRegn01Inin00.PwrDiscnctNtc0x04APassStep.Val "MICROSAR RTE" VALUE 0x0 RTE_RL_UWORD 0 NO_COMPU_METHOD 0 65535 SYMBOL_LINK "Rte_CalprmRom_CalRegn01Inin00_DEFAULT_RTE_CALPRM_GROUP.PwrDiscnctNtc0x04APassStep_Val" 0 DISPLAY_IDENTIFIER CalRegn01Inin00.CalibrationPorts.PwrDiscnctNtc0x04APassStep.Val /end CHARACTERISTIC
/begin CHARACTERISTIC CalRegn01Inin00.RtnPahFwlUpprBndTblX.Ary1D "MICROSAR RTE" VAL_BLK 0x0 RTE_RL_SWORD 0 NO_COMPU_METHOD -32768 32767 MATRIX_DIM 11 1 1 SYMBOL_LINK "Rte_CalprmRom_CalRegn01Inin00_DEFAULT_RTE_CALPRM_GROUP.RtnPahFwlUpprBndTblX_Ary1D" 0 DISPLAY_IDENTIFIER CalRegn01Inin00.CalibrationPorts.RtnPahFwlUpprBndTblX.Ary1D /end CHARACTERISTIC
/begin CHARACTERISTIC CalRegn01Inin00.RtnPahFwlUpprBndTblY.Ary2D "MICROSAR RTE" VAL_BLK 0x0 RTE_RL_SWORD 0 NO_COMPU_METHOD -32768 32767 MATRIX_DIM 8 11 1 SYMBOL_LINK "Rte_CalprmRom_CalRegn01Inin00_DEFAULT_RTE_CALPRM_GROUP.RtnPahFwlUpprBndTblY_Ary2D" 0 DISPLAY_IDENTIFIER CalRegn01Inin00.CalibrationPorts.RtnPahFwlUpprBndTblY.Ary2D /end CHARACTERISTIC
/begin CHARACTERISTIC CalRegn01Inin00.RtnPahFwlVehSpd.Ary1D "MICROSAR RTE" VAL_BLK 0x0 RTE_RL_UWORD 0 NO_COMPU_METHOD 0 65535 MATRIX_DIM 8 1 1 SYMBOL_LINK "Rte_CalprmRom_CalRegn01Inin00_DEFAULT_RTE_CALPRM_GROUP.RtnPahFwlVehSpd_Ary1D" 0 DISPLAY_IDENTIFIER CalRegn01Inin00.CalibrationPorts.RtnPahFwlVehSpd.Ary1D /end CHARACTERISTIC
/begin CHARACTERISTIC CalRegn01Inin00.SnsrMeasStrtTrigDly.Val "MICROSAR RTE" VALUE 0x0 RTE_RL_UWORD 0 NO_COMPU_METHOD 0 65535 SYMBOL_LINK "Rte_CalprmRom_CalRegn01Inin00_DEFAULT_RTE_CALPRM_GROUP.SnsrMeasStrtTrigDly_Val" 0 DISPLAY_IDENTIFIER CalRegn01Inin00.CalibrationPorts.SnsrMeasStrtTrigDly.Val /end CHARACTERISTIC
/begin CHARACTERISTIC CalRegn01Inin00.StHlthSigNormnHiCtrlrT.Val "MICROSAR RTE" VALUE 0x0 RTE_RL_FLOAT32_IEEE 0 NO_COMPU_METHOD -3.402823466e+38 3.402823466e+38 SYMBOL_LINK "Rte_CalprmRom_CalRegn01Inin00_DEFAULT_RTE_CALPRM_GROUP.StHlthSigNormnHiCtrlrT_Val" 0 DISPLAY_IDENTIFIER CalRegn01Inin00.CalibrationPorts.StHlthSigNormnHiCtrlrT.Val /end CHARACTERISTIC
/begin CHARACTERISTIC CalRegn01Inin00.StHlthSigNormnLoCtrlrT.Val "MICROSAR RTE" VALUE 0x0 RTE_RL_FLOAT32_IEEE 0 NO_COMPU_METHOD -3.402823466e+38 3.402823466e+38 SYMBOL_LINK "Rte_CalprmRom_CalRegn01Inin00_DEFAULT_RTE_CALPRM_GROUP.StHlthSigNormnLoCtrlrT_Val" 0 DISPLAY_IDENTIFIER CalRegn01Inin00.CalibrationPorts.StHlthSigNormnLoCtrlrT.Val /end CHARACTERISTIC
/begin CHARACTERISTIC CalRegn01Inin00.SysFricLrngAvrgFricFrq.Val "MICROSAR RTE" VALUE 0x0 RTE_RL_FLOAT32_IEEE 0 NO_COMPU_METHOD -3.402823466e+38 3.402823466e+38 SYMBOL_LINK "Rte_CalprmRom_CalRegn01Inin00_DEFAULT_RTE_CALPRM_GROUP.SysFricLrngAvrgFricFrq_Val" 0 DISPLAY_IDENTIFIER CalRegn01Inin00.CalibrationPorts.SysFricLrngAvrgFricFrq.Val /end CHARACTERISTIC
/begin CHARACTERISTIC CalRegn01Inin00.SysFricLrngBasLineEolFric.Val "MICROSAR RTE" VALUE 0x0 RTE_RL_FLOAT32_IEEE 0 NO_COMPU_METHOD -3.402823466e+38 3.402823466e+38 SYMBOL_LINK "Rte_CalprmRom_CalRegn01Inin00_DEFAULT_RTE_CALPRM_GROUP.SysFricLrngBasLineEolFric_Val" 0 DISPLAY_IDENTIFIER CalRegn01Inin00.CalibrationPorts.SysFricLrngBasLineEolFric.Val /end CHARACTERISTIC
/begin CHARACTERISTIC CalRegn01Inin00.SysFricLrngBasLineFric.Ary1D "MICROSAR RTE" VAL_BLK 0x0 RTE_RL_FLOAT32_IEEE 0 NO_COMPU_METHOD -3.402823466e+38 3.402823466e+38 MATRIX_DIM 4 1 1 SYMBOL_LINK "Rte_CalprmRom_CalRegn01Inin00_DEFAULT_RTE_CALPRM_GROUP.SysFricLrngBasLineFric_Ary1D" 0 DISPLAY_IDENTIFIER CalRegn01Inin00.CalibrationPorts.SysFricLrngBasLineFric.Ary1D /end CHARACTERISTIC
/begin CHARACTERISTIC CalRegn01Inin00.SysFricLrngBasLineHys.Ary2D "MICROSAR RTE" VAL_BLK 0x0 RTE_RL_FLOAT32_IEEE 0 NO_COMPU_METHOD -3.402823466e+38 3.402823466e+38 MATRIX_DIM 4 8 1 SYMBOL_LINK "Rte_CalprmRom_CalRegn01Inin00_DEFAULT_RTE_CALPRM_GROUP.SysFricLrngBasLineHys_Ary2D" 0 DISPLAY_IDENTIFIER CalRegn01Inin00.CalibrationPorts.SysFricLrngBasLineHys.Ary2D /end CHARACTERISTIC
/begin CHARACTERISTIC CalRegn01Inin00.SysFricLrngBasLineRngCntr.Ary2D "MICROSAR RTE" VAL_BLK 0x0 RTE_RL_UWORD 0 NO_COMPU_METHOD 0 65535 MATRIX_DIM 3 8 1 SYMBOL_LINK "Rte_CalprmRom_CalRegn01Inin00_DEFAULT_RTE_CALPRM_GROUP.SysFricLrngBasLineRngCntr_Ary2D" 0 DISPLAY_IDENTIFIER CalRegn01Inin00.CalibrationPorts.SysFricLrngBasLineRngCntr.Ary2D /end CHARACTERISTIC
/begin CHARACTERISTIC CalRegn01Inin00.SysFricLrngDataPrepLpFilFrq.Val "MICROSAR RTE" VALUE 0x0 RTE_RL_FLOAT32_IEEE 0 NO_COMPU_METHOD -3.402823466e+38 3.402823466e+38 SYMBOL_LINK "Rte_CalprmRom_CalRegn01Inin00_DEFAULT_RTE_CALPRM_GROUP.SysFricLrngDataPrepLpFilFrq_Val" 0 DISPLAY_IDENTIFIER CalRegn01Inin00.CalibrationPorts.SysFricLrngDataPrepLpFilFrq.Val /end CHARACTERISTIC
/begin CHARACTERISTIC CalRegn01Inin00.SysFricLrngEolFricDifHiLim.Val "MICROSAR RTE" VALUE 0x0 RTE_RL_FLOAT32_IEEE 0 NO_COMPU_METHOD -3.402823466e+38 3.402823466e+38 SYMBOL_LINK "Rte_CalprmRom_CalRegn01Inin00_DEFAULT_RTE_CALPRM_GROUP.SysFricLrngEolFricDifHiLim_Val" 0 DISPLAY_IDENTIFIER CalRegn01Inin00.CalibrationPorts.SysFricLrngEolFricDifHiLim.Val /end CHARACTERISTIC
/begin CHARACTERISTIC CalRegn01Inin00.SysFricLrngEolFricDifLoLim.Val "MICROSAR RTE" VALUE 0x0 RTE_RL_FLOAT32_IEEE 0 NO_COMPU_METHOD -3.402823466e+38 3.402823466e+38 SYMBOL_LINK "Rte_CalprmRom_CalRegn01Inin00_DEFAULT_RTE_CALPRM_GROUP.SysFricLrngEolFricDifLoLim_Val" 0 DISPLAY_IDENTIFIER CalRegn01Inin00.CalibrationPorts.SysFricLrngEolFricDifLoLim.Val /end CHARACTERISTIC
/begin CHARACTERISTIC CalRegn01Inin00.SysFricLrngEolFricDifScagFac.Val "MICROSAR RTE" VALUE 0x0 RTE_RL_FLOAT32_IEEE 0 NO_COMPU_METHOD -3.402823466e+38 3.402823466e+38 SYMBOL_LINK "Rte_CalprmRom_CalRegn01Inin00_DEFAULT_RTE_CALPRM_GROUP.SysFricLrngEolFricDifScagFac_Val" 0 DISPLAY_IDENTIFIER CalRegn01Inin00.CalibrationPorts.SysFricLrngEolFricDifScagFac.Val /end CHARACTERISTIC
/begin CHARACTERISTIC CalRegn01Inin00.SysFricLrngFricChgWght.Ary1D "MICROSAR RTE" VAL_BLK 0x0 RTE_RL_FLOAT32_IEEE 0 NO_COMPU_METHOD -3.402823466e+38 3.402823466e+38 MATRIX_DIM 4 1 1 SYMBOL_LINK "Rte_CalprmRom_CalRegn01Inin00_DEFAULT_RTE_CALPRM_GROUP.SysFricLrngFricChgWght_Ary1D" 0 DISPLAY_IDENTIFIER CalRegn01Inin00.CalibrationPorts.SysFricLrngFricChgWght.Ary1D /end CHARACTERISTIC
/begin CHARACTERISTIC CalRegn01Inin00.SysFricLrngFricDiagcThd.Val "MICROSAR RTE" VALUE 0x0 RTE_RL_FLOAT32_IEEE 0 NO_COMPU_METHOD -3.402823466e+38 3.402823466e+38 SYMBOL_LINK "Rte_CalprmRom_CalRegn01Inin00_DEFAULT_RTE_CALPRM_GROUP.SysFricLrngFricDiagcThd_Val" 0 DISPLAY_IDENTIFIER CalRegn01Inin00.CalibrationPorts.SysFricLrngFricDiagcThd.Val /end CHARACTERISTIC
/begin CHARACTERISTIC CalRegn01Inin00.SysFricLrngFricDiagcTiThd.Val "MICROSAR RTE" VALUE 0x0 RTE_RL_FLOAT32_IEEE 0 NO_COMPU_METHOD -3.402823466e+38 3.402823466e+38 SYMBOL_LINK "Rte_CalprmRom_CalRegn01Inin00_DEFAULT_RTE_CALPRM_GROUP.SysFricLrngFricDiagcTiThd_Val" 0 DISPLAY_IDENTIFIER CalRegn01Inin00.CalibrationPorts.SysFricLrngFricDiagcTiThd.Val /end CHARACTERISTIC
/begin CHARACTERISTIC CalRegn01Inin00.SysFricLrngFricHysHwAgPt.Ary1D "MICROSAR RTE" VAL_BLK 0x0 RTE_RL_FLOAT32_IEEE 0 NO_COMPU_METHOD -3.402823466e+38 3.402823466e+38 MATRIX_DIM 4 1 1 SYMBOL_LINK "Rte_CalprmRom_CalRegn01Inin00_DEFAULT_RTE_CALPRM_GROUP.SysFricLrngFricHysHwAgPt_Ary1D" 0 DISPLAY_IDENTIFIER CalRegn01Inin00.CalibrationPorts.SysFricLrngFricHysHwAgPt.Ary1D /end CHARACTERISTIC
/begin CHARACTERISTIC CalRegn01Inin00.SysFricLrngFricOffs.Val "MICROSAR RTE" VALUE 0x0 RTE_RL_FLOAT32_IEEE 0 NO_COMPU_METHOD -3.402823466e+38 3.402823466e+38 SYMBOL_LINK "Rte_CalprmRom_CalRegn01Inin00_DEFAULT_RTE_CALPRM_GROUP.SysFricLrngFricOffs_Val" 0 DISPLAY_IDENTIFIER CalRegn01Inin00.CalibrationPorts.SysFricLrngFricOffs.Val /end CHARACTERISTIC
/begin CHARACTERISTIC CalRegn01Inin00.SysFricLrngFricOffsHiLim.Val "MICROSAR RTE" VALUE 0x0 RTE_RL_FLOAT32_IEEE 0 NO_COMPU_METHOD -3.402823466e+38 3.402823466e+38 SYMBOL_LINK "Rte_CalprmRom_CalRegn01Inin00_DEFAULT_RTE_CALPRM_GROUP.SysFricLrngFricOffsHiLim_Val" 0 DISPLAY_IDENTIFIER CalRegn01Inin00.CalibrationPorts.SysFricLrngFricOffsHiLim.Val /end CHARACTERISTIC
/begin CHARACTERISTIC CalRegn01Inin00.SysFricLrngFricOffsLoLim.Val "MICROSAR RTE" VALUE 0x0 RTE_RL_FLOAT32_IEEE 0 NO_COMPU_METHOD -3.402823466e+38 3.402823466e+38 SYMBOL_LINK "Rte_CalprmRom_CalRegn01Inin00_DEFAULT_RTE_CALPRM_GROUP.SysFricLrngFricOffsLoLim_Val" 0 DISPLAY_IDENTIFIER CalRegn01Inin00.CalibrationPorts.SysFricLrngFricOffsLoLim.Val /end CHARACTERISTIC
/begin CHARACTERISTIC CalRegn01Inin00.SysFricLrngFricOffsLpFilFrq.Val "MICROSAR RTE" VALUE 0x0 RTE_RL_FLOAT32_IEEE 0 NO_COMPU_METHOD -3.402823466e+38 3.402823466e+38 SYMBOL_LINK "Rte_CalprmRom_CalRegn01Inin00_DEFAULT_RTE_CALPRM_GROUP.SysFricLrngFricOffsLpFilFrq_Val" 0 DISPLAY_IDENTIFIER CalRegn01Inin00.CalibrationPorts.SysFricLrngFricOffsLpFilFrq.Val /end CHARACTERISTIC
/begin CHARACTERISTIC CalRegn01Inin00.SysFricLrngGain.Val "MICROSAR RTE" VALUE 0x0 RTE_RL_FLOAT32_IEEE 0 NO_COMPU_METHOD -3.402823466e+38 3.402823466e+38 SYMBOL_LINK "Rte_CalprmRom_CalRegn01Inin00_DEFAULT_RTE_CALPRM_GROUP.SysFricLrngGain_Val" 0 DISPLAY_IDENTIFIER CalRegn01Inin00.CalibrationPorts.SysFricLrngGain.Val /end CHARACTERISTIC
/begin CHARACTERISTIC CalRegn01Inin00.SysFricLrngHwPosnAuthyThd.Val "MICROSAR RTE" VALUE 0x0 RTE_RL_FLOAT32_IEEE 0 NO_COMPU_METHOD -3.402823466e+38 3.402823466e+38 SYMBOL_LINK "Rte_CalprmRom_CalRegn01Inin00_DEFAULT_RTE_CALPRM_GROUP.SysFricLrngHwPosnAuthyThd_Val" 0 DISPLAY_IDENTIFIER CalRegn01Inin00.CalibrationPorts.SysFricLrngHwPosnAuthyThd.Val /end CHARACTERISTIC
/begin CHARACTERISTIC CalRegn01Inin00.SysFricLrngHwVelConstrLim.Val "MICROSAR RTE" VALUE 0x0 RTE_RL_FLOAT32_IEEE 0 NO_COMPU_METHOD -3.402823466e+38 3.402823466e+38 SYMBOL_LINK "Rte_CalprmRom_CalRegn01Inin00_DEFAULT_RTE_CALPRM_GROUP.SysFricLrngHwVelConstrLim_Val" 0 DISPLAY_IDENTIFIER CalRegn01Inin00.CalibrationPorts.SysFricLrngHwVelConstrLim.Val /end CHARACTERISTIC
/begin CHARACTERISTIC CalRegn01Inin00.SysFricLrngHwVelHiLim.Val "MICROSAR RTE" VALUE 0x0 RTE_RL_FLOAT32_IEEE 0 NO_COMPU_METHOD -3.402823466e+38 3.402823466e+38 SYMBOL_LINK "Rte_CalprmRom_CalRegn01Inin00_DEFAULT_RTE_CALPRM_GROUP.SysFricLrngHwVelHiLim_Val" 0 DISPLAY_IDENTIFIER CalRegn01Inin00.CalibrationPorts.SysFricLrngHwVelHiLim.Val /end CHARACTERISTIC
/begin CHARACTERISTIC CalRegn01Inin00.SysFricLrngHwVelLoLim.Val "MICROSAR RTE" VALUE 0x0 RTE_RL_FLOAT32_IEEE 0 NO_COMPU_METHOD -3.402823466e+38 3.402823466e+38 SYMBOL_LINK "Rte_CalprmRom_CalRegn01Inin00_DEFAULT_RTE_CALPRM_GROUP.SysFricLrngHwVelLoLim_Val" 0 DISPLAY_IDENTIFIER CalRegn01Inin00.CalibrationPorts.SysFricLrngHwVelLoLim.Val /end CHARACTERISTIC
/begin CHARACTERISTIC CalRegn01Inin00.SysFricLrngIgnCycFricChgLim.Val "MICROSAR RTE" VALUE 0x0 RTE_RL_FLOAT32_IEEE 0 NO_COMPU_METHOD -3.402823466e+38 3.402823466e+38 SYMBOL_LINK "Rte_CalprmRom_CalRegn01Inin00_DEFAULT_RTE_CALPRM_GROUP.SysFricLrngIgnCycFricChgLim_Val" 0 DISPLAY_IDENTIFIER CalRegn01Inin00.CalibrationPorts.SysFricLrngIgnCycFricChgLim.Val /end CHARACTERISTIC
/begin CHARACTERISTIC CalRegn01Inin00.SysFricLrngIvsTrsmRatX.Ary1D "MICROSAR RTE" VAL_BLK 0x0 RTE_RL_UWORD 0 NO_COMPU_METHOD 0 65535 MATRIX_DIM 10 1 1 SYMBOL_LINK "Rte_CalprmRom_CalRegn01Inin00_DEFAULT_RTE_CALPRM_GROUP.SysFricLrngIvsTrsmRatX_Ary1D" 0 DISPLAY_IDENTIFIER CalRegn01Inin00.CalibrationPorts.SysFricLrngIvsTrsmRatX.Ary1D /end CHARACTERISTIC
/begin CHARACTERISTIC CalRegn01Inin00.SysFricLrngIvsTrsmRatY.Ary1D "MICROSAR RTE" VAL_BLK 0x0 RTE_RL_UWORD 0 NO_COMPU_METHOD 0 65535 MATRIX_DIM 10 1 1 SYMBOL_LINK "Rte_CalprmRom_CalRegn01Inin00_DEFAULT_RTE_CALPRM_GROUP.SysFricLrngIvsTrsmRatY_Ary1D" 0 DISPLAY_IDENTIFIER CalRegn01Inin00.CalibrationPorts.SysFricLrngIvsTrsmRatY.Ary1D /end CHARACTERISTIC
/begin CHARACTERISTIC CalRegn01Inin00.SysFricLrngLatAHiLim.Val "MICROSAR RTE" VALUE 0x0 RTE_RL_FLOAT32_IEEE 0 NO_COMPU_METHOD -3.402823466e+38 3.402823466e+38 SYMBOL_LINK "Rte_CalprmRom_CalRegn01Inin00_DEFAULT_RTE_CALPRM_GROUP.SysFricLrngLatAHiLim_Val" 0 DISPLAY_IDENTIFIER CalRegn01Inin00.CalibrationPorts.SysFricLrngLatAHiLim.Val /end CHARACTERISTIC
/begin CHARACTERISTIC CalRegn01Inin00.SysFricLrngLatALoLim.Val "MICROSAR RTE" VALUE 0x0 RTE_RL_FLOAT32_IEEE 0 NO_COMPU_METHOD -3.402823466e+38 3.402823466e+38 SYMBOL_LINK "Rte_CalprmRom_CalRegn01Inin00_DEFAULT_RTE_CALPRM_GROUP.SysFricLrngLatALoLim_Val" 0 DISPLAY_IDENTIFIER CalRegn01Inin00.CalibrationPorts.SysFricLrngLatALoLim.Val /end CHARACTERISTIC
/begin CHARACTERISTIC CalRegn01Inin00.SysFricLrngMaskVehSpd.Ary1D "MICROSAR RTE" VAL_BLK 0x0 RTE_RL_BOOLEAN 0 RTE_CM_BOOLEAN 0 255 MATRIX_DIM 4 1 1 SYMBOL_LINK "Rte_CalprmRom_CalRegn01Inin00_DEFAULT_RTE_CALPRM_GROUP.SysFricLrngMaskVehSpd_Ary1D" 0 DISPLAY_IDENTIFIER CalRegn01Inin00.CalibrationPorts.SysFricLrngMaskVehSpd.Ary1D /end CHARACTERISTIC
/begin CHARACTERISTIC CalRegn01Inin00.SysFricLrngRngCntrThd.Val "MICROSAR RTE" VALUE 0x0 RTE_RL_UWORD 0 NO_COMPU_METHOD 0 65535 SYMBOL_LINK "Rte_CalprmRom_CalRegn01Inin00_DEFAULT_RTE_CALPRM_GROUP.SysFricLrngRngCntrThd_Val" 0 DISPLAY_IDENTIFIER CalRegn01Inin00.CalibrationPorts.SysFricLrngRngCntrThd.Val /end CHARACTERISTIC
/begin CHARACTERISTIC CalRegn01Inin00.SysFricLrngTHiLim.Val "MICROSAR RTE" VALUE 0x0 RTE_RL_FLOAT32_IEEE 0 NO_COMPU_METHOD -3.402823466e+38 3.402823466e+38 SYMBOL_LINK "Rte_CalprmRom_CalRegn01Inin00_DEFAULT_RTE_CALPRM_GROUP.SysFricLrngTHiLim_Val" 0 DISPLAY_IDENTIFIER CalRegn01Inin00.CalibrationPorts.SysFricLrngTHiLim.Val /end CHARACTERISTIC
/begin CHARACTERISTIC CalRegn01Inin00.SysFricLrngTLoLim.Val "MICROSAR RTE" VALUE 0x0 RTE_RL_FLOAT32_IEEE 0 NO_COMPU_METHOD -3.402823466e+38 3.402823466e+38 SYMBOL_LINK "Rte_CalprmRom_CalRegn01Inin00_DEFAULT_RTE_CALPRM_GROUP.SysFricLrngTLoLim_Val" 0 DISPLAY_IDENTIFIER CalRegn01Inin00.CalibrationPorts.SysFricLrngTLoLim.Val /end CHARACTERISTIC
/begin CHARACTERISTIC CalRegn01Inin00.SysFricLrngThd.Val "MICROSAR RTE" VALUE 0x0 RTE_RL_ULONG 0 NO_COMPU_METHOD 0 4294967295 SYMBOL_LINK "Rte_CalprmRom_CalRegn01Inin00_DEFAULT_RTE_CALPRM_GROUP.SysFricLrngThd_Val" 0 DISPLAY_IDENTIFIER CalRegn01Inin00.CalibrationPorts.SysFricLrngThd.Val /end CHARACTERISTIC
/begin CHARACTERISTIC CalRegn01Inin00.SysFricLrngVehSpd.Ary2D "MICROSAR RTE" VAL_BLK 0x0 RTE_RL_FLOAT32_IEEE 0 NO_COMPU_METHOD -3.402823466e+38 3.402823466e+38 MATRIX_DIM 2 4 1 SYMBOL_LINK "Rte_CalprmRom_CalRegn01Inin00_DEFAULT_RTE_CALPRM_GROUP.SysFricLrngVehSpd_Ary2D" 0 DISPLAY_IDENTIFIER CalRegn01Inin00.CalibrationPorts.SysFricLrngVehSpd.Ary2D /end CHARACTERISTIC
/begin CHARACTERISTIC CalRegn01Inin00.SysGlbPrmMotPoleCnt.Val "MICROSAR RTE" VALUE 0x0 RTE_RL_UBYTE 0 NO_COMPU_METHOD 0 255 SYMBOL_LINK "Rte_CalprmRom_CalRegn01Inin00_DEFAULT_RTE_CALPRM_GROUP.SysGlbPrmMotPoleCnt_Val" 0 DISPLAY_IDENTIFIER CalRegn01Inin00.CalibrationPorts.SysGlbPrmMotPoleCnt.Val /end CHARACTERISTIC
/begin CHARACTERISTIC CalRegn01Inin00.SysGlbPrmTorsBarStfn.Val "MICROSAR RTE" VALUE 0x0 RTE_RL_FLOAT32_IEEE 0 NO_COMPU_METHOD -3.402823466e+38 3.402823466e+38 SYMBOL_LINK "Rte_CalprmRom_CalRegn01Inin00_DEFAULT_RTE_CALPRM_GROUP.SysGlbPrmTorsBarStfn_Val" 0 DISPLAY_IDENTIFIER CalRegn01Inin00.CalibrationPorts.SysGlbPrmTorsBarStfn.Val /end CHARACTERISTIC
/begin CHARACTERISTIC CalRegn01Inin00.TEstimnAmbPwrMplr.Val "MICROSAR RTE" VALUE 0x0 RTE_RL_FLOAT32_IEEE 0 NO_COMPU_METHOD -3.402823466e+38 3.402823466e+38 SYMBOL_LINK "Rte_CalprmRom_CalRegn01Inin00_DEFAULT_RTE_CALPRM_GROUP.TEstimnAmbPwrMplr_Val" 0 DISPLAY_IDENTIFIER CalRegn01Inin00.CalibrationPorts.TEstimnAmbPwrMplr.Val /end CHARACTERISTIC
/begin CHARACTERISTIC CalRegn01Inin00.TEstimnAmbTSca.Val "MICROSAR RTE" VALUE 0x0 RTE_RL_FLOAT32_IEEE 0 NO_COMPU_METHOD -3.402823466e+38 3.402823466e+38 SYMBOL_LINK "Rte_CalprmRom_CalRegn01Inin00_DEFAULT_RTE_CALPRM_GROUP.TEstimnAmbTSca_Val" 0 DISPLAY_IDENTIFIER CalRegn01Inin00.CalibrationPorts.TEstimnAmbTSca.Val /end CHARACTERISTIC
/begin CHARACTERISTIC CalRegn01Inin00.TEstimnAssiMechAmbLpFilFrq.Val "MICROSAR RTE" VALUE 0x0 RTE_RL_FLOAT32_IEEE 0 NO_COMPU_METHOD -3.402823466e+38 3.402823466e+38 SYMBOL_LINK "Rte_CalprmRom_CalRegn01Inin00_DEFAULT_RTE_CALPRM_GROUP.TEstimnAssiMechAmbLpFilFrq_Val" 0 DISPLAY_IDENTIFIER CalRegn01Inin00.CalibrationPorts.TEstimnAssiMechAmbLpFilFrq.Val /end CHARACTERISTIC
/begin CHARACTERISTIC CalRegn01Inin00.TEstimnAssiMechAmbMplr.Val "MICROSAR RTE" VALUE 0x0 RTE_RL_FLOAT32_IEEE 0 NO_COMPU_METHOD -3.402823466e+38 3.402823466e+38 SYMBOL_LINK "Rte_CalprmRom_CalRegn01Inin00_DEFAULT_RTE_CALPRM_GROUP.TEstimnAssiMechAmbMplr_Val" 0 DISPLAY_IDENTIFIER CalRegn01Inin00.CalibrationPorts.TEstimnAssiMechAmbMplr.Val /end CHARACTERISTIC
/begin CHARACTERISTIC CalRegn01Inin00.TEstimnAssiMechCorrLim.Val "MICROSAR RTE" VALUE 0x0 RTE_RL_FLOAT32_IEEE 0 NO_COMPU_METHOD -3.402823466e+38 3.402823466e+38 SYMBOL_LINK "Rte_CalprmRom_CalRegn01Inin00_DEFAULT_RTE_CALPRM_GROUP.TEstimnAssiMechCorrLim_Val" 0 DISPLAY_IDENTIFIER CalRegn01Inin00.CalibrationPorts.TEstimnAssiMechCorrLim.Val /end CHARACTERISTIC
/begin CHARACTERISTIC CalRegn01Inin00.TEstimnAssiMechDampgSca.Val "MICROSAR RTE" VALUE 0x0 RTE_RL_FLOAT32_IEEE 0 NO_COMPU_METHOD -3.402823466e+38 3.402823466e+38 SYMBOL_LINK "Rte_CalprmRom_CalRegn01Inin00_DEFAULT_RTE_CALPRM_GROUP.TEstimnAssiMechDampgSca_Val" 0 DISPLAY_IDENTIFIER CalRegn01Inin00.CalibrationPorts.TEstimnAssiMechDampgSca.Val /end CHARACTERISTIC
/begin CHARACTERISTIC CalRegn01Inin00.TEstimnAssiMechDftT.Val "MICROSAR RTE" VALUE 0x0 RTE_RL_FLOAT32_IEEE 0 NO_COMPU_METHOD -3.402823466e+38 3.402823466e+38 SYMBOL_LINK "Rte_CalprmRom_CalRegn01Inin00_DEFAULT_RTE_CALPRM_GROUP.TEstimnAssiMechDftT_Val" 0 DISPLAY_IDENTIFIER CalRegn01Inin00.CalibrationPorts.TEstimnAssiMechDftT.Val /end CHARACTERISTIC
/begin CHARACTERISTIC CalRegn01Inin00.TEstimnAssiMechLLFilCoeffA1.Val "MICROSAR RTE" VALUE 0x0 RTE_RL_FLOAT32_IEEE 0 NO_COMPU_METHOD -3.402823466e+38 3.402823466e+38 SYMBOL_LINK "Rte_CalprmRom_CalRegn01Inin00_DEFAULT_RTE_CALPRM_GROUP.TEstimnAssiMechLLFilCoeffA1_Val" 0 DISPLAY_IDENTIFIER CalRegn01Inin00.CalibrationPorts.TEstimnAssiMechLLFilCoeffA1.Val /end CHARACTERISTIC
/begin CHARACTERISTIC CalRegn01Inin00.TEstimnAssiMechLLFilCoeffB0.Val "MICROSAR RTE" VALUE 0x0 RTE_RL_FLOAT32_IEEE 0 NO_COMPU_METHOD -3.402823466e+38 3.402823466e+38 SYMBOL_LINK "Rte_CalprmRom_CalRegn01Inin00_DEFAULT_RTE_CALPRM_GROUP.TEstimnAssiMechLLFilCoeffB0_Val" 0 DISPLAY_IDENTIFIER CalRegn01Inin00.CalibrationPorts.TEstimnAssiMechLLFilCoeffB0.Val /end CHARACTERISTIC
/begin CHARACTERISTIC CalRegn01Inin00.TEstimnAssiMechLLFilCoeffB1.Val "MICROSAR RTE" VALUE 0x0 RTE_RL_FLOAT32_IEEE 0 NO_COMPU_METHOD -3.402823466e+38 3.402823466e+38 SYMBOL_LINK "Rte_CalprmRom_CalRegn01Inin00_DEFAULT_RTE_CALPRM_GROUP.TEstimnAssiMechLLFilCoeffB1_Val" 0 DISPLAY_IDENTIFIER CalRegn01Inin00.CalibrationPorts.TEstimnAssiMechLLFilCoeffB1.Val /end CHARACTERISTIC
/begin CHARACTERISTIC CalRegn01Inin00.TEstimnAssiMechSlew.Val "MICROSAR RTE" VALUE 0x0 RTE_RL_FLOAT32_IEEE 0 NO_COMPU_METHOD -3.402823466e+38 3.402823466e+38 SYMBOL_LINK "Rte_CalprmRom_CalRegn01Inin00_DEFAULT_RTE_CALPRM_GROUP.TEstimnAssiMechSlew_Val" 0 DISPLAY_IDENTIFIER CalRegn01Inin00.CalibrationPorts.TEstimnAssiMechSlew.Val /end CHARACTERISTIC
/begin CHARACTERISTIC CalRegn01Inin00.TEstimnCorrnTAssiMech.Val "MICROSAR RTE" VALUE 0x0 RTE_RL_FLOAT32_IEEE 0 NO_COMPU_METHOD -3.402823466e+38 3.402823466e+38 SYMBOL_LINK "Rte_CalprmRom_CalRegn01Inin00_DEFAULT_RTE_CALPRM_GROUP.TEstimnCorrnTAssiMech_Val" 0 DISPLAY_IDENTIFIER CalRegn01Inin00.CalibrationPorts.TEstimnCorrnTAssiMech.Val /end CHARACTERISTIC
/begin CHARACTERISTIC CalRegn01Inin00.TEstimnCorrnTCu.Val "MICROSAR RTE" VALUE 0x0 RTE_RL_FLOAT32_IEEE 0 NO_COMPU_METHOD -3.402823466e+38 3.402823466e+38 SYMBOL_LINK "Rte_CalprmRom_CalRegn01Inin00_DEFAULT_RTE_CALPRM_GROUP.TEstimnCorrnTCu_Val" 0 DISPLAY_IDENTIFIER CalRegn01Inin00.CalibrationPorts.TEstimnCorrnTCu.Val /end CHARACTERISTIC
/begin CHARACTERISTIC CalRegn01Inin00.TEstimnCorrnTMag.Val "MICROSAR RTE" VALUE 0x0 RTE_RL_FLOAT32_IEEE 0 NO_COMPU_METHOD -3.402823466e+38 3.402823466e+38 SYMBOL_LINK "Rte_CalprmRom_CalRegn01Inin00_DEFAULT_RTE_CALPRM_GROUP.TEstimnCorrnTMag_Val" 0 DISPLAY_IDENTIFIER CalRegn01Inin00.CalibrationPorts.TEstimnCorrnTMag.Val /end CHARACTERISTIC
/begin CHARACTERISTIC CalRegn01Inin00.TEstimnCorrnTSi.Val "MICROSAR RTE" VALUE 0x0 RTE_RL_FLOAT32_IEEE 0 NO_COMPU_METHOD -3.402823466e+38 3.402823466e+38 SYMBOL_LINK "Rte_CalprmRom_CalRegn01Inin00_DEFAULT_RTE_CALPRM_GROUP.TEstimnCorrnTSi_Val" 0 DISPLAY_IDENTIFIER CalRegn01Inin00.CalibrationPorts.TEstimnCorrnTSi.Val /end CHARACTERISTIC
/begin CHARACTERISTIC CalRegn01Inin00.TEstimnCuAmbLpFilFrq.Val "MICROSAR RTE" VALUE 0x0 RTE_RL_FLOAT32_IEEE 0 NO_COMPU_METHOD -3.402823466e+38 3.402823466e+38 SYMBOL_LINK "Rte_CalprmRom_CalRegn01Inin00_DEFAULT_RTE_CALPRM_GROUP.TEstimnCuAmbLpFilFrq_Val" 0 DISPLAY_IDENTIFIER CalRegn01Inin00.CalibrationPorts.TEstimnCuAmbLpFilFrq.Val /end CHARACTERISTIC
/begin CHARACTERISTIC CalRegn01Inin00.TEstimnCuAmbMplr.Val "MICROSAR RTE" VALUE 0x0 RTE_RL_FLOAT32_IEEE 0 NO_COMPU_METHOD -3.402823466e+38 3.402823466e+38 SYMBOL_LINK "Rte_CalprmRom_CalRegn01Inin00_DEFAULT_RTE_CALPRM_GROUP.TEstimnCuAmbMplr_Val" 0 DISPLAY_IDENTIFIER CalRegn01Inin00.CalibrationPorts.TEstimnCuAmbMplr.Val /end CHARACTERISTIC
/begin CHARACTERISTIC CalRegn01Inin00.TEstimnCuCorrnLim.Val "MICROSAR RTE" VALUE 0x0 RTE_RL_FLOAT32_IEEE 0 NO_COMPU_METHOD -3.402823466e+38 3.402823466e+38 SYMBOL_LINK "Rte_CalprmRom_CalRegn01Inin00_DEFAULT_RTE_CALPRM_GROUP.TEstimnCuCorrnLim_Val" 0 DISPLAY_IDENTIFIER CalRegn01Inin00.CalibrationPorts.TEstimnCuCorrnLim.Val /end CHARACTERISTIC
/begin CHARACTERISTIC CalRegn01Inin00.TEstimnCuLLFilCoeffA1.Val "MICROSAR RTE" VALUE 0x0 RTE_RL_FLOAT32_IEEE 0 NO_COMPU_METHOD -3.402823466e+38 3.402823466e+38 SYMBOL_LINK "Rte_CalprmRom_CalRegn01Inin00_DEFAULT_RTE_CALPRM_GROUP.TEstimnCuLLFilCoeffA1_Val" 0 DISPLAY_IDENTIFIER CalRegn01Inin00.CalibrationPorts.TEstimnCuLLFilCoeffA1.Val /end CHARACTERISTIC
/begin CHARACTERISTIC CalRegn01Inin00.TEstimnCuLLFilCoeffB0.Val "MICROSAR RTE" VALUE 0x0 RTE_RL_FLOAT32_IEEE 0 NO_COMPU_METHOD -3.402823466e+38 3.402823466e+38 SYMBOL_LINK "Rte_CalprmRom_CalRegn01Inin00_DEFAULT_RTE_CALPRM_GROUP.TEstimnCuLLFilCoeffB0_Val" 0 DISPLAY_IDENTIFIER CalRegn01Inin00.CalibrationPorts.TEstimnCuLLFilCoeffB0.Val /end CHARACTERISTIC
/begin CHARACTERISTIC CalRegn01Inin00.TEstimnCuLLFilCoeffB1.Val "MICROSAR RTE" VALUE 0x0 RTE_RL_FLOAT32_IEEE 0 NO_COMPU_METHOD -3.402823466e+38 3.402823466e+38 SYMBOL_LINK "Rte_CalprmRom_CalRegn01Inin00_DEFAULT_RTE_CALPRM_GROUP.TEstimnCuLLFilCoeffB1_Val" 0 DISPLAY_IDENTIFIER CalRegn01Inin00.CalibrationPorts.TEstimnCuLLFilCoeffB1.Val /end CHARACTERISTIC
/begin CHARACTERISTIC CalRegn01Inin00.TEstimnEngTSca.Val "MICROSAR RTE" VALUE 0x0 RTE_RL_FLOAT32_IEEE 0 NO_COMPU_METHOD -3.402823466e+38 3.402823466e+38 SYMBOL_LINK "Rte_CalprmRom_CalRegn01Inin00_DEFAULT_RTE_CALPRM_GROUP.TEstimnEngTSca_Val" 0 DISPLAY_IDENTIFIER CalRegn01Inin00.CalibrationPorts.TEstimnEngTSca.Val /end CHARACTERISTIC
/begin CHARACTERISTIC CalRegn01Inin00.TEstimnMagAmbLpFilFrq.Val "MICROSAR RTE" VALUE 0x0 RTE_RL_FLOAT32_IEEE 0 NO_COMPU_METHOD -3.402823466e+38 3.402823466e+38 SYMBOL_LINK "Rte_CalprmRom_CalRegn01Inin00_DEFAULT_RTE_CALPRM_GROUP.TEstimnMagAmbLpFilFrq_Val" 0 DISPLAY_IDENTIFIER CalRegn01Inin00.CalibrationPorts.TEstimnMagAmbLpFilFrq.Val /end CHARACTERISTIC
/begin CHARACTERISTIC CalRegn01Inin00.TEstimnMagCorrnLim.Val "MICROSAR RTE" VALUE 0x0 RTE_RL_FLOAT32_IEEE 0 NO_COMPU_METHOD -3.402823466e+38 3.402823466e+38 SYMBOL_LINK "Rte_CalprmRom_CalRegn01Inin00_DEFAULT_RTE_CALPRM_GROUP.TEstimnMagCorrnLim_Val" 0 DISPLAY_IDENTIFIER CalRegn01Inin00.CalibrationPorts.TEstimnMagCorrnLim.Val /end CHARACTERISTIC
/begin CHARACTERISTIC CalRegn01Inin00.TEstimnMagLLFilCoeffA1.Val "MICROSAR RTE" VALUE 0x0 RTE_RL_FLOAT32_IEEE 0 NO_COMPU_METHOD -3.402823466e+38 3.402823466e+38 SYMBOL_LINK "Rte_CalprmRom_CalRegn01Inin00_DEFAULT_RTE_CALPRM_GROUP.TEstimnMagLLFilCoeffA1_Val" 0 DISPLAY_IDENTIFIER CalRegn01Inin00.CalibrationPorts.TEstimnMagLLFilCoeffA1.Val /end CHARACTERISTIC
/begin CHARACTERISTIC CalRegn01Inin00.TEstimnMagLLFilCoeffB0.Val "MICROSAR RTE" VALUE 0x0 RTE_RL_FLOAT32_IEEE 0 NO_COMPU_METHOD -3.402823466e+38 3.402823466e+38 SYMBOL_LINK "Rte_CalprmRom_CalRegn01Inin00_DEFAULT_RTE_CALPRM_GROUP.TEstimnMagLLFilCoeffB0_Val" 0 DISPLAY_IDENTIFIER CalRegn01Inin00.CalibrationPorts.TEstimnMagLLFilCoeffB0.Val /end CHARACTERISTIC
/begin CHARACTERISTIC CalRegn01Inin00.TEstimnMagLLFilCoeffB1.Val "MICROSAR RTE" VALUE 0x0 RTE_RL_FLOAT32_IEEE 0 NO_COMPU_METHOD -3.402823466e+38 3.402823466e+38 SYMBOL_LINK "Rte_CalprmRom_CalRegn01Inin00_DEFAULT_RTE_CALPRM_GROUP.TEstimnMagLLFilCoeffB1_Val" 0 DISPLAY_IDENTIFIER CalRegn01Inin00.CalibrationPorts.TEstimnMagLLFilCoeffB1.Val /end CHARACTERISTIC
/begin CHARACTERISTIC CalRegn01Inin00.TEstimnSiAmbLpFilFrq.Val "MICROSAR RTE" VALUE 0x0 RTE_RL_FLOAT32_IEEE 0 NO_COMPU_METHOD -3.402823466e+38 3.402823466e+38 SYMBOL_LINK "Rte_CalprmRom_CalRegn01Inin00_DEFAULT_RTE_CALPRM_GROUP.TEstimnSiAmbLpFilFrq_Val" 0 DISPLAY_IDENTIFIER CalRegn01Inin00.CalibrationPorts.TEstimnSiAmbLpFilFrq.Val /end CHARACTERISTIC
/begin CHARACTERISTIC CalRegn01Inin00.TEstimnSiAmbMplr.Val "MICROSAR RTE" VALUE 0x0 RTE_RL_FLOAT32_IEEE 0 NO_COMPU_METHOD -3.402823466e+38 3.402823466e+38 SYMBOL_LINK "Rte_CalprmRom_CalRegn01Inin00_DEFAULT_RTE_CALPRM_GROUP.TEstimnSiAmbMplr_Val" 0 DISPLAY_IDENTIFIER CalRegn01Inin00.CalibrationPorts.TEstimnSiAmbMplr.Val /end CHARACTERISTIC
/begin CHARACTERISTIC CalRegn01Inin00.TEstimnSiCorrnLim.Val "MICROSAR RTE" VALUE 0x0 RTE_RL_FLOAT32_IEEE 0 NO_COMPU_METHOD -3.402823466e+38 3.402823466e+38 SYMBOL_LINK "Rte_CalprmRom_CalRegn01Inin00_DEFAULT_RTE_CALPRM_GROUP.TEstimnSiCorrnLim_Val" 0 DISPLAY_IDENTIFIER CalRegn01Inin00.CalibrationPorts.TEstimnSiCorrnLim.Val /end CHARACTERISTIC
/begin CHARACTERISTIC CalRegn01Inin00.TEstimnSiLLFilCoeffA1.Val "MICROSAR RTE" VALUE 0x0 RTE_RL_FLOAT32_IEEE 0 NO_COMPU_METHOD -3.402823466e+38 3.402823466e+38 SYMBOL_LINK "Rte_CalprmRom_CalRegn01Inin00_DEFAULT_RTE_CALPRM_GROUP.TEstimnSiLLFilCoeffA1_Val" 0 DISPLAY_IDENTIFIER CalRegn01Inin00.CalibrationPorts.TEstimnSiLLFilCoeffA1.Val /end CHARACTERISTIC
/begin CHARACTERISTIC CalRegn01Inin00.TEstimnSiLLFilCoeffB0.Val "MICROSAR RTE" VALUE 0x0 RTE_RL_FLOAT32_IEEE 0 NO_COMPU_METHOD -3.402823466e+38 3.402823466e+38 SYMBOL_LINK "Rte_CalprmRom_CalRegn01Inin00_DEFAULT_RTE_CALPRM_GROUP.TEstimnSiLLFilCoeffB0_Val" 0 DISPLAY_IDENTIFIER CalRegn01Inin00.CalibrationPorts.TEstimnSiLLFilCoeffB0.Val /end CHARACTERISTIC
/begin CHARACTERISTIC CalRegn01Inin00.TEstimnSiLLFilCoeffB1.Val "MICROSAR RTE" VALUE 0x0 RTE_RL_FLOAT32_IEEE 0 NO_COMPU_METHOD -3.402823466e+38 3.402823466e+38 SYMBOL_LINK "Rte_CalprmRom_CalRegn01Inin00_DEFAULT_RTE_CALPRM_GROUP.TEstimnSiLLFilCoeffB1_Val" 0 DISPLAY_IDENTIFIER CalRegn01Inin00.CalibrationPorts.TEstimnSiLLFilCoeffB1.Val /end CHARACTERISTIC
/begin CHARACTERISTIC CalRegn01Inin00.TEstimnWghtAvrgTDi.Logl "MICROSAR RTE" VALUE 0x0 RTE_RL_BOOLEAN 0 RTE_CM_BOOLEAN 0 255 SYMBOL_LINK "Rte_CalprmRom_CalRegn01Inin00_DEFAULT_RTE_CALPRM_GROUP.TEstimnWghtAvrgTDi_Logl" 0 DISPLAY_IDENTIFIER CalRegn01Inin00.CalibrationPorts.TEstimnWghtAvrgTDi.Logl /end CHARACTERISTIC
/begin CHARACTERISTIC CalRegn01Inin00.TunSelnAuthyVehSpdX.Ary1D "MICROSAR RTE" VAL_BLK 0x0 RTE_RL_UWORD 0 NO_COMPU_METHOD 0 65535 MATRIX_DIM 6 1 1 SYMBOL_LINK "Rte_CalprmRom_CalRegn01Inin00_DEFAULT_RTE_CALPRM_GROUP.TunSelnAuthyVehSpdX_Ary1D" 0 DISPLAY_IDENTIFIER CalRegn01Inin00.CalibrationPorts.TunSelnAuthyVehSpdX.Ary1D /end CHARACTERISTIC
/begin CHARACTERISTIC CalRegn01Inin00.VehSigCdngLatASlewRate.Val "MICROSAR RTE" VALUE 0x0 RTE_RL_FLOAT32_IEEE 0 NO_COMPU_METHOD 0.1 400.0 SYMBOL_LINK "Rte_CalprmRom_CalRegn01Inin00_DEFAULT_RTE_CALPRM_GROUP.VehSigCdngLatASlewRate_Val" 0 DISPLAY_IDENTIFIER CalRegn01Inin00.CalibrationPorts.VehSigCdngLatASlewRate.Val /end CHARACTERISTIC
/begin CHARACTERISTIC CalRegn01Inin00.VehSigCdngLtgASlewRate.Val "MICROSAR RTE" VALUE 0x0 RTE_RL_FLOAT32_IEEE 0 NO_COMPU_METHOD 0.1 500.0 SYMBOL_LINK "Rte_CalprmRom_CalRegn01Inin00_DEFAULT_RTE_CALPRM_GROUP.VehSigCdngLtgASlewRate_Val" 0 DISPLAY_IDENTIFIER CalRegn01Inin00.CalibrationPorts.VehSigCdngLtgASlewRate.Val /end CHARACTERISTIC
/begin CHARACTERISTIC CalRegn01Inin00.VehSigCdngVehSpdSlewRate.Val "MICROSAR RTE" VALUE 0x0 RTE_RL_FLOAT32_IEEE 0 NO_COMPU_METHOD 1.0 50.0 SYMBOL_LINK "Rte_CalprmRom_CalRegn01Inin00_DEFAULT_RTE_CALPRM_GROUP.VehSigCdngVehSpdSlewRate_Val" 0 DISPLAY_IDENTIFIER CalRegn01Inin00.CalibrationPorts.VehSigCdngVehSpdSlewRate.Val /end CHARACTERISTIC
/begin CHARACTERISTIC CalRegn01Inin00.WhlImbRejctnDcTrendFltRcvryThd.Val "MICROSAR RTE" VALUE 0x0 RTE_RL_FLOAT32_IEEE 0 NO_COMPU_METHOD -3.402823466e+38 3.402823466e+38 SYMBOL_LINK "Rte_CalprmRom_CalRegn01Inin00_DEFAULT_RTE_CALPRM_GROUP.WhlImbRejctnDcTrendFltRcvryThd_Val" 0 DISPLAY_IDENTIFIER CalRegn01Inin00.CalibrationPorts.WhlImbRejctnDcTrendFltRcvryThd.Val /end CHARACTERISTIC
/begin CHARACTERISTIC CalRegn01Inin00GroupB.GmRoadWhlInQlfrMaxAllwblFrq.Val "MICROSAR RTE" VALUE 0x0 RTE_RL_FLOAT32_IEEE 0 NO_COMPU_METHOD -3.402823466e+38 3.402823466e+38 SYMBOL_LINK "Rte_CalprmRom_CalRegn01Inin00GroupB_DEFAULT_RTE_CALPRM_GROUP.GmRoadWhlInQlfrMaxAllwblFrq_Val" 0 DISPLAY_IDENTIFIER CalRegn01Inin00GroupB.CalibrationPorts.GmRoadWhlInQlfrMaxAllwblFrq.Val /end CHARACTERISTIC
/begin CHARACTERISTIC CalRegn01Inin00GroupB.GmRoadWhlInQlfrMaxFrqChg.Val "MICROSAR RTE" VALUE 0x0 RTE_RL_FLOAT32_IEEE 0 NO_COMPU_METHOD -3.402823466e+38 3.402823466e+38 SYMBOL_LINK "Rte_CalprmRom_CalRegn01Inin00GroupB_DEFAULT_RTE_CALPRM_GROUP.GmRoadWhlInQlfrMaxFrqChg_Val" 0 DISPLAY_IDENTIFIER CalRegn01Inin00GroupB.CalibrationPorts.GmRoadWhlInQlfrMaxFrqChg.Val /end CHARACTERISTIC
/begin CHARACTERISTIC CalRegn01Inin00GroupB.WhlImbRejctnDcTrendFltRcvryNegStep.Val "MICROSAR RTE" VALUE 0x0 RTE_RL_FLOAT32_IEEE 0 NO_COMPU_METHOD -3.402823466e+38 3.402823466e+38 SYMBOL_LINK "Rte_CalprmRom_CalRegn01Inin00GroupB_DEFAULT_RTE_CALPRM_GROUP.WhlImbRejctnDcTrendFltRcvryNegStep_Val" 0 DISPLAY_IDENTIFIER CalRegn01Inin00GroupB.CalibrationPorts.WhlImbRejctnDcTrendFltRcvryNegStep.Val /end CHARACTERISTIC
/begin CHARACTERISTIC CalRegn01Inin00GroupB.WhlImbRejctnDcTrendFltRcvryPosStep.Val "MICROSAR RTE" VALUE 0x0 RTE_RL_FLOAT32_IEEE 0 NO_COMPU_METHOD -3.402823466e+38 3.402823466e+38 SYMBOL_LINK "Rte_CalprmRom_CalRegn01Inin00GroupB_DEFAULT_RTE_CALPRM_GROUP.WhlImbRejctnDcTrendFltRcvryPosStep_Val" 0 DISPLAY_IDENTIFIER CalRegn01Inin00GroupB.CalibrationPorts.WhlImbRejctnDcTrendFltRcvryPosStep.Val /end CHARACTERISTIC
/begin CHARACTERISTIC CalRegn01Inin00GroupB.WhlImbRejctnFrqDiagcAmpThd.Val "MICROSAR RTE" VALUE 0x0 RTE_RL_FLOAT32_IEEE 0 NO_COMPU_METHOD -3.402823466e+38 3.402823466e+38 SYMBOL_LINK "Rte_CalprmRom_CalRegn01Inin00GroupB_DEFAULT_RTE_CALPRM_GROUP.WhlImbRejctnFrqDiagcAmpThd_Val" 0 DISPLAY_IDENTIFIER CalRegn01Inin00GroupB.CalibrationPorts.WhlImbRejctnFrqDiagcAmpThd.Val /end CHARACTERISTIC
/begin CHARACTERISTIC CalRegn01Inin00GroupB.WhlImbRejctnFrqDiagcFltRcvryNegStep.Val "MICROSAR RTE" VALUE 0x0 RTE_RL_FLOAT32_IEEE 0 NO_COMPU_METHOD -3.402823466e+38 3.402823466e+38 SYMBOL_LINK "Rte_CalprmRom_CalRegn01Inin00GroupB_DEFAULT_RTE_CALPRM_GROUP.WhlImbRejctnFrqDiagcFltRcvryNegStep_Val" 0 DISPLAY_IDENTIFIER CalRegn01Inin00GroupB.CalibrationPorts.WhlImbRejctnFrqDiagcFltRcvryNegStep.Val /end CHARACTERISTIC
/begin CHARACTERISTIC CalRegn01Inin00GroupB.WhlImbRejctnFrqDiagcFltRcvryPosStep.Val "MICROSAR RTE" VALUE 0x0 RTE_RL_FLOAT32_IEEE 0 NO_COMPU_METHOD -3.402823466e+38 3.402823466e+38 SYMBOL_LINK "Rte_CalprmRom_CalRegn01Inin00GroupB_DEFAULT_RTE_CALPRM_GROUP.WhlImbRejctnFrqDiagcFltRcvryPosStep_Val" 0 DISPLAY_IDENTIFIER CalRegn01Inin00GroupB.CalibrationPorts.WhlImbRejctnFrqDiagcFltRcvryPosStep.Val /end CHARACTERISTIC
/begin CHARACTERISTIC CalRegn01Inin00GroupB.WhlImbRejctnFrqDiagcFltRcvryThd.Val "MICROSAR RTE" VALUE 0x0 RTE_RL_FLOAT32_IEEE 0 NO_COMPU_METHOD -3.402823466e+38 3.402823466e+38 SYMBOL_LINK "Rte_CalprmRom_CalRegn01Inin00GroupB_DEFAULT_RTE_CALPRM_GROUP.WhlImbRejctnFrqDiagcFltRcvryThd_Val" 0 DISPLAY_IDENTIFIER CalRegn01Inin00GroupB.CalibrationPorts.WhlImbRejctnFrqDiagcFltRcvryThd.Val /end CHARACTERISTIC
/begin CHARACTERISTIC CalRegn01Inin00GroupB.WhlImbRejctnFrqDiagcThd.Val "MICROSAR RTE" VALUE 0x0 RTE_RL_FLOAT32_IEEE 0 NO_COMPU_METHOD -3.402823466e+38 3.402823466e+38 SYMBOL_LINK "Rte_CalprmRom_CalRegn01Inin00GroupB_DEFAULT_RTE_CALPRM_GROUP.WhlImbRejctnFrqDiagcThd_Val" 0 DISPLAY_IDENTIFIER CalRegn01Inin00GroupB.CalibrationPorts.WhlImbRejctnFrqDiagcThd.Val /end CHARACTERISTIC
/begin CHARACTERISTIC CalRegn01Inin00GroupB.WhlImbRejctnFrqDiagcTout.Val "MICROSAR RTE" VALUE 0x0 RTE_RL_UWORD 0 NO_COMPU_METHOD 0 65535 SYMBOL_LINK "Rte_CalprmRom_CalRegn01Inin00GroupB_DEFAULT_RTE_CALPRM_GROUP.WhlImbRejctnFrqDiagcTout_Val" 0 DISPLAY_IDENTIFIER CalRegn01Inin00GroupB.CalibrationPorts.WhlImbRejctnFrqDiagcTout.Val /end CHARACTERISTIC
/begin CHARACTERISTIC CalRegn01Inin00GroupB.WhlImbRejctnMaxMgnFltNegStep.Val "MICROSAR RTE" VALUE 0x0 RTE_RL_FLOAT32_IEEE 0 NO_COMPU_METHOD -3.402823466e+38 3.402823466e+38 SYMBOL_LINK "Rte_CalprmRom_CalRegn01Inin00GroupB_DEFAULT_RTE_CALPRM_GROUP.WhlImbRejctnMaxMgnFltNegStep_Val" 0 DISPLAY_IDENTIFIER CalRegn01Inin00GroupB.CalibrationPorts.WhlImbRejctnMaxMgnFltNegStep.Val /end CHARACTERISTIC
/begin CHARACTERISTIC CalRegn01Inin00GroupB.WhlImbRejctnMaxMgnFltPosStep.Val "MICROSAR RTE" VALUE 0x0 RTE_RL_FLOAT32_IEEE 0 NO_COMPU_METHOD -3.402823466e+38 3.402823466e+38 SYMBOL_LINK "Rte_CalprmRom_CalRegn01Inin00GroupB_DEFAULT_RTE_CALPRM_GROUP.WhlImbRejctnMaxMgnFltPosStep_Val" 0 DISPLAY_IDENTIFIER CalRegn01Inin00GroupB.CalibrationPorts.WhlImbRejctnMaxMgnFltPosStep.Val /end CHARACTERISTIC
/begin CHARACTERISTIC CalRegn01Inin00GroupB.WhlImbRejctnMaxMgnFltRcvryNegStep.Val "MICROSAR RTE" VALUE 0x0 RTE_RL_FLOAT32_IEEE 0 NO_COMPU_METHOD -3.402823466e+38 3.402823466e+38 SYMBOL_LINK "Rte_CalprmRom_CalRegn01Inin00GroupB_DEFAULT_RTE_CALPRM_GROUP.WhlImbRejctnMaxMgnFltRcvryNegStep_Val" 0 DISPLAY_IDENTIFIER CalRegn01Inin00GroupB.CalibrationPorts.WhlImbRejctnMaxMgnFltRcvryNegStep.Val /end CHARACTERISTIC
/begin CHARACTERISTIC CalRegn01Inin00GroupB.WhlImbRejctnMaxMgnFltRcvryPosStep.Val "MICROSAR RTE" VALUE 0x0 RTE_RL_FLOAT32_IEEE 0 NO_COMPU_METHOD -3.402823466e+38 3.402823466e+38 SYMBOL_LINK "Rte_CalprmRom_CalRegn01Inin00GroupB_DEFAULT_RTE_CALPRM_GROUP.WhlImbRejctnMaxMgnFltRcvryPosStep_Val" 0 DISPLAY_IDENTIFIER CalRegn01Inin00GroupB.CalibrationPorts.WhlImbRejctnMaxMgnFltRcvryPosStep.Val /end CHARACTERISTIC
/begin CHARACTERISTIC CalRegn01Inin00GroupB.WhlImbRejctnMaxMgnFltRcvryThd.Val "MICROSAR RTE" VALUE 0x0 RTE_RL_FLOAT32_IEEE 0 NO_COMPU_METHOD -3.402823466e+38 3.402823466e+38 SYMBOL_LINK "Rte_CalprmRom_CalRegn01Inin00GroupB_DEFAULT_RTE_CALPRM_GROUP.WhlImbRejctnMaxMgnFltRcvryThd_Val" 0 DISPLAY_IDENTIFIER CalRegn01Inin00GroupB.CalibrationPorts.WhlImbRejctnMaxMgnFltRcvryThd.Val /end CHARACTERISTIC
/begin CHARACTERISTIC CalRegn01Inin00GroupB.WhlImbRejctnMaxMgnFltThd.Val "MICROSAR RTE" VALUE 0x0 RTE_RL_FLOAT32_IEEE 0 NO_COMPU_METHOD -3.402823466e+38 3.402823466e+38 SYMBOL_LINK "Rte_CalprmRom_CalRegn01Inin00GroupB_DEFAULT_RTE_CALPRM_GROUP.WhlImbRejctnMaxMgnFltThd_Val" 0 DISPLAY_IDENTIFIER CalRegn01Inin00GroupB.CalibrationPorts.WhlImbRejctnMaxMgnFltThd.Val /end CHARACTERISTIC
/begin CHARACTERISTIC CalRegn01Inin00GroupB.WhlImbRejctnWhlSpdCorrlnFltRcvryNegStep.Val "MICROSAR RTE" VALUE 0x0 RTE_RL_FLOAT32_IEEE 0 NO_COMPU_METHOD -3.402823466e+38 3.402823466e+38 SYMBOL_LINK "Rte_CalprmRom_CalRegn01Inin00GroupB_DEFAULT_RTE_CALPRM_GROUP.WhlImbRejctnWhlSpdCorrlnFltRcvryNegStep_Val" 0 DISPLAY_IDENTIFIER CalRegn01Inin00GroupB.CalibrationPorts.WhlImbRejctnWhlSpdCorrlnFltRcvryNegStep.Val /end CHARACTERISTIC
/begin CHARACTERISTIC CalRegn01Inin00GroupB.WhlImbRejctnWhlSpdCorrlnFltRcvryPosStep.Val "MICROSAR RTE" VALUE 0x0 RTE_RL_FLOAT32_IEEE 0 NO_COMPU_METHOD -3.402823466e+38 3.402823466e+38 SYMBOL_LINK "Rte_CalprmRom_CalRegn01Inin00GroupB_DEFAULT_RTE_CALPRM_GROUP.WhlImbRejctnWhlSpdCorrlnFltRcvryPosStep_Val" 0 DISPLAY_IDENTIFIER CalRegn01Inin00GroupB.CalibrationPorts.WhlImbRejctnWhlSpdCorrlnFltRcvryPosStep.Val /end CHARACTERISTIC
/begin CHARACTERISTIC CalRegn01Inin00GroupB.WhlImbRejctnWhlSpdCorrlnFltRcvryThd.Val "MICROSAR RTE" VALUE 0x0 RTE_RL_FLOAT32_IEEE 0 NO_COMPU_METHOD -3.402823466e+38 3.402823466e+38 SYMBOL_LINK "Rte_CalprmRom_CalRegn01Inin00GroupB_DEFAULT_RTE_CALPRM_GROUP.WhlImbRejctnWhlSpdCorrlnFltRcvryThd_Val" 0 DISPLAY_IDENTIFIER CalRegn01Inin00GroupB.CalibrationPorts.WhlImbRejctnWhlSpdCorrlnFltRcvryThd.Val /end CHARACTERISTIC
/begin CHARACTERISTIC CalRegn01Inin00GroupC.EotProtnFwlEotDampgActvBndY.Ary2D "MICROSAR RTE" VAL_BLK 0x0 RTE_RL_SWORD 0 NO_COMPU_METHOD -32768 32767 MATRIX_DIM 5 4 1 SYMBOL_LINK "Rte_CalprmRom_CalRegn01Inin00GroupC_DEFAULT_RTE_CALPRM_GROUP.EotProtnFwlEotDampgActvBndY_Ary2D" 0 DISPLAY_IDENTIFIER CalRegn01Inin00GroupC.CalibrationPorts.EotProtnFwlEotDampgActvBndY.Ary2D /end CHARACTERISTIC
/begin CHARACTERISTIC CalRegn01Inin00GroupC.GmVehPwrModHwTqMinKeepAssi.Val "MICROSAR RTE" VALUE 0x0 RTE_RL_FLOAT32_IEEE 0 NO_COMPU_METHOD -3.402823466e+38 3.402823466e+38 SYMBOL_LINK "Rte_CalprmRom_CalRegn01Inin00GroupC_DEFAULT_RTE_CALPRM_GROUP.GmVehPwrModHwTqMinKeepAssi_Val" 0 DISPLAY_IDENTIFIER CalRegn01Inin00GroupC.CalibrationPorts.GmVehPwrModHwTqMinKeepAssi.Val /end CHARACTERISTIC
/begin CHARACTERISTIC CalRegn01Inin00GroupC.GmVehPwrModHwTqMinKeepTmr.Val "MICROSAR RTE" VALUE 0x0 RTE_RL_ULONG 0 NO_COMPU_METHOD 0 4294967295 SYMBOL_LINK "Rte_CalprmRom_CalRegn01Inin00GroupC_DEFAULT_RTE_CALPRM_GROUP.GmVehPwrModHwTqMinKeepTmr_Val" 0 DISPLAY_IDENTIFIER CalRegn01Inin00GroupC.CalibrationPorts.GmVehPwrModHwTqMinKeepTmr.Val /end CHARACTERISTIC
/begin CHARACTERISTIC CalRegn01Inin00GroupC.GmVehPwrModVehSpdAssiOnMin.Val "MICROSAR RTE" VALUE 0x0 RTE_RL_FLOAT32_IEEE 0 NO_COMPU_METHOD -3.402823466e+38 3.402823466e+38 SYMBOL_LINK "Rte_CalprmRom_CalRegn01Inin00GroupC_DEFAULT_RTE_CALPRM_GROUP.GmVehPwrModVehSpdAssiOnMin_Val" 0 DISPLAY_IDENTIFIER CalRegn01Inin00GroupC.CalibrationPorts.GmVehPwrModVehSpdAssiOnMin.Val /end CHARACTERISTIC
/begin CHARACTERISTIC CalRegn01Inin00GroupC.GmVehPwrModVehSpdMinKeepAssi.Val "MICROSAR RTE" VALUE 0x0 RTE_RL_FLOAT32_IEEE 0 NO_COMPU_METHOD -3.402823466e+38 3.402823466e+38 SYMBOL_LINK "Rte_CalprmRom_CalRegn01Inin00GroupC_DEFAULT_RTE_CALPRM_GROUP.GmVehPwrModVehSpdMinKeepAssi_Val" 0 DISPLAY_IDENTIFIER CalRegn01Inin00GroupC.CalibrationPorts.GmVehPwrModVehSpdMinKeepAssi.Val /end CHARACTERISTIC
/begin CHARACTERISTIC CalRegn01Rt00.TEstimnMagAmbMplr.Val "MICROSAR RTE" VALUE 0x0 RTE_RL_FLOAT32_IEEE 0 NO_COMPU_METHOD -3.402823466e+38 3.402823466e+38 SYMBOL_LINK "Rte_CalprmRom_CalRegn01Rt00_DEFAULT_RTE_CALPRM_GROUP.TEstimnMagAmbMplr_Val" 0 DISPLAY_IDENTIFIER CalRegn01Rt00.CalibrationPorts.TEstimnMagAmbMplr.Val /end CHARACTERISTIC
/begin CHARACTERISTIC CalRegn01Rt00.TunSelnAuthyHwTqY.Ary1D "MICROSAR RTE" VAL_BLK 0x0 RTE_RL_UWORD 0 NO_COMPU_METHOD 0 65535 MATRIX_DIM 6 1 1 SYMBOL_LINK "Rte_CalprmRom_CalRegn01Rt00_DEFAULT_RTE_CALPRM_GROUP.TunSelnAuthyHwTqY_Ary1D" 0 DISPLAY_IDENTIFIER CalRegn01Rt00.CalibrationPorts.TunSelnAuthyHwTqY.Ary1D /end CHARACTERISTIC
/begin CHARACTERISTIC CalRegn01Rt00.TunSelnAuthyHwVelY.Ary1D "MICROSAR RTE" VAL_BLK 0x0 RTE_RL_UWORD 0 NO_COMPU_METHOD 0 65535 MATRIX_DIM 6 1 1 SYMBOL_LINK "Rte_CalprmRom_CalRegn01Rt00_DEFAULT_RTE_CALPRM_GROUP.TunSelnAuthyHwVelY_Ary1D" 0 DISPLAY_IDENTIFIER CalRegn01Rt00.CalibrationPorts.TunSelnAuthyHwVelY.Ary1D /end CHARACTERISTIC
/begin CHARACTERISTIC CalRegn01Rt01.TEstimnMagAmbMplr.Val "MICROSAR RTE" VALUE 0x0 RTE_RL_FLOAT32_IEEE 0 NO_COMPU_METHOD -3.402823466e+38 3.402823466e+38 SYMBOL_LINK "Rte_CalprmRom_CalRegn01Rt01_DEFAULT_RTE_CALPRM_GROUP.TEstimnMagAmbMplr_Val" 0 DISPLAY_IDENTIFIER CalRegn01Rt01.CalibrationPorts.TEstimnMagAmbMplr.Val /end CHARACTERISTIC
/begin CHARACTERISTIC CalRegn01Rt01.TunSelnAuthyHwTqY.Ary1D "MICROSAR RTE" VAL_BLK 0x0 RTE_RL_UWORD 0 NO_COMPU_METHOD 0 65535 MATRIX_DIM 6 1 1 SYMBOL_LINK "Rte_CalprmRom_CalRegn01Rt01_DEFAULT_RTE_CALPRM_GROUP.TunSelnAuthyHwTqY_Ary1D" 0 DISPLAY_IDENTIFIER CalRegn01Rt01.CalibrationPorts.TunSelnAuthyHwTqY.Ary1D /end CHARACTERISTIC
/begin CHARACTERISTIC CalRegn01Rt01.TunSelnAuthyHwVelY.Ary1D "MICROSAR RTE" VAL_BLK 0x0 RTE_RL_UWORD 0 NO_COMPU_METHOD 0 65535 MATRIX_DIM 6 1 1 SYMBOL_LINK "Rte_CalprmRom_CalRegn01Rt01_DEFAULT_RTE_CALPRM_GROUP.TunSelnAuthyHwVelY_Ary1D" 0 DISPLAY_IDENTIFIER CalRegn01Rt01.CalibrationPorts.TunSelnAuthyHwVelY.Ary1D /end CHARACTERISTIC
/begin CHARACTERISTIC CalRegn01Rt02.TEstimnMagAmbMplr.Val "MICROSAR RTE" VALUE 0x0 RTE_RL_FLOAT32_IEEE 0 NO_COMPU_METHOD -3.402823466e+38 3.402823466e+38 SYMBOL_LINK "Rte_CalprmRom_CalRegn01Rt02_DEFAULT_RTE_CALPRM_GROUP.TEstimnMagAmbMplr_Val" 0 DISPLAY_IDENTIFIER CalRegn01Rt02.CalibrationPorts.TEstimnMagAmbMplr.Val /end CHARACTERISTIC
/begin CHARACTERISTIC CalRegn01Rt02.TunSelnAuthyHwTqY.Ary1D "MICROSAR RTE" VAL_BLK 0x0 RTE_RL_UWORD 0 NO_COMPU_METHOD 0 65535 MATRIX_DIM 6 1 1 SYMBOL_LINK "Rte_CalprmRom_CalRegn01Rt02_DEFAULT_RTE_CALPRM_GROUP.TunSelnAuthyHwTqY_Ary1D" 0 DISPLAY_IDENTIFIER CalRegn01Rt02.CalibrationPorts.TunSelnAuthyHwTqY.Ary1D /end CHARACTERISTIC
/begin CHARACTERISTIC CalRegn01Rt02.TunSelnAuthyHwVelY.Ary1D "MICROSAR RTE" VAL_BLK 0x0 RTE_RL_UWORD 0 NO_COMPU_METHOD 0 65535 MATRIX_DIM 6 1 1 SYMBOL_LINK "Rte_CalprmRom_CalRegn01Rt02_DEFAULT_RTE_CALPRM_GROUP.TunSelnAuthyHwVelY_Ary1D" 0 DISPLAY_IDENTIFIER CalRegn01Rt02.CalibrationPorts.TunSelnAuthyHwVelY.Ary1D /end CHARACTERISTIC
/begin CHARACTERISTIC CalRegn01Rt03.TEstimnMagAmbMplr.Val "MICROSAR RTE" VALUE 0x0 RTE_RL_FLOAT32_IEEE 0 NO_COMPU_METHOD -3.402823466e+38 3.402823466e+38 SYMBOL_LINK "Rte_CalprmRom_CalRegn01Rt03_DEFAULT_RTE_CALPRM_GROUP.TEstimnMagAmbMplr_Val" 0 DISPLAY_IDENTIFIER CalRegn01Rt03.CalibrationPorts.TEstimnMagAmbMplr.Val /end CHARACTERISTIC
/begin CHARACTERISTIC CalRegn01Rt03.TunSelnAuthyHwTqY.Ary1D "MICROSAR RTE" VAL_BLK 0x0 RTE_RL_UWORD 0 NO_COMPU_METHOD 0 65535 MATRIX_DIM 6 1 1 SYMBOL_LINK "Rte_CalprmRom_CalRegn01Rt03_DEFAULT_RTE_CALPRM_GROUP.TunSelnAuthyHwTqY_Ary1D" 0 DISPLAY_IDENTIFIER CalRegn01Rt03.CalibrationPorts.TunSelnAuthyHwTqY.Ary1D /end CHARACTERISTIC
/begin CHARACTERISTIC CalRegn01Rt03.TunSelnAuthyHwVelY.Ary1D "MICROSAR RTE" VAL_BLK 0x0 RTE_RL_UWORD 0 NO_COMPU_METHOD 0 65535 MATRIX_DIM 6 1 1 SYMBOL_LINK "Rte_CalprmRom_CalRegn01Rt03_DEFAULT_RTE_CALPRM_GROUP.TunSelnAuthyHwVelY_Ary1D" 0 DISPLAY_IDENTIFIER CalRegn01Rt03.CalibrationPorts.TunSelnAuthyHwVelY.Ary1D /end CHARACTERISTIC
/begin CHARACTERISTIC CalRegn01Rt04.TEstimnMagAmbMplr.Val "MICROSAR RTE" VALUE 0x0 RTE_RL_FLOAT32_IEEE 0 NO_COMPU_METHOD -3.402823466e+38 3.402823466e+38 SYMBOL_LINK "Rte_CalprmRom_CalRegn01Rt04_DEFAULT_RTE_CALPRM_GROUP.TEstimnMagAmbMplr_Val" 0 DISPLAY_IDENTIFIER CalRegn01Rt04.CalibrationPorts.TEstimnMagAmbMplr.Val /end CHARACTERISTIC
/begin CHARACTERISTIC CalRegn01Rt04.TunSelnAuthyHwTqY.Ary1D "MICROSAR RTE" VAL_BLK 0x0 RTE_RL_UWORD 0 NO_COMPU_METHOD 0 65535 MATRIX_DIM 6 1 1 SYMBOL_LINK "Rte_CalprmRom_CalRegn01Rt04_DEFAULT_RTE_CALPRM_GROUP.TunSelnAuthyHwTqY_Ary1D" 0 DISPLAY_IDENTIFIER CalRegn01Rt04.CalibrationPorts.TunSelnAuthyHwTqY.Ary1D /end CHARACTERISTIC
/begin CHARACTERISTIC CalRegn01Rt04.TunSelnAuthyHwVelY.Ary1D "MICROSAR RTE" VAL_BLK 0x0 RTE_RL_UWORD 0 NO_COMPU_METHOD 0 65535 MATRIX_DIM 6 1 1 SYMBOL_LINK "Rte_CalprmRom_CalRegn01Rt04_DEFAULT_RTE_CALPRM_GROUP.TunSelnAuthyHwVelY_Ary1D" 0 DISPLAY_IDENTIFIER CalRegn01Rt04.CalibrationPorts.TunSelnAuthyHwVelY.Ary1D /end CHARACTERISTIC
/begin CHARACTERISTIC CalRegn02Cmn.DiagcMgrFltResp.Ary1D "MICROSAR RTE" VAL_BLK 0x0 RTE_RL_ULONG 0 NO_COMPU_METHOD 0 4294967295 MATRIX_DIM 512 1 1 SYMBOL_LINK "Rte_CalprmRom_CalRegn02Cmn_DEFAULT_RTE_CALPRM_GROUP.DiagcMgrFltResp_Ary1D" 0 DISPLAY_IDENTIFIER CalRegn02Cmn.CalibrationPorts.DiagcMgrFltResp.Ary1D /end CHARACTERISTIC
/begin CHARACTERISTIC CalRegn02Cmn.InertiaCmpVelDecelGainEnaCal.Logl "MICROSAR RTE" VALUE 0x0 RTE_RL_BOOLEAN 0 RTE_CM_BOOLEAN 0 255 SYMBOL_LINK "Rte_CalprmRom_CalRegn02Cmn_DEFAULT_RTE_CALPRM_GROUP.InertiaCmpVelDecelGainEnaCal_Logl" 0 DISPLAY_IDENTIFIER CalRegn02Cmn.CalibrationPorts.InertiaCmpVelDecelGainEnaCal.Logl /end CHARACTERISTIC
/begin CHARACTERISTIC CalRegn02Cmn.NxtrCalIdsCal1DevlpAuthor.Ary1D "MICROSAR RTE" VAL_BLK 0x0 RTE_RL_UBYTE 0 NO_COMPU_METHOD 0 255 MATRIX_DIM 6 1 1 SYMBOL_LINK "Rte_CalprmRom_CalRegn02Cmn_DEFAULT_RTE_CALPRM_GROUP.NxtrCalIdsCal1DevlpAuthor_Ary1D" 0 DISPLAY_IDENTIFIER CalRegn02Cmn.CalibrationPorts.NxtrCalIdsCal1DevlpAuthor.Ary1D /end CHARACTERISTIC
/begin CHARACTERISTIC CalRegn02Cmn.NxtrCalIdsCal1DevlpDesc.Ary1D "MICROSAR RTE" VAL_BLK 0x0 RTE_RL_UBYTE 0 NO_COMPU_METHOD 0 255 MATRIX_DIM 48 1 1 SYMBOL_LINK "Rte_CalprmRom_CalRegn02Cmn_DEFAULT_RTE_CALPRM_GROUP.NxtrCalIdsCal1DevlpDesc_Ary1D" 0 DISPLAY_IDENTIFIER CalRegn02Cmn.CalibrationPorts.NxtrCalIdsCal1DevlpDesc.Ary1D /end CHARACTERISTIC
/begin CHARACTERISTIC CalRegn02Cmn.NxtrCalIdsCal1DevlpRelNr.Val "MICROSAR RTE" VALUE 0x0 RTE_RL_ULONG 0 NO_COMPU_METHOD 0 4294967295 SYMBOL_LINK "Rte_CalprmRom_CalRegn02Cmn_DEFAULT_RTE_CALPRM_GROUP.NxtrCalIdsCal1DevlpRelNr_Val" 0 DISPLAY_IDENTIFIER CalRegn02Cmn.CalibrationPorts.NxtrCalIdsCal1DevlpRelNr.Val /end CHARACTERISTIC
/begin CHARACTERISTIC CalRegn02Cmn.NxtrCalIdsCal1DevlpRelSt.Val "MICROSAR RTE" VALUE 0x0 RTE_RL_UBYTE 0 NO_COMPU_METHOD 0 255 SYMBOL_LINK "Rte_CalprmRom_CalRegn02Cmn_DEFAULT_RTE_CALPRM_GROUP.NxtrCalIdsCal1DevlpRelSt_Val" 0 DISPLAY_IDENTIFIER CalRegn02Cmn.CalibrationPorts.NxtrCalIdsCal1DevlpRelSt.Val /end CHARACTERISTIC
/begin CHARACTERISTIC CalRegn02Cmn.NxtrCalIdsCal1DevlpTiStamp.Val "MICROSAR RTE" VALUE 0x0 RTE_RL_ULONG 0 NO_COMPU_METHOD 0 4294967295 SYMBOL_LINK "Rte_CalprmRom_CalRegn02Cmn_DEFAULT_RTE_CALPRM_GROUP.NxtrCalIdsCal1DevlpTiStamp_Val" 0 DISPLAY_IDENTIFIER CalRegn02Cmn.CalibrationPorts.NxtrCalIdsCal1DevlpTiStamp.Val /end CHARACTERISTIC
/begin CHARACTERISTIC CalRegn02Cmn.NxtrCalIdsCal1DevlpVers.Val "MICROSAR RTE" VALUE 0x0 RTE_RL_UBYTE 0 NO_COMPU_METHOD 0 255 SYMBOL_LINK "Rte_CalprmRom_CalRegn02Cmn_DEFAULT_RTE_CALPRM_GROUP.NxtrCalIdsCal1DevlpVers_Val" 0 DISPLAY_IDENTIFIER CalRegn02Cmn.CalibrationPorts.NxtrCalIdsCal1DevlpVers.Val /end CHARACTERISTIC
/begin CHARACTERISTIC CalRegn02Cmn.SnsrOffsCorrnHwAgLrndOffsLim.Val "MICROSAR RTE" VALUE 0x0 RTE_RL_FLOAT32_IEEE 0 NO_COMPU_METHOD -3.402823466e+38 3.402823466e+38 SYMBOL_LINK "Rte_CalprmRom_CalRegn02Cmn_DEFAULT_RTE_CALPRM_GROUP.SnsrOffsCorrnHwAgLrndOffsLim_Val" 0 DISPLAY_IDENTIFIER CalRegn02Cmn.CalibrationPorts.SnsrOffsCorrnHwAgLrndOffsLim.Val /end CHARACTERISTIC
/begin CHARACTERISTIC CalRegn02Cmn.SnsrOffsCorrnHwTqLrndOffsLim.Val "MICROSAR RTE" VALUE 0x0 RTE_RL_FLOAT32_IEEE 0 NO_COMPU_METHOD -3.402823466e+38 3.402823466e+38 SYMBOL_LINK "Rte_CalprmRom_CalRegn02Cmn_DEFAULT_RTE_CALPRM_GROUP.SnsrOffsCorrnHwTqLrndOffsLim_Val" 0 DISPLAY_IDENTIFIER CalRegn02Cmn.CalibrationPorts.SnsrOffsCorrnHwTqLrndOffsLim.Val /end CHARACTERISTIC
/begin CHARACTERISTIC CalRegn02Cmn.SnsrOffsCorrnOffsEna.Logl "MICROSAR RTE" VALUE 0x0 RTE_RL_BOOLEAN 0 RTE_CM_BOOLEAN 0 255 SYMBOL_LINK "Rte_CalprmRom_CalRegn02Cmn_DEFAULT_RTE_CALPRM_GROUP.SnsrOffsCorrnOffsEna_Logl" 0 DISPLAY_IDENTIFIER CalRegn02Cmn.CalibrationPorts.SnsrOffsCorrnOffsEna.Logl /end CHARACTERISTIC
/begin CHARACTERISTIC CalRegn02Cmn.SnsrOffsCorrnVehYawRateLrndOffsLim.Val "MICROSAR RTE" VALUE 0x0 RTE_RL_FLOAT32_IEEE 0 NO_COMPU_METHOD -3.402823466e+38 3.402823466e+38 SYMBOL_LINK "Rte_CalprmRom_CalRegn02Cmn_DEFAULT_RTE_CALPRM_GROUP.SnsrOffsCorrnVehYawRateLrndOffsLim_Val" 0 DISPLAY_IDENTIFIER CalRegn02Cmn.CalibrationPorts.SnsrOffsCorrnVehYawRateLrndOffsLim.Val /end CHARACTERISTIC
/begin CHARACTERISTIC CalRegn02Cmn.SnsrOffsLrngHwAgLrngTi.Val "MICROSAR RTE" VALUE 0x0 RTE_RL_FLOAT32_IEEE 0 NO_COMPU_METHOD -3.402823466e+38 3.402823466e+38 SYMBOL_LINK "Rte_CalprmRom_CalRegn02Cmn_DEFAULT_RTE_CALPRM_GROUP.SnsrOffsLrngHwAgLrngTi_Val" 0 DISPLAY_IDENTIFIER CalRegn02Cmn.CalibrationPorts.SnsrOffsLrngHwAgLrngTi.Val /end CHARACTERISTIC
/begin CHARACTERISTIC CalRegn02Cmn.SnsrOffsLrngHwTqLrngHwTqZeroOffsThd.Val "MICROSAR RTE" VALUE 0x0 RTE_RL_FLOAT32_IEEE 0 NO_COMPU_METHOD -3.402823466e+38 3.402823466e+38 SYMBOL_LINK "Rte_CalprmRom_CalRegn02Cmn_DEFAULT_RTE_CALPRM_GROUP.SnsrOffsLrngHwTqLrngHwTqZeroOffsThd_Val" 0 DISPLAY_IDENTIFIER CalRegn02Cmn.CalibrationPorts.SnsrOffsLrngHwTqLrngHwTqZeroOffsThd.Val /end CHARACTERISTIC
/begin CHARACTERISTIC CalRegn02Cmn.SnsrOffsLrngHwTqLrngMeasTi.Val "MICROSAR RTE" VALUE 0x0 RTE_RL_FLOAT32_IEEE 0 NO_COMPU_METHOD -3.402823466e+38 3.402823466e+38 SYMBOL_LINK "Rte_CalprmRom_CalRegn02Cmn_DEFAULT_RTE_CALPRM_GROUP.SnsrOffsLrngHwTqLrngMeasTi_Val" 0 DISPLAY_IDENTIFIER CalRegn02Cmn.CalibrationPorts.SnsrOffsLrngHwTqLrngMeasTi.Val /end CHARACTERISTIC
/begin CHARACTERISTIC CalRegn02Cmn.SnsrOffsLrngHwTqLrngSampleImbThd1.Val "MICROSAR RTE" VALUE 0x0 RTE_RL_FLOAT32_IEEE 0 NO_COMPU_METHOD -3.402823466e+38 3.402823466e+38 SYMBOL_LINK "Rte_CalprmRom_CalRegn02Cmn_DEFAULT_RTE_CALPRM_GROUP.SnsrOffsLrngHwTqLrngSampleImbThd1_Val" 0 DISPLAY_IDENTIFIER CalRegn02Cmn.CalibrationPorts.SnsrOffsLrngHwTqLrngSampleImbThd1.Val /end CHARACTERISTIC
/begin CHARACTERISTIC CalRegn02Cmn.SnsrOffsLrngHwTqLrngSampleImbThd2.Val "MICROSAR RTE" VALUE 0x0 RTE_RL_FLOAT32_IEEE 0 NO_COMPU_METHOD -3.402823466e+38 3.402823466e+38 SYMBOL_LINK "Rte_CalprmRom_CalRegn02Cmn_DEFAULT_RTE_CALPRM_GROUP.SnsrOffsLrngHwTqLrngSampleImbThd2_Val" 0 DISPLAY_IDENTIFIER CalRegn02Cmn.CalibrationPorts.SnsrOffsLrngHwTqLrngSampleImbThd2.Val /end CHARACTERISTIC
/begin CHARACTERISTIC CalRegn02Cmn.SnsrOffsLrngHwTqLrngSampleThd1.Val "MICROSAR RTE" VALUE 0x0 RTE_RL_UWORD 0 NO_COMPU_METHOD 0 65535 SYMBOL_LINK "Rte_CalprmRom_CalRegn02Cmn_DEFAULT_RTE_CALPRM_GROUP.SnsrOffsLrngHwTqLrngSampleThd1_Val" 0 DISPLAY_IDENTIFIER CalRegn02Cmn.CalibrationPorts.SnsrOffsLrngHwTqLrngSampleThd1.Val /end CHARACTERISTIC
/begin CHARACTERISTIC CalRegn02Cmn.SnsrOffsLrngHwTqLrngSampleThd2.Val "MICROSAR RTE" VALUE 0x0 RTE_RL_UWORD 0 NO_COMPU_METHOD 0 65535 SYMBOL_LINK "Rte_CalprmRom_CalRegn02Cmn_DEFAULT_RTE_CALPRM_GROUP.SnsrOffsLrngHwTqLrngSampleThd2_Val" 0 DISPLAY_IDENTIFIER CalRegn02Cmn.CalibrationPorts.SnsrOffsLrngHwTqLrngSampleThd2.Val /end CHARACTERISTIC
/begin CHARACTERISTIC CalRegn02Cmn.SnsrOffsLrngHwTqLrngTiWghtCoeff.Val "MICROSAR RTE" VALUE 0x0 RTE_RL_FLOAT32_IEEE 0 NO_COMPU_METHOD -3.402823466e+38 3.402823466e+38 SYMBOL_LINK "Rte_CalprmRom_CalRegn02Cmn_DEFAULT_RTE_CALPRM_GROUP.SnsrOffsLrngHwTqLrngTiWghtCoeff_Val" 0 DISPLAY_IDENTIFIER CalRegn02Cmn.CalibrationPorts.SnsrOffsLrngHwTqLrngTiWghtCoeff.Val /end CHARACTERISTIC
/begin CHARACTERISTIC CalRegn02Cmn.SnsrOffsLrngYawLrngTi.Val "MICROSAR RTE" VALUE 0x0 RTE_RL_FLOAT32_IEEE 0 NO_COMPU_METHOD -3.402823466e+38 3.402823466e+38 SYMBOL_LINK "Rte_CalprmRom_CalRegn02Cmn_DEFAULT_RTE_CALPRM_GROUP.SnsrOffsLrngYawLrngTi_Val" 0 DISPLAY_IDENTIFIER CalRegn02Cmn.CalibrationPorts.SnsrOffsLrngYawLrngTi.Val /end CHARACTERISTIC
/begin CHARACTERISTIC CalRegn02CmnGroupA.GmOvrlStMgrApaMfgEna.Logl "MICROSAR RTE" VALUE 0x0 RTE_RL_BOOLEAN 0 RTE_CM_BOOLEAN 0 255 SYMBOL_LINK "Rte_CalprmRom_CalRegn02CmnGroupA_DEFAULT_RTE_CALPRM_GROUP.GmOvrlStMgrApaMfgEna_Logl" 0 DISPLAY_IDENTIFIER CalRegn02CmnGroupA.CalibrationPorts.GmOvrlStMgrApaMfgEna.Logl /end CHARACTERISTIC
/begin CHARACTERISTIC CalRegn02CmnGroupA.GmOvrlStMgrEscMfgEna.Logl "MICROSAR RTE" VALUE 0x0 RTE_RL_BOOLEAN 0 RTE_CM_BOOLEAN 0 255 SYMBOL_LINK "Rte_CalprmRom_CalRegn02CmnGroupA_DEFAULT_RTE_CALPRM_GROUP.GmOvrlStMgrEscMfgEna_Logl" 0 DISPLAY_IDENTIFIER CalRegn02CmnGroupA.CalibrationPorts.GmOvrlStMgrEscMfgEna.Logl /end CHARACTERISTIC
/begin CHARACTERISTIC CalRegn02CmnGroupA.GmOvrlStMgrLkaHwTqThd1.Val "MICROSAR RTE" VALUE 0x0 RTE_RL_FLOAT32_IEEE 0 NO_COMPU_METHOD -3.402823466e+38 3.402823466e+38 SYMBOL_LINK "Rte_CalprmRom_CalRegn02CmnGroupA_DEFAULT_RTE_CALPRM_GROUP.GmOvrlStMgrLkaHwTqThd1_Val" 0 DISPLAY_IDENTIFIER CalRegn02CmnGroupA.CalibrationPorts.GmOvrlStMgrLkaHwTqThd1.Val /end CHARACTERISTIC
/begin CHARACTERISTIC CalRegn02CmnGroupA.GmOvrlStMgrLkaHwTqThd2.Val "MICROSAR RTE" VALUE 0x0 RTE_RL_FLOAT32_IEEE 0 NO_COMPU_METHOD -3.402823466e+38 3.402823466e+38 SYMBOL_LINK "Rte_CalprmRom_CalRegn02CmnGroupA_DEFAULT_RTE_CALPRM_GROUP.GmOvrlStMgrLkaHwTqThd2_Val" 0 DISPLAY_IDENTIFIER CalRegn02CmnGroupA.CalibrationPorts.GmOvrlStMgrLkaHwTqThd2.Val /end CHARACTERISTIC
/begin CHARACTERISTIC CalRegn02CmnGroupA.GmOvrlStMgrLkaMfgEna.Logl "MICROSAR RTE" VALUE 0x0 RTE_RL_BOOLEAN 0 RTE_CM_BOOLEAN 0 255 SYMBOL_LINK "Rte_CalprmRom_CalRegn02CmnGroupA_DEFAULT_RTE_CALPRM_GROUP.GmOvrlStMgrLkaMfgEna_Logl" 0 DISPLAY_IDENTIFIER CalRegn02CmnGroupA.CalibrationPorts.GmOvrlStMgrLkaMfgEna.Logl /end CHARACTERISTIC
/begin CHARACTERISTIC CalRegn02CmnGroupA.PullCmpActvEna.Logl "MICROSAR RTE" VALUE 0x0 RTE_RL_BOOLEAN 0 RTE_CM_BOOLEAN 0 255 SYMBOL_LINK "Rte_CalprmRom_CalRegn02CmnGroupA_DEFAULT_RTE_CALPRM_GROUP.PullCmpActvEna_Logl" 0 DISPLAY_IDENTIFIER CalRegn02CmnGroupA.CalibrationPorts.PullCmpActvEna.Logl /end CHARACTERISTIC
/begin CHARACTERISTIC CalRegn02CmnGroupB.WhlImbRejctnFctEna.Logl "MICROSAR RTE" VALUE 0x0 RTE_RL_BOOLEAN 0 RTE_CM_BOOLEAN 0 255 SYMBOL_LINK "Rte_CalprmRom_CalRegn02CmnGroupB_DEFAULT_RTE_CALPRM_GROUP.WhlImbRejctnFctEna_Logl" 0 DISPLAY_IDENTIFIER CalRegn02CmnGroupB.CalibrationPorts.WhlImbRejctnFctEna.Logl /end CHARACTERISTIC
/begin GROUP CalRegn01Cmn.SysGlbPrmVehSpdBilnrSeln.Ary1D "MICROSAR RTE" /begin SUB_GROUP /end SUB_GROUP /begin FUNCTION_LIST /end FUNCTION_LIST /begin REF_CHARACTERISTIC CalRegn01Cmn.SysGlbPrmVehSpdBilnrSeln.Ary1D /end REF_CHARACTERISTIC /begin REF_MEASUREMENT /end REF_MEASUREMENT /end GROUP
/begin GROUP CalRegn01Cmn.TSG31CfgAndUseAdcStrtOfCnvn2Offs.Val "MICROSAR RTE" /begin SUB_GROUP /end SUB_GROUP /begin FUNCTION_LIST /end FUNCTION_LIST /begin REF_CHARACTERISTIC CalRegn01Cmn.TSG31CfgAndUseAdcStrtOfCnvn2Offs.Val /end REF_CHARACTERISTIC /begin REF_MEASUREMENT /end REF_MEASUREMENT /end GROUP
/begin GROUP CalRegn01Cmn.TSG31CfgAndUseAdcStrtOfCnvnMotCtrlPeakOffs.Val "MICROSAR RTE" /begin SUB_GROUP /end SUB_GROUP /begin FUNCTION_LIST /end FUNCTION_LIST
 /begin REF_CHARACTERISTIC CalRegn01Cmn.TSG31CfgAndUseAdcStrtOfCnvnMotCtrlPeakOffs.Val /end REF_CHARACTERISTIC
 /begin REF_MEASUREMENT /end REF_MEASUREMENT
/end GROUP
/begin GROUP CalRegn01Cmn.TSG31CfgAndUseAdcStrtOfCnvnMotCtrlVlyOffs.Val "MICROSAR RTE" /begin SUB_GROUP /end SUB_GROUP /begin FUNCTION_LIST /end FUNCTION_LIST /begin REF_CHARACTERISTIC CalRegn01Cmn.TSG31CfgAndUseAdcStrtOfCnvnMotCtrlVlyOffs.Val /end REF_CHARACTERISTIC /begin REF_MEASUREMENT /end REF_MEASUREMENT /end GROUP
/begin GROUP CalRegn01Cmn.TSG31CfgAndUseMtrAg0SPIStart.Val "MICROSAR RTE" /begin SUB_GROUP /end SUB_GROUP /begin FUNCTION_LIST /end FUNCTION_LIST /begin REF_CHARACTERISTIC CalRegn01Cmn.TSG31CfgAndUseMtrAg0SPIStart.Val /end REF_CHARACTERISTIC /begin REF_MEASUREMENT /end REF_MEASUREMENT /end GROUP
/begin GROUP CalRegn01Cmn.TSG31CfgAndUsePwmDbnd.Val "MICROSAR RTE" /begin SUB_GROUP /end SUB_GROUP /begin FUNCTION_LIST /end FUNCTION_LIST /begin REF_CHARACTERISTIC CalRegn01Cmn.TSG31CfgAndUsePwmDbnd.Val /end REF_CHARACTERISTIC /begin REF_MEASUREMENT /end REF_MEASUREMENT /end GROUP
/begin GROUP CalRegn01Cmn.TqOscnAmpLimY.Ary1D "MICROSAR RTE" /begin SUB_GROUP /end SUB_GROUP /begin FUNCTION_LIST /end FUNCTION_LIST /begin REF_CHARACTERISTIC CalRegn01Cmn.TqOscnAmpLimY.Ary1D /end REF_CHARACTERISTIC /begin REF_MEASUREMENT /end REF_MEASUREMENT /end GROUP
/begin GROUP CalRegn01Cmn.TqOscnFallRampRateCal.Val "MICROSAR RTE" /begin SUB_GROUP /end SUB_GROUP /begin FUNCTION_LIST /end FUNCTION_LIST /begin REF_CHARACTERISTIC CalRegn01Cmn.TqOscnFallRampRateCal.Val /end REF_CHARACTERISTIC /begin REF_MEASUREMENT /end REF_MEASUREMENT /end GROUP
/begin GROUP CalRegn01Cmn.TqOscnFrqIn.Ary1D "MICROSAR RTE" /begin SUB_GROUP /end SUB_GROUP /begin FUNCTION_LIST /end FUNCTION_LIST /begin REF_CHARACTERISTIC CalRegn01Cmn.TqOscnFrqIn.Ary1D /end REF_CHARACTERISTIC /begin REF_MEASUREMENT /end REF_MEASUREMENT /end GROUP
/begin GROUP CalRegn01Cmn.TqOscnRisngRampRateCal.Val "MICROSAR RTE" /begin SUB_GROUP /end SUB_GROUP /begin FUNCTION_LIST /end FUNCTION_LIST /begin REF_CHARACTERISTIC CalRegn01Cmn.TqOscnRisngRampRateCal.Val /end REF_CHARACTERISTIC /begin REF_MEASUREMENT /end REF_MEASUREMENT /end GROUP
/begin GROUP CalRegn01Cmn.TqOscnUseRampRateCal.Logl "MICROSAR RTE" /begin SUB_GROUP /end SUB_GROUP /begin FUNCTION_LIST /end FUNCTION_LIST /begin REF_CHARACTERISTIC CalRegn01Cmn.TqOscnUseRampRateCal.Logl /end REF_CHARACTERISTIC /begin REF_MEASUREMENT /end REF_MEASUREMENT /end GROUP
/begin GROUP CalRegn01Cmn.TunSelnAuthyTunSelnRtDiCmd.Logl "MICROSAR RTE" /begin SUB_GROUP /end SUB_GROUP /begin FUNCTION_LIST /end FUNCTION_LIST /begin REF_CHARACTERISTIC CalRegn01Cmn.TunSelnAuthyTunSelnRtDiCmd.Logl /end REF_CHARACTERISTIC /begin REF_MEASUREMENT /end REF_MEASUREMENT /end GROUP
/begin GROUP CalRegn01Cmn.VehSigCdngDftLatA.Val "MICROSAR RTE" /begin SUB_GROUP /end SUB_GROUP /begin FUNCTION_LIST /end FUNCTION_LIST /begin REF_CHARACTERISTIC CalRegn01Cmn.VehSigCdngDftLatA.Val /end REF_CHARACTERISTIC /begin REF_MEASUREMENT /end REF_MEASUREMENT /end GROUP
/begin GROUP CalRegn01Cmn.VehSigCdngDftLgtA.Val "MICROSAR RTE" /begin SUB_GROUP /end SUB_GROUP /begin FUNCTION_LIST /end FUNCTION_LIST /begin REF_CHARACTERISTIC CalRegn01Cmn.VehSigCdngDftLgtA.Val /end REF_CHARACTERISTIC /begin REF_MEASUREMENT /end REF_MEASUREMENT /end GROUP
/begin GROUP CalRegn01Cmn.VehSigCdngDftVehSpd.Val "MICROSAR RTE" /begin SUB_GROUP /end SUB_GROUP /begin FUNCTION_LIST /end FUNCTION_LIST /begin REF_CHARACTERISTIC CalRegn01Cmn.VehSigCdngDftVehSpd.Val /end REF_CHARACTERISTIC /begin REF_MEASUREMENT /end REF_MEASUREMENT /end GROUP
/begin GROUP CalRegn01Cmn.VehSigCdngDftYawRate.Val "MICROSAR RTE" /begin SUB_GROUP /end SUB_GROUP /begin FUNCTION_LIST /end FUNCTION_LIST /begin REF_CHARACTERISTIC CalRegn01Cmn.VehSigCdngDftYawRate.Val /end REF_CHARACTERISTIC /begin REF_MEASUREMENT /end REF_MEASUREMENT /end GROUP
/begin GROUP CalRegn01Cmn.VehSigCdngLatADifThd.Val "MICROSAR RTE" /begin SUB_GROUP /end SUB_GROUP /begin FUNCTION_LIST /end FUNCTION_LIST /begin REF_CHARACTERISTIC CalRegn01Cmn.VehSigCdngLatADifThd.Val /end REF_CHARACTERISTIC /begin REF_MEASUREMENT /end REF_MEASUREMENT /end GROUP
/begin GROUP CalRegn01Cmn.VehSigCdngLatAFilFrq.Val "MICROSAR RTE" /begin SUB_GROUP /end SUB_GROUP /begin FUNCTION_LIST /end FUNCTION_LIST /begin REF_CHARACTERISTIC CalRegn01Cmn.VehSigCdngLatAFilFrq.Val /end REF_CHARACTERISTIC /begin REF_MEASUREMENT /end REF_MEASUREMENT /end GROUP
/begin GROUP CalRegn01Cmn.VehSigCdngLtgADifThd.Val "MICROSAR RTE" /begin SUB_GROUP /end SUB_GROUP /begin FUNCTION_LIST /end FUNCTION_LIST /begin REF_CHARACTERISTIC CalRegn01Cmn.VehSigCdngLtgADifThd.Val /end REF_CHARACTERISTIC /begin REF_MEASUREMENT /end REF_MEASUREMENT /end GROUP
/begin GROUP CalRegn01Cmn.VehSigCdngVehSpdDifThd.Val "MICROSAR RTE" /begin SUB_GROUP /end SUB_GROUP /begin FUNCTION_LIST /end FUNCTION_LIST /begin REF_CHARACTERISTIC CalRegn01Cmn.VehSigCdngVehSpdDifThd.Val /end REF_CHARACTERISTIC /begin REF_MEASUREMENT /end REF_MEASUREMENT /end GROUP
/begin GROUP CalRegn01Cmn.VehSigCdngVehYawSlewRate.Val "MICROSAR RTE" /begin SUB_GROUP /end SUB_GROUP /begin FUNCTION_LIST /end FUNCTION_LIST /begin REF_CHARACTERISTIC CalRegn01Cmn.VehSigCdngVehYawSlewRate.Val /end REF_CHARACTERISTIC /begin REF_MEASUREMENT /end REF_MEASUREMENT /end GROUP
/begin GROUP CalRegn01Cmn.VehSigCdngYawRateDifThd.Val "MICROSAR RTE" /begin SUB_GROUP /end SUB_GROUP /begin FUNCTION_LIST /end FUNCTION_LIST /begin REF_CHARACTERISTIC CalRegn01Cmn.VehSigCdngYawRateDifThd.Val /end REF_CHARACTERISTIC /begin REF_MEASUREMENT /end REF_MEASUREMENT /end GROUP
/begin GROUP CalRegn01Cmn.VehSpdLimrMaxAssiX.Ary1D "MICROSAR RTE" /begin SUB_GROUP /end SUB_GROUP /begin FUNCTION_LIST /end FUNCTION_LIST /begin REF_CHARACTERISTIC CalRegn01Cmn.VehSpdLimrMaxAssiX.Ary1D /end REF_CHARACTERISTIC /begin REF_MEASUREMENT /end REF_MEASUREMENT /end GROUP
/begin GROUP CalRegn01Cmn.VehSpdLimrMaxAssiY.Ary1D "MICROSAR RTE" /begin SUB_GROUP /end SUB_GROUP /begin FUNCTION_LIST /end FUNCTION_LIST /begin REF_CHARACTERISTIC CalRegn01Cmn.VehSpdLimrMaxAssiY.Ary1D /end REF_CHARACTERISTIC /begin REF_MEASUREMENT /end REF_MEASUREMENT /end GROUP
/begin GROUP CalRegn01Cmn.VehSpdLimrPosMaxOffs1.Val "MICROSAR RTE" /begin SUB_GROUP /end SUB_GROUP /begin FUNCTION_LIST /end FUNCTION_LIST /begin REF_CHARACTERISTIC CalRegn01Cmn.VehSpdLimrPosMaxOffs1.Val /end REF_CHARACTERISTIC /begin REF_MEASUREMENT /end REF_MEASUREMENT /end GROUP
/begin GROUP CalRegn01Cmn.VehSpdLimrPosMaxOffs2.Val "MICROSAR RTE" /begin SUB_GROUP /end SUB_GROUP /begin FUNCTION_LIST /end FUNCTION_LIST /begin REF_CHARACTERISTIC CalRegn01Cmn.VehSpdLimrPosMaxOffs2.Val /end REF_CHARACTERISTIC /begin REF_MEASUREMENT /end REF_MEASUREMENT /end GROUP
/begin GROUP CalRegn01Cmn.WhlImbRejctnFrqDiagcLpFil.Val "MICROSAR RTE" /begin SUB_GROUP /end SUB_GROUP /begin FUNCTION_LIST /end FUNCTION_LIST /begin REF_CHARACTERISTIC CalRegn01Cmn.WhlImbRejctnFrqDiagcLpFil.Val /end REF_CHARACTERISTIC /begin REF_MEASUREMENT /end REF_MEASUREMENT /end GROUP
/begin GROUP CalRegn01CmnGroupB "MICROSAR RTE" /begin SUB_GROUP CalRegn01CmnGroupB.CalibrationPorts /end SUB_GROUP /begin FUNCTION_LIST /end FUNCTION_LIST /begin REF_CHARACTERISTIC /end REF_CHARACTERISTIC /begin REF_MEASUREMENT /end REF_MEASUREMENT /end GROUP
/begin GROUP CalRegn01CmnGroupB.CalibrationPorts "MICROSAR RTE"
 /begin SUB_GROUP CalRegn01CmnGroupB.WhlImbRejctnDcTrendFltRcvryDly.Val CalRegn01CmnGroupB.WhlImbRejctnFrqDiagcEna.Logl CalRegn01CmnGroupB.WhlImbRejctnFrqDiagcFltRcvryDly.Val CalRegn01CmnGroupB.WhlImbRejctnFrqDiagcUgrPoleMgn.Val CalRegn01CmnGroupB.WhlImbRejctnMaxMgnFltRcvryDly.Val CalRegn01CmnGroupB.WhlImbRejctnWhlSpdCorrlnFltRcvryDly.Val /end SUB_GROUP
 /begin FUNCTION_LIST /end FUNCTION_LIST
 /begin REF_CHARACTERISTIC /end REF_CHARACTERISTIC
 /begin REF_MEASUREMENT /end REF_MEASUREMENT
/end GROUP
/begin GROUP CalRegn01CmnGroupB.WhlImbRejctnDcTrendFltRcvryDly.Val "MICROSAR RTE" /begin SUB_GROUP /end SUB_GROUP /begin FUNCTION_LIST /end FUNCTION_LIST /begin REF_CHARACTERISTIC CalRegn01CmnGroupB.WhlImbRejctnDcTrendFltRcvryDly.Val /end REF_CHARACTERISTIC /begin REF_MEASUREMENT /end REF_MEASUREMENT /end GROUP
/begin GROUP CalRegn01CmnGroupB.WhlImbRejctnFrqDiagcEna.Logl "MICROSAR RTE" /begin SUB_GROUP /end SUB_GROUP /begin FUNCTION_LIST /end FUNCTION_LIST /begin REF_CHARACTERISTIC CalRegn01CmnGroupB.WhlImbRejctnFrqDiagcEna.Logl /end REF_CHARACTERISTIC /begin REF_MEASUREMENT /end REF_MEASUREMENT /end GROUP
/begin GROUP CalRegn01CmnGroupB.WhlImbRejctnFrqDiagcFltRcvryDly.Val "MICROSAR RTE" /begin SUB_GROUP /end SUB_GROUP /begin FUNCTION_LIST /end FUNCTION_LIST /begin REF_CHARACTERISTIC CalRegn01CmnGroupB.WhlImbRejctnFrqDiagcFltRcvryDly.Val /end REF_CHARACTERISTIC /begin REF_MEASUREMENT /end REF_MEASUREMENT /end GROUP
/begin GROUP CalRegn01CmnGroupB.WhlImbRejctnFrqDiagcUgrPoleMgn.Val "MICROSAR RTE" /begin SUB_GROUP /end SUB_GROUP /begin FUNCTION_LIST /end FUNCTION_LIST /begin REF_CHARACTERISTIC CalRegn01CmnGroupB.WhlImbRejctnFrqDiagcUgrPoleMgn.Val /end REF_CHARACTERISTIC /begin REF_MEASUREMENT /end REF_MEASUREMENT /end GROUP
/begin GROUP CalRegn01CmnGroupB.WhlImbRejctnMaxMgnFltRcvryDly.Val "MICROSAR RTE" /begin SUB_GROUP /end SUB_GROUP /begin FUNCTION_LIST /end FUNCTION_LIST /begin REF_CHARACTERISTIC CalRegn01CmnGroupB.WhlImbRejctnMaxMgnFltRcvryDly.Val /end REF_CHARACTERISTIC /begin REF_MEASUREMENT /end REF_MEASUREMENT /end GROUP
/begin GROUP CalRegn01CmnGroupB.WhlImbRejctnWhlSpdCorrlnFltRcvryDly.Val "MICROSAR RTE" /begin SUB_GROUP /end SUB_GROUP /begin FUNCTION_LIST /end FUNCTION_LIST /begin REF_CHARACTERISTIC CalRegn01CmnGroupB.WhlImbRejctnWhlSpdCorrlnFltRcvryDly.Val /end REF_CHARACTERISTIC /begin REF_MEASUREMENT /end REF_MEASUREMENT /end GROUP
/begin GROUP CalRegn01CmnGroupC "MICROSAR RTE" /begin SUB_GROUP CalRegn01CmnGroupC.CalibrationPorts /end SUB_GROUP /begin FUNCTION_LIST /end FUNCTION_LIST /begin REF_CHARACTERISTIC /end REF_CHARACTERISTIC /begin REF_MEASUREMENT /end REF_MEASUREMENT /end GROUP
/begin GROUP CalRegn01CmnGroupC.CalibrationPorts "MICROSAR RTE"
 /begin SUB_GROUP CalRegn01CmnGroupC.HwAgVehCentrTrimHwAgLim.Val CalRegn01CmnGroupC.HwAgVehCentrTrimVehSpdMaxThd.Val /end SUB_GROUP
 /begin FUNCTION_LIST /end FUNCTION_LIST
 /begin REF_CHARACTERISTIC /end REF_CHARACTERISTIC
 /begin REF_MEASUREMENT /end REF_MEASUREMENT
/end GROUP
/begin GROUP CalRegn01CmnGroupC.HwAgVehCentrTrimHwAgLim.Val "MICROSAR RTE" /begin SUB_GROUP /end SUB_GROUP /begin FUNCTION_LIST /end FUNCTION_LIST /begin REF_CHARACTERISTIC CalRegn01CmnGroupC.HwAgVehCentrTrimHwAgLim.Val /end REF_CHARACTERISTIC /begin REF_MEASUREMENT /end REF_MEASUREMENT /end GROUP
/begin GROUP CalRegn01CmnGroupC.HwAgVehCentrTrimVehSpdMaxThd.Val "MICROSAR RTE" /begin SUB_GROUP /end SUB_GROUP /begin FUNCTION_LIST /end FUNCTION_LIST /begin REF_CHARACTERISTIC CalRegn01CmnGroupC.HwAgVehCentrTrimVehSpdMaxThd.Val /end REF_CHARACTERISTIC /begin REF_MEASUREMENT /end REF_MEASUREMENT /end GROUP
/begin GROUP CalRegn01Inin00 "MICROSAR RTE" /begin SUB_GROUP CalRegn01Inin00.CalibrationPorts /end SUB_GROUP /begin FUNCTION_LIST /end FUNCTION_LIST /begin REF_CHARACTERISTIC /end REF_CHARACTERISTIC /begin REF_MEASUREMENT /end REF_MEASUREMENT /end GROUP
/begin GROUP CalRegn01Inin00.AssiPahFwlCmdSplitLpFilFrq.Val "MICROSAR RTE" /begin SUB_GROUP /end SUB_GROUP /begin FUNCTION_LIST /end FUNCTION_LIST /begin REF_CHARACTERISTIC CalRegn01Inin00.AssiPahFwlCmdSplitLpFilFrq.Val /end REF_CHARACTERISTIC /begin REF_MEASUREMENT /end REF_MEASUREMENT /end GROUP
/begin GROUP CalRegn01Inin00.AssiPahFwlDftAssiX.Ary1D "MICROSAR RTE" /begin SUB_GROUP /end SUB_GROUP /begin FUNCTION_LIST /end FUNCTION_LIST /begin REF_CHARACTERISTIC CalRegn01Inin00.AssiPahFwlDftAssiX.Ary1D /end REF_CHARACTERISTIC /begin REF_MEASUREMENT /end REF_MEASUREMENT /end GROUP
/begin GROUP CalRegn01Inin00.AssiPahFwlDftAssiY.Ary1D "MICROSAR RTE" /begin SUB_GROUP /end SUB_GROUP /begin FUNCTION_LIST /end FUNCTION_LIST /begin REF_CHARACTERISTIC CalRegn01Inin00.AssiPahFwlDftAssiY.Ary1D /end REF_CHARACTERISTIC /begin REF_MEASUREMENT /end REF_MEASUREMENT /end GROUP
/begin GROUP CalRegn01Inin00.AssiPahFwlFwlActvLpFilFrq.Val "MICROSAR RTE" /begin SUB_GROUP /end SUB_GROUP /begin FUNCTION_LIST /end FUNCTION_LIST /begin REF_CHARACTERISTIC CalRegn01Inin00.AssiPahFwlFwlActvLpFilFrq.Val /end REF_CHARACTERISTIC /begin REF_MEASUREMENT /end REF_MEASUREMENT /end GROUP
/begin GROUP CalRegn01Inin00.AssiPahFwlHiFrqUpprLimY.Ary2D "MICROSAR RTE" /begin SUB_GROUP /end SUB_GROUP /begin FUNCTION_LIST /end FUNCTION_LIST /begin REF_CHARACTERISTIC CalRegn01Inin00.AssiPahFwlHiFrqUpprLimY.Ary2D /end REF_CHARACTERISTIC /begin REF_MEASUREMENT /end REF_MEASUREMENT /end GROUP
/begin GROUP CalRegn01Inin00.AssiPahFwlHysCmpLim.Val "MICROSAR RTE" /begin SUB_GROUP /end SUB_GROUP /begin FUNCTION_LIST /end FUNCTION_LIST /begin REF_CHARACTERISTIC CalRegn01Inin00.AssiPahFwlHysCmpLim.Val /end REF_CHARACTERISTIC /begin REF_MEASUREMENT /end REF_MEASUREMENT /end GROUP
/begin GROUP CalRegn01Inin00.AssiPahFwlRestoreThd.Val "MICROSAR RTE" /begin SUB_GROUP /end SUB_GROUP /begin FUNCTION_LIST /end FUNCTION_LIST /begin REF_CHARACTERISTIC CalRegn01Inin00.AssiPahFwlRestoreThd.Val /end REF_CHARACTERISTIC /begin REF_MEASUREMENT /end REF_MEASUREMENT /end GROUP
/begin GROUP CalRegn01Inin00.AssiPahFwlUpprLimX.Ary2D "MICROSAR RTE" /begin SUB_GROUP /end SUB_GROUP /begin FUNCTION_LIST /end FUNCTION_LIST /begin REF_CHARACTERISTIC CalRegn01Inin00.AssiPahFwlUpprLimX.Ary2D /end REF_CHARACTERISTIC /begin REF_MEASUREMENT /end REF_MEASUREMENT /end GROUP
/begin GROUP CalRegn01Inin00.AssiPahFwlUpprLimY.Ary2D "MICROSAR RTE" /begin SUB_GROUP /end SUB_GROUP /begin FUNCTION_LIST /end FUNCTION_LIST /begin REF_CHARACTERISTIC CalRegn01Inin00.AssiPahFwlUpprLimY.Ary2D /end REF_CHARACTERISTIC /begin REF_MEASUREMENT /end REF_MEASUREMENT /end GROUP
/begin GROUP CalRegn01Inin00.CalibrationPorts "MICROSAR RTE"
 /begin SUB_GROUP CalRegn01Inin00.AssiPahFwlCmdSplitLpFilFrq.Val CalRegn01Inin00.AssiPahFwlDftAssiX.Ary1D CalRegn01Inin00.AssiPahFwlDftAssiY.Ary1D CalRegn01Inin00.AssiPahFwlFwlActvLpFilFrq.Val CalRegn01Inin00.AssiPahFwlHiFrqUpprLimY.Ary2D CalRegn01Inin00.AssiPahFwlHysCmpLim.Val CalRegn01Inin00.AssiPahFwlRestoreThd.Val CalRegn01Inin00.AssiPahFwlUpprLimX.Ary2D CalRegn01Inin00.AssiPahFwlUpprLimY.Ary2D CalRegn01Inin00.DampgPahFwlActvFwlLpFilFrq.Val CalRegn01Inin00.DampgPahFwlDampgCmdLpFilFrq.Val CalRegn01Inin00.DampgPahFwlDampgCmdUpprLimX.Ary1D CalRegn01Inin00.DampgPahFwlDampgCmdUpprLimY.Ary2D CalRegn01Inin00.DampgPahFwlDftDampgY.Ary1D CalRegn01Inin00.DampgPahFwlInertiaCmpLpFilFrq.Val CalRegn01Inin00.DampgPahFwlInertiaCmpUpprLimX.Ary1D CalRegn01Inin00.DampgPahFwlInertiaCmpUpprLimY.Ary2D CalRegn01Inin00.EotProtnFwlActvCmdLowrBnd.Ary1D CalRegn01Inin00.EotProtnFwlActvCmdUpprBnd.Ary1D CalRegn01Inin00.GmVehPwrModOperRampRate.Val CalRegn01Inin00.HiLoadStallLimrMotTqCmdFilFrq.Val CalRegn01Inin00.HiLoadStallLimrMotVelMgnThd.Val CalRegn01Inin00.HiLoadStallLimrStallMotTqCmdLimX.Ary1D CalRegn01Inin00.HiLoadStallLimrStallMotTqCmdLimY.Ary1D CalRegn01Inin00.HiLoadStallLimrStallMotTqLimSlewRate.Val CalRegn01Inin00.HwAg0MeasHwAg0IfFltFailStep.Val CalRegn01Inin00.HwAg0MeasHwAg0IfFltPassStep.Val CalRegn01Inin00.HwAg0MeasHwAg0Snsr0PrtclFltFailStep.Val CalRegn01Inin00.HwAg0MeasHwAg0Snsr0PrtclFltPassStep.Val CalRegn01Inin00.HwAg0MeasHwAg0Snsr1PrtclFltFailStep.Val CalRegn01Inin00.HwAg0MeasHwAg0Snsr1PrtclFltPassStep.Val CalRegn01Inin00.HwAg0MeasSnsr0Rev.Ary1D CalRegn01Inin00.HwAg0MeasSnsr1Rev.Ary1D CalRegn01Inin00.HwAg0MeasStep.Ary1D CalRegn01Inin00.HwAg0MeasVrnrErrThd.Val CalRegn01Inin00.HwAg1MeasHwAg1IfFltFailStep.Val CalRegn01Inin00.HwAg1MeasHwAg1IfFltPassStep.Val CalRegn01Inin00.HwAg1MeasHwAg1Snsr0PrtclFltFailStep.Val CalRegn01Inin00.HwAg1MeasHwAg1Snsr0PrtclFltPassStep.Val CalRegn01Inin00.HwAg1MeasHwAg1Snsr1PrtclFltFailStep.Val CalRegn01Inin00.HwAg1MeasHwAg1Snsr1PrtclFltPassStep.Val CalRegn01Inin00.HwAg1MeasSnsr0Rev.Ary1D CalRegn01Inin00.HwAg1MeasSnsr1Rev.Ary1D CalRegn01Inin00.HwAg1MeasStep.Ary1D CalRegn01Inin00.HwAg1MeasVrnrErrThd.Val CalRegn01Inin00.HwAgSnsrlsVehDynVehSpdThd.Val CalRegn01Inin00.HwAgSnsrlsVehDynYawRateThd.Val CalRegn01Inin00.HwAgSnsrlsYawRateFilFrq.Val CalRegn01Inin00.HwAgSysArbnTqSnsrVelFilFrq.Val CalRegn01Inin00.HwTq0MeasHwTq0PrtclFltFailStep.Val CalRegn01Inin00.HwTq0MeasHwTq0PrtclFltPassStep.Val CalRegn01Inin00.HwTq1MeasHwTq1PrtclFltFailStep.Val CalRegn01Inin00.HwTq1MeasHwTq1PrtclFltPassStep.Val CalRegn01Inin00.LimrCdngGainDecSlew.Val CalRegn01Inin00.LimrCdngGainIncSlewX.Ary1D CalRegn01Inin00.LimrCdngGainIncSlewY.Ary1D CalRegn01Inin00.LimrCdngTqDecSlew.Val CalRegn01Inin00.LimrCdngTqIncSlewX.Ary1D CalRegn01Inin00.LimrCdngTqIncSlewY.Ary1D CalRegn01Inin00.McuDiagc2MilliSecCntrCompThd.Val CalRegn01Inin00.McuDiagcFltFailStep.Val CalRegn01Inin00.McuDiagcFltPassStep.Val CalRegn01Inin00.MotTqTranlDampgCmdLim.Val CalRegn01Inin00.MotTqTranlDampgDampgCoeff.Val CalRegn01Inin00.MotTqTranlDampgRampEnd.Val CalRegn01Inin00.MotTqTranlDampgTmrPt1.Val CalRegn01Inin00.MotTqTranlDampgTmrPt2.Val CalRegn01Inin00.MotTqTranlDampgVehSpdBlndX.Ary1D CalRegn01Inin00.MotTqTranlDampgVelThd.Val CalRegn01Inin00.PwrDiscnctNtc0x042FailStep.Val CalRegn01Inin00.PwrDiscnctNtc0x042PassStep.Val CalRegn01Inin00.PwrDiscnctNtc0x04AFailStep.Val CalRegn01Inin00.PwrDiscnctNtc0x04APassStep.Val CalRegn01Inin00.RtnPahFwlUpprBndTblX.Ary1D CalRegn01Inin00.RtnPahFwlUpprBndTblY.Ary2D CalRegn01Inin00.RtnPahFwlVehSpd.Ary1D CalRegn01Inin00.SnsrMeasStrtTrigDly.Val CalRegn01Inin00.StHlthSigNormnHiCtrlrT.Val CalRegn01Inin00.StHlthSigNormnLoCtrlrT.Val CalRegn01Inin00.SysFricLrngAvrgFricFrq.Val CalRegn01Inin00.SysFricLrngBasLineEolFric.Val CalRegn01Inin00.SysFricLrngBasLineFric.Ary1D CalRegn01Inin00.SysFricLrngBasLineHys.Ary2D CalRegn01Inin00.SysFricLrngBasLineRngCntr.Ary2D CalRegn01Inin00.SysFricLrngDataPrepLpFilFrq.Val CalRegn01Inin00.SysFricLrngEolFricDifHiLim.Val CalRegn01Inin00.SysFricLrngEolFricDifLoLim.Val CalRegn01Inin00.SysFricLrngEolFricDifScagFac.Val CalRegn01Inin00.SysFricLrngFricChgWght.Ary1D CalRegn01Inin00.SysFricLrngFricDiagcThd.Val CalRegn01Inin00.SysFricLrngFricDiagcTiThd.Val CalRegn01Inin00.SysFricLrngFricHysHwAgPt.Ary1D CalRegn01Inin00.SysFricLrngFricOffs.Val CalRegn01Inin00.SysFricLrngFricOffsHiLim.Val CalRegn01Inin00.SysFricLrngFricOffsLoLim.Val CalRegn01Inin00.SysFricLrngFricOffsLpFilFrq.Val CalRegn01Inin00.SysFricLrngGain.Val CalRegn01Inin00.SysFricLrngHwPosnAuthyThd.Val CalRegn01Inin00.SysFricLrngHwVelConstrLim.Val CalRegn01Inin00.SysFricLrngHwVelHiLim.Val CalRegn01Inin00.SysFricLrngHwVelLoLim.Val CalRegn01Inin00.SysFricLrngIgnCycFricChgLim.Val CalRegn01Inin00.SysFricLrngIvsTrsmRatX.Ary1D CalRegn01Inin00.SysFricLrngIvsTrsmRatY.Ary1D CalRegn01Inin00.SysFricLrngLatAHiLim.Val CalRegn01Inin00.SysFricLrngLatALoLim.Val CalRegn01Inin00.SysFricLrngMaskVehSpd.Ary1D CalRegn01Inin00.SysFricLrngRngCntrThd.Val CalRegn01Inin00.SysFricLrngTHiLim.Val CalRegn01Inin00.SysFricLrngTLoLim.Val CalRegn01Inin00.SysFricLrngThd.Val CalRegn01Inin00.SysFricLrngVehSpd.Ary2D CalRegn01Inin00.SysGlbPrmMotPoleCnt.Val CalRegn01Inin00.SysGlbPrmTorsBarStfn.Val CalRegn01Inin00.TEstimnAmbPwrMplr.Val CalRegn01Inin00.TEstimnAmbTSca.Val CalRegn01Inin00.TEstimnAssiMechAmbLpFilFrq.Val CalRegn01Inin00.TEstimnAssiMechAmbMplr.Val CalRegn01Inin00.TEstimnAssiMechCorrLim.Val CalRegn01Inin00.TEstimnAssiMechDampgSca.Val CalRegn01Inin00.TEstimnAssiMechDftT.Val CalRegn01Inin00.TEstimnAssiMechLLFilCoeffA1.Val CalRegn01Inin00.TEstimnAssiMechLLFilCoeffB0.Val CalRegn01Inin00.TEstimnAssiMechLLFilCoeffB1.Val CalRegn01Inin00.TEstimnAssiMechSlew.Val CalRegn01Inin00.TEstimnCorrnTAssiMech.Val CalRegn01Inin00.TEstimnCorrnTCu.Val CalRegn01Inin00.TEstimnCorrnTMag.Val CalRegn01Inin00.TEstimnCorrnTSi.Val CalRegn01Inin00.TEstimnCuAmbLpFilFrq.Val CalRegn01Inin00.TEstimnCuAmbMplr.Val CalRegn01Inin00.TEstimnCuCorrnLim.Val CalRegn01Inin00.TEstimnCuLLFilCoeffA1.Val CalRegn01Inin00.TEstimnCuLLFilCoeffB0.Val CalRegn01Inin00.TEstimnCuLLFilCoeffB1.Val CalRegn01Inin00.TEstimnEngTSca.Val CalRegn01Inin00.TEstimnMagAmbLpFilFrq.Val CalRegn01Inin00.TEstimnMagCorrnLim.Val CalRegn01Inin00.TEstimnMagLLFilCoeffA1.Val CalRegn01Inin00.TEstimnMagLLFilCoeffB0.Val CalRegn01Inin00.TEstimnMagLLFilCoeffB1.Val CalRegn01Inin00.TEstimnSiAmbLpFilFrq.Val CalRegn01Inin00.TEstimnSiAmbMplr.Val CalRegn01Inin00.TEstimnSiCorrnLim.Val CalRegn01Inin00.TEstimnSiLLFilCoeffA1.Val CalRegn01Inin00.TEstimnSiLLFilCoeffB0.Val CalRegn01Inin00.TEstimnSiLLFilCoeffB1.Val CalRegn01Inin00.TEstimnWghtAvrgTDi.Logl CalRegn01Inin00.TunSelnAuthyVehSpdX.Ary1D CalRegn01Inin00.VehSigCdngLatASlewRate.Val CalRegn01Inin00.VehSigCdngLtgASlewRate.Val CalRegn01Inin00.VehSigCdngVehSpdSlewRate.Val CalRegn01Inin00.WhlImbRejctnDcTrendFltRcvryThd.Val /end SUB_GROUP
 /begin FUNCTION_LIST /end FUNCTION_LIST
 /begin REF_CHARACTERISTIC /end REF_CHARACTERISTIC
 /begin REF_MEASUREMENT /end REF_MEASUREMENT
/end GROUP
/begin GROUP CalRegn01Inin00.DampgPahFwlActvFwlLpFilFrq.Val "MICROSAR RTE" /begin SUB_GROUP /end SUB_GROUP /begin FUNCTION_LIST /end FUNCTION_LIST /begin REF_CHARACTERISTIC CalRegn01Inin00.DampgPahFwlActvFwlLpFilFrq.Val /end REF_CHARACTERISTIC /begin REF_MEASUREMENT /end REF_MEASUREMENT /end GROUP
/begin GROUP CalRegn01Inin00.DampgPahFwlDampgCmdLpFilFrq.Val "MICROSAR RTE" /begin SUB_GROUP /end SUB_GROUP /begin FUNCTION_LIST /end FUNCTION_LIST /begin REF_CHARACTERISTIC CalRegn01Inin00.DampgPahFwlDampgCmdLpFilFrq.Val /end REF_CHARACTERISTIC /begin REF_MEASUREMENT /end REF_MEASUREMENT /end GROUP
/begin GROUP CalRegn01Inin00.DampgPahFwlDampgCmdUpprLimX.Ary1D "MICROSAR RTE" /begin SUB_GROUP /end SUB_GROUP /begin FUNCTION_LIST /end FUNCTION_LIST /begin REF_CHARACTERISTIC CalRegn01Inin00.DampgPahFwlDampgCmdUpprLimX.Ary1D /end REF_CHARACTERISTIC /begin REF_MEASUREMENT /end REF_MEASUREMENT /end GROUP
/begin GROUP CalRegn01Inin00.DampgPahFwlDampgCmdUpprLimY.Ary2D "MICROSAR RTE" /begin SUB_GROUP /end SUB_GROUP /begin FUNCTION_LIST /end FUNCTION_LIST /begin REF_CHARACTERISTIC CalRegn01Inin00.DampgPahFwlDampgCmdUpprLimY.Ary2D /end REF_CHARACTERISTIC /begin REF_MEASUREMENT /end REF_MEASUREMENT /end GROUP
/begin GROUP CalRegn01Inin00.DampgPahFwlDftDampgY.Ary1D "MICROSAR RTE" /begin SUB_GROUP /end SUB_GROUP /begin FUNCTION_LIST /end FUNCTION_LIST /begin REF_CHARACTERISTIC CalRegn01Inin00.DampgPahFwlDftDampgY.Ary1D /end REF_CHARACTERISTIC /begin REF_MEASUREMENT /end REF_MEASUREMENT /end GROUP
/begin GROUP CalRegn01Inin00.DampgPahFwlInertiaCmpLpFilFrq.Val "MICROSAR RTE" /begin SUB_GROUP /end SUB_GROUP /begin FUNCTION_LIST /end FUNCTION_LIST /begin REF_CHARACTERISTIC CalRegn01Inin00.DampgPahFwlInertiaCmpLpFilFrq.Val /end REF_CHARACTERISTIC /begin REF_MEASUREMENT /end REF_MEASUREMENT /end GROUP
/begin GROUP CalRegn01Inin00.DampgPahFwlInertiaCmpUpprLimX.Ary1D "MICROSAR RTE" /begin SUB_GROUP /end SUB_GROUP /begin FUNCTION_LIST /end FUNCTION_LIST /begin REF_CHARACTERISTIC CalRegn01Inin00.DampgPahFwlInertiaCmpUpprLimX.Ary1D /end REF_CHARACTERISTIC /begin REF_MEASUREMENT /end REF_MEASUREMENT /end GROUP
/begin GROUP CalRegn01Inin00.DampgPahFwlInertiaCmpUpprLimY.Ary2D "MICROSAR RTE" /begin SUB_GROUP /end SUB_GROUP /begin FUNCTION_LIST /end FUNCTION_LIST /begin REF_CHARACTERISTIC CalRegn01Inin00.DampgPahFwlInertiaCmpUpprLimY.Ary2D /end REF_CHARACTERISTIC /begin REF_MEASUREMENT /end REF_MEASUREMENT /end GROUP
/begin GROUP CalRegn01Inin00.EotProtnFwlActvCmdLowrBnd.Ary1D "MICROSAR RTE" /begin SUB_GROUP /end SUB_GROUP /begin FUNCTION_LIST /end FUNCTION_LIST /begin REF_CHARACTERISTIC CalRegn01Inin00.EotProtnFwlActvCmdLowrBnd.Ary1D /end REF_CHARACTERISTIC /begin REF_MEASUREMENT /end REF_MEASUREMENT /end GROUP
/begin GROUP CalRegn01Inin00.EotProtnFwlActvCmdUpprBnd.Ary1D "MICROSAR RTE" /begin SUB_GROUP /end SUB_GROUP /begin FUNCTION_LIST /end FUNCTION_LIST /begin REF_CHARACTERISTIC CalRegn01Inin00.EotProtnFwlActvCmdUpprBnd.Ary1D /end REF_CHARACTERISTIC /begin REF_MEASUREMENT /end REF_MEASUREMENT /end GROUP
/begin GROUP CalRegn01Inin00.GmVehPwrModOperRampRate.Val "MICROSAR RTE" /begin SUB_GROUP /end SUB_GROUP /begin FUNCTION_LIST /end FUNCTION_LIST /begin REF_CHARACTERISTIC CalRegn01Inin00.GmVehPwrModOperRampRate.Val /end REF_CHARACTERISTIC /begin REF_MEASUREMENT /end REF_MEASUREMENT /end GROUP
/begin GROUP CalRegn01Inin00.HiLoadStallLimrMotTqCmdFilFrq.Val "MICROSAR RTE" /begin SUB_GROUP /end SUB_GROUP /begin FUNCTION_LIST /end FUNCTION_LIST /begin REF_CHARACTERISTIC CalRegn01Inin00.HiLoadStallLimrMotTqCmdFilFrq.Val /end REF_CHARACTERISTIC /begin REF_MEASUREMENT /end REF_MEASUREMENT /end GROUP
/begin GROUP CalRegn01Inin00.HiLoadStallLimrMotVelMgnThd.Val "MICROSAR RTE" /begin SUB_GROUP /end SUB_GROUP /begin FUNCTION_LIST /end FUNCTION_LIST /begin REF_CHARACTERISTIC CalRegn01Inin00.HiLoadStallLimrMotVelMgnThd.Val /end REF_CHARACTERISTIC /begin REF_MEASUREMENT /end REF_MEASUREMENT /end GROUP
/begin GROUP CalRegn01Inin00.HiLoadStallLimrStallMotTqCmdLimX.Ary1D "MICROSAR RTE" /begin SUB_GROUP /end SUB_GROUP /begin FUNCTION_LIST /end FUNCTION_LIST /begin REF_CHARACTERISTIC CalRegn01Inin00.HiLoadStallLimrStallMotTqCmdLimX.Ary1D /end REF_CHARACTERISTIC /begin REF_MEASUREMENT /end REF_MEASUREMENT /end GROUP
/begin GROUP CalRegn01Inin00.HiLoadStallLimrStallMotTqCmdLimY.Ary1D "MICROSAR RTE" /begin SUB_GROUP /end SUB_GROUP /begin FUNCTION_LIST /end FUNCTION_LIST /begin REF_CHARACTERISTIC CalRegn01Inin00.HiLoadStallLimrStallMotTqCmdLimY.Ary1D /end REF_CHARACTERISTIC /begin REF_MEASUREMENT /end REF_MEASUREMENT /end GROUP
/begin GROUP CalRegn01Inin00.HiLoadStallLimrStallMotTqLimSlewRate.Val "MICROSAR RTE" /begin SUB_GROUP /end SUB_GROUP /begin FUNCTION_LIST /end FUNCTION_LIST /begin REF_CHARACTERISTIC CalRegn01Inin00.HiLoadStallLimrStallMotTqLimSlewRate.Val /end REF_CHARACTERISTIC /begin REF_MEASUREMENT /end REF_MEASUREMENT /end GROUP
/begin GROUP CalRegn01Inin00.HwAg0MeasHwAg0IfFltFailStep.Val "MICROSAR RTE" /begin SUB_GROUP /end SUB_GROUP /begin FUNCTION_LIST /end FUNCTION_LIST /begin REF_CHARACTERISTIC CalRegn01Inin00.HwAg0MeasHwAg0IfFltFailStep.Val /end REF_CHARACTERISTIC /begin REF_MEASUREMENT /end REF_MEASUREMENT /end GROUP
/begin GROUP CalRegn01Inin00.HwAg0MeasHwAg0IfFltPassStep.Val "MICROSAR RTE" /begin SUB_GROUP /end SUB_GROUP /begin FUNCTION_LIST /end FUNCTION_LIST /begin REF_CHARACTERISTIC CalRegn01Inin00.HwAg0MeasHwAg0IfFltPassStep.Val /end REF_CHARACTERISTIC /begin REF_MEASUREMENT /end REF_MEASUREMENT /end GROUP
/begin GROUP CalRegn01Inin00.HwAg0MeasHwAg0Snsr0PrtclFltFailStep.Val "MICROSAR RTE" /begin SUB_GROUP /end SUB_GROUP /begin FUNCTION_LIST /end FUNCTION_LIST /begin REF_CHARACTERISTIC CalRegn01Inin00.HwAg0MeasHwAg0Snsr0PrtclFltFailStep.Val /end REF_CHARACTERISTIC /begin REF_MEASUREMENT /end REF_MEASUREMENT /end GROUP
/begin GROUP CalRegn01Inin00.HwAg0MeasHwAg0Snsr0PrtclFltPassStep.Val "MICROSAR RTE" /begin SUB_GROUP /end SUB_GROUP /begin FUNCTION_LIST /end FUNCTION_LIST /begin REF_CHARACTERISTIC CalRegn01Inin00.HwAg0MeasHwAg0Snsr0PrtclFltPassStep.Val /end REF_CHARACTERISTIC /begin REF_MEASUREMENT /end REF_MEASUREMENT /end GROUP
/begin GROUP CalRegn01Inin00.HwAg0MeasHwAg0Snsr1PrtclFltFailStep.Val "MICROSAR RTE" /begin SUB_GROUP /end SUB_GROUP /begin FUNCTION_LIST /end FUNCTION_LIST /begin REF_CHARACTERISTIC CalRegn01Inin00.HwAg0MeasHwAg0Snsr1PrtclFltFailStep.Val /end REF_CHARACTERISTIC /begin REF_MEASUREMENT /end REF_MEASUREMENT /end GROUP
/begin GROUP CalRegn01Inin00.HwAg0MeasHwAg0Snsr1PrtclFltPassStep.Val "MICROSAR RTE" /begin SUB_GROUP /end SUB_GROUP /begin FUNCTION_LIST /end FUNCTION_LIST /begin REF_CHARACTERISTIC CalRegn01Inin00.HwAg0MeasHwAg0Snsr1PrtclFltPassStep.Val /end REF_CHARACTERISTIC /begin REF_MEASUREMENT /end REF_MEASUREMENT /end GROUP
/begin GROUP CalRegn01Inin00.HwAg0MeasSnsr0Rev.Ary1D "MICROSAR RTE" /begin SUB_GROUP /end SUB_GROUP /begin FUNCTION_LIST /end FUNCTION_LIST /begin REF_CHARACTERISTIC CalRegn01Inin00.HwAg0MeasSnsr0Rev.Ary1D /end REF_CHARACTERISTIC /begin REF_MEASUREMENT /end REF_MEASUREMENT /end GROUP
/begin GROUP CalRegn01Inin00.HwAg0MeasSnsr1Rev.Ary1D "MICROSAR RTE" /begin SUB_GROUP /end SUB_GROUP /begin FUNCTION_LIST /end FUNCTION_LIST /begin REF_CHARACTERISTIC CalRegn01Inin00.HwAg0MeasSnsr1Rev.Ary1D /end REF_CHARACTERISTIC /begin REF_MEASUREMENT /end REF_MEASUREMENT /end GROUP
/begin GROUP CalRegn01Inin00.HwAg0MeasStep.Ary1D "MICROSAR RTE" /begin SUB_GROUP /end SUB_GROUP /begin FUNCTION_LIST /end FUNCTION_LIST /begin REF_CHARACTERISTIC CalRegn01Inin00.HwAg0MeasStep.Ary1D /end REF_CHARACTERISTIC /begin REF_MEASUREMENT /end REF_MEASUREMENT /end GROUP
/begin GROUP CalRegn01Inin00.HwAg0MeasVrnrErrThd.Val "MICROSAR RTE" /begin SUB_GROUP /end SUB_GROUP /begin FUNCTION_LIST /end FUNCTION_LIST /begin REF_CHARACTERISTIC CalRegn01Inin00.HwAg0MeasVrnrErrThd.Val /end REF_CHARACTERISTIC /begin REF_MEASUREMENT /end REF_MEASUREMENT /end GROUP
/begin GROUP CalRegn01Inin00.HwAg1MeasHwAg1IfFltFailStep.Val "MICROSAR RTE" /begin SUB_GROUP /end SUB_GROUP /begin FUNCTION_LIST /end FUNCTION_LIST /begin REF_CHARACTERISTIC CalRegn01Inin00.HwAg1MeasHwAg1IfFltFailStep.Val /end REF_CHARACTERISTIC /begin REF_MEASUREMENT /end REF_MEASUREMENT /end GROUP
/begin GROUP CalRegn01Inin00.HwAg1MeasHwAg1IfFltPassStep.Val "MICROSAR RTE" /begin SUB_GROUP /end SUB_GROUP /begin FUNCTION_LIST /end FUNCTION_LIST /begin REF_CHARACTERISTIC CalRegn01Inin00.HwAg1MeasHwAg1IfFltPassStep.Val /end REF_CHARACTERISTIC /begin REF_MEASUREMENT /end REF_MEASUREMENT /end GROUP
/begin GROUP CalRegn01Inin00.HwAg1MeasHwAg1Snsr0PrtclFltFailStep.Val "MICROSAR RTE" /begin SUB_GROUP /end SUB_GROUP /begin FUNCTION_LIST /end FUNCTION_LIST /begin REF_CHARACTERISTIC CalRegn01Inin00.HwAg1MeasHwAg1Snsr0PrtclFltFailStep.Val /end REF_CHARACTERISTIC /begin REF_MEASUREMENT /end REF_MEASUREMENT /end GROUP
/begin GROUP CalRegn01Inin00.HwAg1MeasHwAg1Snsr0PrtclFltPassStep.Val "MICROSAR RTE" /begin SUB_GROUP /end SUB_GROUP /begin FUNCTION_LIST /end FUNCTION_LIST /begin REF_CHARACTERISTIC CalRegn01Inin00.HwAg1MeasHwAg1Snsr0PrtclFltPassStep.Val /end REF_CHARACTERISTIC /begin REF_MEASUREMENT /end REF_MEASUREMENT /end GROUP
/begin GROUP CalRegn01Inin00.HwAg1MeasHwAg1Snsr1PrtclFltFailStep.Val "MICROSAR RTE" /begin SUB_GROUP /end SUB_GROUP /begin FUNCTION_LIST /end FUNCTION_LIST /begin REF_CHARACTERISTIC CalRegn01Inin00.HwAg1MeasHwAg1Snsr1PrtclFltFailStep.Val /end REF_CHARACTERISTIC /begin REF_MEASUREMENT /end REF_MEASUREMENT /end GROUP
/begin GROUP CalRegn01Inin00.HwAg1MeasHwAg1Snsr1PrtclFltPassStep.Val "MICROSAR RTE" /begin SUB_GROUP /end SUB_GROUP /begin FUNCTION_LIST /end FUNCTION_LIST /begin REF_CHARACTERISTIC CalRegn01Inin00.HwAg1MeasHwAg1Snsr1PrtclFltPassStep.Val /end REF_CHARACTERISTIC /begin REF_MEASUREMENT /end REF_MEASUREMENT /end GROUP
/begin GROUP CalRegn01Inin00.HwAg1MeasSnsr0Rev.Ary1D "MICROSAR RTE" /begin SUB_GROUP /end SUB_GROUP /begin FUNCTION_LIST /end FUNCTION_LIST /begin REF_CHARACTERISTIC CalRegn01Inin00.HwAg1MeasSnsr0Rev.Ary1D /end REF_CHARACTERISTIC /begin REF_MEASUREMENT /end REF_MEASUREMENT /end GROUP
/begin GROUP CalRegn01Inin00.HwAg1MeasSnsr1Rev.Ary1D "MICROSAR RTE" /begin SUB_GROUP /end SUB_GROUP /begin FUNCTION_LIST /end FUNCTION_LIST /begin REF_CHARACTERISTIC CalRegn01Inin00.HwAg1MeasSnsr1Rev.Ary1D /end REF_CHARACTERISTIC /begin REF_MEASUREMENT /end REF_MEASUREMENT /end GROUP
/begin GROUP CalRegn01Inin00.HwAg1MeasStep.Ary1D "MICROSAR RTE" /begin SUB_GROUP /end SUB_GROUP /begin FUNCTION_LIST /end FUNCTION_LIST /begin REF_CHARACTERISTIC CalRegn01Inin00.HwAg1MeasStep.Ary1D /end REF_CHARACTERISTIC /begin REF_MEASUREMENT /end REF_MEASUREMENT /end GROUP
/begin GROUP CalRegn01Inin00.HwAg1MeasVrnrErrThd.Val "MICROSAR RTE" /begin SUB_GROUP /end SUB_GROUP /begin FUNCTION_LIST /end FUNCTION_LIST /begin REF_CHARACTERISTIC CalRegn01Inin00.HwAg1MeasVrnrErrThd.Val /end REF_CHARACTERISTIC /begin REF_MEASUREMENT /end REF_MEASUREMENT /end GROUP
/begin GROUP CalRegn01Inin00.HwAgSnsrlsVehDynVehSpdThd.Val "MICROSAR RTE" /begin SUB_GROUP /end SUB_GROUP /begin FUNCTION_LIST /end FUNCTION_LIST /begin REF_CHARACTERISTIC CalRegn01Inin00.HwAgSnsrlsVehDynVehSpdThd.Val /end REF_CHARACTERISTIC /begin REF_MEASUREMENT /end REF_MEASUREMENT /end GROUP
/begin GROUP CalRegn01Inin00.HwAgSnsrlsVehDynYawRateThd.Val "MICROSAR RTE" /begin SUB_GROUP /end SUB_GROUP /begin FUNCTION_LIST /end FUNCTION_LIST /begin REF_CHARACTERISTIC CalRegn01Inin00.HwAgSnsrlsVehDynYawRateThd.Val /end REF_CHARACTERISTIC /begin REF_MEASUREMENT /end REF_MEASUREMENT /end GROUP
/begin GROUP CalRegn01Inin00.HwAgSnsrlsYawRateFilFrq.Val "MICROSAR RTE" /begin SUB_GROUP /end SUB_GROUP /begin FUNCTION_LIST /end FUNCTION_LIST /begin REF_CHARACTERISTIC CalRegn01Inin00.HwAgSnsrlsYawRateFilFrq.Val /end REF_CHARACTERISTIC /begin REF_MEASUREMENT /end REF_MEASUREMENT /end GROUP
/begin GROUP CalRegn01Inin00.HwAgSysArbnTqSnsrVelFilFrq.Val "MICROSAR RTE" /begin SUB_GROUP /end SUB_GROUP /begin FUNCTION_LIST /end FUNCTION_LIST /begin REF_CHARACTERISTIC CalRegn01Inin00.HwAgSysArbnTqSnsrVelFilFrq.Val /end REF_CHARACTERISTIC /begin REF_MEASUREMENT /end REF_MEASUREMENT /end GROUP
/begin GROUP CalRegn01Inin00.HwTq0MeasHwTq0PrtclFltFailStep.Val "MICROSAR RTE" /begin SUB_GROUP /end SUB_GROUP /begin FUNCTION_LIST /end FUNCTION_LIST /begin REF_CHARACTERISTIC CalRegn01Inin00.HwTq0MeasHwTq0PrtclFltFailStep.Val /end REF_CHARACTERISTIC /begin REF_MEASUREMENT /end REF_MEASUREMENT /end GROUP
/begin GROUP CalRegn01Inin00.HwTq0MeasHwTq0PrtclFltPassStep.Val "MICROSAR RTE" /begin SUB_GROUP /end SUB_GROUP /begin FUNCTION_LIST /end FUNCTION_LIST /begin REF_CHARACTERISTIC CalRegn01Inin00.HwTq0MeasHwTq0PrtclFltPassStep.Val /end REF_CHARACTERISTIC /begin REF_MEASUREMENT /end REF_MEASUREMENT /end GROUP
/begin GROUP CalRegn01Inin00.HwTq1MeasHwTq1PrtclFltFailStep.Val "MICROSAR RTE" /begin SUB_GROUP /end SUB_GROUP /begin FUNCTION_LIST /end FUNCTION_LIST /begin REF_CHARACTERISTIC CalRegn01Inin00.HwTq1MeasHwTq1PrtclFltFailStep.Val /end REF_CHARACTERISTIC /begin REF_MEASUREMENT /end REF_MEASUREMENT /end GROUP
/begin GROUP CalRegn01Inin00.HwTq1MeasHwTq1PrtclFltPassStep.Val "MICROSAR RTE" /begin SUB_GROUP /end SUB_GROUP /begin FUNCTION_LIST /end FUNCTION_LIST /begin REF_CHARACTERISTIC CalRegn01Inin00.HwTq1MeasHwTq1PrtclFltPassStep.Val /end REF_CHARACTERISTIC /begin REF_MEASUREMENT /end REF_MEASUREMENT /end GROUP
/begin GROUP CalRegn01Inin00.LimrCdngGainDecSlew.Val "MICROSAR RTE" /begin SUB_GROUP /end SUB_GROUP /begin FUNCTION_LIST /end FUNCTION_LIST /begin REF_CHARACTERISTIC CalRegn01Inin00.LimrCdngGainDecSlew.Val /end REF_CHARACTERISTIC /begin REF_MEASUREMENT /end REF_MEASUREMENT /end GROUP
/begin GROUP CalRegn01Inin00.LimrCdngGainIncSlewX.Ary1D "MICROSAR RTE" /begin SUB_GROUP /end SUB_GROUP /begin FUNCTION_LIST /end FUNCTION_LIST /begin REF_CHARACTERISTIC CalRegn01Inin00.LimrCdngGainIncSlewX.Ary1D /end REF_CHARACTERISTIC /begin REF_MEASUREMENT /end REF_MEASUREMENT /end GROUP
/begin GROUP CalRegn01Inin00.LimrCdngGainIncSlewY.Ary1D "MICROSAR RTE" /begin SUB_GROUP /end SUB_GROUP /begin FUNCTION_LIST /end FUNCTION_LIST /begin REF_CHARACTERISTIC CalRegn01Inin00.LimrCdngGainIncSlewY.Ary1D /end REF_CHARACTERISTIC /begin REF_MEASUREMENT /end REF_MEASUREMENT /end GROUP
/begin GROUP CalRegn01Inin00.LimrCdngTqDecSlew.Val "MICROSAR RTE" /begin SUB_GROUP /end SUB_GROUP /begin FUNCTION_LIST /end FUNCTION_LIST /begin REF_CHARACTERISTIC CalRegn01Inin00.LimrCdngTqDecSlew.Val /end REF_CHARACTERISTIC /begin REF_MEASUREMENT /end REF_MEASUREMENT /end GROUP
/begin GROUP CalRegn01Inin00.LimrCdngTqIncSlewX.Ary1D "MICROSAR RTE" /begin SUB_GROUP /end SUB_GROUP /begin FUNCTION_LIST /end FUNCTION_LIST /begin REF_CHARACTERISTIC CalRegn01Inin00.LimrCdngTqIncSlewX.Ary1D /end REF_CHARACTERISTIC /begin REF_MEASUREMENT /end REF_MEASUREMENT /end GROUP
/begin GROUP CalRegn01Inin00.LimrCdngTqIncSlewY.Ary1D "MICROSAR RTE" /begin SUB_GROUP /end SUB_GROUP /begin FUNCTION_LIST /end FUNCTION_LIST /begin REF_CHARACTERISTIC CalRegn01Inin00.LimrCdngTqIncSlewY.Ary1D /end REF_CHARACTERISTIC /begin REF_MEASUREMENT /end REF_MEASUREMENT /end GROUP
/begin GROUP CalRegn01Inin00.McuDiagc2MilliSecCntrCompThd.Val "MICROSAR RTE" /begin SUB_GROUP /end SUB_GROUP /begin FUNCTION_LIST /end FUNCTION_LIST /begin REF_CHARACTERISTIC CalRegn01Inin00.McuDiagc2MilliSecCntrCompThd.Val /end REF_CHARACTERISTIC /begin REF_MEASUREMENT /end REF_MEASUREMENT /end GROUP
/begin GROUP CalRegn01Inin00.McuDiagcFltFailStep.Val "MICROSAR RTE" /begin SUB_GROUP /end SUB_GROUP /begin FUNCTION_LIST /end FUNCTION_LIST /begin REF_CHARACTERISTIC CalRegn01Inin00.McuDiagcFltFailStep.Val /end REF_CHARACTERISTIC /begin REF_MEASUREMENT /end REF_MEASUREMENT /end GROUP
/begin GROUP CalRegn01Inin00.McuDiagcFltPassStep.Val "MICROSAR RTE" /begin SUB_GROUP /end SUB_GROUP /begin FUNCTION_LIST /end FUNCTION_LIST /begin REF_CHARACTERISTIC CalRegn01Inin00.McuDiagcFltPassStep.Val /end REF_CHARACTERISTIC /begin REF_MEASUREMENT /end REF_MEASUREMENT /end GROUP
/begin GROUP CalRegn01Inin00.MotTqTranlDampgCmdLim.Val "MICROSAR RTE" /begin SUB_GROUP /end SUB_GROUP /begin FUNCTION_LIST /end FUNCTION_LIST /begin REF_CHARACTERISTIC CalRegn01Inin00.MotTqTranlDampgCmdLim.Val /end REF_CHARACTERISTIC /begin REF_MEASUREMENT /end REF_MEASUREMENT /end GROUP
/begin GROUP CalRegn01Inin00.MotTqTranlDampgDampgCoeff.Val "MICROSAR RTE" /begin SUB_GROUP /end SUB_GROUP /begin FUNCTION_LIST /end FUNCTION_LIST /begin REF_CHARACTERISTIC CalRegn01Inin00.MotTqTranlDampgDampgCoeff.Val /end REF_CHARACTERISTIC /begin REF_MEASUREMENT /end REF_MEASUREMENT /end GROUP
/begin GROUP CalRegn01Inin00.MotTqTranlDampgRampEnd.Val "MICROSAR RTE" /begin SUB_GROUP /end SUB_GROUP /begin FUNCTION_LIST /end FUNCTION_LIST /begin REF_CHARACTERISTIC CalRegn01Inin00.MotTqTranlDampgRampEnd.Val /end REF_CHARACTERISTIC /begin REF_MEASUREMENT /end REF_MEASUREMENT /end GROUP
/begin GROUP CalRegn01Inin00.MotTqTranlDampgTmrPt1.Val "MICROSAR RTE" /begin SUB_GROUP /end SUB_GROUP /begin FUNCTION_LIST /end FUNCTION_LIST /begin REF_CHARACTERISTIC CalRegn01Inin00.MotTqTranlDampgTmrPt1.Val /end REF_CHARACTERISTIC /begin REF_MEASUREMENT /end REF_MEASUREMENT /end GROUP
/begin GROUP CalRegn01Inin00.MotTqTranlDampgTmrPt2.Val "MICROSAR RTE" /begin SUB_GROUP /end SUB_GROUP /begin FUNCTION_LIST /end FUNCTION_LIST /begin REF_CHARACTERISTIC CalRegn01Inin00.MotTqTranlDampgTmrPt2.Val /end REF_CHARACTERISTIC /begin REF_MEASUREMENT /end REF_MEASUREMENT /end GROUP
/begin GROUP CalRegn01Inin00.MotTqTranlDampgVehSpdBlndX.Ary1D "MICROSAR RTE" /begin SUB_GROUP /end SUB_GROUP /begin FUNCTION_LIST /end FUNCTION_LIST /begin REF_CHARACTERISTIC CalRegn01Inin00.MotTqTranlDampgVehSpdBlndX.Ary1D /end REF_CHARACTERISTIC /begin REF_MEASUREMENT /end REF_MEASUREMENT /end GROUP
/begin GROUP CalRegn01Inin00.MotTqTranlDampgVelThd.Val "MICROSAR RTE" /begin SUB_GROUP /end SUB_GROUP /begin FUNCTION_LIST /end FUNCTION_LIST /begin REF_CHARACTERISTIC CalRegn01Inin00.MotTqTranlDampgVelThd.Val /end REF_CHARACTERISTIC /begin REF_MEASUREMENT /end REF_MEASUREMENT /end GROUP
/begin GROUP CalRegn01Inin00.PwrDiscnctNtc0x042FailStep.Val "MICROSAR RTE" /begin SUB_GROUP /end SUB_GROUP /begin FUNCTION_LIST /end FUNCTION_LIST /begin REF_CHARACTERISTIC CalRegn01Inin00.PwrDiscnctNtc0x042FailStep.Val /end REF_CHARACTERISTIC /begin REF_MEASUREMENT /end REF_MEASUREMENT /end GROUP
/begin GROUP CalRegn01Inin00.PwrDiscnctNtc0x042PassStep.Val "MICROSAR RTE" /begin SUB_GROUP /end SUB_GROUP /begin FUNCTION_LIST /end FUNCTION_LIST /begin REF_CHARACTERISTIC CalRegn01Inin00.PwrDiscnctNtc0x042PassStep.Val /end REF_CHARACTERISTIC /begin REF_MEASUREMENT /end REF_MEASUREMENT /end GROUP
/begin GROUP CalRegn01Inin00.PwrDiscnctNtc0x04AFailStep.Val "MICROSAR RTE" /begin SUB_GROUP /end SUB_GROUP /begin FUNCTION_LIST /end FUNCTION_LIST /begin REF_CHARACTERISTIC CalRegn01Inin00.PwrDiscnctNtc0x04AFailStep.Val /end REF_CHARACTERISTIC /begin REF_MEASUREMENT /end REF_MEASUREMENT /end GROUP
/begin GROUP CalRegn01Inin00.PwrDiscnctNtc0x04APassStep.Val "MICROSAR RTE" /begin SUB_GROUP /end SUB_GROUP /begin FUNCTION_LIST /end FUNCTION_LIST /begin REF_CHARACTERISTIC CalRegn01Inin00.PwrDiscnctNtc0x04APassStep.Val /end REF_CHARACTERISTIC /begin REF_MEASUREMENT /end REF_MEASUREMENT /end GROUP
/begin GROUP CalRegn01Inin00.RtnPahFwlUpprBndTblX.Ary1D "MICROSAR RTE" /begin SUB_GROUP /end SUB_GROUP /begin FUNCTION_LIST /end FUNCTION_LIST /begin REF_CHARACTERISTIC CalRegn01Inin00.RtnPahFwlUpprBndTblX.Ary1D /end REF_CHARACTERISTIC /begin REF_MEASUREMENT /end REF_MEASUREMENT /end GROUP
/begin GROUP CalRegn01Inin00.RtnPahFwlUpprBndTblY.Ary2D "MICROSAR RTE" /begin SUB_GROUP /end SUB_GROUP /begin FUNCTION_LIST /end FUNCTION_LIST /begin REF_CHARACTERISTIC CalRegn01Inin00.RtnPahFwlUpprBndTblY.Ary2D /end REF_CHARACTERISTIC /begin REF_MEASUREMENT /end REF_MEASUREMENT /end GROUP
/begin GROUP CalRegn01Inin00.RtnPahFwlVehSpd.Ary1D "MICROSAR RTE" /begin SUB_GROUP /end SUB_GROUP /begin FUNCTION_LIST /end FUNCTION_LIST /begin REF_CHARACTERISTIC CalRegn01Inin00.RtnPahFwlVehSpd.Ary1D /end REF_CHARACTERISTIC /begin REF_MEASUREMENT /end REF_MEASUREMENT /end GROUP
/begin GROUP CalRegn01Inin00.SnsrMeasStrtTrigDly.Val "MICROSAR RTE" /begin SUB_GROUP /end SUB_GROUP /begin FUNCTION_LIST /end FUNCTION_LIST /begin REF_CHARACTERISTIC CalRegn01Inin00.SnsrMeasStrtTrigDly.Val /end REF_CHARACTERISTIC /begin REF_MEASUREMENT /end REF_MEASUREMENT /end GROUP
/begin GROUP CalRegn01Inin00.StHlthSigNormnHiCtrlrT.Val "MICROSAR RTE" /begin SUB_GROUP /end SUB_GROUP /begin FUNCTION_LIST /end FUNCTION_LIST /begin REF_CHARACTERISTIC CalRegn01Inin00.StHlthSigNormnHiCtrlrT.Val /end REF_CHARACTERISTIC /begin REF_MEASUREMENT /end REF_MEASUREMENT /end GROUP
/begin GROUP CalRegn01Inin00.StHlthSigNormnLoCtrlrT.Val "MICROSAR RTE" /begin SUB_GROUP /end SUB_GROUP /begin FUNCTION_LIST /end FUNCTION_LIST /begin REF_CHARACTERISTIC CalRegn01Inin00.StHlthSigNormnLoCtrlrT.Val /end REF_CHARACTERISTIC /begin REF_MEASUREMENT /end REF_MEASUREMENT /end GROUP
/begin GROUP CalRegn01Inin00.SysFricLrngAvrgFricFrq.Val "MICROSAR RTE" /begin SUB_GROUP /end SUB_GROUP /begin FUNCTION_LIST /end FUNCTION_LIST /begin REF_CHARACTERISTIC CalRegn01Inin00.SysFricLrngAvrgFricFrq.Val /end REF_CHARACTERISTIC /begin REF_MEASUREMENT /end REF_MEASUREMENT /end GROUP
/begin GROUP CalRegn01Inin00.SysFricLrngBasLineEolFric.Val "MICROSAR RTE" /begin SUB_GROUP /end SUB_GROUP /begin FUNCTION_LIST /end FUNCTION_LIST /begin REF_CHARACTERISTIC CalRegn01Inin00.SysFricLrngBasLineEolFric.Val /end REF_CHARACTERISTIC /begin REF_MEASUREMENT /end REF_MEASUREMENT /end GROUP
/begin GROUP CalRegn01Inin00.SysFricLrngBasLineFric.Ary1D "MICROSAR RTE" /begin SUB_GROUP /end SUB_GROUP /begin FUNCTION_LIST /end FUNCTION_LIST /begin REF_CHARACTERISTIC CalRegn01Inin00.SysFricLrngBasLineFric.Ary1D /end REF_CHARACTERISTIC /begin REF_MEASUREMENT /end REF_MEASUREMENT /end GROUP
/begin GROUP CalRegn01Inin00.SysFricLrngBasLineHys.Ary2D "MICROSAR RTE" /begin SUB_GROUP /end SUB_GROUP /begin FUNCTION_LIST /end FUNCTION_LIST /begin REF_CHARACTERISTIC CalRegn01Inin00.SysFricLrngBasLineHys.Ary2D /end REF_CHARACTERISTIC /begin REF_MEASUREMENT /end REF_MEASUREMENT /end GROUP
/begin GROUP CalRegn01Inin00.SysFricLrngBasLineRngCntr.Ary2D "MICROSAR RTE" /begin SUB_GROUP /end SUB_GROUP /begin FUNCTION_LIST /end FUNCTION_LIST /begin REF_CHARACTERISTIC CalRegn01Inin00.SysFricLrngBasLineRngCntr.Ary2D /end REF_CHARACTERISTIC /begin REF_MEASUREMENT /end REF_MEASUREMENT /end GROUP
/begin GROUP CalRegn01Inin00.SysFricLrngDataPrepLpFilFrq.Val "MICROSAR RTE" /begin SUB_GROUP /end SUB_GROUP /begin FUNCTION_LIST /end FUNCTION_LIST /begin REF_CHARACTERISTIC CalRegn01Inin00.SysFricLrngDataPrepLpFilFrq.Val /end REF_CHARACTERISTIC /begin REF_MEASUREMENT /end REF_MEASUREMENT /end GROUP
/begin GROUP CalRegn01Inin00.SysFricLrngEolFricDifHiLim.Val "MICROSAR RTE" /begin SUB_GROUP /end SUB_GROUP /begin FUNCTION_LIST /end FUNCTION_LIST /begin REF_CHARACTERISTIC CalRegn01Inin00.SysFricLrngEolFricDifHiLim.Val /end REF_CHARACTERISTIC /begin REF_MEASUREMENT /end REF_MEASUREMENT /end GROUP
/begin GROUP CalRegn01Inin00.SysFricLrngEolFricDifLoLim.Val "MICROSAR RTE" /begin SUB_GROUP /end SUB_GROUP /begin FUNCTION_LIST /end FUNCTION_LIST /begin REF_CHARACTERISTIC CalRegn01Inin00.SysFricLrngEolFricDifLoLim.Val /end REF_CHARACTERISTIC /begin REF_MEASUREMENT /end REF_MEASUREMENT /end GROUP
/begin GROUP CalRegn01Inin00.SysFricLrngEolFricDifScagFac.Val "MICROSAR RTE" /begin SUB_GROUP /end SUB_GROUP /begin FUNCTION_LIST /end FUNCTION_LIST /begin REF_CHARACTERISTIC CalRegn01Inin00.SysFricLrngEolFricDifScagFac.Val /end REF_CHARACTERISTIC /begin REF_MEASUREMENT /end REF_MEASUREMENT /end GROUP
/begin GROUP CalRegn01Inin00.SysFricLrngFricChgWght.Ary1D "MICROSAR RTE" /begin SUB_GROUP /end SUB_GROUP /begin FUNCTION_LIST /end FUNCTION_LIST /begin REF_CHARACTERISTIC CalRegn01Inin00.SysFricLrngFricChgWght.Ary1D /end REF_CHARACTERISTIC /begin REF_MEASUREMENT /end REF_MEASUREMENT /end GROUP
/begin GROUP CalRegn01Inin00.SysFricLrngFricDiagcThd.Val "MICROSAR RTE" /begin SUB_GROUP /end SUB_GROUP /begin FUNCTION_LIST /end FUNCTION_LIST /begin REF_CHARACTERISTIC CalRegn01Inin00.SysFricLrngFricDiagcThd.Val /end REF_CHARACTERISTIC /begin REF_MEASUREMENT /end REF_MEASUREMENT /end GROUP
/begin GROUP CalRegn01Inin00.SysFricLrngFricDiagcTiThd.Val "MICROSAR RTE" /begin SUB_GROUP /end SUB_GROUP /begin FUNCTION_LIST /end FUNCTION_LIST /begin REF_CHARACTERISTIC CalRegn01Inin00.SysFricLrngFricDiagcTiThd.Val /end REF_CHARACTERISTIC /begin REF_MEASUREMENT /end REF_MEASUREMENT /end GROUP
/begin GROUP CalRegn01Inin00.SysFricLrngFricHysHwAgPt.Ary1D "MICROSAR RTE" /begin SUB_GROUP /end SUB_GROUP /begin FUNCTION_LIST /end FUNCTION_LIST /begin REF_CHARACTERISTIC CalRegn01Inin00.SysFricLrngFricHysHwAgPt.Ary1D /end REF_CHARACTERISTIC /begin REF_MEASUREMENT /end REF_MEASUREMENT /end GROUP
/begin GROUP CalRegn01Inin00.SysFricLrngFricOffs.Val "MICROSAR RTE" /begin SUB_GROUP /end SUB_GROUP /begin FUNCTION_LIST /end FUNCTION_LIST /begin REF_CHARACTERISTIC CalRegn01Inin00.SysFricLrngFricOffs.Val /end REF_CHARACTERISTIC /begin REF_MEASUREMENT /end REF_MEASUREMENT /end GROUP
/begin GROUP CalRegn01Inin00.SysFricLrngFricOffsHiLim.Val "MICROSAR RTE" /begin SUB_GROUP /end SUB_GROUP /begin FUNCTION_LIST /end FUNCTION_LIST /begin REF_CHARACTERISTIC CalRegn01Inin00.SysFricLrngFricOffsHiLim.Val /end REF_CHARACTERISTIC /begin REF_MEASUREMENT /end REF_MEASUREMENT /end GROUP
/begin GROUP CalRegn01Inin00.SysFricLrngFricOffsLoLim.Val "MICROSAR RTE" /begin SUB_GROUP /end SUB_GROUP /begin FUNCTION_LIST /end FUNCTION_LIST /begin REF_CHARACTERISTIC CalRegn01Inin00.SysFricLrngFricOffsLoLim.Val /end REF_CHARACTERISTIC /begin REF_MEASUREMENT /end REF_MEASUREMENT /end GROUP
/begin GROUP CalRegn01Inin00.SysFricLrngFricOffsLpFilFrq.Val "MICROSAR RTE" /begin SUB_GROUP /end SUB_GROUP /begin FUNCTION_LIST /end FUNCTION_LIST /begin REF_CHARACTERISTIC CalRegn01Inin00.SysFricLrngFricOffsLpFilFrq.Val /end REF_CHARACTERISTIC /begin REF_MEASUREMENT /end REF_MEASUREMENT /end GROUP
/begin GROUP CalRegn01Inin00.SysFricLrngGain.Val "MICROSAR RTE" /begin SUB_GROUP /end SUB_GROUP /begin FUNCTION_LIST /end FUNCTION_LIST /begin REF_CHARACTERISTIC CalRegn01Inin00.SysFricLrngGain.Val /end REF_CHARACTERISTIC /begin REF_MEASUREMENT /end REF_MEASUREMENT /end GROUP
/begin GROUP CalRegn01Inin00.SysFricLrngHwPosnAuthyThd.Val "MICROSAR RTE" /begin SUB_GROUP /end SUB_GROUP /begin FUNCTION_LIST /end FUNCTION_LIST /begin REF_CHARACTERISTIC CalRegn01Inin00.SysFricLrngHwPosnAuthyThd.Val /end REF_CHARACTERISTIC /begin REF_MEASUREMENT /end REF_MEASUREMENT /end GROUP
/begin GROUP CalRegn01Inin00.SysFricLrngHwVelConstrLim.Val "MICROSAR RTE" /begin SUB_GROUP /end SUB_GROUP /begin FUNCTION_LIST /end FUNCTION_LIST /begin REF_CHARACTERISTIC CalRegn01Inin00.SysFricLrngHwVelConstrLim.Val /end REF_CHARACTERISTIC /begin REF_MEASUREMENT /end REF_MEASUREMENT /end GROUP
/begin GROUP CalRegn01Inin00.SysFricLrngHwVelHiLim.Val "MICROSAR RTE" /begin SUB_GROUP /end SUB_GROUP /begin FUNCTION_LIST /end FUNCTION_LIST /begin REF_CHARACTERISTIC CalRegn01Inin00.SysFricLrngHwVelHiLim.Val /end REF_CHARACTERISTIC /begin REF_MEASUREMENT /end REF_MEASUREMENT /end GROUP
/begin GROUP CalRegn01Inin00.SysFricLrngHwVelLoLim.Val "MICROSAR RTE" /begin SUB_GROUP /end SUB_GROUP /begin FUNCTION_LIST /end FUNCTION_LIST /begin REF_CHARACTERISTIC CalRegn01Inin00.SysFricLrngHwVelLoLim.Val /end REF_CHARACTERISTIC /begin REF_MEASUREMENT /end REF_MEASUREMENT /end GROUP
/begin GROUP CalRegn01Inin00.SysFricLrngIgnCycFricChgLim.Val "MICROSAR RTE" /begin SUB_GROUP /end SUB_GROUP /begin FUNCTION_LIST /end FUNCTION_LIST /begin REF_CHARACTERISTIC CalRegn01Inin00.SysFricLrngIgnCycFricChgLim.Val /end REF_CHARACTERISTIC /begin REF_MEASUREMENT /end REF_MEASUREMENT /end GROUP
/begin GROUP CalRegn01Inin00.SysFricLrngIvsTrsmRatX.Ary1D "MICROSAR RTE" /begin SUB_GROUP /end SUB_GROUP /begin FUNCTION_LIST /end FUNCTION_LIST /begin REF_CHARACTERISTIC CalRegn01Inin00.SysFricLrngIvsTrsmRatX.Ary1D /end REF_CHARACTERISTIC /begin REF_MEASUREMENT /end REF_MEASUREMENT /end GROUP
/begin GROUP CalRegn01Inin00.SysFricLrngIvsTrsmRatY.Ary1D "MICROSAR RTE" /begin SUB_GROUP /end SUB_GROUP /begin FUNCTION_LIST /end FUNCTION_LIST /begin REF_CHARACTERISTIC CalRegn01Inin00.SysFricLrngIvsTrsmRatY.Ary1D /end REF_CHARACTERISTIC /begin REF_MEASUREMENT /end REF_MEASUREMENT /end GROUP
/begin GROUP CalRegn01Inin00.SysFricLrngLatAHiLim.Val "MICROSAR RTE" /begin SUB_GROUP /end SUB_GROUP /begin FUNCTION_LIST /end FUNCTION_LIST /begin REF_CHARACTERISTIC CalRegn01Inin00.SysFricLrngLatAHiLim.Val /end REF_CHARACTERISTIC /begin REF_MEASUREMENT /end REF_MEASUREMENT /end GROUP
/begin GROUP CalRegn01Inin00.SysFricLrngLatALoLim.Val "MICROSAR RTE" /begin SUB_GROUP /end SUB_GROUP /begin FUNCTION_LIST /end FUNCTION_LIST /begin REF_CHARACTERISTIC CalRegn01Inin00.SysFricLrngLatALoLim.Val /end REF_CHARACTERISTIC /begin REF_MEASUREMENT /end REF_MEASUREMENT /end GROUP
/begin GROUP CalRegn01Inin00.SysFricLrngMaskVehSpd.Ary1D "MICROSAR RTE" /begin SUB_GROUP /end SUB_GROUP /begin FUNCTION_LIST /end FUNCTION_LIST /begin REF_CHARACTERISTIC CalRegn01Inin00.SysFricLrngMaskVehSpd.Ary1D /end REF_CHARACTERISTIC /begin REF_MEASUREMENT /end REF_MEASUREMENT /end GROUP
/begin GROUP CalRegn01Inin00.SysFricLrngRngCntrThd.Val "MICROSAR RTE" /begin SUB_GROUP /end SUB_GROUP /begin FUNCTION_LIST /end FUNCTION_LIST /begin REF_CHARACTERISTIC CalRegn01Inin00.SysFricLrngRngCntrThd.Val /end REF_CHARACTERISTIC /begin REF_MEASUREMENT /end REF_MEASUREMENT /end GROUP
/begin GROUP CalRegn01Inin00.SysFricLrngTHiLim.Val "MICROSAR RTE" /begin SUB_GROUP /end SUB_GROUP /begin FUNCTION_LIST /end FUNCTION_LIST /begin REF_CHARACTERISTIC CalRegn01Inin00.SysFricLrngTHiLim.Val /end REF_CHARACTERISTIC /begin REF_MEASUREMENT /end REF_MEASUREMENT /end GROUP
/begin GROUP CalRegn01Inin00.SysFricLrngTLoLim.Val "MICROSAR RTE" /begin SUB_GROUP /end SUB_GROUP /begin FUNCTION_LIST /end FUNCTION_LIST /begin REF_CHARACTERISTIC CalRegn01Inin00.SysFricLrngTLoLim.Val /end REF_CHARACTERISTIC /begin REF_MEASUREMENT /end REF_MEASUREMENT /end GROUP
/begin GROUP CalRegn01Inin00.SysFricLrngThd.Val "MICROSAR RTE" /begin SUB_GROUP /end SUB_GROUP /begin FUNCTION_LIST /end FUNCTION_LIST /begin REF_CHARACTERISTIC CalRegn01Inin00.SysFricLrngThd.Val /end REF_CHARACTERISTIC /begin REF_MEASUREMENT /end REF_MEASUREMENT /end GROUP
/begin GROUP CalRegn01Inin00.SysFricLrngVehSpd.Ary2D "MICROSAR RTE" /begin SUB_GROUP /end SUB_GROUP /begin FUNCTION_LIST /end FUNCTION_LIST /begin REF_CHARACTERISTIC CalRegn01Inin00.SysFricLrngVehSpd.Ary2D /end REF_CHARACTERISTIC /begin REF_MEASUREMENT /end REF_MEASUREMENT /end GROUP
/begin GROUP CalRegn01Inin00.SysGlbPrmMotPoleCnt.Val "MICROSAR RTE" /begin SUB_GROUP /end SUB_GROUP /begin FUNCTION_LIST /end FUNCTION_LIST /begin REF_CHARACTERISTIC CalRegn01Inin00.SysGlbPrmMotPoleCnt.Val /end REF_CHARACTERISTIC /begin REF_MEASUREMENT /end REF_MEASUREMENT /end GROUP
/begin GROUP CalRegn01Inin00.SysGlbPrmTorsBarStfn.Val "MICROSAR RTE" /begin SUB_GROUP /end SUB_GROUP /begin FUNCTION_LIST /end FUNCTION_LIST /begin REF_CHARACTERISTIC CalRegn01Inin00.SysGlbPrmTorsBarStfn.Val /end REF_CHARACTERISTIC /begin REF_MEASUREMENT /end REF_MEASUREMENT /end GROUP
/begin GROUP CalRegn01Inin00.TEstimnAmbPwrMplr.Val "MICROSAR RTE" /begin SUB_GROUP /end SUB_GROUP /begin FUNCTION_LIST /end FUNCTION_LIST /begin REF_CHARACTERISTIC CalRegn01Inin00.TEstimnAmbPwrMplr.Val /end REF_CHARACTERISTIC /begin REF_MEASUREMENT /end REF_MEASUREMENT /end GROUP
/begin GROUP CalRegn01Inin00.TEstimnAmbTSca.Val "MICROSAR RTE" /begin SUB_GROUP /end SUB_GROUP /begin FUNCTION_LIST /end FUNCTION_LIST /begin REF_CHARACTERISTIC CalRegn01Inin00.TEstimnAmbTSca.Val /end REF_CHARACTERISTIC /begin REF_MEASUREMENT /end REF_MEASUREMENT /end GROUP
/begin GROUP CalRegn01Inin00.TEstimnAssiMechAmbLpFilFrq.Val "MICROSAR RTE" /begin SUB_GROUP /end SUB_GROUP /begin FUNCTION_LIST /end FUNCTION_LIST /begin REF_CHARACTERISTIC CalRegn01Inin00.TEstimnAssiMechAmbLpFilFrq.Val /end REF_CHARACTERISTIC /begin REF_MEASUREMENT /end REF_MEASUREMENT /end GROUP
/begin GROUP CalRegn01Inin00.TEstimnAssiMechAmbMplr.Val "MICROSAR RTE" /begin SUB_GROUP /end SUB_GROUP /begin FUNCTION_LIST /end FUNCTION_LIST /begin REF_CHARACTERISTIC CalRegn01Inin00.TEstimnAssiMechAmbMplr.Val /end REF_CHARACTERISTIC /begin REF_MEASUREMENT /end REF_MEASUREMENT /end GROUP
/begin GROUP CalRegn01Inin00.TEstimnAssiMechCorrLim.Val "MICROSAR RTE" /begin SUB_GROUP /end SUB_GROUP /begin FUNCTION_LIST /end FUNCTION_LIST /begin REF_CHARACTERISTIC CalRegn01Inin00.TEstimnAssiMechCorrLim.Val /end REF_CHARACTERISTIC /begin REF_MEASUREMENT /end REF_MEASUREMENT /end GROUP
/begin GROUP CalRegn01Inin00.TEstimnAssiMechDampgSca.Val "MICROSAR RTE" /begin SUB_GROUP /end SUB_GROUP /begin FUNCTION_LIST /end FUNCTION_LIST /begin REF_CHARACTERISTIC CalRegn01Inin00.TEstimnAssiMechDampgSca.Val /end REF_CHARACTERISTIC /begin REF_MEASUREMENT /end REF_MEASUREMENT /end GROUP
/begin GROUP CalRegn01Inin00.TEstimnAssiMechDftT.Val "MICROSAR RTE" /begin SUB_GROUP /end SUB_GROUP /begin FUNCTION_LIST /end FUNCTION_LIST /begin REF_CHARACTERISTIC CalRegn01Inin00.TEstimnAssiMechDftT.Val /end REF_CHARACTERISTIC /begin REF_MEASUREMENT /end REF_MEASUREMENT /end GROUP
/begin GROUP CalRegn01Inin00.TEstimnAssiMechLLFilCoeffA1.Val "MICROSAR RTE" /begin SUB_GROUP /end SUB_GROUP /begin FUNCTION_LIST /end FUNCTION_LIST /begin REF_CHARACTERISTIC CalRegn01Inin00.TEstimnAssiMechLLFilCoeffA1.Val /end REF_CHARACTERISTIC /begin REF_MEASUREMENT /end REF_MEASUREMENT /end GROUP
/begin GROUP CalRegn01Inin00.TEstimnAssiMechLLFilCoeffB0.Val "MICROSAR RTE" /begin SUB_GROUP /end SUB_GROUP /begin FUNCTION_LIST /end FUNCTION_LIST /begin REF_CHARACTERISTIC CalRegn01Inin00.TEstimnAssiMechLLFilCoeffB0.Val /end REF_CHARACTERISTIC /begin REF_MEASUREMENT /end REF_MEASUREMENT /end GROUP
/begin GROUP CalRegn01Inin00.TEstimnAssiMechLLFilCoeffB1.Val "MICROSAR RTE" /begin SUB_GROUP /end SUB_GROUP /begin FUNCTION_LIST /end FUNCTION_LIST /begin REF_CHARACTERISTIC CalRegn01Inin00.TEstimnAssiMechLLFilCoeffB1.Val /end REF_CHARACTERISTIC /begin REF_MEASUREMENT /end REF_MEASUREMENT /end GROUP
/begin GROUP CalRegn01Inin00.TEstimnAssiMechSlew.Val "MICROSAR RTE" /begin SUB_GROUP /end SUB_GROUP /begin FUNCTION_LIST /end FUNCTION_LIST /begin REF_CHARACTERISTIC CalRegn01Inin00.TEstimnAssiMechSlew.Val /end REF_CHARACTERISTIC /begin REF_MEASUREMENT /end REF_MEASUREMENT /end GROUP
/begin GROUP CalRegn01Inin00.TEstimnCorrnTAssiMech.Val "MICROSAR RTE" /begin SUB_GROUP /end SUB_GROUP /begin FUNCTION_LIST /end FUNCTION_LIST /begin REF_CHARACTERISTIC CalRegn01Inin00.TEstimnCorrnTAssiMech.Val /end REF_CHARACTERISTIC /begin REF_MEASUREMENT /end REF_MEASUREMENT /end GROUP
/begin GROUP CalRegn01Inin00.TEstimnCorrnTCu.Val "MICROSAR RTE" /begin SUB_GROUP /end SUB_GROUP /begin FUNCTION_LIST /end FUNCTION_LIST /begin REF_CHARACTERISTIC CalRegn01Inin00.TEstimnCorrnTCu.Val /end REF_CHARACTERISTIC /begin REF_MEASUREMENT /end REF_MEASUREMENT /end GROUP
/begin GROUP CalRegn01Inin00.TEstimnCorrnTMag.Val "MICROSAR RTE" /begin SUB_GROUP /end SUB_GROUP /begin FUNCTION_LIST /end FUNCTION_LIST /begin REF_CHARACTERISTIC CalRegn01Inin00.TEstimnCorrnTMag.Val /end REF_CHARACTERISTIC /begin REF_MEASUREMENT /end REF_MEASUREMENT /end GROUP
/begin GROUP CalRegn01Inin00.TEstimnCorrnTSi.Val "MICROSAR RTE" /begin SUB_GROUP /end SUB_GROUP /begin FUNCTION_LIST /end FUNCTION_LIST /begin REF_CHARACTERISTIC CalRegn01Inin00.TEstimnCorrnTSi.Val /end REF_CHARACTERISTIC /begin REF_MEASUREMENT /end REF_MEASUREMENT /end GROUP
/begin GROUP CalRegn01Inin00.TEstimnCuAmbLpFilFrq.Val "MICROSAR RTE" /begin SUB_GROUP /end SUB_GROUP /begin FUNCTION_LIST /end FUNCTION_LIST /begin REF_CHARACTERISTIC CalRegn01Inin00.TEstimnCuAmbLpFilFrq.Val /end REF_CHARACTERISTIC /begin REF_MEASUREMENT /end REF_MEASUREMENT /end GROUP
/begin GROUP CalRegn01Inin00.TEstimnCuAmbMplr.Val "MICROSAR RTE" /begin SUB_GROUP /end SUB_GROUP /begin FUNCTION_LIST /end FUNCTION_LIST /begin REF_CHARACTERISTIC CalRegn01Inin00.TEstimnCuAmbMplr.Val /end REF_CHARACTERISTIC /begin REF_MEASUREMENT /end REF_MEASUREMENT /end GROUP
/begin GROUP CalRegn01Inin00.TEstimnCuCorrnLim.Val "MICROSAR RTE" /begin SUB_GROUP /end SUB_GROUP /begin FUNCTION_LIST /end FUNCTION_LIST /begin REF_CHARACTERISTIC CalRegn01Inin00.TEstimnCuCorrnLim.Val /end REF_CHARACTERISTIC /begin REF_MEASUREMENT /end REF_MEASUREMENT /end GROUP
/begin GROUP CalRegn01Inin00.TEstimnCuLLFilCoeffA1.Val "MICROSAR RTE" /begin SUB_GROUP /end SUB_GROUP /begin FUNCTION_LIST /end FUNCTION_LIST /begin REF_CHARACTERISTIC CalRegn01Inin00.TEstimnCuLLFilCoeffA1.Val /end REF_CHARACTERISTIC /begin REF_MEASUREMENT /end REF_MEASUREMENT /end GROUP
/begin GROUP CalRegn01Inin00.TEstimnCuLLFilCoeffB0.Val "MICROSAR RTE" /begin SUB_GROUP /end SUB_GROUP /begin FUNCTION_LIST /end FUNCTION_LIST /begin REF_CHARACTERISTIC CalRegn01Inin00.TEstimnCuLLFilCoeffB0.Val /end REF_CHARACTERISTIC /begin REF_MEASUREMENT /end REF_MEASUREMENT /end GROUP
/begin GROUP CalRegn01Inin00.TEstimnCuLLFilCoeffB1.Val "MICROSAR RTE" /begin SUB_GROUP /end SUB_GROUP /begin FUNCTION_LIST /end FUNCTION_LIST /begin REF_CHARACTERISTIC CalRegn01Inin00.TEstimnCuLLFilCoeffB1.Val /end REF_CHARACTERISTIC /begin REF_MEASUREMENT /end REF_MEASUREMENT /end GROUP
/begin GROUP CalRegn01Inin00.TEstimnEngTSca.Val "MICROSAR RTE" /begin SUB_GROUP /end SUB_GROUP /begin FUNCTION_LIST /end FUNCTION_LIST /begin REF_CHARACTERISTIC CalRegn01Inin00.TEstimnEngTSca.Val /end REF_CHARACTERISTIC /begin REF_MEASUREMENT /end REF_MEASUREMENT /end GROUP
/begin GROUP CalRegn01Inin00.TEstimnMagAmbLpFilFrq.Val "MICROSAR RTE" /begin SUB_GROUP /end SUB_GROUP /begin FUNCTION_LIST /end FUNCTION_LIST /begin REF_CHARACTERISTIC CalRegn01Inin00.TEstimnMagAmbLpFilFrq.Val /end REF_CHARACTERISTIC /begin REF_MEASUREMENT /end REF_MEASUREMENT /end GROUP
/begin GROUP CalRegn01Inin00.TEstimnMagCorrnLim.Val "MICROSAR RTE" /begin SUB_GROUP /end SUB_GROUP /begin FUNCTION_LIST /end FUNCTION_LIST /begin REF_CHARACTERISTIC CalRegn01Inin00.TEstimnMagCorrnLim.Val /end REF_CHARACTERISTIC /begin REF_MEASUREMENT /end REF_MEASUREMENT /end GROUP
/begin GROUP CalRegn01Inin00.TEstimnMagLLFilCoeffA1.Val "MICROSAR RTE" /begin SUB_GROUP /end SUB_GROUP /begin FUNCTION_LIST /end FUNCTION_LIST /begin REF_CHARACTERISTIC CalRegn01Inin00.TEstimnMagLLFilCoeffA1.Val /end REF_CHARACTERISTIC /begin REF_MEASUREMENT /end REF_MEASUREMENT /end GROUP
/begin GROUP CalRegn01Inin00.TEstimnMagLLFilCoeffB0.Val "MICROSAR RTE" /begin SUB_GROUP /end SUB_GROUP /begin FUNCTION_LIST /end FUNCTION_LIST /begin REF_CHARACTERISTIC CalRegn01Inin00.TEstimnMagLLFilCoeffB0.Val /end REF_CHARACTERISTIC /begin REF_MEASUREMENT /end REF_MEASUREMENT /end GROUP
/begin GROUP CalRegn01Inin00.TEstimnMagLLFilCoeffB1.Val "MICROSAR RTE" /begin SUB_GROUP /end SUB_GROUP /begin FUNCTION_LIST /end FUNCTION_LIST /begin REF_CHARACTERISTIC CalRegn01Inin00.TEstimnMagLLFilCoeffB1.Val /end REF_CHARACTERISTIC /begin REF_MEASUREMENT /end REF_MEASUREMENT /end GROUP
/begin GROUP CalRegn01Inin00.TEstimnSiAmbLpFilFrq.Val "MICROSAR RTE" /begin SUB_GROUP /end SUB_GROUP /begin FUNCTION_LIST /end FUNCTION_LIST /begin REF_CHARACTERISTIC CalRegn01Inin00.TEstimnSiAmbLpFilFrq.Val /end REF_CHARACTERISTIC /begin REF_MEASUREMENT /end REF_MEASUREMENT /end GROUP
/begin GROUP CalRegn01Inin00.TEstimnSiAmbMplr.Val "MICROSAR RTE" /begin SUB_GROUP /end SUB_GROUP /begin FUNCTION_LIST /end FUNCTION_LIST /begin REF_CHARACTERISTIC CalRegn01Inin00.TEstimnSiAmbMplr.Val /end REF_CHARACTERISTIC /begin REF_MEASUREMENT /end REF_MEASUREMENT /end GROUP
/begin GROUP CalRegn01Inin00.TEstimnSiCorrnLim.Val "MICROSAR RTE" /begin SUB_GROUP /end SUB_GROUP /begin FUNCTION_LIST /end FUNCTION_LIST /begin REF_CHARACTERISTIC CalRegn01Inin00.TEstimnSiCorrnLim.Val /end REF_CHARACTERISTIC /begin REF_MEASUREMENT /end REF_MEASUREMENT /end GROUP
/begin GROUP CalRegn01Inin00.TEstimnSiLLFilCoeffA1.Val "MICROSAR RTE" /begin SUB_GROUP /end SUB_GROUP /begin FUNCTION_LIST /end FUNCTION_LIST /begin REF_CHARACTERISTIC CalRegn01Inin00.TEstimnSiLLFilCoeffA1.Val /end REF_CHARACTERISTIC /begin REF_MEASUREMENT /end REF_MEASUREMENT /end GROUP
/begin GROUP CalRegn01Inin00.TEstimnSiLLFilCoeffB0.Val "MICROSAR RTE" /begin SUB_GROUP /end SUB_GROUP /begin FUNCTION_LIST /end FUNCTION_LIST /begin REF_CHARACTERISTIC CalRegn01Inin00.TEstimnSiLLFilCoeffB0.Val /end REF_CHARACTERISTIC /begin REF_MEASUREMENT /end REF_MEASUREMENT /end GROUP
/begin GROUP CalRegn01Inin00.TEstimnSiLLFilCoeffB1.Val "MICROSAR RTE" /begin SUB_GROUP /end SUB_GROUP /begin FUNCTION_LIST /end FUNCTION_LIST /begin REF_CHARACTERISTIC CalRegn01Inin00.TEstimnSiLLFilCoeffB1.Val /end REF_CHARACTERISTIC /begin REF_MEASUREMENT /end REF_MEASUREMENT /end GROUP
/begin GROUP CalRegn01Inin00.TEstimnWghtAvrgTDi.Logl "MICROSAR RTE" /begin SUB_GROUP /end SUB_GROUP /begin FUNCTION_LIST /end FUNCTION_LIST /begin REF_CHARACTERISTIC CalRegn01Inin00.TEstimnWghtAvrgTDi.Logl /end REF_CHARACTERISTIC /begin REF_MEASUREMENT /end REF_MEASUREMENT /end GROUP
/begin GROUP CalRegn01Inin00.TunSelnAuthyVehSpdX.Ary1D "MICROSAR RTE" /begin SUB_GROUP /end SUB_GROUP /begin FUNCTION_LIST /end FUNCTION_LIST /begin REF_CHARACTERISTIC CalRegn01Inin00.TunSelnAuthyVehSpdX.Ary1D /end REF_CHARACTERISTIC /begin REF_MEASUREMENT /end REF_MEASUREMENT /end GROUP
/begin GROUP CalRegn01Inin00.VehSigCdngLatASlewRate.Val "MICROSAR RTE" /begin SUB_GROUP /end SUB_GROUP /begin FUNCTION_LIST /end FUNCTION_LIST /begin REF_CHARACTERISTIC CalRegn01Inin00.VehSigCdngLatASlewRate.Val /end REF_CHARACTERISTIC /begin REF_MEASUREMENT /end REF_MEASUREMENT /end GROUP
/begin GROUP CalRegn01Inin00.VehSigCdngLtgASlewRate.Val "MICROSAR RTE" /begin SUB_GROUP /end SUB_GROUP /begin FUNCTION_LIST /end FUNCTION_LIST /begin REF_CHARACTERISTIC CalRegn01Inin00.VehSigCdngLtgASlewRate.Val /end REF_CHARACTERISTIC /begin REF_MEASUREMENT /end REF_MEASUREMENT /end GROUP
/begin GROUP CalRegn01Inin00.VehSigCdngVehSpdSlewRate.Val "MICROSAR RTE" /begin SUB_GROUP /end SUB_GROUP /begin FUNCTION_LIST /end FUNCTION_LIST /begin REF_CHARACTERISTIC CalRegn01Inin00.VehSigCdngVehSpdSlewRate.Val /end REF_CHARACTERISTIC /begin REF_MEASUREMENT /end REF_MEASUREMENT /end GROUP
/begin GROUP CalRegn01Inin00.WhlImbRejctnDcTrendFltRcvryThd.Val "MICROSAR RTE" /begin SUB_GROUP /end SUB_GROUP /begin FUNCTION_LIST /end FUNCTION_LIST /begin REF_CHARACTERISTIC CalRegn01Inin00.WhlImbRejctnDcTrendFltRcvryThd.Val /end REF_CHARACTERISTIC /begin REF_MEASUREMENT /end REF_MEASUREMENT /end GROUP
/begin GROUP CalRegn01Inin00GroupB "MICROSAR RTE" /begin SUB_GROUP CalRegn01Inin00GroupB.CalibrationPorts /end SUB_GROUP /begin FUNCTION_LIST /end FUNCTION_LIST /begin REF_CHARACTERISTIC /end REF_CHARACTERISTIC /begin REF_MEASUREMENT /end REF_MEASUREMENT /end GROUP
/begin GROUP CalRegn01Inin00GroupB.CalibrationPorts "MICROSAR RTE"
 /begin SUB_GROUP CalRegn01Inin00GroupB.GmRoadWhlInQlfrMaxAllwblFrq.Val CalRegn01Inin00GroupB.GmRoadWhlInQlfrMaxFrqChg.Val CalRegn01Inin00GroupB.WhlImbRejctnDcTrendFltRcvryNegStep.Val CalRegn01Inin00GroupB.WhlImbRejctnDcTrendFltRcvryPosStep.Val CalRegn01Inin00GroupB.WhlImbRejctnFrqDiagcAmpThd.Val CalRegn01Inin00GroupB.WhlImbRejctnFrqDiagcFltRcvryNegStep.Val CalRegn01Inin00GroupB.WhlImbRejctnFrqDiagcFltRcvryPosStep.Val CalRegn01Inin00GroupB.WhlImbRejctnFrqDiagcFltRcvryThd.Val CalRegn01Inin00GroupB.WhlImbRejctnFrqDiagcThd.Val CalRegn01Inin00GroupB.WhlImbRejctnFrqDiagcTout.Val CalRegn01Inin00GroupB.WhlImbRejctnMaxMgnFltNegStep.Val CalRegn01Inin00GroupB.WhlImbRejctnMaxMgnFltPosStep.Val CalRegn01Inin00GroupB.WhlImbRejctnMaxMgnFltRcvryNegStep.Val CalRegn01Inin00GroupB.WhlImbRejctnMaxMgnFltRcvryPosStep.Val CalRegn01Inin00GroupB.WhlImbRejctnMaxMgnFltRcvryThd.Val CalRegn01Inin00GroupB.WhlImbRejctnMaxMgnFltThd.Val CalRegn01Inin00GroupB.WhlImbRejctnWhlSpdCorrlnFltRcvryNegStep.Val CalRegn01Inin00GroupB.WhlImbRejctnWhlSpdCorrlnFltRcvryPosStep.Val CalRegn01Inin00GroupB.WhlImbRejctnWhlSpdCorrlnFltRcvryThd.Val /end SUB_GROUP
 /begin FUNCTION_LIST /end FUNCTION_LIST
 /begin REF_CHARACTERISTIC /end REF_CHARACTERISTIC
 /begin REF_MEASUREMENT /end REF_MEASUREMENT
/end GROUP
/begin GROUP CalRegn01Inin00GroupB.GmRoadWhlInQlfrMaxAllwblFrq.Val "MICROSAR RTE" /begin SUB_GROUP /end SUB_GROUP /begin FUNCTION_LIST /end FUNCTION_LIST /begin REF_CHARACTERISTIC CalRegn01Inin00GroupB.GmRoadWhlInQlfrMaxAllwblFrq.Val /end REF_CHARACTERISTIC /begin REF_MEASUREMENT /end REF_MEASUREMENT /end GROUP
/begin GROUP CalRegn01Inin00GroupB.GmRoadWhlInQlfrMaxFrqChg.Val "MICROSAR RTE" /begin SUB_GROUP /end SUB_GROUP /begin FUNCTION_LIST /end FUNCTION_LIST /begin REF_CHARACTERISTIC CalRegn01Inin00GroupB.GmRoadWhlInQlfrMaxFrqChg.Val /end REF_CHARACTERISTIC /begin REF_MEASUREMENT /end REF_MEASUREMENT /end GROUP
/begin GROUP CalRegn01Inin00GroupB.WhlImbRejctnDcTrendFltRcvryNegStep.Val "MICROSAR RTE" /begin SUB_GROUP /end SUB_GROUP /begin FUNCTION_LIST /end FUNCTION_LIST
 /begin REF_CHARACTERISTIC CalRegn01Inin00GroupB.WhlImbRejctnDcTrendFltRcvryNegStep.Val /end REF_CHARACTERISTIC
 /begin REF_MEASUREMENT /end REF_MEASUREMENT
/end GROUP
/begin GROUP CalRegn01Inin00GroupB.WhlImbRejctnDcTrendFltRcvryPosStep.Val "MICROSAR RTE" /begin SUB_GROUP /end SUB_GROUP /begin FUNCTION_LIST /end FUNCTION_LIST
 /begin REF_CHARACTERISTIC CalRegn01Inin00GroupB.WhlImbRejctnDcTrendFltRcvryPosStep.Val /end REF_CHARACTERISTIC
 /begin REF_MEASUREMENT /end REF_MEASUREMENT
/end GROUP
/begin GROUP CalRegn01Inin00GroupB.WhlImbRejctnFrqDiagcAmpThd.Val "MICROSAR RTE" /begin SUB_GROUP /end SUB_GROUP /begin FUNCTION_LIST /end FUNCTION_LIST /begin REF_CHARACTERISTIC CalRegn01Inin00GroupB.WhlImbRejctnFrqDiagcAmpThd.Val /end REF_CHARACTERISTIC /begin REF_MEASUREMENT /end REF_MEASUREMENT /end GROUP
/begin GROUP CalRegn01Inin00GroupB.WhlImbRejctnFrqDiagcFltRcvryNegStep.Val "MICROSAR RTE" /begin SUB_GROUP /end SUB_GROUP /begin FUNCTION_LIST /end FUNCTION_LIST
 /begin REF_CHARACTERISTIC CalRegn01Inin00GroupB.WhlImbRejctnFrqDiagcFltRcvryNegStep.Val /end REF_CHARACTERISTIC
 /begin REF_MEASUREMENT /end REF_MEASUREMENT
/end GROUP
/begin GROUP CalRegn01Inin00GroupB.WhlImbRejctnFrqDiagcFltRcvryPosStep.Val "MICROSAR RTE" /begin SUB_GROUP /end SUB_GROUP /begin FUNCTION_LIST /end FUNCTION_LIST
 /begin REF_CHARACTERISTIC CalRegn01Inin00GroupB.WhlImbRejctnFrqDiagcFltRcvryPosStep.Val /end REF_CHARACTERISTIC
 /begin REF_MEASUREMENT /end REF_MEASUREMENT
/end GROUP
/begin GROUP CalRegn01Inin00GroupB.WhlImbRejctnFrqDiagcFltRcvryThd.Val "MICROSAR RTE" /begin SUB_GROUP /end SUB_GROUP /begin FUNCTION_LIST /end FUNCTION_LIST /begin REF_CHARACTERISTIC CalRegn01Inin00GroupB.WhlImbRejctnFrqDiagcFltRcvryThd.Val /end REF_CHARACTERISTIC /begin REF_MEASUREMENT /end REF_MEASUREMENT /end GROUP
/begin GROUP CalRegn01Inin00GroupB.WhlImbRejctnFrqDiagcThd.Val "MICROSAR RTE" /begin SUB_GROUP /end SUB_GROUP /begin FUNCTION_LIST /end FUNCTION_LIST /begin REF_CHARACTERISTIC CalRegn01Inin00GroupB.WhlImbRejctnFrqDiagcThd.Val /end REF_CHARACTERISTIC /begin REF_MEASUREMENT /end REF_MEASUREMENT /end GROUP
/begin GROUP CalRegn01Inin00GroupB.WhlImbRejctnFrqDiagcTout.Val "MICROSAR RTE" /begin SUB_GROUP /end SUB_GROUP /begin FUNCTION_LIST /end FUNCTION_LIST /begin REF_CHARACTERISTIC CalRegn01Inin00GroupB.WhlImbRejctnFrqDiagcTout.Val /end REF_CHARACTERISTIC /begin REF_MEASUREMENT /end REF_MEASUREMENT /end GROUP
/begin GROUP CalRegn01Inin00GroupB.WhlImbRejctnMaxMgnFltNegStep.Val "MICROSAR RTE" /begin SUB_GROUP /end SUB_GROUP /begin FUNCTION_LIST /end FUNCTION_LIST /begin REF_CHARACTERISTIC CalRegn01Inin00GroupB.WhlImbRejctnMaxMgnFltNegStep.Val /end REF_CHARACTERISTIC /begin REF_MEASUREMENT /end REF_MEASUREMENT /end GROUP
/begin GROUP CalRegn01Inin00GroupB.WhlImbRejctnMaxMgnFltPosStep.Val "MICROSAR RTE" /begin SUB_GROUP /end SUB_GROUP /begin FUNCTION_LIST /end FUNCTION_LIST /begin REF_CHARACTERISTIC CalRegn01Inin00GroupB.WhlImbRejctnMaxMgnFltPosStep.Val /end REF_CHARACTERISTIC /begin REF_MEASUREMENT /end REF_MEASUREMENT /end GROUP
/begin GROUP CalRegn01Inin00GroupB.WhlImbRejctnMaxMgnFltRcvryNegStep.Val "MICROSAR RTE" /begin SUB_GROUP /end SUB_GROUP /begin FUNCTION_LIST /end FUNCTION_LIST
 /begin REF_CHARACTERISTIC CalRegn01Inin00GroupB.WhlImbRejctnMaxMgnFltRcvryNegStep.Val /end REF_CHARACTERISTIC
 /begin REF_MEASUREMENT /end REF_MEASUREMENT
/end GROUP
/begin GROUP CalRegn01Inin00GroupB.WhlImbRejctnMaxMgnFltRcvryPosStep.Val "MICROSAR RTE" /begin SUB_GROUP /end SUB_GROUP /begin FUNCTION_LIST /end FUNCTION_LIST
 /begin REF_CHARACTERISTIC CalRegn01Inin00GroupB.WhlImbRejctnMaxMgnFltRcvryPosStep.Val /end REF_CHARACTERISTIC
 /begin REF_MEASUREMENT /end REF_MEASUREMENT
/end GROUP
/begin GROUP CalRegn01Inin00GroupB.WhlImbRejctnMaxMgnFltRcvryThd.Val "MICROSAR RTE" /begin SUB_GROUP /end SUB_GROUP /begin FUNCTION_LIST /end FUNCTION_LIST /begin REF_CHARACTERISTIC CalRegn01Inin00GroupB.WhlImbRejctnMaxMgnFltRcvryThd.Val /end REF_CHARACTERISTIC /begin REF_MEASUREMENT /end REF_MEASUREMENT /end GROUP
/begin GROUP CalRegn01Inin00GroupB.WhlImbRejctnMaxMgnFltThd.Val "MICROSAR RTE" /begin SUB_GROUP /end SUB_GROUP /begin FUNCTION_LIST /end FUNCTION_LIST /begin REF_CHARACTERISTIC CalRegn01Inin00GroupB.WhlImbRejctnMaxMgnFltThd.Val /end REF_CHARACTERISTIC /begin REF_MEASUREMENT /end REF_MEASUREMENT /end GROUP
/begin GROUP CalRegn01Inin00GroupB.WhlImbRejctnWhlSpdCorrlnFltRcvryNegStep.Val "MICROSAR RTE" /begin SUB_GROUP /end SUB_GROUP /begin FUNCTION_LIST /end FUNCTION_LIST
 /begin REF_CHARACTERISTIC CalRegn01Inin00GroupB.WhlImbRejctnWhlSpdCorrlnFltRcvryNegStep.Val /end REF_CHARACTERISTIC
 /begin REF_MEASUREMENT /end REF_MEASUREMENT
/end GROUP
/begin GROUP CalRegn01Inin00GroupB.WhlImbRejctnWhlSpdCorrlnFltRcvryPosStep.Val "MICROSAR RTE" /begin SUB_GROUP /end SUB_GROUP /begin FUNCTION_LIST /end FUNCTION_LIST
 /begin REF_CHARACTERISTIC CalRegn01Inin00GroupB.WhlImbRejctnWhlSpdCorrlnFltRcvryPosStep.Val /end REF_CHARACTERISTIC
 /begin REF_MEASUREMENT /end REF_MEASUREMENT
/end GROUP
/begin GROUP CalRegn01Inin00GroupB.WhlImbRejctnWhlSpdCorrlnFltRcvryThd.Val "MICROSAR RTE" /begin SUB_GROUP /end SUB_GROUP /begin FUNCTION_LIST /end FUNCTION_LIST
 /begin REF_CHARACTERISTIC CalRegn01Inin00GroupB.WhlImbRejctnWhlSpdCorrlnFltRcvryThd.Val /end REF_CHARACTERISTIC
 /begin REF_MEASUREMENT /end REF_MEASUREMENT
/end GROUP
/begin GROUP CalRegn01Inin00GroupC "MICROSAR RTE" /begin SUB_GROUP CalRegn01Inin00GroupC.CalibrationPorts /end SUB_GROUP /begin FUNCTION_LIST /end FUNCTION_LIST /begin REF_CHARACTERISTIC /end REF_CHARACTERISTIC /begin REF_MEASUREMENT /end REF_MEASUREMENT /end GROUP
/begin GROUP CalRegn01Inin00GroupC.CalibrationPorts "MICROSAR RTE"
 /begin SUB_GROUP CalRegn01Inin00GroupC.EotProtnFwlEotDampgActvBndY.Ary2D CalRegn01Inin00GroupC.GmVehPwrModHwTqMinKeepAssi.Val CalRegn01Inin00GroupC.GmVehPwrModHwTqMinKeepTmr.Val CalRegn01Inin00GroupC.GmVehPwrModVehSpdAssiOnMin.Val CalRegn01Inin00GroupC.GmVehPwrModVehSpdMinKeepAssi.Val /end SUB_GROUP
 /begin FUNCTION_LIST /end FUNCTION_LIST
 /begin REF_CHARACTERISTIC /end REF_CHARACTERISTIC
 /begin REF_MEASUREMENT /end REF_MEASUREMENT
/end GROUP
/begin GROUP CalRegn01Inin00GroupC.EotProtnFwlEotDampgActvBndY.Ary2D "MICROSAR RTE" /begin SUB_GROUP /end SUB_GROUP /begin FUNCTION_LIST /end FUNCTION_LIST /begin REF_CHARACTERISTIC CalRegn01Inin00GroupC.EotProtnFwlEotDampgActvBndY.Ary2D /end REF_CHARACTERISTIC /begin REF_MEASUREMENT /end REF_MEASUREMENT /end GROUP
/begin GROUP CalRegn01Inin00GroupC.GmVehPwrModHwTqMinKeepAssi.Val "MICROSAR RTE" /begin SUB_GROUP /end SUB_GROUP /begin FUNCTION_LIST /end FUNCTION_LIST /begin REF_CHARACTERISTIC CalRegn01Inin00GroupC.GmVehPwrModHwTqMinKeepAssi.Val /end REF_CHARACTERISTIC /begin REF_MEASUREMENT /end REF_MEASUREMENT /end GROUP
/begin GROUP CalRegn01Inin00GroupC.GmVehPwrModHwTqMinKeepTmr.Val "MICROSAR RTE" /begin SUB_GROUP /end SUB_GROUP /begin FUNCTION_LIST /end FUNCTION_LIST /begin REF_CHARACTERISTIC CalRegn01Inin00GroupC.GmVehPwrModHwTqMinKeepTmr.Val /end REF_CHARACTERISTIC /begin REF_MEASUREMENT /end REF_MEASUREMENT /end GROUP
/begin GROUP CalRegn01Inin00GroupC.GmVehPwrModVehSpdAssiOnMin.Val "MICROSAR RTE" /begin SUB_GROUP /end SUB_GROUP /begin FUNCTION_LIST /end FUNCTION_LIST /begin REF_CHARACTERISTIC CalRegn01Inin00GroupC.GmVehPwrModVehSpdAssiOnMin.Val /end REF_CHARACTERISTIC /begin REF_MEASUREMENT /end REF_MEASUREMENT /end GROUP
/begin GROUP CalRegn01Inin00GroupC.GmVehPwrModVehSpdMinKeepAssi.Val "MICROSAR RTE" /begin SUB_GROUP /end SUB_GROUP /begin FUNCTION_LIST /end FUNCTION_LIST /begin REF_CHARACTERISTIC CalRegn01Inin00GroupC.GmVehPwrModVehSpdMinKeepAssi.Val /end REF_CHARACTERISTIC /begin REF_MEASUREMENT /end REF_MEASUREMENT /end GROUP
/begin GROUP CalRegn01Rt00 "MICROSAR RTE" /begin SUB_GROUP CalRegn01Rt00.CalibrationPorts /end SUB_GROUP /begin FUNCTION_LIST /end FUNCTION_LIST /begin REF_CHARACTERISTIC /end REF_CHARACTERISTIC /begin REF_MEASUREMENT /end REF_MEASUREMENT /end GROUP
/begin GROUP CalRegn01Rt00.CalibrationPorts "MICROSAR RTE"
 /begin SUB_GROUP CalRegn01Rt00.TEstimnMagAmbMplr.Val CalRegn01Rt00.TunSelnAuthyHwTqY.Ary1D CalRegn01Rt00.TunSelnAuthyHwVelY.Ary1D /end SUB_GROUP
 /begin FUNCTION_LIST /end FUNCTION_LIST
 /begin REF_CHARACTERISTIC /end REF_CHARACTERISTIC
 /begin REF_MEASUREMENT /end REF_MEASUREMENT
/end GROUP
/begin GROUP CalRegn01Rt00.TEstimnMagAmbMplr.Val "MICROSAR RTE" /begin SUB_GROUP /end SUB_GROUP /begin FUNCTION_LIST /end FUNCTION_LIST /begin REF_CHARACTERISTIC CalRegn01Rt00.TEstimnMagAmbMplr.Val /end REF_CHARACTERISTIC /begin REF_MEASUREMENT /end REF_MEASUREMENT /end GROUP
/begin GROUP CalRegn01Rt00.TunSelnAuthyHwTqY.Ary1D "MICROSAR RTE" /begin SUB_GROUP /end SUB_GROUP /begin FUNCTION_LIST /end FUNCTION_LIST /begin REF_CHARACTERISTIC CalRegn01Rt00.TunSelnAuthyHwTqY.Ary1D /end REF_CHARACTERISTIC /begin REF_MEASUREMENT /end REF_MEASUREMENT /end GROUP
/begin GROUP CalRegn01Rt00.TunSelnAuthyHwVelY.Ary1D "MICROSAR RTE" /begin SUB_GROUP /end SUB_GROUP /begin FUNCTION_LIST /end FUNCTION_LIST /begin REF_CHARACTERISTIC CalRegn01Rt00.TunSelnAuthyHwVelY.Ary1D /end REF_CHARACTERISTIC /begin REF_MEASUREMENT /end REF_MEASUREMENT /end GROUP
/begin GROUP CalRegn01Rt01 "MICROSAR RTE" /begin SUB_GROUP CalRegn01Rt01.CalibrationPorts /end SUB_GROUP /begin FUNCTION_LIST /end FUNCTION_LIST /begin REF_CHARACTERISTIC /end REF_CHARACTERISTIC /begin REF_MEASUREMENT /end REF_MEASUREMENT /end GROUP
/begin GROUP CalRegn01Rt01.CalibrationPorts "MICROSAR RTE"
 /begin SUB_GROUP CalRegn01Rt01.TEstimnMagAmbMplr.Val CalRegn01Rt01.TunSelnAuthyHwTqY.Ary1D CalRegn01Rt01.TunSelnAuthyHwVelY.Ary1D /end SUB_GROUP
 /begin FUNCTION_LIST /end FUNCTION_LIST
 /begin REF_CHARACTERISTIC /end REF_CHARACTERISTIC
 /begin REF_MEASUREMENT /end REF_MEASUREMENT
/end GROUP
/begin GROUP CalRegn01Rt01.TEstimnMagAmbMplr.Val "MICROSAR RTE" /begin SUB_GROUP /end SUB_GROUP /begin FUNCTION_LIST /end FUNCTION_LIST /begin REF_CHARACTERISTIC CalRegn01Rt01.TEstimnMagAmbMplr.Val /end REF_CHARACTERISTIC /begin REF_MEASUREMENT /end REF_MEASUREMENT /end GROUP
/begin GROUP CalRegn01Rt01.TunSelnAuthyHwTqY.Ary1D "MICROSAR RTE" /begin SUB_GROUP /end SUB_GROUP /begin FUNCTION_LIST /end FUNCTION_LIST /begin REF_CHARACTERISTIC CalRegn01Rt01.TunSelnAuthyHwTqY.Ary1D /end REF_CHARACTERISTIC /begin REF_MEASUREMENT /end REF_MEASUREMENT /end GROUP
/begin GROUP CalRegn01Rt01.TunSelnAuthyHwVelY.Ary1D "MICROSAR RTE" /begin SUB_GROUP /end SUB_GROUP /begin FUNCTION_LIST /end FUNCTION_LIST /begin REF_CHARACTERISTIC CalRegn01Rt01.TunSelnAuthyHwVelY.Ary1D /end REF_CHARACTERISTIC /begin REF_MEASUREMENT /end REF_MEASUREMENT /end GROUP
/begin GROUP CalRegn01Rt02 "MICROSAR RTE" /begin SUB_GROUP CalRegn01Rt02.CalibrationPorts /end SUB_GROUP /begin FUNCTION_LIST /end FUNCTION_LIST /begin REF_CHARACTERISTIC /end REF_CHARACTERISTIC /begin REF_MEASUREMENT /end REF_MEASUREMENT /end GROUP
/begin GROUP CalRegn01Rt02.CalibrationPorts "MICROSAR RTE"
 /begin SUB_GROUP CalRegn01Rt02.TEstimnMagAmbMplr.Val CalRegn01Rt02.TunSelnAuthyHwTqY.Ary1D CalRegn01Rt02.TunSelnAuthyHwVelY.Ary1D /end SUB_GROUP
 /begin FUNCTION_LIST /end FUNCTION_LIST
 /begin REF_CHARACTERISTIC /end REF_CHARACTERISTIC
 /begin REF_MEASUREMENT /end REF_MEASUREMENT
/end GROUP
/begin GROUP CalRegn01Rt02.TEstimnMagAmbMplr.Val "MICROSAR RTE" /begin SUB_GROUP /end SUB_GROUP /begin FUNCTION_LIST /end FUNCTION_LIST /begin REF_CHARACTERISTIC CalRegn01Rt02.TEstimnMagAmbMplr.Val /end REF_CHARACTERISTIC /begin REF_MEASUREMENT /end REF_MEASUREMENT /end GROUP
/begin GROUP CalRegn01Rt02.TunSelnAuthyHwTqY.Ary1D "MICROSAR RTE" /begin SUB_GROUP /end SUB_GROUP /begin FUNCTION_LIST /end FUNCTION_LIST /begin REF_CHARACTERISTIC CalRegn01Rt02.TunSelnAuthyHwTqY.Ary1D /end REF_CHARACTERISTIC /begin REF_MEASUREMENT /end REF_MEASUREMENT /end GROUP
/begin GROUP CalRegn01Rt02.TunSelnAuthyHwVelY.Ary1D "MICROSAR RTE" /begin SUB_GROUP /end SUB_GROUP /begin FUNCTION_LIST /end FUNCTION_LIST /begin REF_CHARACTERISTIC CalRegn01Rt02.TunSelnAuthyHwVelY.Ary1D /end REF_CHARACTERISTIC /begin REF_MEASUREMENT /end REF_MEASUREMENT /end GROUP
/begin GROUP CalRegn01Rt03 "MICROSAR RTE" /begin SUB_GROUP CalRegn01Rt03.CalibrationPorts /end SUB_GROUP /begin FUNCTION_LIST /end FUNCTION_LIST /begin REF_CHARACTERISTIC /end REF_CHARACTERISTIC /begin REF_MEASUREMENT /end REF_MEASUREMENT /end GROUP
/begin GROUP CalRegn01Rt03.CalibrationPorts "MICROSAR RTE"
 /begin SUB_GROUP CalRegn01Rt03.TEstimnMagAmbMplr.Val CalRegn01Rt03.TunSelnAuthyHwTqY.Ary1D CalRegn01Rt03.TunSelnAuthyHwVelY.Ary1D /end SUB_GROUP
 /begin FUNCTION_LIST /end FUNCTION_LIST
 /begin REF_CHARACTERISTIC /end REF_CHARACTERISTIC
 /begin REF_MEASUREMENT /end REF_MEASUREMENT
/end GROUP
/begin GROUP CalRegn01Rt03.TEstimnMagAmbMplr.Val "MICROSAR RTE" /begin SUB_GROUP /end SUB_GROUP /begin FUNCTION_LIST /end FUNCTION_LIST /begin REF_CHARACTERISTIC CalRegn01Rt03.TEstimnMagAmbMplr.Val /end REF_CHARACTERISTIC /begin REF_MEASUREMENT /end REF_MEASUREMENT /end GROUP
/begin GROUP CalRegn01Rt03.TunSelnAuthyHwTqY.Ary1D "MICROSAR RTE" /begin SUB_GROUP /end SUB_GROUP /begin FUNCTION_LIST /end FUNCTION_LIST /begin REF_CHARACTERISTIC CalRegn01Rt03.TunSelnAuthyHwTqY.Ary1D /end REF_CHARACTERISTIC /begin REF_MEASUREMENT /end REF_MEASUREMENT /end GROUP
/begin GROUP CalRegn01Rt03.TunSelnAuthyHwVelY.Ary1D "MICROSAR RTE" /begin SUB_GROUP /end SUB_GROUP /begin FUNCTION_LIST /end FUNCTION_LIST /begin REF_CHARACTERISTIC CalRegn01Rt03.TunSelnAuthyHwVelY.Ary1D /end REF_CHARACTERISTIC /begin REF_MEASUREMENT /end REF_MEASUREMENT /end GROUP
/begin GROUP CalRegn01Rt04 "MICROSAR RTE" /begin SUB_GROUP CalRegn01Rt04.CalibrationPorts /end SUB_GROUP /begin FUNCTION_LIST /end FUNCTION_LIST /begin REF_CHARACTERISTIC /end REF_CHARACTERISTIC /begin REF_MEASUREMENT /end REF_MEASUREMENT /end GROUP
/begin GROUP CalRegn01Rt04.CalibrationPorts "MICROSAR RTE"
 /begin SUB_GROUP CalRegn01Rt04.TEstimnMagAmbMplr.Val CalRegn01Rt04.TunSelnAuthyHwTqY.Ary1D CalRegn01Rt04.TunSelnAuthyHwVelY.Ary1D /end SUB_GROUP
 /begin FUNCTION_LIST /end FUNCTION_LIST
 /begin REF_CHARACTERISTIC /end REF_CHARACTERISTIC
 /begin REF_MEASUREMENT /end REF_MEASUREMENT
/end GROUP
/begin GROUP CalRegn01Rt04.TEstimnMagAmbMplr.Val "MICROSAR RTE" /begin SUB_GROUP /end SUB_GROUP /begin FUNCTION_LIST /end FUNCTION_LIST /begin REF_CHARACTERISTIC CalRegn01Rt04.TEstimnMagAmbMplr.Val /end REF_CHARACTERISTIC /begin REF_MEASUREMENT /end REF_MEASUREMENT /end GROUP
/begin GROUP CalRegn01Rt04.TunSelnAuthyHwTqY.Ary1D "MICROSAR RTE" /begin SUB_GROUP /end SUB_GROUP /begin FUNCTION_LIST /end FUNCTION_LIST /begin REF_CHARACTERISTIC CalRegn01Rt04.TunSelnAuthyHwTqY.Ary1D /end REF_CHARACTERISTIC /begin REF_MEASUREMENT /end REF_MEASUREMENT /end GROUP
/begin GROUP CalRegn01Rt04.TunSelnAuthyHwVelY.Ary1D "MICROSAR RTE" /begin SUB_GROUP /end SUB_GROUP /begin FUNCTION_LIST /end FUNCTION_LIST /begin REF_CHARACTERISTIC CalRegn01Rt04.TunSelnAuthyHwVelY.Ary1D /end REF_CHARACTERISTIC /begin REF_MEASUREMENT /end REF_MEASUREMENT /end GROUP
/begin GROUP CalRegn02Cmn "MICROSAR RTE" /begin SUB_GROUP CalRegn02Cmn.CalibrationPorts /end SUB_GROUP /begin FUNCTION_LIST /end FUNCTION_LIST /begin REF_CHARACTERISTIC /end REF_CHARACTERISTIC /begin REF_MEASUREMENT /end REF_MEASUREMENT /end GROUP
/begin GROUP CalRegn02Cmn.CalibrationPorts "MICROSAR RTE"
 /begin SUB_GROUP CalRegn02Cmn.DiagcMgrFltResp.Ary1D CalRegn02Cmn.InertiaCmpVelDecelGainEnaCal.Logl CalRegn02Cmn.NxtrCalIdsCal1DevlpAuthor.Ary1D CalRegn02Cmn.NxtrCalIdsCal1DevlpDesc.Ary1D CalRegn02Cmn.NxtrCalIdsCal1DevlpRelNr.Val CalRegn02Cmn.NxtrCalIdsCal1DevlpRelSt.Val CalRegn02Cmn.NxtrCalIdsCal1DevlpTiStamp.Val CalRegn02Cmn.NxtrCalIdsCal1DevlpVers.Val CalRegn02Cmn.SnsrOffsCorrnHwAgLrndOffsLim.Val CalRegn02Cmn.SnsrOffsCorrnHwTqLrndOffsLim.Val CalRegn02Cmn.SnsrOffsCorrnOffsEna.Logl CalRegn02Cmn.SnsrOffsCorrnVehYawRateLrndOffsLim.Val CalRegn02Cmn.SnsrOffsLrngHwAgLrngTi.Val CalRegn02Cmn.SnsrOffsLrngHwTqLrngHwTqZeroOffsThd.Val CalRegn02Cmn.SnsrOffsLrngHwTqLrngMeasTi.Val CalRegn02Cmn.SnsrOffsLrngHwTqLrngSampleImbThd1.Val CalRegn02Cmn.SnsrOffsLrngHwTqLrngSampleImbThd2.Val CalRegn02Cmn.SnsrOffsLrngHwTqLrngSampleThd1.Val CalRegn02Cmn.SnsrOffsLrngHwTqLrngSampleThd2.Val CalRegn02Cmn.SnsrOffsLrngHwTqLrngTiWghtCoeff.Val CalRegn02Cmn.SnsrOffsLrngYawLrngTi.Val /end SUB_GROUP
 /begin FUNCTION_LIST /end FUNCTION_LIST
 /begin REF_CHARACTERISTIC /end REF_CHARACTERISTIC
 /begin REF_MEASUREMENT /end REF_MEASUREMENT
/end GROUP
/begin GROUP CalRegn02Cmn.DiagcMgrFltResp.Ary1D "MICROSAR RTE" /begin SUB_GROUP /end SUB_GROUP /begin FUNCTION_LIST /end FUNCTION_LIST /begin REF_CHARACTERISTIC CalRegn02Cmn.DiagcMgrFltResp.Ary1D /end REF_CHARACTERISTIC /begin REF_MEASUREMENT /end REF_MEASUREMENT /end GROUP
/begin GROUP CalRegn02Cmn.InertiaCmpVelDecelGainEnaCal.Logl "MICROSAR RTE" /begin SUB_GROUP /end SUB_GROUP /begin FUNCTION_LIST /end FUNCTION_LIST /begin REF_CHARACTERISTIC CalRegn02Cmn.InertiaCmpVelDecelGainEnaCal.Logl /end REF_CHARACTERISTIC /begin REF_MEASUREMENT /end REF_MEASUREMENT /end GROUP
/begin GROUP CalRegn02Cmn.NxtrCalIdsCal1DevlpAuthor.Ary1D "MICROSAR RTE" /begin SUB_GROUP /end SUB_GROUP /begin FUNCTION_LIST /end FUNCTION_LIST /begin REF_CHARACTERISTIC CalRegn02Cmn.NxtrCalIdsCal1DevlpAuthor.Ary1D /end REF_CHARACTERISTIC /begin REF_MEASUREMENT /end REF_MEASUREMENT /end GROUP
/begin GROUP CalRegn02Cmn.NxtrCalIdsCal1DevlpDesc.Ary1D "MICROSAR RTE" /begin SUB_GROUP /end SUB_GROUP /begin FUNCTION_LIST /end FUNCTION_LIST /begin REF_CHARACTERISTIC CalRegn02Cmn.NxtrCalIdsCal1DevlpDesc.Ary1D /end REF_CHARACTERISTIC /begin REF_MEASUREMENT /end REF_MEASUREMENT /end GROUP
/begin GROUP CalRegn02Cmn.NxtrCalIdsCal1DevlpRelNr.Val "MICROSAR RTE" /begin SUB_GROUP /end SUB_GROUP /begin FUNCTION_LIST /end FUNCTION_LIST /begin REF_CHARACTERISTIC CalRegn02Cmn.NxtrCalIdsCal1DevlpRelNr.Val /end REF_CHARACTERISTIC /begin REF_MEASUREMENT /end REF_MEASUREMENT /end GROUP
/begin GROUP CalRegn02Cmn.NxtrCalIdsCal1DevlpRelSt.Val "MICROSAR RTE" /begin SUB_GROUP /end SUB_GROUP /begin FUNCTION_LIST /end FUNCTION_LIST /begin REF_CHARACTERISTIC CalRegn02Cmn.NxtrCalIdsCal1DevlpRelSt.Val /end REF_CHARACTERISTIC /begin REF_MEASUREMENT /end REF_MEASUREMENT /end GROUP
/begin GROUP CalRegn02Cmn.NxtrCalIdsCal1DevlpTiStamp.Val "MICROSAR RTE" /begin SUB_GROUP /end SUB_GROUP /begin FUNCTION_LIST /end FUNCTION_LIST /begin REF_CHARACTERISTIC CalRegn02Cmn.NxtrCalIdsCal1DevlpTiStamp.Val /end REF_CHARACTERISTIC /begin REF_MEASUREMENT /end REF_MEASUREMENT /end GROUP
/begin GROUP CalRegn02Cmn.NxtrCalIdsCal1DevlpVers.Val "MICROSAR RTE" /begin SUB_GROUP /end SUB_GROUP /begin FUNCTION_LIST /end FUNCTION_LIST /begin REF_CHARACTERISTIC CalRegn02Cmn.NxtrCalIdsCal1DevlpVers.Val /end REF_CHARACTERISTIC /begin REF_MEASUREMENT /end REF_MEASUREMENT /end GROUP
/begin GROUP CalRegn02Cmn.SnsrOffsCorrnHwAgLrndOffsLim.Val "MICROSAR RTE" /begin SUB_GROUP /end SUB_GROUP /begin FUNCTION_LIST /end FUNCTION_LIST /begin REF_CHARACTERISTIC CalRegn02Cmn.SnsrOffsCorrnHwAgLrndOffsLim.Val /end REF_CHARACTERISTIC /begin REF_MEASUREMENT /end REF_MEASUREMENT /end GROUP
/begin GROUP CalRegn02Cmn.SnsrOffsCorrnHwTqLrndOffsLim.Val "MICROSAR RTE" /begin SUB_GROUP /end SUB_GROUP /begin FUNCTION_LIST /end FUNCTION_LIST /begin REF_CHARACTERISTIC CalRegn02Cmn.SnsrOffsCorrnHwTqLrndOffsLim.Val /end REF_CHARACTERISTIC /begin REF_MEASUREMENT /end REF_MEASUREMENT /end GROUP
/begin GROUP CalRegn02Cmn.SnsrOffsCorrnOffsEna.Logl "MICROSAR RTE" /begin SUB_GROUP /end SUB_GROUP /begin FUNCTION_LIST /end FUNCTION_LIST /begin REF_CHARACTERISTIC CalRegn02Cmn.SnsrOffsCorrnOffsEna.Logl /end REF_CHARACTERISTIC /begin REF_MEASUREMENT /end REF_MEASUREMENT /end GROUP
/begin GROUP CalRegn02Cmn.SnsrOffsCorrnVehYawRateLrndOffsLim.Val "MICROSAR RTE" /begin SUB_GROUP /end SUB_GROUP /begin FUNCTION_LIST /end FUNCTION_LIST /begin REF_CHARACTERISTIC CalRegn02Cmn.SnsrOffsCorrnVehYawRateLrndOffsLim.Val /end REF_CHARACTERISTIC /begin REF_MEASUREMENT /end REF_MEASUREMENT /end GROUP
/begin GROUP CalRegn02Cmn.SnsrOffsLrngHwAgLrngTi.Val "MICROSAR RTE" /begin SUB_GROUP /end SUB_GROUP /begin FUNCTION_LIST /end FUNCTION_LIST /begin REF_CHARACTERISTIC CalRegn02Cmn.SnsrOffsLrngHwAgLrngTi.Val /end REF_CHARACTERISTIC /begin REF_MEASUREMENT /end REF_MEASUREMENT /end GROUP
/begin GROUP CalRegn02Cmn.SnsrOffsLrngHwTqLrngHwTqZeroOffsThd.Val "MICROSAR RTE" /begin SUB_GROUP /end SUB_GROUP /begin FUNCTION_LIST /end FUNCTION_LIST /begin REF_CHARACTERISTIC CalRegn02Cmn.SnsrOffsLrngHwTqLrngHwTqZeroOffsThd.Val /end REF_CHARACTERISTIC /begin REF_MEASUREMENT /end REF_MEASUREMENT /end GROUP
/begin GROUP CalRegn02Cmn.SnsrOffsLrngHwTqLrngMeasTi.Val "MICROSAR RTE" /begin SUB_GROUP /end SUB_GROUP /begin FUNCTION_LIST /end FUNCTION_LIST /begin REF_CHARACTERISTIC CalRegn02Cmn.SnsrOffsLrngHwTqLrngMeasTi.Val /end REF_CHARACTERISTIC /begin REF_MEASUREMENT /end REF_MEASUREMENT /end GROUP
/begin GROUP CalRegn02Cmn.SnsrOffsLrngHwTqLrngSampleImbThd1.Val "MICROSAR RTE" /begin SUB_GROUP /end SUB_GROUP /begin FUNCTION_LIST /end FUNCTION_LIST /begin REF_CHARACTERISTIC CalRegn02Cmn.SnsrOffsLrngHwTqLrngSampleImbThd1.Val /end REF_CHARACTERISTIC /begin REF_MEASUREMENT /end REF_MEASUREMENT /end GROUP
/begin GROUP CalRegn02Cmn.SnsrOffsLrngHwTqLrngSampleImbThd2.Val "MICROSAR RTE" /begin SUB_GROUP /end SUB_GROUP /begin FUNCTION_LIST /end FUNCTION_LIST /begin REF_CHARACTERISTIC CalRegn02Cmn.SnsrOffsLrngHwTqLrngSampleImbThd2.Val /end REF_CHARACTERISTIC /begin REF_MEASUREMENT /end REF_MEASUREMENT /end GROUP
/begin GROUP CalRegn02Cmn.SnsrOffsLrngHwTqLrngSampleThd1.Val "MICROSAR RTE" /begin SUB_GROUP /end SUB_GROUP /begin FUNCTION_LIST /end FUNCTION_LIST /begin REF_CHARACTERISTIC CalRegn02Cmn.SnsrOffsLrngHwTqLrngSampleThd1.Val /end REF_CHARACTERISTIC /begin REF_MEASUREMENT /end REF_MEASUREMENT /end GROUP
/begin GROUP CalRegn02Cmn.SnsrOffsLrngHwTqLrngSampleThd2.Val "MICROSAR RTE" /begin SUB_GROUP /end SUB_GROUP /begin FUNCTION_LIST /end FUNCTION_LIST /begin REF_CHARACTERISTIC CalRegn02Cmn.SnsrOffsLrngHwTqLrngSampleThd2.Val /end REF_CHARACTERISTIC /begin REF_MEASUREMENT /end REF_MEASUREMENT /end GROUP
/begin GROUP CalRegn02Cmn.SnsrOffsLrngHwTqLrngTiWghtCoeff.Val "MICROSAR RTE" /begin SUB_GROUP /end SUB_GROUP /begin FUNCTION_LIST /end FUNCTION_LIST /begin REF_CHARACTERISTIC CalRegn02Cmn.SnsrOffsLrngHwTqLrngTiWghtCoeff.Val /end REF_CHARACTERISTIC /begin REF_MEASUREMENT /end REF_MEASUREMENT /end GROUP
/begin GROUP CalRegn02Cmn.SnsrOffsLrngYawLrngTi.Val "MICROSAR RTE" /begin SUB_GROUP /end SUB_GROUP /begin FUNCTION_LIST /end FUNCTION_LIST /begin REF_CHARACTERISTIC CalRegn02Cmn.SnsrOffsLrngYawLrngTi.Val /end REF_CHARACTERISTIC /begin REF_MEASUREMENT /end REF_MEASUREMENT /end GROUP
/begin GROUP CalRegn02CmnGroupA "MICROSAR RTE" /begin SUB_GROUP CalRegn02CmnGroupA.CalibrationPorts /end SUB_GROUP /begin FUNCTION_LIST /end FUNCTION_LIST /begin REF_CHARACTERISTIC /end REF_CHARACTERISTIC /begin REF_MEASUREMENT /end REF_MEASUREMENT /end GROUP
/begin GROUP CalRegn02CmnGroupA.CalibrationPorts "MICROSAR RTE"
 /begin SUB_GROUP CalRegn02CmnGroupA.GmOvrlStMgrApaMfgEna.Logl CalRegn02CmnGroupA.GmOvrlStMgrEscMfgEna.Logl CalRegn02CmnGroupA.GmOvrlStMgrLkaHwTqThd1.Val CalRegn02CmnGroupA.GmOvrlStMgrLkaHwTqThd2.Val CalRegn02CmnGroupA.GmOvrlStMgrLkaMfgEna.Logl CalRegn02CmnGroupA.PullCmpActvEna.Logl /end SUB_GROUP
 /begin FUNCTION_LIST /end FUNCTION_LIST
 /begin REF_CHARACTERISTIC /end REF_CHARACTERISTIC
 /begin REF_MEASUREMENT /end REF_MEASUREMENT
/end GROUP
/begin GROUP CalRegn02CmnGroupA.GmOvrlStMgrApaMfgEna.Logl "MICROSAR RTE" /begin SUB_GROUP /end SUB_GROUP /begin FUNCTION_LIST /end FUNCTION_LIST /begin REF_CHARACTERISTIC CalRegn02CmnGroupA.GmOvrlStMgrApaMfgEna.Logl /end REF_CHARACTERISTIC /begin REF_MEASUREMENT /end REF_MEASUREMENT /end GROUP
/begin GROUP CalRegn02CmnGroupA.GmOvrlStMgrEscMfgEna.Logl "MICROSAR RTE" /begin SUB_GROUP /end SUB_GROUP /begin FUNCTION_LIST /end FUNCTION_LIST /begin REF_CHARACTERISTIC CalRegn02CmnGroupA.GmOvrlStMgrEscMfgEna.Logl /end REF_CHARACTERISTIC /begin REF_MEASUREMENT /end REF_MEASUREMENT /end GROUP
/begin GROUP CalRegn02CmnGroupA.GmOvrlStMgrLkaHwTqThd1.Val "MICROSAR RTE" /begin SUB_GROUP /end SUB_GROUP /begin FUNCTION_LIST /end FUNCTION_LIST /begin REF_CHARACTERISTIC CalRegn02CmnGroupA.GmOvrlStMgrLkaHwTqThd1.Val /end REF_CHARACTERISTIC /begin REF_MEASUREMENT /end REF_MEASUREMENT /end GROUP
/begin GROUP CalRegn02CmnGroupA.GmOvrlStMgrLkaHwTqThd2.Val "MICROSAR RTE" /begin SUB_GROUP /end SUB_GROUP /begin FUNCTION_LIST /end FUNCTION_LIST /begin REF_CHARACTERISTIC CalRegn02CmnGroupA.GmOvrlStMgrLkaHwTqThd2.Val /end REF_CHARACTERISTIC /begin REF_MEASUREMENT /end REF_MEASUREMENT /end GROUP
/begin GROUP CalRegn02CmnGroupA.GmOvrlStMgrLkaMfgEna.Logl "MICROSAR RTE" /begin SUB_GROUP /end SUB_GROUP /begin FUNCTION_LIST /end FUNCTION_LIST /begin REF_CHARACTERISTIC CalRegn02CmnGroupA.GmOvrlStMgrLkaMfgEna.Logl /end REF_CHARACTERISTIC /begin REF_MEASUREMENT /end REF_MEASUREMENT /end GROUP
/begin GROUP CalRegn02CmnGroupA.PullCmpActvEna.Logl "MICROSAR RTE" /begin SUB_GROUP /end SUB_GROUP /begin FUNCTION_LIST /end FUNCTION_LIST /begin REF_CHARACTERISTIC CalRegn02CmnGroupA.PullCmpActvEna.Logl /end REF_CHARACTERISTIC /begin REF_MEASUREMENT /end REF_MEASUREMENT /end GROUP
/begin GROUP CalRegn02CmnGroupB "MICROSAR RTE" /begin SUB_GROUP CalRegn02CmnGroupB.CalibrationPorts /end SUB_GROUP /begin FUNCTION_LIST /end FUNCTION_LIST /begin REF_CHARACTERISTIC /end REF_CHARACTERISTIC /begin REF_MEASUREMENT /end REF_MEASUREMENT /end GROUP
/begin GROUP CalRegn02CmnGroupB.CalibrationPorts "MICROSAR RTE" /begin SUB_GROUP CalRegn02CmnGroupB.WhlImbRejctnFctEna.Logl /end SUB_GROUP /begin FUNCTION_LIST /end FUNCTION_LIST /begin REF_CHARACTERISTIC /end REF_CHARACTERISTIC /begin REF_MEASUREMENT /end REF_MEASUREMENT /end GROUP
/begin GROUP CalRegn02CmnGroupB.WhlImbRejctnFctEna.Logl "MICROSAR RTE" /begin SUB_GROUP /end SUB_GROUP /begin FUNCTION_LIST /end FUNCTION_LIST /begin REF_CHARACTERISTIC CalRegn02CmnGroupB.WhlImbRejctnFctEna.Logl /end REF_CHARACTERISTIC /begin REF_MEASUREMENT /end REF_MEASUREMENT /end GROUP
/begin GROUP CalRegn02CmnGroupC "MICROSAR RTE" /begin SUB_GROUP CalRegn02CmnGroupC.CalibrationPorts /end SUB_GROUP /begin FUNCTION_LIST /end FUNCTION_LIST /begin REF_CHARACTERISTIC /end REF_CHARACTERISTIC /begin REF_MEASUREMENT /end REF_MEASUREMENT /end GROUP
/**********************************************************************************************************************
* RECORD_LAYOUT
*********************************************************************************************************************/
/begin RECORD_LAYOUT RTE_RL_UBYTE FNC_VALUES 1 UBYTE ROW_DIR DIRECT /end RECORD_LAYOUT
/begin RECORD_LAYOUT RTE_RL_UWORD FNC_VALUES 1 UWORD ROW_DIR DIRECT /end RECORD_LAYOUT
/begin RECORD_LAYOUT RTE_RL_ULONG FNC_VALUES 1 ULONG ROW_DIR DIRECT /end RECORD_LAYOUT
/begin RECORD_LAYOUT RTE_RL_SWORD FNC_VALUES 1 SWORD ROW_DIR DIRECT /end RECORD_LAYOUT
/begin RECORD_LAYOUT RTE_RL_FLOAT32_IEEE FNC_VALUES 1 FLOAT32_IEEE ROW_DIR DIRECT /end RECORD_LAYOUT
/begin RECORD_LAYOUT RTE_RL_BOOLEAN FNC_VALUES 1 UBYTE ROW_DIR DIRECT /end RECORD_LAYOUT
/**********************************************************************************************************************
* COMPU_METHOD / COMPU_VTAB_RANGE
*********************************************************************************************************************/
/begin COMPU_METHOD RTE_CM_BOOLEAN "" TAB_VERB "%3.1" "" COMPU_TAB_REF RTE_CM_BOOLEAN /end COMPU_METHOD
/begin COMPU_VTAB_RANGE RTE_CM_BOOLEAN "" 2 0 0 "false" 1 255 "true" /end COMPU_VTAB_RANGE
/begin COMPU_METHOD RTE_CM_Spd2 "" RAT_FUNC "%.1" "kph" COEFFS 0 128 0 0 0 1 /end COMPU_METHOD
