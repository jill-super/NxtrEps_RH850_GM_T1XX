/begin CHARACTERISTIC TunSelnAuthy.TunSelnAuthyHwVelY.Ary1D "MICROSAR RTE" VAL_BLK 0x0 RTE_RL_UWORD 0 NO_COMPU_METHOD 0 65535 MATRIX_DIM 6 1 1 SYMBOL_LINK "Rte_CalprmRom_CalRegn01Rt00_DEFAULT_RTE_CALPRM_GROUP.TunSelnAuthyHwVelY_Ary1D" 0 DISPLAY_IDENTIFIER TunSelnAuthy.CalibrationPorts.TunSelnAuthyHwVelY.Ary1D /end CHARACTERISTIC
/begin CHARACTERISTIC TunSelnAuthy.TunSelnAuthyTunSelnRtDiCmd.Logl "MICROSAR RTE" VALUE 0x0 RTE_RL_BOOLEAN 0 RTE_CM_BOOLEAN 0 255 SYMBOL_LINK "Rte_CalprmRom_CalRegn01Cmn_DEFAULT_RTE_CALPRM_GROUP.TunSelnAuthyTunSelnRtDiCmd_Logl" 0 DISPLAY_IDENTIFIER TunSelnAuthy.CalibrationPorts.TunSelnAuthyTunSelnRtDiCmd.Logl /end CHARACTERISTIC
/begin CHARACTERISTIC TunSelnAuthy.TunSelnAuthyVehSpdX.Ary1D "MICROSAR RTE" VAL_BLK 0x0 RTE_RL_UWORD 0 NO_COMPU_METHOD 0 65535 MATRIX_DIM 6 1 1 SYMBOL_LINK "Rte_CalprmRom_CalRegn01Inin00_DEFAULT_RTE_CALPRM_GROUP.TunSelnAuthyVehSpdX_Ary1D" 0 DISPLAY_IDENTIFIER TunSelnAuthy.CalibrationPorts.TunSelnAuthyVehSpdX.Ary1D /end CHARACTERISTIC
/begin CHARACTERISTIC VehSigCdng.VehSigCdngDftLatA.Val "MICROSAR RTE" VALUE 0x0 RTE_RL_FLOAT32_IEEE 0 NO_COMPU_METHOD -10.0 10.0 SYMBOL_LINK "Rte_CalprmRom_CalRegn01Cmn_DEFAULT_RTE_CALPRM_GROUP.VehSigCdngDftLatA_Val" 0 DISPLAY_IDENTIFIER VehSigCdng.CalibrationPorts.VehSigCdngDftLatA.Val /end CHARACTERISTIC
/begin CHARACTERISTIC VehSigCdng.VehSigCdngDftLgtA.Val "MICROSAR RTE" VALUE 0x0 RTE_RL_FLOAT32_IEEE 0 NO_COMPU_METHOD -50.0 50.0 SYMBOL_LINK "Rte_CalprmRom_CalRegn01Cmn_DEFAULT_RTE_CALPRM_GROUP.VehSigCdngDftLgtA_Val" 0 DISPLAY_IDENTIFIER VehSigCdng.CalibrationPorts.VehSigCdngDftLgtA.Val /end CHARACTERISTIC
/begin CHARACTERISTIC VehSigCdng.VehSigCdngDftVehSpd.Val "MICROSAR RTE" VALUE 0x0 RTE_RL_FLOAT32_IEEE 0 NO_COMPU_METHOD 0.0 511.0 SYMBOL_LINK "Rte_CalprmRom_CalRegn01Cmn_DEFAULT_RTE_CALPRM_GROUP.VehSigCdngDftVehSpd_Val" 0 DISPLAY_IDENTIFIER VehSigCdng.CalibrationPorts.VehSigCdngDftVehSpd.Val /end CHARACTERISTIC
/begin CHARACTERISTIC VehSigCdng.VehSigCdngDftYawRate.Val "MICROSAR RTE" VALUE 0x0 RTE_RL_FLOAT32_IEEE 0 NO_COMPU_METHOD -120.0 120.0 SYMBOL_LINK "Rte_CalprmRom_CalRegn01Cmn_DEFAULT_RTE_CALPRM_GROUP.VehSigCdngDftYawRate_Val" 0 DISPLAY_IDENTIFIER VehSigCdng.CalibrationPorts.VehSigCdngDftYawRate.Val /end CHARACTERISTIC
/begin CHARACTERISTIC VehSigCdng.VehSigCdngLatADifThd.Val "MICROSAR RTE" VALUE 0x0 RTE_RL_FLOAT32_IEEE 0 NO_COMPU_METHOD 0.1 10.0 SYMBOL_LINK "Rte_CalprmRom_CalRegn01Cmn_DEFAULT_RTE_CALPRM_GROUP.VehSigCdngLatADifThd_Val" 0 DISPLAY_IDENTIFIER VehSigCdng.CalibrationPorts.VehSigCdngLatADifThd.Val /end CHARACTERISTIC
/begin CHARACTERISTIC VehSigCdng.VehSigCdngLatAFilFrq.Val "MICROSAR RTE" VALUE 0x0 RTE_RL_FLOAT32_IEEE 0 NO_COMPU_METHOD 1.0 100.0 SYMBOL_LINK "Rte_CalprmRom_CalRegn01Cmn_DEFAULT_RTE_CALPRM_GROUP.VehSigCdngLatAFilFrq_Val" 0 DISPLAY_IDENTIFIER VehSigCdng.CalibrationPorts.VehSigCdngLatAFilFrq.Val /end CHARACTERISTIC
/begin CHARACTERISTIC VehSigCdng.VehSigCdngLatASlewRate.Val "MICROSAR RTE" VALUE 0x0 RTE_RL_FLOAT32_IEEE 0 NO_COMPU_METHOD 0.1 400.0 SYMBOL_LINK "Rte_CalprmRom_CalRegn01Inin00_DEFAULT_RTE_CALPRM_GROUP.VehSigCdngLatASlewRate_Val" 0 DISPLAY_IDENTIFIER VehSigCdng.CalibrationPorts.VehSigCdngLatASlewRate.Val /end CHARACTERISTIC
/begin CHARACTERISTIC VehSigCdng.VehSigCdngLtgADifThd.Val "MICROSAR RTE" VALUE 0x0 RTE_RL_FLOAT32_IEEE 0 NO_COMPU_METHOD 0.1 10.0 SYMBOL_LINK "Rte_CalprmRom_CalRegn01Cmn_DEFAULT_RTE_CALPRM_GROUP.VehSigCdngLtgADifThd_Val" 0 DISPLAY_IDENTIFIER VehSigCdng.CalibrationPorts.VehSigCdngLtgADifThd.Val /end CHARACTERISTIC
/begin CHARACTERISTIC VehSigCdng.VehSigCdngLtgASlewRate.Val "MICROSAR RTE" VALUE 0x0 RTE_RL_FLOAT32_IEEE 0 NO_COMPU_METHOD 0.1 500.0 SYMBOL_LINK "Rte_CalprmRom_CalRegn01Inin00_DEFAULT_RTE_CALPRM_GROUP.VehSigCdngLtgASlewRate_Val" 0 DISPLAY_IDENTIFIER VehSigCdng.CalibrationPorts.VehSigCdngLtgASlewRate.Val /end CHARACTERISTIC
/begin CHARACTERISTIC VehSigCdng.VehSigCdngVehSpdDifThd.Val "MICROSAR RTE" VALUE 0x0 RTE_RL_FLOAT32_IEEE 0 NO_COMPU_METHOD 0.1 511.0 SYMBOL_LINK "Rte_CalprmRom_CalRegn01Cmn_DEFAULT_RTE_CALPRM_GROUP.VehSigCdngVehSpdDifThd_Val" 0 DISPLAY_IDENTIFIER VehSigCdng.CalibrationPorts.VehSigCdngVehSpdDifThd.Val /end CHARACTERISTIC
/begin CHARACTERISTIC VehSigCdng.VehSigCdngVehSpdSlewRate.Val "MICROSAR RTE" VALUE 0x0 RTE_RL_FLOAT32_IEEE 0 NO_COMPU_METHOD 1.0 50.0 SYMBOL_LINK "Rte_CalprmRom_CalRegn01Inin00_DEFAULT_RTE_CALPRM_GROUP.VehSigCdngVehSpdSlewRate_Val" 0 DISPLAY_IDENTIFIER VehSigCdng.CalibrationPorts.VehSigCdngVehSpdSlewRate.Val /end CHARACTERISTIC
/begin CHARACTERISTIC VehSigCdng.VehSigCdngVehYawSlewRate.Val "MICROSAR RTE" VALUE 0x0 RTE_RL_FLOAT32_IEEE 0 NO_COMPU_METHOD 1.0 1200.0 SYMBOL_LINK "Rte_CalprmRom_CalRegn01Cmn_DEFAULT_RTE_CALPRM_GROUP.VehSigCdngVehYawSlewRate_Val" 0 DISPLAY_IDENTIFIER VehSigCdng.CalibrationPorts.VehSigCdngVehYawSlewRate.Val /end CHARACTERISTIC
/begin CHARACTERISTIC VehSigCdng.VehSigCdngYawRateDifThd.Val "MICROSAR RTE" VALUE 0x0 RTE_RL_FLOAT32_IEEE 0 NO_COMPU_METHOD 0.1 120.0 SYMBOL_LINK "Rte_CalprmRom_CalRegn01Cmn_DEFAULT_RTE_CALPRM_GROUP.VehSigCdngYawRateDifThd_Val" 0 DISPLAY_IDENTIFIER VehSigCdng.CalibrationPorts.VehSigCdngYawRateDifThd.Val /end CHARACTERISTIC
/begin CHARACTERISTIC VehSpdLimr.VehSpdLimrMaxAssiX.Ary1D "MICROSAR RTE" VAL_BLK 0x0 RTE_RL_UWORD 0 NO_COMPU_METHOD 0 65535 MATRIX_DIM 5 1 1 SYMBOL_LINK "Rte_CalprmRom_CalRegn01Cmn_DEFAULT_RTE_CALPRM_GROUP.VehSpdLimrMaxAssiX_Ary1D" 0 DISPLAY_IDENTIFIER VehSpdLimr.CalibrationPorts.VehSpdLimrMaxAssiX.Ary1D /end CHARACTERISTIC
/begin CHARACTERISTIC VehSpdLimr.VehSpdLimrMaxAssiY.Ary1D "MICROSAR RTE" VAL_BLK 0x0 RTE_RL_UWORD 0 NO_COMPU_METHOD 0 65535 MATRIX_DIM 5 1 1 SYMBOL_LINK "Rte_CalprmRom_CalRegn01Cmn_DEFAULT_RTE_CALPRM_GROUP.VehSpdLimrMaxAssiY_Ary1D" 0 DISPLAY_IDENTIFIER VehSpdLimr.CalibrationPorts.VehSpdLimrMaxAssiY.Ary1D /end CHARACTERISTIC
/begin CHARACTERISTIC VehSpdLimr.VehSpdLimrPosMaxOffs1.Val "MICROSAR RTE" VALUE 0x0 RTE_RL_FLOAT32_IEEE 0 NO_COMPU_METHOD -3.402823466e+38 3.402823466e+38 SYMBOL_LINK "Rte_CalprmRom_CalRegn01Cmn_DEFAULT_RTE_CALPRM_GROUP.VehSpdLimrPosMaxOffs1_Val" 0 DISPLAY_IDENTIFIER VehSpdLimr.CalibrationPorts.VehSpdLimrPosMaxOffs1.Val /end CHARACTERISTIC
/begin CHARACTERISTIC VehSpdLimr.VehSpdLimrPosMaxOffs2.Val "MICROSAR RTE" VALUE 0x0 RTE_RL_FLOAT32_IEEE 0 NO_COMPU_METHOD -3.402823466e+38 3.402823466e+38 SYMBOL_LINK "Rte_CalprmRom_CalRegn01Cmn_DEFAULT_RTE_CALPRM_GROUP.VehSpdLimrPosMaxOffs2_Val" 0 DISPLAY_IDENTIFIER VehSpdLimr.CalibrationPorts.VehSpdLimrPosMaxOffs2.Val /end CHARACTERISTIC
/begin CHARACTERISTIC WhlImbRejctn.ActvCmpBand1Dft "MICROSAR RTE" VALUE 0x0 RTE_RL_ULONG 0 NO_COMPU_METHOD 0 4294967295 SYMBOL_LINK "Rte_CalprmRom_WhlImbRejctn_DEFAULT_RTE_CDATA_GROUP.ActvCmpBand1Dft" 0 DISPLAY_IDENTIFIER WhlImbRejctn.CalibrationParameters.ActvCmpBand1Dft /end CHARACTERISTIC
/begin CHARACTERISTIC WhlImbRejctn.ActvCmpBand2Dft "MICROSAR RTE" VALUE 0x0 RTE_RL_ULONG 0 NO_COMPU_METHOD 0 4294967295 SYMBOL_LINK "Rte_CalprmRom_WhlImbRejctn_DEFAULT_RTE_CDATA_GROUP.ActvCmpBand2Dft" 0 DISPLAY_IDENTIFIER WhlImbRejctn.CalibrationParameters.ActvCmpBand2Dft /end CHARACTERISTIC
/begin CHARACTERISTIC WhlImbRejctn.ActvCmpBand3Dft "MICROSAR RTE" VALUE 0x0 RTE_RL_ULONG 0 NO_COMPU_METHOD 0 4294967295 SYMBOL_LINK "Rte_CalprmRom_WhlImbRejctn_DEFAULT_RTE_CDATA_GROUP.ActvCmpBand3Dft" 0 DISPLAY_IDENTIFIER WhlImbRejctn.CalibrationParameters.ActvCmpBand3Dft /end CHARACTERISTIC
/begin CHARACTERISTIC WhlImbRejctn.LePeakPrevDft "MICROSAR RTE" VALUE 0x0 RTE_RL_FLOAT32_IEEE 0 NO_COMPU_METHOD -3.402823466e+38 3.402823466e+38 SYMBOL_LINK "Rte_CalprmRom_WhlImbRejctn_DEFAULT_RTE_CDATA_GROUP.LePeakPrevDft" 0 DISPLAY_IDENTIFIER WhlImbRejctn.CalibrationParameters.LePeakPrevDft /end CHARACTERISTIC
/begin CHARACTERISTIC WhlImbRejctn.MaxCompPercDft "MICROSAR RTE" VALUE 0x0 RTE_RL_FLOAT32_IEEE 0 NO_COMPU_METHOD -3.402823466e+38 3.402823466e+38 SYMBOL_LINK "Rte_CalprmRom_WhlImbRejctn_DEFAULT_RTE_CDATA_GROUP.MaxCompPercDft" 0 DISPLAY_IDENTIFIER WhlImbRejctn.CalibrationParameters.MaxCompPercDft /end CHARACTERISTIC
/begin CHARACTERISTIC WhlImbRejctn.RiPeakPrevDft "MICROSAR RTE" VALUE 0x0 RTE_RL_FLOAT32_IEEE 0 NO_COMPU_METHOD -3.402823466e+38 3.402823466e+38 SYMBOL_LINK "Rte_CalprmRom_WhlImbRejctn_DEFAULT_RTE_CDATA_GROUP.RiPeakPrevDft" 0 DISPLAY_IDENTIFIER WhlImbRejctn.CalibrationParameters.RiPeakPrevDft /end CHARACTERISTIC
/begin CHARACTERISTIC WhlImbRejctn.WhlImbRejctnAdpvFac.Val "MICROSAR RTE" VALUE 0x0 RTE_RL_FLOAT32_IEEE 0 NO_COMPU_METHOD -3.402823466e+38 3.402823466e+38 SYMBOL_LINK "Rte_CalprmRom_CalRegn03Inin00GroupB_DEFAULT_RTE_CALPRM_GROUP.WhlImbRejctnAdpvFac_Val" 0 DISPLAY_IDENTIFIER WhlImbRejctn.CalibrationPorts.WhlImbRejctnAdpvFac.Val /end CHARACTERISTIC
/begin CHARACTERISTIC WhlImbRejctn.WhlImbRejctnAutScaEna.Logl "MICROSAR RTE" VALUE 0x0 RTE_RL_BOOLEAN 0 RTE_CM_BOOLEAN 0 255 SYMBOL_LINK "Rte_CalprmRom_CalRegn03CmnGroupB_DEFAULT_RTE_CALPRM_GROUP.WhlImbRejctnAutScaEna_Logl" 0 DISPLAY_IDENTIFIER WhlImbRejctn.CalibrationPorts.WhlImbRejctnAutScaEna.Logl /end CHARACTERISTIC
/begin CHARACTERISTIC WhlImbRejctn.WhlImbRejctnAutScaTar.Val "MICROSAR RTE" VALUE 0x0 RTE_RL_FLOAT32_IEEE 0 NO_COMPU_METHOD -3.402823466e+38 3.402823466e+38 SYMBOL_LINK "Rte_CalprmRom_CalRegn03CmnGroupB_DEFAULT_RTE_CALPRM_GROUP.WhlImbRejctnAutScaTar_Val" 0 DISPLAY_IDENTIFIER WhlImbRejctn.CalibrationPorts.WhlImbRejctnAutScaTar.Val /end CHARACTERISTIC
/begin CHARACTERISTIC WhlImbRejctn.WhlImbRejctnBlndCmdMgnLp1FilFrq.Val "MICROSAR RTE" VALUE 0x0 RTE_RL_FLOAT32_IEEE 0 NO_COMPU_METHOD -3.402823466e+38 3.402823466e+38 SYMBOL_LINK "Rte_CalprmRom_CalRegn03Inin00_DEFAULT_RTE_CALPRM_GROUP.WhlImbRejctnBlndCmdMgnLp1FilFrq_Val" 0 DISPLAY_IDENTIFIER WhlImbRejctn.CalibrationPorts.WhlImbRejctnBlndCmdMgnLp1FilFrq.Val /end CHARACTERISTIC
/begin CHARACTERISTIC WhlImbRejctn.WhlImbRejctnBlndCmdMgnLp2FilFrq.Val "MICROSAR RTE" VALUE 0x0 RTE_RL_FLOAT32_IEEE 0 NO_COMPU_METHOD -3.402823466e+38 3.402823466e+38 SYMBOL_LINK "Rte_CalprmRom_CalRegn03Inin00_DEFAULT_RTE_CALPRM_GROUP.WhlImbRejctnBlndCmdMgnLp2FilFrq_Val" 0 DISPLAY_IDENTIFIER WhlImbRejctn.CalibrationPorts.WhlImbRejctnBlndCmdMgnLp2FilFrq.Val /end CHARACTERISTIC
/begin CHARACTERISTIC WhlImbRejctn.WhlImbRejctnCmdMgnLp1FilFrq.Val "MICROSAR RTE" VALUE 0x0 RTE_RL_FLOAT32_IEEE 0 NO_COMPU_METHOD -3.402823466e+38 3.402823466e+38 SYMBOL_LINK "Rte_CalprmRom_CalRegn03Cmn_DEFAULT_RTE_CALPRM_GROUP.WhlImbRejctnCmdMgnLp1FilFrq_Val" 0 DISPLAY_IDENTIFIER WhlImbRejctn.CalibrationPorts.WhlImbRejctnCmdMgnLp1FilFrq.Val /end CHARACTERISTIC
/begin CHARACTERISTIC WhlImbRejctn.WhlImbRejctnCmdMgnLp2FilFrq.Val "MICROSAR RTE" VALUE 0x0 RTE_RL_FLOAT32_IEEE 0 NO_COMPU_METHOD -3.402823466e+38 3.402823466e+38 SYMBOL_LINK "Rte_CalprmRom_CalRegn03Cmn_DEFAULT_RTE_CALPRM_GROUP.WhlImbRejctnCmdMgnLp2FilFrq_Val" 0 DISPLAY_IDENTIFIER WhlImbRejctn.CalibrationPorts.WhlImbRejctnCmdMgnLp2FilFrq.Val /end CHARACTERISTIC
/begin CHARACTERISTIC WhlImbRejctn.WhlImbRejctnCurrMgnSlewPerLoop.Val "MICROSAR RTE" VALUE 0x0 RTE_RL_FLOAT32_IEEE 0 NO_COMPU_METHOD -3.402823466e+38 3.402823466e+38 SYMBOL_LINK "Rte_CalprmRom_CalRegn03Inin00GroupB_DEFAULT_RTE_CALPRM_GROUP.WhlImbRejctnCurrMgnSlewPerLoop_Val" 0 DISPLAY_IDENTIFIER WhlImbRejctn.CalibrationPorts.WhlImbRejctnCurrMgnSlewPerLoop.Val /end CHARACTERISTIC
/begin CHARACTERISTIC WhlImbRejctn.WhlImbRejctnDcTrendFltRcvryDly.Val "MICROSAR RTE" VALUE 0x0 RTE_RL_FLOAT32_IEEE 0 NO_COMPU_METHOD -3.402823466e+38 3.402823466e+38 SYMBOL_LINK "Rte_CalprmRom_CalRegn01CmnGroupB_DEFAULT_RTE_CALPRM_GROUP.WhlImbRejctnDcTrendFltRcvryDly_Val" 0 DISPLAY_IDENTIFIER WhlImbRejctn.CalibrationPorts.WhlImbRejctnDcTrendFltRcvryDly.Val /end CHARACTERISTIC
/begin CHARACTERISTIC WhlImbRejctn.WhlImbRejctnDcTrendFltRcvryNegStep.Val "MICROSAR RTE" VALUE 0x0 RTE_RL_FLOAT32_IEEE 0 NO_COMPU_METHOD -3.402823466e+38 3.402823466e+38 SYMBOL_LINK "Rte_CalprmRom_CalRegn01Inin00GroupB_DEFAULT_RTE_CALPRM_GROUP.WhlImbRejctnDcTrendFltRcvryNegStep_Val" 0 DISPLAY_IDENTIFIER WhlImbRejctn.CalibrationPorts.WhlImbRejctnDcTrendFltRcvryNegStep.Val /end CHARACTERISTIC
/begin CHARACTERISTIC WhlImbRejctn.WhlImbRejctnDcTrendFltRcvryPosStep.Val "MICROSAR RTE" VALUE 0x0 RTE_RL_FLOAT32_IEEE 0 NO_COMPU_METHOD -3.402823466e+38 3.402823466e+38 SYMBOL_LINK "Rte_CalprmRom_CalRegn01Inin00GroupB_DEFAULT_RTE_CALPRM_GROUP.WhlImbRejctnDcTrendFltRcvryPosStep_Val" 0 DISPLAY_IDENTIFIER WhlImbRejctn.CalibrationPorts.WhlImbRejctnDcTrendFltRcvryPosStep.Val /end CHARACTERISTIC
/begin CHARACTERISTIC WhlImbRejctn.WhlImbRejctnDcTrendFltRcvryThd.Val "MICROSAR RTE" VALUE 0x0 RTE_RL_FLOAT32_IEEE 0 NO_COMPU_METHOD -3.402823466e+38 3.402823466e+38 SYMBOL_LINK "Rte_CalprmRom_CalRegn01Inin00_DEFAULT_RTE_CALPRM_GROUP.WhlImbRejctnDcTrendFltRcvryThd_Val" 0 DISPLAY_IDENTIFIER WhlImbRejctn.CalibrationPorts.WhlImbRejctnDcTrendFltRcvryThd.Val /end CHARACTERISTIC
/begin CHARACTERISTIC WhlImbRejctn.WhlImbRejctnDcTrendLpFil.Val "MICROSAR RTE" VALUE 0x0 RTE_RL_FLOAT32_IEEE 0 NO_COMPU_METHOD -3.402823466e+38 3.402823466e+38 SYMBOL_LINK "Rte_CalprmRom_CalRegn03Cmn_DEFAULT_RTE_CALPRM_GROUP.WhlImbRejctnDcTrendLpFil_Val" 0 DISPLAY_IDENTIFIER WhlImbRejctn.CalibrationPorts.WhlImbRejctnDcTrendLpFil.Val /end CHARACTERISTIC
/begin CHARACTERISTIC WhlImbRejctn.WhlImbRejctnDcTrendTh2Tq.Val "MICROSAR RTE" VALUE 0x0 RTE_RL_FLOAT32_IEEE 0 NO_COMPU_METHOD -3.402823466e+38 3.402823466e+38 SYMBOL_LINK "Rte_CalprmRom_CalRegn03Inin00GroupB_DEFAULT_RTE_CALPRM_GROUP.WhlImbRejctnDcTrendTh2Tq_Val" 0 DISPLAY_IDENTIFIER WhlImbRejctn.CalibrationPorts.WhlImbRejctnDcTrendTh2Tq.Val /end CHARACTERISTIC
/begin CHARACTERISTIC WhlImbRejctn.WhlImbRejctnDcTrendThTq.Val "MICROSAR RTE" VALUE 0x0 RTE_RL_FLOAT32_IEEE 0 NO_COMPU_METHOD -3.402823466e+38 3.402823466e+38 SYMBOL_LINK "Rte_CalprmRom_CalRegn03Inin00GroupB_DEFAULT_RTE_CALPRM_GROUP.WhlImbRejctnDcTrendThTq_Val" 0 DISPLAY_IDENTIFIER WhlImbRejctn.CalibrationPorts.WhlImbRejctnDcTrendThTq.Val /end CHARACTERISTIC
/begin CHARACTERISTIC WhlImbRejctn.WhlImbRejctnDcTrendTi2Sec.Val "MICROSAR RTE" VALUE 0x0 RTE_RL_FLOAT32_IEEE 0 NO_COMPU_METHOD -3.402823466e+38 3.402823466e+38 SYMBOL_LINK "Rte_CalprmRom_CalRegn03Inin00GroupB_DEFAULT_RTE_CALPRM_GROUP.WhlImbRejctnDcTrendTi2Sec_Val" 0 DISPLAY_IDENTIFIER WhlImbRejctn.CalibrationPorts.WhlImbRejctnDcTrendTi2Sec.Val /end CHARACTERISTIC
/begin CHARACTERISTIC WhlImbRejctn.WhlImbRejctnDcTrendTiSec.Val "MICROSAR RTE" VALUE 0x0 RTE_RL_FLOAT32_IEEE 0 NO_COMPU_METHOD -3.402823466e+38 3.402823466e+38 SYMBOL_LINK "Rte_CalprmRom_CalRegn03Inin00GroupB_DEFAULT_RTE_CALPRM_GROUP.WhlImbRejctnDcTrendTiSec_Val" 0 DISPLAY_IDENTIFIER WhlImbRejctn.CalibrationPorts.WhlImbRejctnDcTrendTiSec.Val /end CHARACTERISTIC
/begin CHARACTERISTIC WhlImbRejctn.WhlImbRejctnDistbnMgnLpFil.Val "MICROSAR RTE" VALUE 0x0 RTE_RL_FLOAT32_IEEE 0 NO_COMPU_METHOD -3.402823466e+38 3.402823466e+38 SYMBOL_LINK "Rte_CalprmRom_CalRegn03Inin00_DEFAULT_RTE_CALPRM_GROUP.WhlImbRejctnDistbnMgnLpFil_Val" 0 DISPLAY_IDENTIFIER WhlImbRejctn.CalibrationPorts.WhlImbRejctnDistbnMgnLpFil.Val /end CHARACTERISTIC
/begin CHARACTERISTIC WhlImbRejctn.WhlImbRejctnEnaSlewPerLoop.Val "MICROSAR RTE" VALUE 0x0 RTE_RL_FLOAT32_IEEE 0 NO_COMPU_METHOD -3.402823466e+38 3.402823466e+38 SYMBOL_LINK "Rte_CalprmRom_CalRegn03Inin00GroupB_DEFAULT_RTE_CALPRM_GROUP.WhlImbRejctnEnaSlewPerLoop_Val" 0 DISPLAY_IDENTIFIER WhlImbRejctn.CalibrationPorts.WhlImbRejctnEnaSlewPerLoop.Val /end CHARACTERISTIC
/begin CHARACTERISTIC WhlImbRejctn.WhlImbRejctnFctEna.Logl "MICROSAR RTE" VALUE 0x0 RTE_RL_BOOLEAN 0 RTE_CM_BOOLEAN 0 255 SYMBOL_LINK "Rte_CalprmRom_CalRegn02CmnGroupB_DEFAULT_RTE_CALPRM_GROUP.WhlImbRejctnFctEna_Logl" 0 DISPLAY_IDENTIFIER WhlImbRejctn.CalibrationPorts.WhlImbRejctnFctEna.Logl /end CHARACTERISTIC
/begin CHARACTERISTIC WhlImbRejctn.WhlImbRejctnFrqDiagcAmpThd.Val "MICROSAR RTE" VALUE 0x0 RTE_RL_FLOAT32_IEEE 0 NO_COMPU_METHOD -3.402823466e+38 3.402823466e+38 SYMBOL_LINK "Rte_CalprmRom_CalRegn01Inin00GroupB_DEFAULT_RTE_CALPRM_GROUP.WhlImbRejctnFrqDiagcAmpThd_Val" 0 DISPLAY_IDENTIFIER WhlImbRejctn.CalibrationPorts.WhlImbRejctnFrqDiagcAmpThd.Val /end CHARACTERISTIC
/begin CHARACTERISTIC WhlImbRejctn.WhlImbRejctnFrqDiagcEna.Logl "MICROSAR RTE" VALUE 0x0 RTE_RL_BOOLEAN 0 RTE_CM_BOOLEAN 0 255 SYMBOL_LINK "Rte_CalprmRom_CalRegn01CmnGroupB_DEFAULT_RTE_CALPRM_GROUP.WhlImbRejctnFrqDiagcEna_Logl" 0 DISPLAY_IDENTIFIER WhlImbRejctn.CalibrationPorts.WhlImbRejctnFrqDiagcEna.Logl /end CHARACTERISTIC
/begin CHARACTERISTIC WhlImbRejctn.WhlImbRejctnFrqDiagcFltRcvryDly.Val "MICROSAR RTE" VALUE 0x0 RTE_RL_FLOAT32_IEEE 0 NO_COMPU_METHOD -3.402823466e+38 3.402823466e+38 SYMBOL_LINK "Rte_CalprmRom_CalRegn01CmnGroupB_DEFAULT_RTE_CALPRM_GROUP.WhlImbRejctnFrqDiagcFltRcvryDly_Val" 0 DISPLAY_IDENTIFIER WhlImbRejctn.CalibrationPorts.WhlImbRejctnFrqDiagcFltRcvryDly.Val /end CHARACTERISTIC
/begin CHARACTERISTIC WhlImbRejctn.WhlImbRejctnFrqDiagcFltRcvryNegStep.Val "MICROSAR RTE" VALUE 0x0 RTE_RL_FLOAT32_IEEE 0 NO_COMPU_METHOD -3.402823466e+38 3.402823466e+38 SYMBOL_LINK "Rte_CalprmRom_CalRegn01Inin00GroupB_DEFAULT_RTE_CALPRM_GROUP.WhlImbRejctnFrqDiagcFltRcvryNegStep_Val" 0 DISPLAY_IDENTIFIER WhlImbRejctn.CalibrationPorts.WhlImbRejctnFrqDiagcFltRcvryNegStep.Val /end CHARACTERISTIC
/begin CHARACTERISTIC WhlImbRejctn.WhlImbRejctnFrqDiagcFltRcvryPosStep.Val "MICROSAR RTE" VALUE 0x0 RTE_RL_FLOAT32_IEEE 0 NO_COMPU_METHOD -3.402823466e+38 3.402823466e+38 SYMBOL_LINK "Rte_CalprmRom_CalRegn01Inin00GroupB_DEFAULT_RTE_CALPRM_GROUP.WhlImbRejctnFrqDiagcFltRcvryPosStep_Val" 0 DISPLAY_IDENTIFIER WhlImbRejctn.CalibrationPorts.WhlImbRejctnFrqDiagcFltRcvryPosStep.Val /end CHARACTERISTIC
/begin CHARACTERISTIC WhlImbRejctn.WhlImbRejctnFrqDiagcFltRcvryThd.Val "MICROSAR RTE" VALUE 0x0 RTE_RL_FLOAT32_IEEE 0 NO_COMPU_METHOD -3.402823466e+38 3.402823466e+38 SYMBOL_LINK "Rte_CalprmRom_CalRegn01Inin00GroupB_DEFAULT_RTE_CALPRM_GROUP.WhlImbRejctnFrqDiagcFltRcvryThd_Val" 0 DISPLAY_IDENTIFIER WhlImbRejctn.CalibrationPorts.WhlImbRejctnFrqDiagcFltRcvryThd.Val /end CHARACTERISTIC
/begin CHARACTERISTIC WhlImbRejctn.WhlImbRejctnFrqDiagcLpFil.Val "MICROSAR RTE" VALUE 0x0 RTE_RL_FLOAT32_IEEE 0 NO_COMPU_METHOD -3.402823466e+38 3.402823466e+38 SYMBOL_LINK "Rte_CalprmRom_CalRegn01Cmn_DEFAULT_RTE_CALPRM_GROUP.WhlImbRejctnFrqDiagcLpFil_Val" 0 DISPLAY_IDENTIFIER WhlImbRejctn.CalibrationPorts.WhlImbRejctnFrqDiagcLpFil.Val /end CHARACTERISTIC
/begin CHARACTERISTIC WhlImbRejctn.WhlImbRejctnFrqDiagcThd.Val "MICROSAR RTE" VALUE 0x0 RTE_RL_FLOAT32_IEEE 0 NO_COMPU_METHOD -3.402823466e+38 3.402823466e+38 SYMBOL_LINK "Rte_CalprmRom_CalRegn01Inin00GroupB_DEFAULT_RTE_CALPRM_GROUP.WhlImbRejctnFrqDiagcThd_Val" 0 DISPLAY_IDENTIFIER WhlImbRejctn.CalibrationPorts.WhlImbRejctnFrqDiagcThd.Val /end CHARACTERISTIC
/begin CHARACTERISTIC WhlImbRejctn.WhlImbRejctnFrqDiagcTout.Val "MICROSAR RTE" VALUE 0x0 RTE_RL_UWORD 0 NO_COMPU_METHOD 0 65535 SYMBOL_LINK "Rte_CalprmRom_CalRegn01Inin00GroupB_DEFAULT_RTE_CALPRM_GROUP.WhlImbRejctnFrqDiagcTout_Val" 0 DISPLAY_IDENTIFIER WhlImbRejctn.CalibrationPorts.WhlImbRejctnFrqDiagcTout.Val /end CHARACTERISTIC
/begin CHARACTERISTIC WhlImbRejctn.WhlImbRejctnFrqDiagcUgrPoleMgn.Val "MICROSAR RTE" VALUE 0x0 RTE_RL_FLOAT32_IEEE 0 NO_COMPU_METHOD -3.402823466e+38 3.402823466e+38 SYMBOL_LINK "Rte_CalprmRom_CalRegn01CmnGroupB_DEFAULT_RTE_CALPRM_GROUP.WhlImbRejctnFrqDiagcUgrPoleMgn_Val" 0 DISPLAY_IDENTIFIER WhlImbRejctn.CalibrationPorts.WhlImbRejctnFrqDiagcUgrPoleMgn.Val /end CHARACTERISTIC
/begin CHARACTERISTIC WhlImbRejctn.WhlImbRejctnFrqScaTblX.Ary1D "MICROSAR RTE" VAL_BLK 0x0 RTE_RL_UWORD 0 NO_COMPU_METHOD 0 65535 MATRIX_DIM 6 1 1 SYMBOL_LINK "Rte_CalprmRom_CalRegn03Inin00GroupB_DEFAULT_RTE_CALPRM_GROUP.WhlImbRejctnFrqScaTblX_Ary1D" 0 DISPLAY_IDENTIFIER WhlImbRejctn.CalibrationPorts.WhlImbRejctnFrqScaTblX.Ary1D /end CHARACTERISTIC
/begin CHARACTERISTIC WhlImbRejctn.WhlImbRejctnFrqScaTblY.Ary1D "MICROSAR RTE" VAL_BLK 0x0 RTE_RL_UWORD 0 NO_COMPU_METHOD 0 65535 MATRIX_DIM 6 1 1 SYMBOL_LINK "Rte_CalprmRom_CalRegn03Inin00GroupB_DEFAULT_RTE_CALPRM_GROUP.WhlImbRejctnFrqScaTblY_Ary1D" 0 DISPLAY_IDENTIFIER WhlImbRejctn.CalibrationPorts.WhlImbRejctnFrqScaTblY.Ary1D /end CHARACTERISTIC
/begin CHARACTERISTIC WhlImbRejctn.WhlImbRejctnMaxDurn.Val "MICROSAR RTE" VALUE 0x0 RTE_RL_UWORD 0 NO_COMPU_METHOD 0 65535 SYMBOL_LINK "Rte_CalprmRom_CalRegn03Inin00GroupB_DEFAULT_RTE_CALPRM_GROUP.WhlImbRejctnMaxDurn_Val" 0 DISPLAY_IDENTIFIER WhlImbRejctn.CalibrationPorts.WhlImbRejctnMaxDurn.Val /end CHARACTERISTIC
/begin CHARACTERISTIC WhlImbRejctn.WhlImbRejctnMaxMgn.Val "MICROSAR RTE" VALUE 0x0 RTE_RL_FLOAT32_IEEE 0 NO_COMPU_METHOD -3.402823466e+38 3.402823466e+38 SYMBOL_LINK "Rte_CalprmRom_CalRegn03Inin00GroupB_DEFAULT_RTE_CALPRM_GROUP.WhlImbRejctnMaxMgn_Val" 0 DISPLAY_IDENTIFIER WhlImbRejctn.CalibrationPorts.WhlImbRejctnMaxMgn.Val /end CHARACTERISTIC
/begin CHARACTERISTIC WhlImbRejctn.WhlImbRejctnMaxMgnFltNegStep.Val "MICROSAR RTE" VALUE 0x0 RTE_RL_FLOAT32_IEEE 0 NO_COMPU_METHOD -3.402823466e+38 3.402823466e+38 SYMBOL_LINK "Rte_CalprmRom_CalRegn01Inin00GroupB_DEFAULT_RTE_CALPRM_GROUP.WhlImbRejctnMaxMgnFltNegStep_Val" 0 DISPLAY_IDENTIFIER WhlImbRejctn.CalibrationPorts.WhlImbRejctnMaxMgnFltNegStep.Val /end CHARACTERISTIC
/begin CHARACTERISTIC WhlImbRejctn.WhlImbRejctnMaxMgnFltPosStep.Val "MICROSAR RTE" VALUE 0x0 RTE_RL_FLOAT32_IEEE 0 NO_COMPU_METHOD -3.402823466e+38 3.402823466e+38 SYMBOL_LINK "Rte_CalprmRom_CalRegn01Inin00GroupB_DEFAULT_RTE_CALPRM_GROUP.WhlImbRejctnMaxMgnFltPosStep_Val" 0 DISPLAY_IDENTIFIER WhlImbRejctn.CalibrationPorts.WhlImbRejctnMaxMgnFltPosStep.Val /end CHARACTERISTIC
/begin CHARACTERISTIC WhlImbRejctn.WhlImbRejctnMaxMgnFltRcvryDly.Val "MICROSAR RTE" VALUE 0x0 RTE_RL_FLOAT32_IEEE 0 NO_COMPU_METHOD -3.402823466e+38 3.402823466e+38 SYMBOL_LINK "Rte_CalprmRom_CalRegn01CmnGroupB_DEFAULT_RTE_CALPRM_GROUP.WhlImbRejctnMaxMgnFltRcvryDly_Val" 0 DISPLAY_IDENTIFIER WhlImbRejctn.CalibrationPorts.WhlImbRejctnMaxMgnFltRcvryDly.Val /end CHARACTERISTIC
/begin CHARACTERISTIC WhlImbRejctn.WhlImbRejctnMaxMgnFltRcvryNegStep.Val "MICROSAR RTE" VALUE 0x0 RTE_RL_FLOAT32_IEEE 0 NO_COMPU_METHOD -3.402823466e+38 3.402823466e+38 SYMBOL_LINK "Rte_CalprmRom_CalRegn01Inin00GroupB_DEFAULT_RTE_CALPRM_GROUP.WhlImbRejctnMaxMgnFltRcvryNegStep_Val" 0 DISPLAY_IDENTIFIER WhlImbRejctn.CalibrationPorts.WhlImbRejctnMaxMgnFltRcvryNegStep.Val /end CHARACTERISTIC
/begin CHARACTERISTIC WhlImbRejctn.WhlImbRejctnMaxMgnFltRcvryPosStep.Val "MICROSAR RTE" VALUE 0x0 RTE_RL_FLOAT32_IEEE 0 NO_COMPU_METHOD -3.402823466e+38 3.402823466e+38 SYMBOL_LINK "Rte_CalprmRom_CalRegn01Inin00GroupB_DEFAULT_RTE_CALPRM_GROUP.WhlImbRejctnMaxMgnFltRcvryPosStep_Val" 0 DISPLAY_IDENTIFIER WhlImbRejctn.CalibrationPorts.WhlImbRejctnMaxMgnFltRcvryPosStep.Val /end CHARACTERISTIC
/begin CHARACTERISTIC WhlImbRejctn.WhlImbRejctnMaxMgnFltRcvryThd.Val "MICROSAR RTE" VALUE 0x0 RTE_RL_FLOAT32_IEEE 0 NO_COMPU_METHOD -3.402823466e+38 3.402823466e+38 SYMBOL_LINK "Rte_CalprmRom_CalRegn01Inin00GroupB_DEFAULT_RTE_CALPRM_GROUP.WhlImbRejctnMaxMgnFltRcvryThd_Val" 0 DISPLAY_IDENTIFIER WhlImbRejctn.CalibrationPorts.WhlImbRejctnMaxMgnFltRcvryThd.Val /end CHARACTERISTIC
/begin CHARACTERISTIC WhlImbRejctn.WhlImbRejctnMaxMgnFltThd.Val "MICROSAR RTE" VALUE 0x0 RTE_RL_FLOAT32_IEEE 0 NO_COMPU_METHOD -3.402823466e+38 3.402823466e+38 SYMBOL_LINK "Rte_CalprmRom_CalRegn01Inin00GroupB_DEFAULT_RTE_CALPRM_GROUP.WhlImbRejctnMaxMgnFltThd_Val" 0 DISPLAY_IDENTIFIER WhlImbRejctn.CalibrationPorts.WhlImbRejctnMaxMgnFltThd.Val /end CHARACTERISTIC
/begin CHARACTERISTIC WhlImbRejctn.WhlImbRejctnMgnEstimnDeltaSca.Val "MICROSAR RTE" VALUE 0x0 RTE_RL_FLOAT32_IEEE 0 NO_COMPU_METHOD -3.402823466e+38 3.402823466e+38 SYMBOL_LINK "Rte_CalprmRom_CalRegn03Inin00GroupB_DEFAULT_RTE_CALPRM_GROUP.WhlImbRejctnMgnEstimnDeltaSca_Val" 0 DISPLAY_IDENTIFIER WhlImbRejctn.CalibrationPorts.WhlImbRejctnMgnEstimnDeltaSca.Val /end CHARACTERISTIC
/begin CHARACTERISTIC WhlImbRejctn.WhlImbRejctnMgnEstimnDiThd.Val "MICROSAR RTE" VALUE 0x0 RTE_RL_FLOAT32_IEEE 0 NO_COMPU_METHOD -3.402823466e+38 3.402823466e+38 SYMBOL_LINK "Rte_CalprmRom_CalRegn03Inin00GroupB_DEFAULT_RTE_CALPRM_GROUP.WhlImbRejctnMgnEstimnDiThd_Val" 0 DISPLAY_IDENTIFIER WhlImbRejctn.CalibrationPorts.WhlImbRejctnMgnEstimnDiThd.Val /end CHARACTERISTIC
/begin CHARACTERISTIC WhlImbRejctn.WhlImbRejctnMgnEstimnEnaThd.Val "MICROSAR RTE" VALUE 0x0 RTE_RL_FLOAT32_IEEE 0 NO_COMPU_METHOD -3.402823466e+38 3.402823466e+38 SYMBOL_LINK "Rte_CalprmRom_CalRegn03Inin00GroupB_DEFAULT_RTE_CALPRM_GROUP.WhlImbRejctnMgnEstimnEnaThd_Val" 0 DISPLAY_IDENTIFIER WhlImbRejctn.CalibrationPorts.WhlImbRejctnMgnEstimnEnaThd.Val /end CHARACTERISTIC
/begin CHARACTERISTIC WhlImbRejctn.WhlImbRejctnMgnEstimnFrq.Val "MICROSAR RTE" VALUE 0x0 RTE_RL_FLOAT32_IEEE 0 NO_COMPU_METHOD -3.402823466e+38 3.402823466e+38 SYMBOL_LINK "Rte_CalprmRom_CalRegn03Inin00GroupB_DEFAULT_RTE_CALPRM_GROUP.WhlImbRejctnMgnEstimnFrq_Val" 0 DISPLAY_IDENTIFIER WhlImbRejctn.CalibrationPorts.WhlImbRejctnMgnEstimnFrq.Val /end CHARACTERISTIC
/begin CHARACTERISTIC WhlImbRejctn.WhlImbRejctnMgnEstimnFrqDelta.Val "MICROSAR RTE" VALUE 0x0 RTE_RL_FLOAT32_IEEE 0 NO_COMPU_METHOD -3.402823466e+38 3.402823466e+38 SYMBOL_LINK "Rte_CalprmRom_CalRegn03Inin00GroupB_DEFAULT_RTE_CALPRM_GROUP.WhlImbRejctnMgnEstimnFrqDelta_Val" 0 DISPLAY_IDENTIFIER WhlImbRejctn.CalibrationPorts.WhlImbRejctnMgnEstimnFrqDelta.Val /end CHARACTERISTIC
/begin CHARACTERISTIC WhlImbRejctn.WhlImbRejctnMgnEstimnLeak.Val "MICROSAR RTE" VALUE 0x0 RTE_RL_FLOAT32_IEEE 0 NO_COMPU_METHOD -3.402823466e+38 3.402823466e+38 SYMBOL_LINK "Rte_CalprmRom_CalRegn03Inin00GroupB_DEFAULT_RTE_CALPRM_GROUP.WhlImbRejctnMgnEstimnLeak_Val" 0 DISPLAY_IDENTIFIER WhlImbRejctn.CalibrationPorts.WhlImbRejctnMgnEstimnLeak.Val /end CHARACTERISTIC
/begin CHARACTERISTIC WhlImbRejctn.WhlImbRejctnPhaAdjX.Ary1D "MICROSAR RTE" VAL_BLK 0x0 RTE_RL_UWORD 0 NO_COMPU_METHOD 0 65535 MATRIX_DIM 3 1 1 SYMBOL_LINK "Rte_CalprmRom_CalRegn03Inin00GroupB_DEFAULT_RTE_CALPRM_GROUP.WhlImbRejctnPhaAdjX_Ary1D" 0 DISPLAY_IDENTIFIER WhlImbRejctn.CalibrationPorts.WhlImbRejctnPhaAdjX.Ary1D /end CHARACTERISTIC
/begin CHARACTERISTIC WhlImbRejctn.WhlImbRejctnPhaAdjY.Ary1D "MICROSAR RTE" VAL_BLK 0x0 RTE_RL_SWORD 0 NO_COMPU_METHOD -32768 32767 MATRIX_DIM 3 1 1 SYMBOL_LINK "Rte_CalprmRom_CalRegn03Inin00GroupB_DEFAULT_RTE_CALPRM_GROUP.WhlImbRejctnPhaAdjY_Ary1D" 0 DISPLAY_IDENTIFIER WhlImbRejctn.CalibrationPorts.WhlImbRejctnPhaAdjY.Ary1D /end CHARACTERISTIC
/begin CHARACTERISTIC WhlImbRejctn.WhlImbRejctnRampDwnTi.Val "MICROSAR RTE" VALUE 0x0 RTE_RL_UWORD 0 NO_COMPU_METHOD 0 65535 SYMBOL_LINK "Rte_CalprmRom_CalRegn03CmnGroupB_DEFAULT_RTE_CALPRM_GROUP.WhlImbRejctnRampDwnTi_Val" 0 DISPLAY_IDENTIFIER WhlImbRejctn.CalibrationPorts.WhlImbRejctnRampDwnTi.Val /end CHARACTERISTIC
/begin CHARACTERISTIC WhlImbRejctn.WhlImbRejctnScaCncl.Val "MICROSAR RTE" VALUE 0x0 RTE_RL_FLOAT32_IEEE 0 NO_COMPU_METHOD -3.402823466e+38 3.402823466e+38 SYMBOL_LINK "Rte_CalprmRom_CalRegn03CmnGroupB_DEFAULT_RTE_CALPRM_GROUP.WhlImbRejctnScaCncl_Val" 0 DISPLAY_IDENTIFIER WhlImbRejctn.CalibrationPorts.WhlImbRejctnScaCncl.Val /end CHARACTERISTIC
/begin CHARACTERISTIC WhlImbRejctn.WhlImbRejctnUgrPoleMgn.Val "MICROSAR RTE" VALUE 0x0 RTE_RL_FLOAT32_IEEE 0 NO_COMPU_METHOD -3.402823466e+38 3.402823466e+38 SYMBOL_LINK "Rte_CalprmRom_CalRegn03CmnGroupB_DEFAULT_RTE_CALPRM_GROUP.WhlImbRejctnUgrPoleMgn_Val" 0 DISPLAY_IDENTIFIER WhlImbRejctn.CalibrationPorts.WhlImbRejctnUgrPoleMgn.Val /end CHARACTERISTIC
/begin CHARACTERISTIC WhlImbRejctn.WhlImbRejctnVehSpdEna.Val "MICROSAR RTE" VALUE 0x0 RTE_RL_FLOAT32_IEEE 0 NO_COMPU_METHOD -3.402823466e+38 3.402823466e+38 SYMBOL_LINK "Rte_CalprmRom_CalRegn03CmnGroupB_DEFAULT_RTE_CALPRM_GROUP.WhlImbRejctnVehSpdEna_Val" 0 DISPLAY_IDENTIFIER WhlImbRejctn.CalibrationPorts.WhlImbRejctnVehSpdEna.Val /end CHARACTERISTIC
/begin CHARACTERISTIC WhlImbRejctn.WhlImbRejctnWhlSpdCorrlnFltRcvryDly.Val "MICROSAR RTE" VALUE 0x0 RTE_RL_FLOAT32_IEEE 0 NO_COMPU_METHOD -3.402823466e+38 3.402823466e+38 SYMBOL_LINK "Rte_CalprmRom_CalRegn01CmnGroupB_DEFAULT_RTE_CALPRM_GROUP.WhlImbRejctnWhlSpdCorrlnFltRcvryDly_Val" 0 DISPLAY_IDENTIFIER WhlImbRejctn.CalibrationPorts.WhlImbRejctnWhlSpdCorrlnFltRcvryDly.Val /end CHARACTERISTIC
/begin CHARACTERISTIC WhlImbRejctn.WhlImbRejctnWhlSpdCorrlnFltRcvryNegStep.Val "MICROSAR RTE" VALUE 0x0 RTE_RL_FLOAT32_IEEE 0 NO_COMPU_METHOD -3.402823466e+38 3.402823466e+38 SYMBOL_LINK "Rte_CalprmRom_CalRegn01Inin00GroupB_DEFAULT_RTE_CALPRM_GROUP.WhlImbRejctnWhlSpdCorrlnFltRcvryNegStep_Val" 0 DISPLAY_IDENTIFIER WhlImbRejctn.CalibrationPorts.WhlImbRejctnWhlSpdCorrlnFltRcvryNegStep.Val /end CHARACTERISTIC
/begin CHARACTERISTIC WhlImbRejctn.WhlImbRejctnWhlSpdCorrlnFltRcvryPosStep.Val "MICROSAR RTE" VALUE 0x0 RTE_RL_FLOAT32_IEEE 0 NO_COMPU_METHOD -3.402823466e+38 3.402823466e+38 SYMBOL_LINK "Rte_CalprmRom_CalRegn01Inin00GroupB_DEFAULT_RTE_CALPRM_GROUP.WhlImbRejctnWhlSpdCorrlnFltRcvryPosStep_Val" 0 DISPLAY_IDENTIFIER WhlImbRejctn.CalibrationPorts.WhlImbRejctnWhlSpdCorrlnFltRcvryPosStep.Val /end CHARACTERISTIC
/begin CHARACTERISTIC WhlImbRejctn.WhlImbRejctnWhlSpdCorrlnFltRcvryThd.Val "MICROSAR RTE" VALUE 0x0 RTE_RL_FLOAT32_IEEE 0 NO_COMPU_METHOD -3.402823466e+38 3.402823466e+38 SYMBOL_LINK "Rte_CalprmRom_CalRegn01Inin00GroupB_DEFAULT_RTE_CALPRM_GROUP.WhlImbRejctnWhlSpdCorrlnFltRcvryThd_Val" 0 DISPLAY_IDENTIFIER WhlImbRejctn.CalibrationPorts.WhlImbRejctnWhlSpdCorrlnFltRcvryThd.Val /end CHARACTERISTIC
/begin CHARACTERISTIC WhlImbRejctn.WhlImbRejctnWhlSpdCorrlnThd.Val "MICROSAR RTE" VALUE 0x0 RTE_RL_FLOAT32_IEEE 0 NO_COMPU_METHOD -3.402823466e+38 3.402823466e+38 SYMBOL_LINK "Rte_CalprmRom_CalRegn03Inin00GroupB_DEFAULT_RTE_CALPRM_GROUP.WhlImbRejctnWhlSpdCorrlnThd_Val" 0 DISPLAY_IDENTIFIER WhlImbRejctn.CalibrationPorts.WhlImbRejctnWhlSpdCorrlnThd.Val /end CHARACTERISTIC
/begin CHARACTERISTIC WhlImbRejctn.WhlImbRejctnWhlSpdCorrlnTi.Val "MICROSAR RTE" VALUE 0x0 RTE_RL_UWORD 0 NO_COMPU_METHOD 0 65535 SYMBOL_LINK "Rte_CalprmRom_CalRegn03Inin00GroupB_DEFAULT_RTE_CALPRM_GROUP.WhlImbRejctnWhlSpdCorrlnTi_Val" 0 DISPLAY_IDENTIFIER WhlImbRejctn.CalibrationPorts.WhlImbRejctnWhlSpdCorrlnTi.Val /end CHARACTERISTIC
/begin CHARACTERISTIC WhlImbRejctn.WhlImbRejctnWhlSpdLpFil.Val "MICROSAR RTE" VALUE 0x0 RTE_RL_FLOAT32_IEEE 0 NO_COMPU_METHOD -3.402823466e+38 3.402823466e+38 SYMBOL_LINK "Rte_CalprmRom_CalRegn03Inin00_DEFAULT_RTE_CALPRM_GROUP.WhlImbRejctnWhlSpdLpFil_Val" 0 DISPLAY_IDENTIFIER WhlImbRejctn.CalibrationPorts.WhlImbRejctnWhlSpdLpFil.Val /end CHARACTERISTIC
/begin MEASUREMENT TunSelnAuthy.TunSelnRtDi.Logl "MICROSAR RTE" UBYTE RTE_CM_BOOLEAN 0 0 0 255 ECU_ADDRESS 0 SYMBOL_LINK "Rte_GmFctDiArbn_TunSetRtDi_Logl" 0 DISPLAY_IDENTIFIER TunSelnAuthy.ReceiverPorts.TunSelnRtDi.Logl /end MEASUREMENT
/begin MEASUREMENT TunSelnAuthy.VehSpd.Val "MICROSAR RTE" FLOAT32_IEEE NO_COMPU_METHOD 0 0 -3.402823466e+38 3.402823466e+38 ECU_ADDRESS 0 SYMBOL_LINK "Rte_VehSigCdng_VehSpd_Val" 0 DISPLAY_IDENTIFIER TunSelnAuthy.ReceiverPorts.VehSpd.Val /end MEASUREMENT
/begin MEASUREMENT TunSelnMngt.ActvIninIdx.Val "MICROSAR RTE" UBYTE NO_COMPU_METHOD 0 0 0 255 ECU_ADDRESS 0 SYMBOL_LINK "Rte_TunSelnMngt_ActvIninIdx_Val" 0 DISPLAY_IDENTIFIER TunSelnMngt.SenderPorts.ActvIninIdx.Val /end MEASUREMENT
/begin MEASUREMENT TunSelnMngt.ActvRtIdx.Val "MICROSAR RTE" UBYTE NO_COMPU_METHOD 0 0 0 255 ECU_ADDRESS 0 SYMBOL_LINK "Rte_TunSelnMngt_ActvRtIdx_Val" 0 DISPLAY_IDENTIFIER TunSelnMngt.SenderPorts.ActvRtIdx.Val /end MEASUREMENT
/begin MEASUREMENT TunSelnMngt.DesIninIdx.Val "MICROSAR RTE" UBYTE NO_COMPU_METHOD 0 0 0 255 ECU_ADDRESS 0 SYMBOL_LINK "Rte_TunSelnMngt_DesIninIdx_Val" 0 DISPLAY_IDENTIFIER TunSelnMngt.ReceiverPorts.DesIninIdx.Val /end MEASUREMENT
/begin MEASUREMENT TunSelnMngt.DesRtIdx.Val "MICROSAR RTE" UBYTE NO_COMPU_METHOD 0 0 0 255 ECU_ADDRESS 0 SYMBOL_LINK "Rte_GmMsg232BusHiSpd_DesRtIdx_Val" 0 DISPLAY_IDENTIFIER TunSelnMngt.ReceiverPorts.DesRtIdx.Val /end MEASUREMENT
/begin MEASUREMENT TunSelnMngt.PrevActvIninIdx "MICROSAR RTE" UBYTE NO_COMPU_METHOD 0 0 0 255 ECU_ADDRESS 0 SYMBOL_LINK "Rte_TunSelnMngt_PrevActvIninIdx" 0 DISPLAY_IDENTIFIER TunSelnMngt.PerInstanceMemories.PrevActvIninIdx /end MEASUREMENT
/begin MEASUREMENT TunSelnMngt.PrevActvRtIdx "MICROSAR RTE" UBYTE NO_COMPU_METHOD 0 0 0 255 ECU_ADDRESS 0 SYMBOL_LINK "Rte_TunSelnMngt_PrevActvRtIdx" 0 DISPLAY_IDENTIFIER TunSelnMngt.PerInstanceMemories.PrevActvRtIdx /end MEASUREMENT
/begin MEASUREMENT TunSelnMngt.PrevRamPageAcs "MICROSAR RTE" UBYTE NO_COMPU_METHOD 0 0 0 255 ECU_ADDRESS 0 SYMBOL_LINK "Rte_TunSelnMngt_PrevRamPageAcs" 0 DISPLAY_IDENTIFIER TunSelnMngt.PerInstanceMemories.PrevRamPageAcs /end MEASUREMENT
/begin MEASUREMENT TunSelnMngt.RamTblSwt "MICROSAR RTE" UBYTE NO_COMPU_METHOD 0 0 0 255 ECU_ADDRESS 0 SYMBOL_LINK "Rte_TunSelnMngt_RamTblSwt" 0 DISPLAY_IDENTIFIER TunSelnMngt.PerInstanceMemories.RamTblSwt /end MEASUREMENT
/begin MEASUREMENT VehSigCdng.HwTq.Val "MICROSAR RTE" FLOAT32_IEEE NO_COMPU_METHOD 0 0 -3.402823466e+38 3.402823466e+38 ECU_ADDRESS 0 SYMBOL_LINK "Rte_Swp_HwTqSwp_Val" 0 DISPLAY_IDENTIFIER VehSigCdng.ReceiverPorts.HwTq.Val /end MEASUREMENT
/begin MEASUREMENT VehSigCdng.HwTqFilRec.FilGain "MICROSAR RTE" FLOAT32_IEEE NO_COMPU_METHOD 0 0 -3.402823466e+38 3.402823466e+38 ECU_ADDRESS 0 SYMBOL_LINK "Rte_VehSigCdng_HwTqFilRec.FilGain" 0 DISPLAY_IDENTIFIER VehSigCdng.PerInstanceMemories.HwTqFilRec.FilGain /end MEASUREMENT
/begin MEASUREMENT VehSigCdng.HwTqFilRec.FilSt "MICROSAR RTE" FLOAT32_IEEE NO_COMPU_METHOD 0 0 -3.402823466e+38 3.402823466e+38 ECU_ADDRESS 0 SYMBOL_LINK "Rte_VehSigCdng_HwTqFilRec.FilSt" 0 DISPLAY_IDENTIFIER VehSigCdng.PerInstanceMemories.HwTqFilRec.FilSt /end MEASUREMENT
/begin MEASUREMENT VehSigCdng.LatAFilRec.FilGain "MICROSAR RTE" FLOAT32_IEEE NO_COMPU_METHOD 0 0 -3.402823466e+38 3.402823466e+38 ECU_ADDRESS 0 SYMBOL_LINK "Rte_VehSigCdng_LatAFilRec.FilGain" 0 DISPLAY_IDENTIFIER VehSigCdng.PerInstanceMemories.LatAFilRec.FilGain /end MEASUREMENT
/begin MEASUREMENT VehSigCdng.LatAFilRec.FilSt "MICROSAR RTE" FLOAT32_IEEE NO_COMPU_METHOD 0 0 -3.402823466e+38 3.402823466e+38 ECU_ADDRESS 0 SYMBOL_LINK "Rte_VehSigCdng_LatAFilRec.FilSt" 0 DISPLAY_IDENTIFIER VehSigCdng.PerInstanceMemories.LatAFilRec.FilSt /end MEASUREMENT
/begin MEASUREMENT VehSigCdng.PrevLatA "MICROSAR RTE" FLOAT32_IEEE NO_COMPU_METHOD 0 0 -10.0 10.0 ECU_ADDRESS 0 SYMBOL_LINK "Rte_VehSigCdng_PrevLatA" 0 DISPLAY_IDENTIFIER VehSigCdng.PerInstanceMemories.PrevLatA /end MEASUREMENT
/begin MEASUREMENT VehSigCdng.PrevLatAVld "MICROSAR RTE" UBYTE RTE_CM_BOOLEAN 0 0 0 255 ECU_ADDRESS 0 SYMBOL_LINK "Rte_VehSigCdng_PrevLatAVld" 0 DISPLAY_IDENTIFIER VehSigCdng.PerInstanceMemories.PrevLatAVld /end MEASUREMENT
/begin MEASUREMENT VehSigCdng.PrevLtgA "MICROSAR RTE" FLOAT32_IEEE NO_COMPU_METHOD 0 0 -50.0 50.0 ECU_ADDRESS 0 SYMBOL_LINK "Rte_VehSigCdng_PrevLtgA" 0 DISPLAY_IDENTIFIER VehSigCdng.PerInstanceMemories.PrevLtgA /end MEASUREMENT
/begin MEASUREMENT VehSigCdng.PrevLtgAVld "MICROSAR RTE" UBYTE RTE_CM_BOOLEAN 0 0 0 255 ECU_ADDRESS 0 SYMBOL_LINK "Rte_VehSigCdng_PrevLtgAVld" 0 DISPLAY_IDENTIFIER VehSigCdng.PerInstanceMemories.PrevLtgAVld /end MEASUREMENT
/begin MEASUREMENT VehSigCdng.PrevVehSpd "MICROSAR RTE" FLOAT32_IEEE NO_COMPU_METHOD 0 0 0.0 511.0 ECU_ADDRESS 0 SYMBOL_LINK "Rte_VehSigCdng_PrevVehSpd" 0 DISPLAY_IDENTIFIER VehSigCdng.PerInstanceMemories.PrevVehSpd /end MEASUREMENT
/begin MEASUREMENT VehSigCdng.PrevVehSpdVld "MICROSAR RTE" UBYTE RTE_CM_BOOLEAN 0 0 0 255 ECU_ADDRESS 0 SYMBOL_LINK "Rte_VehSigCdng_PrevVehSpdVld" 0 DISPLAY_IDENTIFIER VehSigCdng.PerInstanceMemories.PrevVehSpdVld /end MEASUREMENT
/begin MEASUREMENT VehSigCdng.PrevYawRate "MICROSAR RTE" FLOAT32_IEEE NO_COMPU_METHOD 0 0 -120.0 120.0 ECU_ADDRESS 0 SYMBOL_LINK "Rte_VehSigCdng_PrevYawRate" 0 DISPLAY_IDENTIFIER VehSigCdng.PerInstanceMemories.PrevYawRate /end MEASUREMENT
/begin MEASUREMENT VehSigCdng.PrevYawRateVld "MICROSAR RTE" UBYTE RTE_CM_BOOLEAN 0 0 0 255 ECU_ADDRESS 0 SYMBOL_LINK "Rte_VehSigCdng_PrevYawRateVld" 0 DISPLAY_IDENTIFIER VehSigCdng.PerInstanceMemories.PrevYawRateVld /end MEASUREMENT
/begin MEASUREMENT VehSigCdng.VehLatA.Val "MICROSAR RTE" FLOAT32_IEEE NO_COMPU_METHOD 0 0 -10.0 10.0 ECU_ADDRESS 0 SYMBOL_LINK "Rte_VehSigCdng_VehLatA_Val" 0 DISPLAY_IDENTIFIER VehSigCdng.SenderPorts.VehLatA.Val /end MEASUREMENT
/begin MEASUREMENT VehSigCdng.VehLatAEstimd.Val "MICROSAR RTE" FLOAT32_IEEE NO_COMPU_METHOD 0 0 -3.402823466e+38 3.402823466e+38 ECU_ADDRESS 0 SYMBOL_LINK "Rte_VehSigCdng_VehLatAEstimd_Val" 0 DISPLAY_IDENTIFIER VehSigCdng.SenderPorts.VehLatAEstimd.Val /end MEASUREMENT
/begin MEASUREMENT VehSigCdng.VehLatAEstimdVld.Logl "MICROSAR RTE" UBYTE RTE_CM_BOOLEAN 0 0 0 255 ECU_ADDRESS 0 SYMBOL_LINK "Rte_VehSigCdng_VehLatAEstimdVld_Logl" 0 DISPLAY_IDENTIFIER VehSigCdng.SenderPorts.VehLatAEstimdVld.Logl /end MEASUREMENT
/begin MEASUREMENT VehSigCdng.VehLatASerlCom.Val "MICROSAR RTE" FLOAT32_IEEE NO_COMPU_METHOD 0 0 -10.0 10.0 ECU_ADDRESS 0 SYMBOL_LINK "Rte_GmMsg1E9BusHiSpd_SerlComLatA_Val" 0 DISPLAY_IDENTIFIER VehSigCdng.ReceiverPorts.VehLatASerlCom.Val /end MEASUREMENT
/begin MEASUREMENT VehSigCdng.VehLatAVld.Logl "MICROSAR RTE" UBYTE RTE_CM_BOOLEAN 0 0 0 255 ECU_ADDRESS 0 SYMBOL_LINK "Rte_VehSigCdng_VehLatAVld_Logl" 0 DISPLAY_IDENTIFIER VehSigCdng.SenderPorts.VehLatAVld.Logl /end MEASUREMENT
/begin MEASUREMENT VehSigCdng.VehLatAVldSerlCom.Logl "MICROSAR RTE" UBYTE RTE_CM_BOOLEAN 0 0 0 255 ECU_ADDRESS 0 SYMBOL_LINK "Rte_GmMsg1E9BusHiSpd_VehLatAVldSerlCom_Logl" 0 DISPLAY_IDENTIFIER VehSigCdng.ReceiverPorts.VehLatAVldSerlCom.Logl /end MEASUREMENT
/begin MEASUREMENT VehSigCdng.VehLgtA.Val "MICROSAR RTE" FLOAT32_IEEE NO_COMPU_METHOD 0 0 -50.0 50.0 ECU_ADDRESS 0 SYMBOL_LINK "Rte_VehSigCdng_VehLgtA_Val" 0 DISPLAY_IDENTIFIER VehSigCdng.SenderPorts.VehLgtA.Val /end MEASUREMENT
/begin MEASUREMENT VehSigCdng.VehLgtASerlCom.Val "MICROSAR RTE" FLOAT32_IEEE NO_COMPU_METHOD 0 0 -180.0 180.0 ECU_ADDRESS 0 SYMBOL_LINK "Rte_GmMsg182BusChassisExp_SerlComVehLgtA_Val" 0 DISPLAY_IDENTIFIER VehSigCdng.ReceiverPorts.VehLgtASerlCom.Val /end MEASUREMENT
/begin MEASUREMENT VehSigCdng.VehLgtAVld.Logl "MICROSAR RTE" UBYTE RTE_CM_BOOLEAN 0 0 0 255 ECU_ADDRESS 0 SYMBOL_LINK "Rte_VehSigCdng_VehLgtAVld_Logl" 0 DISPLAY_IDENTIFIER VehSigCdng.SenderPorts.VehLgtAVld.Logl /end MEASUREMENT
/begin MEASUREMENT VehSigCdng.VehLgtAVldSerlCom.Logl "MICROSAR RTE" UBYTE RTE_CM_BOOLEAN 0 0 0 255 ECU_ADDRESS 0 SYMBOL_LINK "Rte_VehSigCdng_VehLgtAVldSerlCom_Logl" 0 DISPLAY_IDENTIFIER VehSigCdng.ReceiverPorts.VehLgtAVldSerlCom.Logl /end MEASUREMENT
/begin MEASUREMENT VehSigCdng.VehSpd.Val "MICROSAR RTE" FLOAT32_IEEE NO_COMPU_METHOD 0 0 0.0 511.0 ECU_ADDRESS 0 SYMBOL_LINK "Rte_VehSigCdng_VehSpd_Val" 0 DISPLAY_IDENTIFIER VehSigCdng.SenderPorts.VehSpd.Val /end MEASUREMENT
/begin MEASUREMENT VehSigCdng.VehSpdOvrd.Val "MICROSAR RTE" FLOAT32_IEEE NO_COMPU_METHOD 0 0 -3.402823466e+38 3.402823466e+38 ECU_ADDRESS 0 SYMBOL_LINK "Rte_CmnMfgSrv_VehSpdOvrd_Val" 0 DISPLAY_IDENTIFIER VehSigCdng.ReceiverPorts.VehSpdOvrd.Val /end MEASUREMENT
/begin MEASUREMENT VehSigCdng.VehSpdOvrdEna.Logl "MICROSAR RTE" UBYTE RTE_CM_BOOLEAN 0 0 0 255 ECU_ADDRESS 0 SYMBOL_LINK "Rte_CmnMfgSrv_VehSpdOvrdEna_Logl" 0 DISPLAY_IDENTIFIER VehSigCdng.ReceiverPorts.VehSpdOvrdEna.Logl /end MEASUREMENT
/begin MEASUREMENT VehSigCdng.VehSpdSerlCom.Val "MICROSAR RTE" FLOAT32_IEEE NO_COMPU_METHOD 0 0 0.0 511.0 ECU_ADDRESS 0 SYMBOL_LINK "Rte_GmVehSpdArbn_VehSpdArbd_Val" 0 DISPLAY_IDENTIFIER VehSigCdng.ReceiverPorts.VehSpdSerlCom.Val /end MEASUREMENT
/begin MEASUREMENT VehSigCdng.VehSpdVld.Logl "MICROSAR RTE" UBYTE RTE_CM_BOOLEAN 0 0 0 255 ECU_ADDRESS 0 SYMBOL_LINK "Rte_VehSigCdng_VehSpdVld_Logl" 0 DISPLAY_IDENTIFIER VehSigCdng.SenderPorts.VehSpdVld.Logl /end MEASUREMENT
/begin MEASUREMENT VehSigCdng.VehSpdVldSerlCom.Logl "MICROSAR RTE" UBYTE RTE_CM_BOOLEAN 0 0 0 255 ECU_ADDRESS 0 SYMBOL_LINK "Rte_GmVehSpdArbn_VehSpdArbdVld_Logl" 0 DISPLAY_IDENTIFIER VehSigCdng.ReceiverPorts.VehSpdVldSerlCom.Logl /end MEASUREMENT
/begin MEASUREMENT VehSigCdng.VehYawRate.Val "MICROSAR RTE" FLOAT32_IEEE NO_COMPU_METHOD 0 0 -120.0 120.0 ECU_ADDRESS 0 SYMBOL_LINK "Rte_VehSigCdng_VehYawRate_Val" 0 DISPLAY_IDENTIFIER VehSigCdng.SenderPorts.VehYawRate.Val /end MEASUREMENT
/begin MEASUREMENT VehSigCdng.VehYawRateSerlCom.Val "MICROSAR RTE" FLOAT32_IEEE NO_COMPU_METHOD 0 0 -120.0 120.0 ECU_ADDRESS 0 SYMBOL_LINK "Rte_GmMsg1E9BusHiSpd_SerlComYawRate_Val" 0 DISPLAY_IDENTIFIER VehSigCdng.ReceiverPorts.VehYawRateSerlCom.Val /end MEASUREMENT
/begin MEASUREMENT VehSigCdng.VehYawRateVld.Logl "MICROSAR RTE" UBYTE RTE_CM_BOOLEAN 0 0 0 255 ECU_ADDRESS 0 SYMBOL_LINK "Rte_VehSigCdng_VehYawRateVld_Logl" 0 DISPLAY_IDENTIFIER VehSigCdng.SenderPorts.VehYawRateVld.Logl /end MEASUREMENT
/begin MEASUREMENT VehSigCdng.VehYawRateVldSerlCom.Logl "MICROSAR RTE" UBYTE RTE_CM_BOOLEAN 0 0 0 255 ECU_ADDRESS 0 SYMBOL_LINK "Rte_GmMsg1E9BusHiSpd_SerlComYawRateVld_Logl" 0 DISPLAY_IDENTIFIER VehSigCdng.ReceiverPorts.VehYawRateVldSerlCom.Logl /end MEASUREMENT
/begin MEASUREMENT VehSpdLimr.HwAg.Val "MICROSAR RTE" FLOAT32_IEEE NO_COMPU_METHOD 0 0 -3.402823466e+38 3.402823466e+38 ECU_ADDRESS 0 SYMBOL_LINK "Rte_HwAgSysArbn_HwAgFinal_Val" 0 DISPLAY_IDENTIFIER VehSpdLimr.ReceiverPorts.HwAg.Val /end MEASUREMENT
/begin MEASUREMENT VehSpdLimr.HwAgAuthy.Val "MICROSAR RTE" FLOAT32_IEEE NO_COMPU_METHOD 0 0 -3.402823466e+38 3.402823466e+38 ECU_ADDRESS 0 SYMBOL_LINK "Rte_HwAgSysArbn_PinionAgConf_Val" 0 DISPLAY_IDENTIFIER VehSpdLimr.ReceiverPorts.HwAgAuthy.Val /end MEASUREMENT
/begin MEASUREMENT VehSpdLimr.HwAgEotCcw.Val "MICROSAR RTE" FLOAT32_IEEE NO_COMPU_METHOD 0 0 -3.402823466e+38 3.402823466e+38 ECU_ADDRESS 0 SYMBOL_LINK "Rte_EotLrng_HwAgEotCcw_Val" 0 DISPLAY_IDENTIFIER VehSpdLimr.ReceiverPorts.HwAgEotCcw.Val /end MEASUREMENT
/begin MEASUREMENT VehSpdLimr.HwAgEotCw.Val "MICROSAR RTE" FLOAT32_IEEE NO_COMPU_METHOD 0 0 -3.402823466e+38 3.402823466e+38 ECU_ADDRESS 0 SYMBOL_LINK "Rte_EotLrng_HwAgEotCw_Val" 0 DISPLAY_IDENTIFIER VehSpdLimr.ReceiverPorts.HwAgEotCw.Val /end MEASUREMENT
/begin MEASUREMENT VehSpdLimr.VehSpd.Val "MICROSAR RTE" FLOAT32_IEEE NO_COMPU_METHOD 0 0 -3.402823466e+38 3.402823466e+38 ECU_ADDRESS 0 SYMBOL_LINK "Rte_VehSigCdng_VehSpd_Val" 0 DISPLAY_IDENTIFIER VehSpdLimr.ReceiverPorts.VehSpd.Val /end MEASUREMENT
/begin MEASUREMENT VehSpdLimr.VehSpdMotTqLim.Val "MICROSAR RTE" FLOAT32_IEEE NO_COMPU_METHOD 0 0 -3.402823466e+38 3.402823466e+38 ECU_ADDRESS 0 SYMBOL_LINK "Rte_VehSpdLimr_VehSpdMotTqLim_Val" 0 DISPLAY_IDENTIFIER VehSpdLimr.SenderPorts.VehSpdMotTqLim.Val /end MEASUREMENT
/begin MEASUREMENT VehSpdLimr.dVehSpdLimrBreakPt1 "MICROSAR RTE" FLOAT32_IEEE NO_COMPU_METHOD 0 0 -3.402823466e+38 3.402823466e+38 ECU_ADDRESS 0 SYMBOL_LINK "Rte_VehSpdLimr_dVehSpdLimrBreakPt1" 0 DISPLAY_IDENTIFIER VehSpdLimr.PerInstanceMemories.dVehSpdLimrBreakPt1 /end MEASUREMENT
/begin MEASUREMENT VehSpdLimr.dVehSpdLimrBreakPt2 "MICROSAR RTE" FLOAT32_IEEE NO_COMPU_METHOD 0 0 -3.402823466e+38 3.402823466e+38 ECU_ADDRESS 0 SYMBOL_LINK "Rte_VehSpdLimr_dVehSpdLimrBreakPt2" 0 DISPLAY_IDENTIFIER VehSpdLimr.PerInstanceMemories.dVehSpdLimrBreakPt2 /end MEASUREMENT
/begin MEASUREMENT VehSpdLimr.dVehSpdLimrLimTerm "MICROSAR RTE" UWORD NO_COMPU_METHOD 0 0 0 65535 ECU_ADDRESS 0 SYMBOL_LINK "Rte_VehSpdLimr_dVehSpdLimrLimTerm" 0 DISPLAY_IDENTIFIER VehSpdLimr.PerInstanceMemories.dVehSpdLimrLimTerm /end MEASUREMENT
/begin MEASUREMENT VehSpdLimr.dVehSpdLimrZeroVehSpd "MICROSAR RTE" UWORD NO_COMPU_METHOD 0 0 0 65535 ECU_ADDRESS 0 SYMBOL_LINK "Rte_VehSpdLimr_dVehSpdLimrZeroVehSpd" 0 DISPLAY_IDENTIFIER VehSpdLimr.PerInstanceMemories.dVehSpdLimrZeroVehSpd /end MEASUREMENT
/begin MEASUREMENT WhlImbRejctn.BlndCmdMgnLp1Fil.FilGain "MICROSAR RTE" FLOAT32_IEEE NO_COMPU_METHOD 0 0 -3.402823466e+38 3.402823466e+38 ECU_ADDRESS 0 SYMBOL_LINK "Rte_WhlImbRejctn_BlndCmdMgnLp1Fil.FilGain" 0 DISPLAY_IDENTIFIER WhlImbRejctn.PerInstanceMemories.BlndCmdMgnLp1Fil.FilGain /end MEASUREMENT
/begin MEASUREMENT WhlImbRejctn.BlndCmdMgnLp1Fil.FilSt "MICROSAR RTE" FLOAT32_IEEE NO_COMPU_METHOD 0 0 -3.402823466e+38 3.402823466e+38 ECU_ADDRESS 0 SYMBOL_LINK "Rte_WhlImbRejctn_BlndCmdMgnLp1Fil.FilSt" 0 DISPLAY_IDENTIFIER WhlImbRejctn.PerInstanceMemories.BlndCmdMgnLp1Fil.FilSt /end MEASUREMENT
/begin MEASUREMENT WhlImbRejctn.BlndCmdMgnLp2Fil.FilGain "MICROSAR RTE" FLOAT32_IEEE NO_COMPU_METHOD 0 0 -3.402823466e+38 3.402823466e+38 ECU_ADDRESS 0 SYMBOL_LINK "Rte_WhlImbRejctn_BlndCmdMgnLp2Fil.FilGain" 0 DISPLAY_IDENTIFIER WhlImbRejctn.PerInstanceMemories.BlndCmdMgnLp2Fil.FilGain /end MEASUREMENT
/begin MEASUREMENT WhlImbRejctn.BlndCmdMgnLp2Fil.FilSt "MICROSAR RTE" FLOAT32_IEEE NO_COMPU_METHOD 0 0 -3.402823466e+38 3.402823466e+38 ECU_ADDRESS 0 SYMBOL_LINK "Rte_WhlImbRejctn_BlndCmdMgnLp2Fil.FilSt" 0 DISPLAY_IDENTIFIER WhlImbRejctn.PerInstanceMemories.BlndCmdMgnLp2Fil.FilSt /end MEASUREMENT
/begin MEASUREMENT WhlImbRejctn.CmdMgnLp1Fil.FilGain "MICROSAR RTE" FLOAT32_IEEE NO_COMPU_METHOD 0 0 -3.402823466e+38 3.402823466e+38 ECU_ADDRESS 0 SYMBOL_LINK "Rte_WhlImbRejctn_CmdMgnLp1Fil.FilGain" 0 DISPLAY_IDENTIFIER WhlImbRejctn.PerInstanceMemories.CmdMgnLp1Fil.FilGain /end MEASUREMENT
/begin MEASUREMENT WhlImbRejctn.CmdMgnLp1Fil.FilSt "MICROSAR RTE" FLOAT32_IEEE NO_COMPU_METHOD 0 0 -3.402823466e+38 3.402823466e+38 ECU_ADDRESS 0 SYMBOL_LINK "Rte_WhlImbRejctn_CmdMgnLp1Fil.FilSt" 0 DISPLAY_IDENTIFIER WhlImbRejctn.PerInstanceMemories.CmdMgnLp1Fil.FilSt /end MEASUREMENT
/begin MEASUREMENT WhlImbRejctn.CmdMgnLp2Fil.FilGain "MICROSAR RTE" FLOAT32_IEEE NO_COMPU_METHOD 0 0 -3.402823466e+38 3.402823466e+38 ECU_ADDRESS 0 SYMBOL_LINK "Rte_WhlImbRejctn_CmdMgnLp2Fil.FilGain" 0 DISPLAY_IDENTIFIER WhlImbRejctn.PerInstanceMemories.CmdMgnLp2Fil.FilGain /end MEASUREMENT
/begin MEASUREMENT WhlImbRejctn.CmdMgnLp2Fil.FilSt "MICROSAR RTE" FLOAT32_IEEE NO_COMPU_METHOD 0 0 -3.402823466e+38 3.402823466e+38 ECU_ADDRESS 0 SYMBOL_LINK "Rte_WhlImbRejctn_CmdMgnLp2Fil.FilSt" 0 DISPLAY_IDENTIFIER WhlImbRejctn.PerInstanceMemories.CmdMgnLp2Fil.FilSt /end MEASUREMENT
/begin MEASUREMENT WhlImbRejctn.CmpPeakData.ActvCmpBand1 "MICROSAR RTE" ULONG NO_COMPU_METHOD 0 0 0 4294967295 ECU_ADDRESS 0 SYMBOL_LINK "Rte_WhlImbRejctn_CmpPeakData.ActvCmpBand1" 0 DISPLAY_IDENTIFIER WhlImbRejctn.PerInstanceMemories.CmpPeakData.ActvCmpBand1 /end MEASUREMENT
/begin MEASUREMENT WhlImbRejctn.CmpPeakData.ActvCmpBand2 "MICROSAR RTE" ULONG NO_COMPU_METHOD 0 0 0 4294967295 ECU_ADDRESS 0 SYMBOL_LINK "Rte_WhlImbRejctn_CmpPeakData.ActvCmpBand2" 0 DISPLAY_IDENTIFIER WhlImbRejctn.PerInstanceMemories.CmpPeakData.ActvCmpBand2 /end MEASUREMENT
/begin MEASUREMENT WhlImbRejctn.CmpPeakData.ActvCmpBand3 "MICROSAR RTE" ULONG NO_COMPU_METHOD 0 0 0 4294967295 ECU_ADDRESS 0 SYMBOL_LINK "Rte_WhlImbRejctn_CmpPeakData.ActvCmpBand3" 0 DISPLAY_IDENTIFIER WhlImbRejctn.PerInstanceMemories.CmpPeakData.ActvCmpBand3 /end MEASUREMENT
/begin MEASUREMENT WhlImbRejctn.CmpPeakData.LePeakPrev "MICROSAR RTE" FLOAT32_IEEE NO_COMPU_METHOD 0 0 -3.402823466e+38 3.402823466e+38 ECU_ADDRESS 0 SYMBOL_LINK "Rte_WhlImbRejctn_CmpPeakData.LePeakPrev" 0 DISPLAY_IDENTIFIER WhlImbRejctn.PerInstanceMemories.CmpPeakData.LePeakPrev /end MEASUREMENT
/begin MEASUREMENT WhlImbRejctn.CmpPeakData.MaxCompPerc "MICROSAR RTE" FLOAT32_IEEE NO_COMPU_METHOD 0 0 -3.402823466e+38 3.402823466e+38 ECU_ADDRESS 0 SYMBOL_LINK "Rte_WhlImbRejctn_CmpPeakData.MaxCompPerc" 0 DISPLAY_IDENTIFIER WhlImbRejctn.PerInstanceMemories.CmpPeakData.MaxCompPerc /end MEASUREMENT
/begin MEASUREMENT WhlImbRejctn.CmpPeakData.RiPeakPrev "MICROSAR RTE" FLOAT32_IEEE NO_COMPU_METHOD 0 0 -3.402823466e+38 3.402823466e+38 ECU_ADDRESS 0 SYMBOL_LINK "Rte_WhlImbRejctn_CmpPeakData.RiPeakPrev" 0 DISPLAY_IDENTIFIER WhlImbRejctn.PerInstanceMemories.CmpPeakData.RiPeakPrev /end MEASUREMENT
/begin MEASUREMENT WhlImbRejctn.DcTrendFltFaild "MICROSAR RTE" UBYTE RTE_CM_BOOLEAN 0 0 0 255 ECU_ADDRESS 0 SYMBOL_LINK "Rte_WhlImbRejctn_DcTrendFltFaild" 0 DISPLAY_IDENTIFIER WhlImbRejctn.PerInstanceMemories.DcTrendFltFaild /end MEASUREMENT
/begin MEASUREMENT WhlImbRejctn.DcTrendFltRcvry.Cntr "MICROSAR RTE" FLOAT32_IEEE NO_COMPU_METHOD 0 0 -3.402823466e+38 3.402823466e+38 ECU_ADDRESS 0 SYMBOL_LINK "Rte_WhlImbRejctn_DcTrendFltRcvry.Cntr" 0 DISPLAY_IDENTIFIER WhlImbRejctn.PerInstanceMemories.DcTrendFltRcvry.Cntr /end MEASUREMENT
/begin MEASUREMENT WhlImbRejctn.DcTrendFltRcvry.NegStep "MICROSAR RTE" FLOAT32_IEEE NO_COMPU_METHOD 0 0 -3.402823466e+38 3.402823466e+38 ECU_ADDRESS 0 SYMBOL_LINK "Rte_WhlImbRejctn_DcTrendFltRcvry.NegStep" 0 DISPLAY_IDENTIFIER WhlImbRejctn.PerInstanceMemories.DcTrendFltRcvry.NegStep /end MEASUREMENT
/begin MEASUREMENT WhlImbRejctn.DcTrendFltRcvry.PosStep "MICROSAR RTE" FLOAT32_IEEE NO_COMPU_METHOD 0 0 -3.402823466e+38 3.402823466e+38 ECU_ADDRESS 0 SYMBOL_LINK "Rte_WhlImbRejctn_DcTrendFltRcvry.PosStep" 0 DISPLAY_IDENTIFIER WhlImbRejctn.PerInstanceMemories.DcTrendFltRcvry.PosStep /end MEASUREMENT
/begin MEASUREMENT WhlImbRejctn.DcTrendFltRcvry.Sts "MICROSAR RTE" UBYTE RTE_CM_ENUM_SigQlfr1 0 0 0 255 ECU_ADDRESS 0 SYMBOL_LINK "Rte_WhlImbRejctn_DcTrendFltRcvry.Sts" 0 DISPLAY_IDENTIFIER WhlImbRejctn.PerInstanceMemories.DcTrendFltRcvry.Sts /end MEASUREMENT
/begin MEASUREMENT WhlImbRejctn.DcTrendFltRcvry.Thd "MICROSAR RTE" FLOAT32_IEEE NO_COMPU_METHOD 0 0 -3.402823466e+38 3.402823466e+38 ECU_ADDRESS 0 SYMBOL_LINK "Rte_WhlImbRejctn_DcTrendFltRcvry.Thd" 0 DISPLAY_IDENTIFIER WhlImbRejctn.PerInstanceMemories.DcTrendFltRcvry.Thd /end MEASUREMENT
/begin MEASUREMENT WhlImbRejctn.DcTrendFltRst "MICROSAR RTE" UBYTE RTE_CM_BOOLEAN 0 0 0 255 ECU_ADDRESS 0 SYMBOL_LINK "Rte_WhlImbRejctn_DcTrendFltRst" 0 DISPLAY_IDENTIFIER WhlImbRejctn.PerInstanceMemories.DcTrendFltRst /end MEASUREMENT
/begin MEASUREMENT WhlImbRejctn.DcTrendLpFil.FilGain "MICROSAR RTE" FLOAT32_IEEE NO_COMPU_METHOD 0 0 -3.402823466e+38 3.402823466e+38 ECU_ADDRESS 0 SYMBOL_LINK "Rte_WhlImbRejctn_DcTrendLpFil.FilGain" 0 DISPLAY_IDENTIFIER WhlImbRejctn.PerInstanceMemories.DcTrendLpFil.FilGain /end MEASUREMENT
/begin MEASUREMENT WhlImbRejctn.DcTrendLpFil.FilSt "MICROSAR RTE" FLOAT32_IEEE NO_COMPU_METHOD 0 0 -3.402823466e+38 3.402823466e+38 ECU_ADDRESS 0 SYMBOL_LINK "Rte_WhlImbRejctn_DcTrendLpFil.FilSt" 0 DISPLAY_IDENTIFIER WhlImbRejctn.PerInstanceMemories.DcTrendLpFil.FilSt /end MEASUREMENT
/begin MEASUREMENT WhlImbRejctn.DcTrendLrngEnaPrev "MICROSAR RTE" UBYTE RTE_CM_BOOLEAN 0 0 0 255 ECU_ADDRESS 0 SYMBOL_LINK "Rte_WhlImbRejctn_DcTrendLrngEnaPrev" 0 DISPLAY_IDENTIFIER WhlImbRejctn.PerInstanceMemories.DcTrendLrngEnaPrev /end MEASUREMENT
/begin MEASUREMENT WhlImbRejctn.DcTrendLrngEnaPrevTmr1 "MICROSAR RTE" UBYTE RTE_CM_BOOLEAN 0 0 0 255 ECU_ADDRESS 0 SYMBOL_LINK "Rte_WhlImbRejctn_DcTrendLrngEnaPrevTmr1" 0 DISPLAY_IDENTIFIER WhlImbRejctn.PerInstanceMemories.DcTrendLrngEnaPrevTmr1 /end MEASUREMENT
/begin MEASUREMENT WhlImbRejctn.DcTrendLrngEnaPrevTmr2 "MICROSAR RTE" UBYTE RTE_CM_BOOLEAN 0 0 0 255 ECU_ADDRESS 0 SYMBOL_LINK "Rte_WhlImbRejctn_DcTrendLrngEnaPrevTmr2" 0 DISPLAY_IDENTIFIER WhlImbRejctn.PerInstanceMemories.DcTrendLrngEnaPrevTmr2 /end MEASUREMENT
/begin MEASUREMENT WhlImbRejctn.DcTrendRefTiEnaLrng "MICROSAR RTE" ULONG NO_COMPU_METHOD 0 0 0 4294967295 ECU_ADDRESS 0 SYMBOL_LINK "Rte_WhlImbRejctn_DcTrendRefTiEnaLrng" 0 DISPLAY_IDENTIFIER WhlImbRejctn.PerInstanceMemories.DcTrendRefTiEnaLrng /end MEASUREMENT
/begin MEASUREMENT WhlImbRejctn.DcTrendRefTiEnaLrngTmr1 "MICROSAR RTE" ULONG NO_COMPU_METHOD 0 0 0 4294967295 ECU_ADDRESS 0 SYMBOL_LINK "Rte_WhlImbRejctn_DcTrendRefTiEnaLrngTmr1" 0 DISPLAY_IDENTIFIER WhlImbRejctn.PerInstanceMemories.DcTrendRefTiEnaLrngTmr1 /end MEASUREMENT
/begin MEASUREMENT WhlImbRejctn.DcTrendRefTiEnaLrngTmr2 "MICROSAR RTE" ULONG NO_COMPU_METHOD 0 0 0 4294967295 ECU_ADDRESS 0 SYMBOL_LINK "Rte_WhlImbRejctn_DcTrendRefTiEnaLrngTmr2" 0 DISPLAY_IDENTIFIER WhlImbRejctn.PerInstanceMemories.DcTrendRefTiEnaLrngTmr2 /end MEASUREMENT
/begin MEASUREMENT WhlImbRejctn.DistbnMagEnadPrev "MICROSAR RTE" UBYTE RTE_CM_BOOLEAN 0 0 0 255 ECU_ADDRESS 0 SYMBOL_LINK "Rte_WhlImbRejctn_DistbnMagEnadPrev" 0 DISPLAY_IDENTIFIER WhlImbRejctn.PerInstanceMemories.DistbnMagEnadPrev /end MEASUREMENT
/begin MEASUREMENT WhlImbRejctn.DistbnMgnLeLpFil.FilGain "MICROSAR RTE" FLOAT32_IEEE NO_COMPU_METHOD 0 0 -3.402823466e+38 3.402823466e+38 ECU_ADDRESS 0 SYMBOL_LINK "Rte_WhlImbRejctn_DistbnMgnLeLpFil.FilGain" 0 DISPLAY_IDENTIFIER WhlImbRejctn.PerInstanceMemories.DistbnMgnLeLpFil.FilGain /end MEASUREMENT
/begin MEASUREMENT WhlImbRejctn.DistbnMgnLeLpFil.FilSt "MICROSAR RTE" FLOAT32_IEEE NO_COMPU_METHOD 0 0 -3.402823466e+38 3.402823466e+38 ECU_ADDRESS 0 SYMBOL_LINK "Rte_WhlImbRejctn_DistbnMgnLeLpFil.FilSt" 0 DISPLAY_IDENTIFIER WhlImbRejctn.PerInstanceMemories.DistbnMgnLeLpFil.FilSt /end MEASUREMENT
/begin MEASUREMENT WhlImbRejctn.DistbnMgnRiLpFil.FilGain "MICROSAR RTE" FLOAT32_IEEE NO_COMPU_METHOD 0 0 -3.402823466e+38 3.402823466e+38 ECU_ADDRESS 0 SYMBOL_LINK "Rte_WhlImbRejctn_DistbnMgnRiLpFil.FilGain" 0 DISPLAY_IDENTIFIER WhlImbRejctn.PerInstanceMemories.DistbnMgnRiLpFil.FilGain /end MEASUREMENT
/begin MEASUREMENT WhlImbRejctn.DistbnMgnRiLpFil.FilSt "MICROSAR RTE" FLOAT32_IEEE NO_COMPU_METHOD 0 0 -3.402823466e+38 3.402823466e+38 ECU_ADDRESS 0 SYMBOL_LINK "Rte_WhlImbRejctn_DistbnMgnRiLpFil.FilSt" 0 DISPLAY_IDENTIFIER WhlImbRejctn.PerInstanceMemories.DistbnMgnRiLpFil.FilSt /end MEASUREMENT
/begin MEASUREMENT WhlImbRejctn.EnaSlewPerLoop "MICROSAR RTE" FLOAT32_IEEE NO_COMPU_METHOD 0 0 -3.402823466e+38 3.402823466e+38 ECU_ADDRESS 0 SYMBOL_LINK "Rte_WhlImbRejctn_EnaSlewPerLoop" 0 DISPLAY_IDENTIFIER WhlImbRejctn.PerInstanceMemories.EnaSlewPerLoop /end MEASUREMENT
/begin MEASUREMENT WhlImbRejctn.FrqDiagcFltFaild "MICROSAR RTE" UBYTE RTE_CM_BOOLEAN 0 0 0 255 ECU_ADDRESS 0 SYMBOL_LINK "Rte_WhlImbRejctn_FrqDiagcFltFaild" 0 DISPLAY_IDENTIFIER WhlImbRejctn.PerInstanceMemories.FrqDiagcFltFaild /end MEASUREMENT
/begin MEASUREMENT WhlImbRejctn.FrqDiagcFltRcvry.Cntr "MICROSAR RTE" FLOAT32_IEEE NO_COMPU_METHOD 0 0 -3.402823466e+38 3.402823466e+38 ECU_ADDRESS 0 SYMBOL_LINK "Rte_WhlImbRejctn_FrqDiagcFltRcvry.Cntr" 0 DISPLAY_IDENTIFIER WhlImbRejctn.PerInstanceMemories.FrqDiagcFltRcvry.Cntr /end MEASUREMENT
/begin MEASUREMENT WhlImbRejctn.FrqDiagcFltRcvry.NegStep "MICROSAR RTE" FLOAT32_IEEE NO_COMPU_METHOD 0 0 -3.402823466e+38 3.402823466e+38 ECU_ADDRESS 0 SYMBOL_LINK "Rte_WhlImbRejctn_FrqDiagcFltRcvry.NegStep" 0 DISPLAY_IDENTIFIER WhlImbRejctn.PerInstanceMemories.FrqDiagcFltRcvry.NegStep /end MEASUREMENT
/begin MEASUREMENT WhlImbRejctn.FrqDiagcFltRcvry.PosStep "MICROSAR RTE" FLOAT32_IEEE NO_COMPU_METHOD 0 0 -3.402823466e+38 3.402823466e+38 ECU_ADDRESS 0 SYMBOL_LINK "Rte_WhlImbRejctn_FrqDiagcFltRcvry.PosStep" 0 DISPLAY_IDENTIFIER WhlImbRejctn.PerInstanceMemories.FrqDiagcFltRcvry.PosStep /end MEASUREMENT
/begin MEASUREMENT WhlImbRejctn.FrqDiagcFltRcvry.Sts "MICROSAR RTE" UBYTE RTE_CM_ENUM_SigQlfr1 0 0 0 255 ECU_ADDRESS 0 SYMBOL_LINK "Rte_WhlImbRejctn_FrqDiagcFltRcvry.Sts" 0 DISPLAY_IDENTIFIER WhlImbRejctn.PerInstanceMemories.FrqDiagcFltRcvry.Sts /end MEASUREMENT
/begin MEASUREMENT WhlImbRejctn.FrqDiagcFltRcvry.Thd "MICROSAR RTE" FLOAT32_IEEE NO_COMPU_METHOD 0 0 -3.402823466e+38 3.402823466e+38 ECU_ADDRESS 0 SYMBOL_LINK "Rte_WhlImbRejctn_FrqDiagcFltRcvry.Thd" 0 DISPLAY_IDENTIFIER WhlImbRejctn.PerInstanceMemories.FrqDiagcFltRcvry.Thd /end MEASUREMENT
/begin MEASUREMENT WhlImbRejctn.FrqDiagcFltRst "MICROSAR RTE" UBYTE RTE_CM_BOOLEAN 0 0 0 255 ECU_ADDRESS 0 SYMBOL_LINK "Rte_WhlImbRejctn_FrqDiagcFltRst" 0 DISPLAY_IDENTIFIER WhlImbRejctn.PerInstanceMemories.FrqDiagcFltRst /end MEASUREMENT
/begin MEASUREMENT WhlImbRejctn.FrqDiagcLpFil.FilGain "MICROSAR RTE" FLOAT32_IEEE NO_COMPU_METHOD 0 0 -3.402823466e+38 3.402823466e+38 ECU_ADDRESS 0 SYMBOL_LINK "Rte_WhlImbRejctn_FrqDiagcLpFil.FilGain" 0 DISPLAY_IDENTIFIER WhlImbRejctn.PerInstanceMemories.FrqDiagcLpFil.FilGain /end MEASUREMENT
/begin MEASUREMENT WhlImbRejctn.FrqDiagcLpFil.FilSt "MICROSAR RTE" FLOAT32_IEEE NO_COMPU_METHOD 0 0 -3.402823466e+38 3.402823466e+38 ECU_ADDRESS 0 SYMBOL_LINK "Rte_WhlImbRejctn_FrqDiagcLpFil.FilSt" 0 DISPLAY_IDENTIFIER WhlImbRejctn.PerInstanceMemories.FrqDiagcLpFil.FilSt /end MEASUREMENT
/begin MEASUREMENT WhlImbRejctn.FrqDiagcLrngEnaPrev "MICROSAR RTE" UBYTE RTE_CM_BOOLEAN 0 0 0 255 ECU_ADDRESS 0 SYMBOL_LINK "Rte_WhlImbRejctn_FrqDiagcLrngEnaPrev" 0 DISPLAY_IDENTIFIER WhlImbRejctn.PerInstanceMemories.FrqDiagcLrngEnaPrev /end MEASUREMENT
/begin MEASUREMENT WhlImbRejctn.FrqDiagcLrngEnaPrevTiOut "MICROSAR RTE" UBYTE RTE_CM_BOOLEAN 0 0 0 255 ECU_ADDRESS 0 SYMBOL_LINK "Rte_WhlImbRejctn_FrqDiagcLrngEnaPrevTiOut" 0 DISPLAY_IDENTIFIER WhlImbRejctn.PerInstanceMemories.FrqDiagcLrngEnaPrevTiOut /end MEASUREMENT
/begin MEASUREMENT WhlImbRejctn.FrqDiagcRefTiEnaLrng "MICROSAR RTE" ULONG NO_COMPU_METHOD 0 0 0 4294967295 ECU_ADDRESS 0 SYMBOL_LINK "Rte_WhlImbRejctn_FrqDiagcRefTiEnaLrng" 0 DISPLAY_IDENTIFIER WhlImbRejctn.PerInstanceMemories.FrqDiagcRefTiEnaLrng /end MEASUREMENT
/begin MEASUREMENT WhlImbRejctn.FrqDiagcRefTiEnaLrngTiOut "MICROSAR RTE" ULONG NO_COMPU_METHOD 0 0 0 4294967295 ECU_ADDRESS 0 SYMBOL_LINK "Rte_WhlImbRejctn_FrqDiagcRefTiEnaLrngTiOut" 0 DISPLAY_IDENTIFIER WhlImbRejctn.PerInstanceMemories.FrqDiagcRefTiEnaLrngTiOut /end MEASUREMENT
/begin MEASUREMENT WhlImbRejctn.FrqDiagcUgr1 "MICROSAR RTE" FLOAT32_IEEE NO_COMPU_METHOD 0 0 -3.402823466e+38 3.402823466e+38 ECU_ADDRESS 0 SYMBOL_LINK "Rte_WhlImbRejctn_FrqDiagcUgr1" 0 DISPLAY_IDENTIFIER WhlImbRejctn.PerInstanceMemories.FrqDiagcUgr1 /end MEASUREMENT
/begin MEASUREMENT WhlImbRejctn.FrqDiagcUgr2 "MICROSAR RTE" FLOAT32_IEEE NO_COMPU_METHOD 0 0 -3.402823466e+38 3.402823466e+38 ECU_ADDRESS 0 SYMBOL_LINK "Rte_WhlImbRejctn_FrqDiagcUgr2" 0 DISPLAY_IDENTIFIER WhlImbRejctn.PerInstanceMemories.FrqDiagcUgr2 /end MEASUREMENT
/begin MEASUREMENT WhlImbRejctn.HwTq.Val "MICROSAR RTE" FLOAT32_IEEE NO_COMPU_METHOD 0 0 -3.402823466e+38 3.402823466e+38 ECU_ADDRESS 0 SYMBOL_LINK "Rte_Swp_HwTqSwp_Val" 0 DISPLAY_IDENTIFIER WhlImbRejctn.ReceiverPorts.HwTq.Val /end MEASUREMENT
/begin MEASUREMENT WhlImbRejctn.LeCurrMgnSlewPerLoop "MICROSAR RTE" FLOAT32_IEEE NO_COMPU_METHOD 0 0 -3.402823466e+38 3.402823466e+38 ECU_ADDRESS 0 SYMBOL_LINK "Rte_WhlImbRejctn_LeCurrMgnSlewPerLoop" 0 DISPLAY_IDENTIFIER WhlImbRejctn.PerInstanceMemories.LeCurrMgnSlewPerLoop /end MEASUREMENT
/begin MEASUREMENT WhlImbRejctn.LeStDlyUpd "MICROSAR RTE" FLOAT32_IEEE NO_COMPU_METHOD 0 0 -3.402823466e+38 3.402823466e+38 MATRIX_DIM 30 1 1 ECU_ADDRESS 0 SYMBOL_LINK "Rte_WhlImbRejctn_LeStDlyUpd" 0 DISPLAY_IDENTIFIER WhlImbRejctn.PerInstanceMemories.LeStDlyUpd /end MEASUREMENT
/begin MEASUREMENT WhlImbRejctn.LeStVariUpd "MICROSAR RTE" FLOAT32_IEEE NO_COMPU_METHOD 0 0 -3.402823466e+38 3.402823466e+38 MATRIX_DIM 30 1 1 ECU_ADDRESS 0 SYMBOL_LINK "Rte_WhlImbRejctn_LeStVariUpd" 0 DISPLAY_IDENTIFIER WhlImbRejctn.PerInstanceMemories.LeStVariUpd /end MEASUREMENT
/begin MEASUREMENT WhlImbRejctn.MaxMgnFltFaild "MICROSAR RTE" UBYTE RTE_CM_BOOLEAN 0 0 0 255 ECU_ADDRESS 0 SYMBOL_LINK "Rte_WhlImbRejctn_MaxMgnFltFaild" 0 DISPLAY_IDENTIFIER WhlImbRejctn.PerInstanceMemories.MaxMgnFltFaild /end MEASUREMENT
/begin MEASUREMENT WhlImbRejctn.MaxMgnFltRcvry.Cntr "MICROSAR RTE" FLOAT32_IEEE NO_COMPU_METHOD 0 0 -3.402823466e+38 3.402823466e+38 ECU_ADDRESS 0 SYMBOL_LINK "Rte_WhlImbRejctn_MaxMgnFltRcvry.Cntr" 0 DISPLAY_IDENTIFIER WhlImbRejctn.PerInstanceMemories.MaxMgnFltRcvry.Cntr /end MEASUREMENT
/begin MEASUREMENT WhlImbRejctn.MaxMgnFltRcvry.NegStep "MICROSAR RTE" FLOAT32_IEEE NO_COMPU_METHOD 0 0 -3.402823466e+38 3.402823466e+38 ECU_ADDRESS 0 SYMBOL_LINK "Rte_WhlImbRejctn_MaxMgnFltRcvry.NegStep" 0 DISPLAY_IDENTIFIER WhlImbRejctn.PerInstanceMemories.MaxMgnFltRcvry.NegStep /end MEASUREMENT
/begin MEASUREMENT WhlImbRejctn.MaxMgnFltRcvry.PosStep "MICROSAR RTE" FLOAT32_IEEE NO_COMPU_METHOD 0 0 -3.402823466e+38 3.402823466e+38 ECU_ADDRESS 0 SYMBOL_LINK "Rte_WhlImbRejctn_MaxMgnFltRcvry.PosStep" 0 DISPLAY_IDENTIFIER WhlImbRejctn.PerInstanceMemories.MaxMgnFltRcvry.PosStep /end MEASUREMENT
/begin MEASUREMENT WhlImbRejctn.MaxMgnFltRcvry.Sts "MICROSAR RTE" UBYTE RTE_CM_ENUM_SigQlfr1 0 0 0 255 ECU_ADDRESS 0 SYMBOL_LINK "Rte_WhlImbRejctn_MaxMgnFltRcvry.Sts" 0 DISPLAY_IDENTIFIER WhlImbRejctn.PerInstanceMemories.MaxMgnFltRcvry.Sts /end MEASUREMENT
/begin MEASUREMENT WhlImbRejctn.MaxMgnFltRcvry.Thd "MICROSAR RTE" FLOAT32_IEEE NO_COMPU_METHOD 0 0 -3.402823466e+38 3.402823466e+38 ECU_ADDRESS 0 SYMBOL_LINK "Rte_WhlImbRejctn_MaxMgnFltRcvry.Thd" 0 DISPLAY_IDENTIFIER WhlImbRejctn.PerInstanceMemories.MaxMgnFltRcvry.Thd /end MEASUREMENT
/begin MEASUREMENT WhlImbRejctn.MaxMgnFltRst "MICROSAR RTE" UBYTE RTE_CM_BOOLEAN 0 0 0 255 ECU_ADDRESS 0 SYMBOL_LINK "Rte_WhlImbRejctn_MaxMgnFltRst" 0 DISPLAY_IDENTIFIER WhlImbRejctn.PerInstanceMemories.MaxMgnFltRst /end MEASUREMENT
/begin MEASUREMENT WhlImbRejctn.MaxMgnLrngEnaPrev "MICROSAR RTE" UBYTE RTE_CM_BOOLEAN 0 0 0 255 ECU_ADDRESS 0 SYMBOL_LINK "Rte_WhlImbRejctn_MaxMgnLrngEnaPrev" 0 DISPLAY_IDENTIFIER WhlImbRejctn.PerInstanceMemories.MaxMgnLrngEnaPrev /end MEASUREMENT
/begin MEASUREMENT WhlImbRejctn.MaxMgnRefTiEnaLrng "MICROSAR RTE" ULONG NO_COMPU_METHOD 0 0 0 4294967295 ECU_ADDRESS 0 SYMBOL_LINK "Rte_WhlImbRejctn_MaxMgnRefTiEnaLrng" 0 DISPLAY_IDENTIFIER WhlImbRejctn.PerInstanceMemories.MaxMgnRefTiEnaLrng /end MEASUREMENT
/begin MEASUREMENT WhlImbRejctn.PhaAdjFil1Coeff1 "MICROSAR RTE" FLOAT32_IEEE NO_COMPU_METHOD 0 0 -3.402823466e+38 3.402823466e+38 ECU_ADDRESS 0 SYMBOL_LINK "Rte_WhlImbRejctn_PhaAdjFil1Coeff1" 0 DISPLAY_IDENTIFIER WhlImbRejctn.PerInstanceMemories.PhaAdjFil1Coeff1 /end MEASUREMENT
/begin MEASUREMENT WhlImbRejctn.PhaAdjFil1Coeff2 "MICROSAR RTE" FLOAT32_IEEE NO_COMPU_METHOD 0 0 -3.402823466e+38 3.402823466e+38 ECU_ADDRESS 0 SYMBOL_LINK "Rte_WhlImbRejctn_PhaAdjFil1Coeff2" 0 DISPLAY_IDENTIFIER WhlImbRejctn.PerInstanceMemories.PhaAdjFil1Coeff2 /end MEASUREMENT
/begin MEASUREMENT WhlImbRejctn.PhaAdjFil2Coeff1 "MICROSAR RTE" FLOAT32_IEEE NO_COMPU_METHOD 0 0 -3.402823466e+38 3.402823466e+38 ECU_ADDRESS 0 SYMBOL_LINK "Rte_WhlImbRejctn_PhaAdjFil2Coeff1" 0 DISPLAY_IDENTIFIER WhlImbRejctn.PerInstanceMemories.PhaAdjFil2Coeff1 /end MEASUREMENT
/begin MEASUREMENT WhlImbRejctn.PhaAdjFil2Coeff2 "MICROSAR RTE" FLOAT32_IEEE NO_COMPU_METHOD 0 0 -3.402823466e+38 3.402823466e+38 ECU_ADDRESS 0 SYMBOL_LINK "Rte_WhlImbRejctn_PhaAdjFil2Coeff2" 0 DISPLAY_IDENTIFIER WhlImbRejctn.PerInstanceMemories.PhaAdjFil2Coeff2 /end MEASUREMENT
/begin MEASUREMENT WhlImbRejctn.PrevFlt "MICROSAR RTE" FLOAT32_IEEE NO_COMPU_METHOD 0 0 -3.402823466e+38 3.402823466e+38 ECU_ADDRESS 0 SYMBOL_LINK "Rte_WhlImbRejctn_PrevFlt" 0 DISPLAY_IDENTIFIER WhlImbRejctn.PerInstanceMemories.PrevFlt /end MEASUREMENT
/begin MEASUREMENT WhlImbRejctn.PrevHwTq "MICROSAR RTE" FLOAT32_IEEE NO_COMPU_METHOD 0 0 -3.402823466e+38 3.402823466e+38 ECU_ADDRESS 0 SYMBOL_LINK "Rte_WhlImbRejctn_PrevHwTq" 0 DISPLAY_IDENTIFIER WhlImbRejctn.PerInstanceMemories.PrevHwTq /end MEASUREMENT
/begin MEASUREMENT WhlImbRejctn.PrevSts "MICROSAR RTE" UBYTE RTE_CM_BOOLEAN 0 0 0 255 ECU_ADDRESS 0 SYMBOL_LINK "Rte_WhlImbRejctn_PrevSts" 0 DISPLAY_IDENTIFIER WhlImbRejctn.PerInstanceMemories.PrevSts /end MEASUREMENT
/begin MEASUREMENT WhlImbRejctn.RampNo "MICROSAR RTE" UBYTE RTE_CM_BOOLEAN 0 0 0 255 ECU_ADDRESS 0 SYMBOL_LINK "Rte_WhlImbRejctn_RampNo" 0 DISPLAY_IDENTIFIER WhlImbRejctn.PerInstanceMemories.RampNo /end MEASUREMENT
/begin MEASUREMENT WhlImbRejctn.RampYes "MICROSAR RTE" UBYTE RTE_CM_BOOLEAN 0 0 0 255 ECU_ADDRESS 0 SYMBOL_LINK "Rte_WhlImbRejctn_RampYes" 0 DISPLAY_IDENTIFIER WhlImbRejctn.PerInstanceMemories.RampYes /end MEASUREMENT
/begin MEASUREMENT WhlImbRejctn.RiCurrMgnSlewPerLoop "MICROSAR RTE" FLOAT32_IEEE NO_COMPU_METHOD 0 0 -3.402823466e+38 3.402823466e+38 ECU_ADDRESS 0 SYMBOL_LINK "Rte_WhlImbRejctn_RiCurrMgnSlewPerLoop" 0 DISPLAY_IDENTIFIER WhlImbRejctn.PerInstanceMemories.RiCurrMgnSlewPerLoop /end MEASUREMENT
/begin MEASUREMENT WhlImbRejctn.RiStDlyUpd "MICROSAR RTE" FLOAT32_IEEE NO_COMPU_METHOD 0 0 -3.402823466e+38 3.402823466e+38 MATRIX_DIM 30 1 1 ECU_ADDRESS 0 SYMBOL_LINK "Rte_WhlImbRejctn_RiStDlyUpd" 0 DISPLAY_IDENTIFIER WhlImbRejctn.PerInstanceMemories.RiStDlyUpd /end MEASUREMENT
/begin MEASUREMENT WhlImbRejctn.RiStVariUpd "MICROSAR RTE" FLOAT32_IEEE NO_COMPU_METHOD 0 0 -3.402823466e+38 3.402823466e+38 MATRIX_DIM 30 1 1 ECU_ADDRESS 0 SYMBOL_LINK "Rte_WhlImbRejctn_RiStVariUpd" 0 DISPLAY_IDENTIFIER WhlImbRejctn.PerInstanceMemories.RiStVariUpd /end MEASUREMENT
/begin MEASUREMENT WhlImbRejctn.ScaLe "MICROSAR RTE" FLOAT32_IEEE NO_COMPU_METHOD 0 0 -3.402823466e+38 3.402823466e+38 ECU_ADDRESS 0 SYMBOL_LINK "Rte_WhlImbRejctn_ScaLe" 0 DISPLAY_IDENTIFIER WhlImbRejctn.PerInstanceMemories.ScaLe /end MEASUREMENT
/begin MEASUREMENT WhlImbRejctn.ScaRi "MICROSAR RTE" FLOAT32_IEEE NO_COMPU_METHOD 0 0 -3.402823466e+38 3.402823466e+38 ECU_ADDRESS 0 SYMBOL_LINK "Rte_WhlImbRejctn_ScaRi" 0 DISPLAY_IDENTIFIER WhlImbRejctn.PerInstanceMemories.ScaRi /end MEASUREMENT
/begin MEASUREMENT WhlImbRejctn.SlowSpdDiagcLrngEnaPrevTmr "MICROSAR RTE" UBYTE RTE_CM_BOOLEAN 0 0 0 255 ECU_ADDRESS 0 SYMBOL_LINK "Rte_WhlImbRejctn_SlowSpdDiagcLrngEnaPrevTmr" 0 DISPLAY_IDENTIFIER WhlImbRejctn.PerInstanceMemories.SlowSpdDiagcLrngEnaPrevTmr /end MEASUREMENT
/begin MEASUREMENT WhlImbRejctn.SlowSpdDiagcRefTiEnaLrngTmr "MICROSAR RTE" ULONG NO_COMPU_METHOD 0 0 0 4294967295 ECU_ADDRESS 0 SYMBOL_LINK "Rte_WhlImbRejctn_SlowSpdDiagcRefTiEnaLrngTmr" 0 DISPLAY_IDENTIFIER WhlImbRejctn.PerInstanceMemories.SlowSpdDiagcRefTiEnaLrngTmr /end MEASUREMENT
/begin MEASUREMENT WhlImbRejctn.StordValLe "MICROSAR RTE" FLOAT32_IEEE NO_COMPU_METHOD 0 0 -3.402823466e+38 3.402823466e+38 MATRIX_DIM 30 1 1 ECU_ADDRESS 0 SYMBOL_LINK "Rte_WhlImbRejctn_StordValLe" 0 DISPLAY_IDENTIFIER WhlImbRejctn.PerInstanceMemories.StordValLe /end MEASUREMENT
/begin MEASUREMENT WhlImbRejctn.StordValRi "MICROSAR RTE" FLOAT32_IEEE NO_COMPU_METHOD 0 0 -3.402823466e+38 3.402823466e+38 MATRIX_DIM 30 1 1 ECU_ADDRESS 0 SYMBOL_LINK "Rte_WhlImbRejctn_StordValRi" 0 DISPLAY_IDENTIFIER WhlImbRejctn.PerInstanceMemories.StordValRi /end MEASUREMENT
/begin MEASUREMENT WhlImbRejctn.SysSt.Val "MICROSAR RTE" UBYTE RTE_CM_ENUM_SysSt1 0 0 0 255 ECU_ADDRESS 0 SYMBOL_LINK "Rte_SysStMod_SysSt_Val" 0 DISPLAY_IDENTIFIER WhlImbRejctn.ReceiverPorts.SysSt.Val /end MEASUREMENT
/begin MEASUREMENT WhlImbRejctn.UgrLe1 "MICROSAR RTE" FLOAT32_IEEE NO_COMPU_METHOD 0 0 -3.402823466e+38 3.402823466e+38 ECU_ADDRESS 0 SYMBOL_LINK "Rte_WhlImbRejctn_UgrLe1" 0 DISPLAY_IDENTIFIER WhlImbRejctn.PerInstanceMemories.UgrLe1 /end MEASUREMENT
/begin MEASUREMENT WhlImbRejctn.UgrLe2 "MICROSAR RTE" FLOAT32_IEEE NO_COMPU_METHOD 0 0 -3.402823466e+38 3.402823466e+38 ECU_ADDRESS 0 SYMBOL_LINK "Rte_WhlImbRejctn_UgrLe2" 0 DISPLAY_IDENTIFIER WhlImbRejctn.PerInstanceMemories.UgrLe2 /end MEASUREMENT
/begin MEASUREMENT WhlImbRejctn.UgrRi1 "MICROSAR RTE" FLOAT32_IEEE NO_COMPU_METHOD 0 0 -3.402823466e+38 3.402823466e+38 ECU_ADDRESS 0 SYMBOL_LINK "Rte_WhlImbRejctn_UgrRi1" 0 DISPLAY_IDENTIFIER WhlImbRejctn.PerInstanceMemories.UgrRi1 /end MEASUREMENT
/begin MEASUREMENT WhlImbRejctn.UgrRi2 "MICROSAR RTE" FLOAT32_IEEE NO_COMPU_METHOD 0 0 -3.402823466e+38 3.402823466e+38 ECU_ADDRESS 0 SYMBOL_LINK "Rte_WhlImbRejctn_UgrRi2" 0 DISPLAY_IDENTIFIER WhlImbRejctn.PerInstanceMemories.UgrRi2 /end MEASUREMENT
/begin MEASUREMENT WhlImbRejctn.VehSpd.Val "MICROSAR RTE" FLOAT32_IEEE NO_COMPU_METHOD 0 0 -3.402823466e+38 3.402823466e+38 ECU_ADDRESS 0 SYMBOL_LINK "Rte_VehSigCdng_VehSpd_Val" 0 DISPLAY_IDENTIFIER WhlImbRejctn.ReceiverPorts.VehSpd.Val /end MEASUREMENT
/begin MEASUREMENT WhlImbRejctn.VehSpdVld.Logl "MICROSAR RTE" UBYTE RTE_CM_BOOLEAN 0 0 0 255 ECU_ADDRESS 0 SYMBOL_LINK "Rte_VehSigCdng_VehSpdVld_Logl" 0 DISPLAY_IDENTIFIER WhlImbRejctn.ReceiverPorts.VehSpdVld.Logl /end MEASUREMENT
/begin MEASUREMENT WhlImbRejctn.WhlFrqVld.Logl "MICROSAR RTE" UBYTE RTE_CM_BOOLEAN 0 0 0 255 ECU_ADDRESS 0 SYMBOL_LINK "Rte_GmRoadWhlInQlfr_WhlFrqVld_Logl" 0 DISPLAY_IDENTIFIER WhlImbRejctn.ReceiverPorts.WhlFrqVld.Logl /end MEASUREMENT
/begin MEASUREMENT WhlImbRejctn.WhlImbRejctnActv.Logl "MICROSAR RTE" UBYTE RTE_CM_BOOLEAN 0 0 0 255 ECU_ADDRESS 0 SYMBOL_LINK "Rte_WhlImbRejctn_WhlImbRejctnActv_Logl" 0 DISPLAY_IDENTIFIER WhlImbRejctn.SenderPorts.WhlImbRejctnActv.Logl /end MEASUREMENT
/begin MEASUREMENT WhlImbRejctn.WhlImbRejctnAmp.Val "MICROSAR RTE" FLOAT32_IEEE NO_COMPU_METHOD 0 0 -3.402823466e+38 3.402823466e+38 ECU_ADDRESS 0 SYMBOL_LINK "Rte_WhlImbRejctn_WhlImbRejctnAmp_Val" 0 DISPLAY_IDENTIFIER WhlImbRejctn.SenderPorts.WhlImbRejctnAmp.Val /end MEASUREMENT
/begin MEASUREMENT WhlImbRejctn.WhlImbRejctnCmd.Val "MICROSAR RTE" FLOAT32_IEEE NO_COMPU_METHOD 0 0 -3.402823466e+38 3.402823466e+38 ECU_ADDRESS 0 SYMBOL_LINK "Rte_WhlImbRejctn_WhlImbRejctnCmd_Val" 0 DISPLAY_IDENTIFIER WhlImbRejctn.SenderPorts.WhlImbRejctnCmd.Val /end MEASUREMENT
/begin MEASUREMENT WhlImbRejctn.WhlImbRejctnCustEna.Logl "MICROSAR RTE" UBYTE RTE_CM_BOOLEAN 0 0 0 255 ECU_ADDRESS 0 SYMBOL_LINK "Rte_WhlImbRejctn_WhlImbRejctnCustEna_Logl" 0 DISPLAY_IDENTIFIER WhlImbRejctn.ReceiverPorts.WhlImbRejctnCustEna.Logl /end MEASUREMENT
/begin MEASUREMENT WhlImbRejctn.WhlImbRejctnDi.Logl "MICROSAR RTE" UBYTE RTE_CM_BOOLEAN 0 0 0 255 ECU_ADDRESS 0 SYMBOL_LINK "Rte_GmFctDiArbn_WhlImbRejctnDi_Logl" 0 DISPLAY_IDENTIFIER WhlImbRejctn.ReceiverPorts.WhlImbRejctnDi.Logl /end MEASUREMENT
/begin MEASUREMENT WhlImbRejctn.WhlLeFrq.Val "MICROSAR RTE" FLOAT32_IEEE NO_COMPU_METHOD 0 0 -3.402823466e+38 3.402823466e+38 ECU_ADDRESS 0 SYMBOL_LINK "Rte_GmRoadWhlInQlfr_WhlLeFrq_Val" 0 DISPLAY_IDENTIFIER WhlImbRejctn.ReceiverPorts.WhlLeFrq.Val /end MEASUREMENT
/begin MEASUREMENT WhlImbRejctn.WhlRiFrq.Val "MICROSAR RTE" FLOAT32_IEEE NO_COMPU_METHOD 0 0 -3.402823466e+38 3.402823466e+38 ECU_ADDRESS 0 SYMBOL_LINK "Rte_GmRoadWhlInQlfr_WhlRiFrq_Val" 0 DISPLAY_IDENTIFIER WhlImbRejctn.ReceiverPorts.WhlRiFrq.Val /end MEASUREMENT
/begin MEASUREMENT WhlImbRejctn.WhlSpdCorrFltFaild "MICROSAR RTE" UBYTE RTE_CM_BOOLEAN 0 0 0 255 ECU_ADDRESS 0 SYMBOL_LINK "Rte_WhlImbRejctn_WhlSpdCorrFltFaild" 0 DISPLAY_IDENTIFIER WhlImbRejctn.PerInstanceMemories.WhlSpdCorrFltFaild /end MEASUREMENT
/begin MEASUREMENT WhlImbRejctn.WhlSpdCorrFltRst "MICROSAR RTE" UBYTE RTE_CM_BOOLEAN 0 0 0 255 ECU_ADDRESS 0 SYMBOL_LINK "Rte_WhlImbRejctn_WhlSpdCorrFltRst" 0 DISPLAY_IDENTIFIER WhlImbRejctn.PerInstanceMemories.WhlSpdCorrFltRst /end MEASUREMENT
/begin MEASUREMENT WhlImbRejctn.WhlSpdCorrlnDiagcLrngEnaPrev "MICROSAR RTE" UBYTE RTE_CM_BOOLEAN 0 0 0 255 ECU_ADDRESS 0 SYMBOL_LINK "Rte_WhlImbRejctn_WhlSpdCorrlnDiagcLrngEnaPrev" 0 DISPLAY_IDENTIFIER WhlImbRejctn.PerInstanceMemories.WhlSpdCorrlnDiagcLrngEnaPrev /end MEASUREMENT
/begin MEASUREMENT WhlImbRejctn.WhlSpdCorrlnDiagcRefTiEnaLrng "MICROSAR RTE" ULONG NO_COMPU_METHOD 0 0 0 4294967295 ECU_ADDRESS 0 SYMBOL_LINK "Rte_WhlImbRejctn_WhlSpdCorrlnDiagcRefTiEnaLrng" 0 DISPLAY_IDENTIFIER WhlImbRejctn.PerInstanceMemories.WhlSpdCorrlnDiagcRefTiEnaLrng /end MEASUREMENT
/begin MEASUREMENT WhlImbRejctn.WhlSpdCorrlnFltRcvry.Cntr "MICROSAR RTE" FLOAT32_IEEE NO_COMPU_METHOD 0 0 -3.402823466e+38 3.402823466e+38 ECU_ADDRESS 0 SYMBOL_LINK "Rte_WhlImbRejctn_WhlSpdCorrlnFltRcvry.Cntr" 0 DISPLAY_IDENTIFIER WhlImbRejctn.PerInstanceMemories.WhlSpdCorrlnFltRcvry.Cntr /end MEASUREMENT
/begin MEASUREMENT WhlImbRejctn.WhlSpdCorrlnFltRcvry.NegStep "MICROSAR RTE" FLOAT32_IEEE NO_COMPU_METHOD 0 0 -3.402823466e+38 3.402823466e+38 ECU_ADDRESS 0 SYMBOL_LINK "Rte_WhlImbRejctn_WhlSpdCorrlnFltRcvry.NegStep" 0 DISPLAY_IDENTIFIER WhlImbRejctn.PerInstanceMemories.WhlSpdCorrlnFltRcvry.NegStep /end MEASUREMENT
/begin MEASUREMENT WhlImbRejctn.WhlSpdCorrlnFltRcvry.PosStep "MICROSAR RTE" FLOAT32_IEEE NO_COMPU_METHOD 0 0 -3.402823466e+38 3.402823466e+38 ECU_ADDRESS 0 SYMBOL_LINK "Rte_WhlImbRejctn_WhlSpdCorrlnFltRcvry.PosStep" 0 DISPLAY_IDENTIFIER WhlImbRejctn.PerInstanceMemories.WhlSpdCorrlnFltRcvry.PosStep /end MEASUREMENT
/begin MEASUREMENT WhlImbRejctn.WhlSpdCorrlnFltRcvry.Sts "MICROSAR RTE" UBYTE RTE_CM_ENUM_SigQlfr1 0 0 0 255 ECU_ADDRESS 0 SYMBOL_LINK "Rte_WhlImbRejctn_WhlSpdCorrlnFltRcvry.Sts" 0 DISPLAY_IDENTIFIER WhlImbRejctn.PerInstanceMemories.WhlSpdCorrlnFltRcvry.Sts /end MEASUREMENT
/begin MEASUREMENT WhlImbRejctn.WhlSpdCorrlnFltRcvry.Thd "MICROSAR RTE" FLOAT32_IEEE NO_COMPU_METHOD 0 0 -3.402823466e+38 3.402823466e+38 ECU_ADDRESS 0 SYMBOL_LINK "Rte_WhlImbRejctn_WhlSpdCorrlnFltRcvry.Thd" 0 DISPLAY_IDENTIFIER WhlImbRejctn.PerInstanceMemories.WhlSpdCorrlnFltRcvry.Thd /end MEASUREMENT
/begin MEASUREMENT WhlImbRejctn.WhlSpdCorrlnLrngEnaPrevTmr "MICROSAR RTE" UBYTE RTE_CM_BOOLEAN 0 0 0 255 ECU_ADDRESS 0 SYMBOL_LINK "Rte_WhlImbRejctn_WhlSpdCorrlnLrngEnaPrevTmr" 0 DISPLAY_IDENTIFIER WhlImbRejctn.PerInstanceMemories.WhlSpdCorrlnLrngEnaPrevTmr /end MEASUREMENT
/begin MEASUREMENT WhlImbRejctn.WhlSpdCorrlnRefTiEnaLrngTmr "MICROSAR RTE" ULONG NO_COMPU_METHOD 0 0 0 4294967295 ECU_ADDRESS 0 SYMBOL_LINK "Rte_WhlImbRejctn_WhlSpdCorrlnRefTiEnaLrngTmr" 0 DISPLAY_IDENTIFIER WhlImbRejctn.PerInstanceMemories.WhlSpdCorrlnRefTiEnaLrngTmr /end MEASUREMENT
/begin MEASUREMENT WhlImbRejctn.WhlSpdLeLpFil.FilGain "MICROSAR RTE" FLOAT32_IEEE NO_COMPU_METHOD 0 0 -3.402823466e+38 3.402823466e+38 ECU_ADDRESS 0 SYMBOL_LINK "Rte_WhlImbRejctn_WhlSpdLeLpFil.FilGain" 0 DISPLAY_IDENTIFIER WhlImbRejctn.PerInstanceMemories.WhlSpdLeLpFil.FilGain /end MEASUREMENT
/begin MEASUREMENT WhlImbRejctn.WhlSpdLeLpFil.FilSt "MICROSAR RTE" FLOAT32_IEEE NO_COMPU_METHOD 0 0 -3.402823466e+38 3.402823466e+38 ECU_ADDRESS 0 SYMBOL_LINK "Rte_WhlImbRejctn_WhlSpdLeLpFil.FilSt" 0 DISPLAY_IDENTIFIER WhlImbRejctn.PerInstanceMemories.WhlSpdLeLpFil.FilSt /end MEASUREMENT
/begin MEASUREMENT WhlImbRejctn.WhlSpdRiLpFil.FilGain "MICROSAR RTE" FLOAT32_IEEE NO_COMPU_METHOD 0 0 -3.402823466e+38 3.402823466e+38 ECU_ADDRESS 0 SYMBOL_LINK "Rte_WhlImbRejctn_WhlSpdRiLpFil.FilGain" 0 DISPLAY_IDENTIFIER WhlImbRejctn.PerInstanceMemories.WhlSpdRiLpFil.FilGain /end MEASUREMENT
/begin MEASUREMENT WhlImbRejctn.WhlSpdRiLpFil.FilSt "MICROSAR RTE" FLOAT32_IEEE NO_COMPU_METHOD 0 0 -3.402823466e+38 3.402823466e+38 ECU_ADDRESS 0 SYMBOL_LINK "Rte_WhlImbRejctn_WhlSpdRiLpFil.FilSt" 0 DISPLAY_IDENTIFIER WhlImbRejctn.PerInstanceMemories.WhlSpdRiLpFil.FilSt /end MEASUREMENT
/begin MEASUREMENT WhlImbRejctn.dWhlImbRejctnCnclTqOutp "MICROSAR RTE" FLOAT32_IEEE NO_COMPU_METHOD 0 0 -3.402823466e+38 3.402823466e+38 ECU_ADDRESS 0 SYMBOL_LINK "Rte_WhlImbRejctn_dWhlImbRejctnCnclTqOutp" 0 DISPLAY_IDENTIFIER WhlImbRejctn.PerInstanceMemories.dWhlImbRejctnCnclTqOutp /end MEASUREMENT
/begin MEASUREMENT WhlImbRejctn.dWhlImbRejctnCurrMgnLe "MICROSAR RTE" FLOAT32_IEEE NO_COMPU_METHOD 0 0 -3.402823466e+38 3.402823466e+38 ECU_ADDRESS 0 SYMBOL_LINK "Rte_WhlImbRejctn_dWhlImbRejctnCurrMgnLe" 0 DISPLAY_IDENTIFIER WhlImbRejctn.PerInstanceMemories.dWhlImbRejctnCurrMgnLe /end MEASUREMENT
/begin MEASUREMENT WhlImbRejctn.dWhlImbRejctnCurrMgnRi "MICROSAR RTE" FLOAT32_IEEE NO_COMPU_METHOD 0 0 -3.402823466e+38 3.402823466e+38 ECU_ADDRESS 0 SYMBOL_LINK "Rte_WhlImbRejctn_dWhlImbRejctnCurrMgnRi" 0 DISPLAY_IDENTIFIER WhlImbRejctn.PerInstanceMemories.dWhlImbRejctnCurrMgnRi /end MEASUREMENT
/begin MEASUREMENT WhlImbRejctn.dWhlImbRejctnFildWhlSpdLe "MICROSAR RTE" FLOAT32_IEEE NO_COMPU_METHOD 0 0 -3.402823466e+38 3.402823466e+38 ECU_ADDRESS 0 SYMBOL_LINK "Rte_WhlImbRejctn_dWhlImbRejctnFildWhlSpdLe" 0 DISPLAY_IDENTIFIER WhlImbRejctn.PerInstanceMemories.dWhlImbRejctnFildWhlSpdLe /end MEASUREMENT
/begin MEASUREMENT WhlImbRejctn.dWhlImbRejctnFildWhlSpdRi "MICROSAR RTE" FLOAT32_IEEE NO_COMPU_METHOD 0 0 -3.402823466e+38 3.402823466e+38 ECU_ADDRESS 0 SYMBOL_LINK "Rte_WhlImbRejctn_dWhlImbRejctnFildWhlSpdRi" 0 DISPLAY_IDENTIFIER WhlImbRejctn.PerInstanceMemories.dWhlImbRejctnFildWhlSpdRi /end MEASUREMENT
/begin MEASUREMENT WhlImbRejctn.dWhlImbRejctnLMSqdOutLe "MICROSAR RTE" FLOAT32_IEEE NO_COMPU_METHOD 0 0 -3.402823466e+38 3.402823466e+38 ECU_ADDRESS 0 SYMBOL_LINK "Rte_WhlImbRejctn_dWhlImbRejctnLMSqdOutLe" 0 DISPLAY_IDENTIFIER WhlImbRejctn.PerInstanceMemories.dWhlImbRejctnLMSqdOutLe /end MEASUREMENT
/begin MEASUREMENT WhlImbRejctn.dWhlImbRejctnLMSqdOutRi "MICROSAR RTE" FLOAT32_IEEE NO_COMPU_METHOD 0 0 -3.402823466e+38 3.402823466e+38 ECU_ADDRESS 0 SYMBOL_LINK "Rte_WhlImbRejctn_dWhlImbRejctnLMSqdOutRi" 0 DISPLAY_IDENTIFIER WhlImbRejctn.PerInstanceMemories.dWhlImbRejctnLMSqdOutRi /end MEASUREMENT
/begin MEASUREMENT WhlImbRejctn.dWhlImbRejctnScaLe "MICROSAR RTE" FLOAT32_IEEE NO_COMPU_METHOD 0 0 -3.402823466e+38 3.402823466e+38 ECU_ADDRESS 0 SYMBOL_LINK "Rte_WhlImbRejctn_dWhlImbRejctnScaLe" 0 DISPLAY_IDENTIFIER WhlImbRejctn.PerInstanceMemories.dWhlImbRejctnScaLe /end MEASUREMENT
/begin MEASUREMENT WhlImbRejctn.dWhlImbRejctnScaRi "MICROSAR RTE" FLOAT32_IEEE NO_COMPU_METHOD 0 0 -3.402823466e+38 3.402823466e+38 ECU_ADDRESS 0 SYMBOL_LINK "Rte_WhlImbRejctn_dWhlImbRejctnScaRi" 0 DISPLAY_IDENTIFIER WhlImbRejctn.PerInstanceMemories.dWhlImbRejctnScaRi /end MEASUREMENT
/begin MEASUREMENT WhlImbRejctn.dWhlImbRejctnWhlSpdCorrPerc "MICROSAR RTE" FLOAT32_IEEE NO_COMPU_METHOD 0 0 -3.402823466e+38 3.402823466e+38 ECU_ADDRESS 0 SYMBOL_LINK "Rte_WhlImbRejctn_dWhlImbRejctnWhlSpdCorrPerc" 0 DISPLAY_IDENTIFIER WhlImbRejctn.PerInstanceMemories.dWhlImbRejctnWhlSpdCorrPerc /end MEASUREMENT
/begin GROUP TunSelnAuthy.TunSelnAuthyHwVelY.Ary1D "MICROSAR RTE" /begin SUB_GROUP /end SUB_GROUP /begin FUNCTION_LIST /end FUNCTION_LIST /begin REF_CHARACTERISTIC TunSelnAuthy.TunSelnAuthyHwVelY.Ary1D /end REF_CHARACTERISTIC /begin REF_MEASUREMENT /end REF_MEASUREMENT /end GROUP
/begin GROUP TunSelnAuthy.TunSelnAuthyTunSelnRtDiCmd.Logl "MICROSAR RTE" /begin SUB_GROUP /end SUB_GROUP /begin FUNCTION_LIST /end FUNCTION_LIST /begin REF_CHARACTERISTIC TunSelnAuthy.TunSelnAuthyTunSelnRtDiCmd.Logl /end REF_CHARACTERISTIC /begin REF_MEASUREMENT /end REF_MEASUREMENT /end GROUP
/begin GROUP TunSelnAuthy.TunSelnAuthyVehSpdX.Ary1D "MICROSAR RTE" /begin SUB_GROUP /end SUB_GROUP /begin FUNCTION_LIST /end FUNCTION_LIST /begin REF_CHARACTERISTIC TunSelnAuthy.TunSelnAuthyVehSpdX.Ary1D /end REF_CHARACTERISTIC /begin REF_MEASUREMENT /end REF_MEASUREMENT /end GROUP
/begin GROUP TunSelnAuthy.TunSelnRtDi.Logl "MICROSAR RTE" /begin SUB_GROUP /end SUB_GROUP /begin FUNCTION_LIST /end FUNCTION_LIST /begin REF_CHARACTERISTIC /end REF_CHARACTERISTIC /begin REF_MEASUREMENT TunSelnAuthy.TunSelnRtDi.Logl /end REF_MEASUREMENT /end GROUP
/begin GROUP TunSelnAuthy.VehSpd.Val "MICROSAR RTE" /begin SUB_GROUP /end SUB_GROUP /begin FUNCTION_LIST /end FUNCTION_LIST /begin REF_CHARACTERISTIC /end REF_CHARACTERISTIC /begin REF_MEASUREMENT TunSelnAuthy.VehSpd.Val /end REF_MEASUREMENT /end GROUP
/begin GROUP TunSelnMngt "MICROSAR RTE"
 /begin SUB_GROUP TunSelnMngt.PerInstanceMemories TunSelnMngt.ReceiverPorts TunSelnMngt.SenderPorts /end SUB_GROUP
 /begin FUNCTION_LIST /end FUNCTION_LIST
 /begin REF_CHARACTERISTIC /end REF_CHARACTERISTIC
 /begin REF_MEASUREMENT /end REF_MEASUREMENT
/end GROUP
/begin GROUP TunSelnMngt.ActvIninIdx.Val "MICROSAR RTE" /begin SUB_GROUP /end SUB_GROUP /begin FUNCTION_LIST /end FUNCTION_LIST /begin REF_CHARACTERISTIC /end REF_CHARACTERISTIC /begin REF_MEASUREMENT TunSelnMngt.ActvIninIdx.Val /end REF_MEASUREMENT /end GROUP
/begin GROUP TunSelnMngt.ActvRtIdx.Val "MICROSAR RTE" /begin SUB_GROUP /end SUB_GROUP /begin FUNCTION_LIST /end FUNCTION_LIST /begin REF_CHARACTERISTIC /end REF_CHARACTERISTIC /begin REF_MEASUREMENT TunSelnMngt.ActvRtIdx.Val /end REF_MEASUREMENT /end GROUP
/begin GROUP TunSelnMngt.DesIninIdx.Val "MICROSAR RTE" /begin SUB_GROUP /end SUB_GROUP /begin FUNCTION_LIST /end FUNCTION_LIST /begin REF_CHARACTERISTIC /end REF_CHARACTERISTIC /begin REF_MEASUREMENT TunSelnMngt.DesIninIdx.Val /end REF_MEASUREMENT /end GROUP
/begin GROUP TunSelnMngt.DesRtIdx.Val "MICROSAR RTE" /begin SUB_GROUP /end SUB_GROUP /begin FUNCTION_LIST /end FUNCTION_LIST /begin REF_CHARACTERISTIC /end REF_CHARACTERISTIC /begin REF_MEASUREMENT TunSelnMngt.DesRtIdx.Val /end REF_MEASUREMENT /end GROUP
/begin GROUP TunSelnMngt.PerInstanceMemories "MICROSAR RTE"
 /begin SUB_GROUP TunSelnMngt.PrevActvIninIdx TunSelnMngt.PrevActvRtIdx TunSelnMngt.PrevRamPageAcs TunSelnMngt.RamTblSwt /end SUB_GROUP
 /begin FUNCTION_LIST /end FUNCTION_LIST
 /begin REF_CHARACTERISTIC /end REF_CHARACTERISTIC
 /begin REF_MEASUREMENT /end REF_MEASUREMENT
/end GROUP
/begin GROUP TunSelnMngt.PrevActvIninIdx "MICROSAR RTE" /begin SUB_GROUP /end SUB_GROUP /begin FUNCTION_LIST /end FUNCTION_LIST /begin REF_CHARACTERISTIC /end REF_CHARACTERISTIC /begin REF_MEASUREMENT TunSelnMngt.PrevActvIninIdx /end REF_MEASUREMENT /end GROUP
/begin GROUP TunSelnMngt.PrevActvRtIdx "MICROSAR RTE" /begin SUB_GROUP /end SUB_GROUP /begin FUNCTION_LIST /end FUNCTION_LIST /begin REF_CHARACTERISTIC /end REF_CHARACTERISTIC /begin REF_MEASUREMENT TunSelnMngt.PrevActvRtIdx /end REF_MEASUREMENT /end GROUP
/begin GROUP TunSelnMngt.PrevRamPageAcs "MICROSAR RTE" /begin SUB_GROUP /end SUB_GROUP /begin FUNCTION_LIST /end FUNCTION_LIST /begin REF_CHARACTERISTIC /end REF_CHARACTERISTIC /begin REF_MEASUREMENT TunSelnMngt.PrevRamPageAcs /end REF_MEASUREMENT /end GROUP
/begin GROUP TunSelnMngt.RamTblSwt "MICROSAR RTE" /begin SUB_GROUP /end SUB_GROUP /begin FUNCTION_LIST /end FUNCTION_LIST /begin REF_CHARACTERISTIC /end REF_CHARACTERISTIC /begin REF_MEASUREMENT TunSelnMngt.RamTblSwt /end REF_MEASUREMENT /end GROUP
/begin GROUP TunSelnMngt.ReceiverPorts "MICROSAR RTE" /begin SUB_GROUP TunSelnMngt.DesIninIdx.Val TunSelnMngt.DesRtIdx.Val /end SUB_GROUP /begin FUNCTION_LIST /end FUNCTION_LIST /begin REF_CHARACTERISTIC /end REF_CHARACTERISTIC /begin REF_MEASUREMENT /end REF_MEASUREMENT /end GROUP
/begin GROUP TunSelnMngt.SenderPorts "MICROSAR RTE" /begin SUB_GROUP TunSelnMngt.ActvIninIdx.Val TunSelnMngt.ActvRtIdx.Val /end SUB_GROUP /begin FUNCTION_LIST /end FUNCTION_LIST /begin REF_CHARACTERISTIC /end REF_CHARACTERISTIC /begin REF_MEASUREMENT /end REF_MEASUREMENT /end GROUP
/begin GROUP VehSigCdng "MICROSAR RTE"
 /begin SUB_GROUP VehSigCdng.CalibrationPorts VehSigCdng.PerInstanceMemories VehSigCdng.ReceiverPorts VehSigCdng.SenderPorts /end SUB_GROUP
 /begin FUNCTION_LIST /end FUNCTION_LIST
 /begin REF_CHARACTERISTIC /end REF_CHARACTERISTIC
 /begin REF_MEASUREMENT /end REF_MEASUREMENT
/end GROUP
/begin GROUP VehSigCdng.CalibrationPorts "MICROSAR RTE"
 /begin SUB_GROUP VehSigCdng.VehSigCdngDftLatA.Val VehSigCdng.VehSigCdngDftLgtA.Val VehSigCdng.VehSigCdngDftVehSpd.Val VehSigCdng.VehSigCdngDftYawRate.Val VehSigCdng.VehSigCdngLatADifThd.Val VehSigCdng.VehSigCdngLatAFilFrq.Val VehSigCdng.VehSigCdngLatASlewRate.Val VehSigCdng.VehSigCdngLtgADifThd.Val VehSigCdng.VehSigCdngLtgASlewRate.Val VehSigCdng.VehSigCdngVehSpdDifThd.Val VehSigCdng.VehSigCdngVehSpdSlewRate.Val VehSigCdng.VehSigCdngVehYawSlewRate.Val VehSigCdng.VehSigCdngYawRateDifThd.Val /end SUB_GROUP
 /begin FUNCTION_LIST /end FUNCTION_LIST
 /begin REF_CHARACTERISTIC /end REF_CHARACTERISTIC
 /begin REF_MEASUREMENT /end REF_MEASUREMENT
/end GROUP
/begin GROUP VehSigCdng.HwTq.Val "MICROSAR RTE" /begin SUB_GROUP /end SUB_GROUP /begin FUNCTION_LIST /end FUNCTION_LIST /begin REF_CHARACTERISTIC /end REF_CHARACTERISTIC /begin REF_MEASUREMENT VehSigCdng.HwTq.Val /end REF_MEASUREMENT /end GROUP
/begin GROUP VehSigCdng.HwTqFilRec "MICROSAR RTE" /begin SUB_GROUP /end SUB_GROUP /begin FUNCTION_LIST /end FUNCTION_LIST /begin REF_CHARACTERISTIC /end REF_CHARACTERISTIC /begin REF_MEASUREMENT VehSigCdng.HwTqFilRec.FilGain VehSigCdng.HwTqFilRec.FilSt /end REF_MEASUREMENT /end GROUP
/begin GROUP VehSigCdng.LatAFilRec "MICROSAR RTE" /begin SUB_GROUP /end SUB_GROUP /begin FUNCTION_LIST /end FUNCTION_LIST /begin REF_CHARACTERISTIC /end REF_CHARACTERISTIC /begin REF_MEASUREMENT VehSigCdng.LatAFilRec.FilGain VehSigCdng.LatAFilRec.FilSt /end REF_MEASUREMENT /end GROUP
/begin GROUP VehSigCdng.PerInstanceMemories "MICROSAR RTE"
 /begin SUB_GROUP VehSigCdng.HwTqFilRec VehSigCdng.LatAFilRec VehSigCdng.PrevLatA VehSigCdng.PrevLatAVld VehSigCdng.PrevLtgA VehSigCdng.PrevLtgAVld VehSigCdng.PrevVehSpd VehSigCdng.PrevVehSpdVld VehSigCdng.PrevYawRate VehSigCdng.PrevYawRateVld /end SUB_GROUP
 /begin FUNCTION_LIST /end FUNCTION_LIST
 /begin REF_CHARACTERISTIC /end REF_CHARACTERISTIC
 /begin REF_MEASUREMENT /end REF_MEASUREMENT
/end GROUP
/begin GROUP VehSigCdng.PrevLatA "MICROSAR RTE" /begin SUB_GROUP /end SUB_GROUP /begin FUNCTION_LIST /end FUNCTION_LIST /begin REF_CHARACTERISTIC /end REF_CHARACTERISTIC /begin REF_MEASUREMENT VehSigCdng.PrevLatA /end REF_MEASUREMENT /end GROUP
/begin GROUP VehSigCdng.PrevLatAVld "MICROSAR RTE" /begin SUB_GROUP /end SUB_GROUP /begin FUNCTION_LIST /end FUNCTION_LIST /begin REF_CHARACTERISTIC /end REF_CHARACTERISTIC /begin REF_MEASUREMENT VehSigCdng.PrevLatAVld /end REF_MEASUREMENT /end GROUP
/begin GROUP VehSigCdng.PrevLtgA "MICROSAR RTE" /begin SUB_GROUP /end SUB_GROUP /begin FUNCTION_LIST /end FUNCTION_LIST /begin REF_CHARACTERISTIC /end REF_CHARACTERISTIC /begin REF_MEASUREMENT VehSigCdng.PrevLtgA /end REF_MEASUREMENT /end GROUP
/begin GROUP VehSigCdng.PrevLtgAVld "MICROSAR RTE" /begin SUB_GROUP /end SUB_GROUP /begin FUNCTION_LIST /end FUNCTION_LIST /begin REF_CHARACTERISTIC /end REF_CHARACTERISTIC /begin REF_MEASUREMENT VehSigCdng.PrevLtgAVld /end REF_MEASUREMENT /end GROUP
/begin GROUP VehSigCdng.PrevVehSpd "MICROSAR RTE" /begin SUB_GROUP /end SUB_GROUP /begin FUNCTION_LIST /end FUNCTION_LIST /begin REF_CHARACTERISTIC /end REF_CHARACTERISTIC /begin REF_MEASUREMENT VehSigCdng.PrevVehSpd /end REF_MEASUREMENT /end GROUP
/begin GROUP VehSigCdng.PrevVehSpdVld "MICROSAR RTE" /begin SUB_GROUP /end SUB_GROUP /begin FUNCTION_LIST /end FUNCTION_LIST /begin REF_CHARACTERISTIC /end REF_CHARACTERISTIC /begin REF_MEASUREMENT VehSigCdng.PrevVehSpdVld /end REF_MEASUREMENT /end GROUP
/begin GROUP VehSigCdng.PrevYawRate "MICROSAR RTE" /begin SUB_GROUP /end SUB_GROUP /begin FUNCTION_LIST /end FUNCTION_LIST /begin REF_CHARACTERISTIC /end REF_CHARACTERISTIC /begin REF_MEASUREMENT VehSigCdng.PrevYawRate /end REF_MEASUREMENT /end GROUP
/begin GROUP VehSigCdng.PrevYawRateVld "MICROSAR RTE" /begin SUB_GROUP /end SUB_GROUP /begin FUNCTION_LIST /end FUNCTION_LIST /begin REF_CHARACTERISTIC /end REF_CHARACTERISTIC /begin REF_MEASUREMENT VehSigCdng.PrevYawRateVld /end REF_MEASUREMENT /end GROUP
/begin GROUP VehSigCdng.ReceiverPorts "MICROSAR RTE"
 /begin SUB_GROUP VehSigCdng.HwTq.Val VehSigCdng.VehLatASerlCom.Val VehSigCdng.VehLatAVldSerlCom.Logl VehSigCdng.VehLgtASerlCom.Val VehSigCdng.VehLgtAVldSerlCom.Logl VehSigCdng.VehSpdOvrd.Val VehSigCdng.VehSpdOvrdEna.Logl VehSigCdng.VehSpdSerlCom.Val VehSigCdng.VehSpdVldSerlCom.Logl VehSigCdng.VehYawRateSerlCom.Val VehSigCdng.VehYawRateVldSerlCom.Logl /end SUB_GROUP
 /begin FUNCTION_LIST /end FUNCTION_LIST
 /begin REF_CHARACTERISTIC /end REF_CHARACTERISTIC
 /begin REF_MEASUREMENT /end REF_MEASUREMENT
/end GROUP
/begin GROUP VehSigCdng.SenderPorts "MICROSAR RTE"
 /begin SUB_GROUP VehSigCdng.VehLatA.Val VehSigCdng.VehLatAEstimd.Val VehSigCdng.VehLatAEstimdVld.Logl VehSigCdng.VehLatAVld.Logl VehSigCdng.VehLgtA.Val VehSigCdng.VehLgtAVld.Logl VehSigCdng.VehSpd.Val VehSigCdng.VehSpdVld.Logl VehSigCdng.VehYawRate.Val VehSigCdng.VehYawRateVld.Logl /end SUB_GROUP
 /begin FUNCTION_LIST /end FUNCTION_LIST
 /begin REF_CHARACTERISTIC /end REF_CHARACTERISTIC
 /begin REF_MEASUREMENT /end REF_MEASUREMENT
/end GROUP
/begin GROUP VehSigCdng.VehLatA.Val "MICROSAR RTE" /begin SUB_GROUP /end SUB_GROUP /begin FUNCTION_LIST /end FUNCTION_LIST /begin REF_CHARACTERISTIC /end REF_CHARACTERISTIC /begin REF_MEASUREMENT VehSigCdng.VehLatA.Val /end REF_MEASUREMENT /end GROUP
/begin GROUP VehSigCdng.VehLatAEstimd.Val "MICROSAR RTE" /begin SUB_GROUP /end SUB_GROUP /begin FUNCTION_LIST /end FUNCTION_LIST /begin REF_CHARACTERISTIC /end REF_CHARACTERISTIC /begin REF_MEASUREMENT VehSigCdng.VehLatAEstimd.Val /end REF_MEASUREMENT /end GROUP
/begin GROUP VehSigCdng.VehLatAEstimdVld.Logl "MICROSAR RTE" /begin SUB_GROUP /end SUB_GROUP /begin FUNCTION_LIST /end FUNCTION_LIST /begin REF_CHARACTERISTIC /end REF_CHARACTERISTIC /begin REF_MEASUREMENT VehSigCdng.VehLatAEstimdVld.Logl /end REF_MEASUREMENT /end GROUP
/begin GROUP VehSigCdng.VehLatASerlCom.Val "MICROSAR RTE" /begin SUB_GROUP /end SUB_GROUP /begin FUNCTION_LIST /end FUNCTION_LIST /begin REF_CHARACTERISTIC /end REF_CHARACTERISTIC /begin REF_MEASUREMENT VehSigCdng.VehLatASerlCom.Val /end REF_MEASUREMENT /end GROUP
/begin GROUP VehSigCdng.VehLatAVld.Logl "MICROSAR RTE" /begin SUB_GROUP /end SUB_GROUP /begin FUNCTION_LIST /end FUNCTION_LIST /begin REF_CHARACTERISTIC /end REF_CHARACTERISTIC /begin REF_MEASUREMENT VehSigCdng.VehLatAVld.Logl /end REF_MEASUREMENT /end GROUP
/begin GROUP VehSigCdng.VehLatAVldSerlCom.Logl "MICROSAR RTE" /begin SUB_GROUP /end SUB_GROUP /begin FUNCTION_LIST /end FUNCTION_LIST /begin REF_CHARACTERISTIC /end REF_CHARACTERISTIC /begin REF_MEASUREMENT VehSigCdng.VehLatAVldSerlCom.Logl /end REF_MEASUREMENT /end GROUP
/begin GROUP VehSigCdng.VehLgtA.Val "MICROSAR RTE" /begin SUB_GROUP /end SUB_GROUP /begin FUNCTION_LIST /end FUNCTION_LIST /begin REF_CHARACTERISTIC /end REF_CHARACTERISTIC /begin REF_MEASUREMENT VehSigCdng.VehLgtA.Val /end REF_MEASUREMENT /end GROUP
/begin GROUP VehSigCdng.VehLgtASerlCom.Val "MICROSAR RTE" /begin SUB_GROUP /end SUB_GROUP /begin FUNCTION_LIST /end FUNCTION_LIST /begin REF_CHARACTERISTIC /end REF_CHARACTERISTIC /begin REF_MEASUREMENT VehSigCdng.VehLgtASerlCom.Val /end REF_MEASUREMENT /end GROUP
/begin GROUP VehSigCdng.VehLgtAVld.Logl "MICROSAR RTE" /begin SUB_GROUP /end SUB_GROUP /begin FUNCTION_LIST /end FUNCTION_LIST /begin REF_CHARACTERISTIC /end REF_CHARACTERISTIC /begin REF_MEASUREMENT VehSigCdng.VehLgtAVld.Logl /end REF_MEASUREMENT /end GROUP
/begin GROUP VehSigCdng.VehLgtAVldSerlCom.Logl "MICROSAR RTE" /begin SUB_GROUP /end SUB_GROUP /begin FUNCTION_LIST /end FUNCTION_LIST /begin REF_CHARACTERISTIC /end REF_CHARACTERISTIC /begin REF_MEASUREMENT VehSigCdng.VehLgtAVldSerlCom.Logl /end REF_MEASUREMENT /end GROUP
/begin GROUP VehSigCdng.VehSigCdngDftLatA.Val "MICROSAR RTE" /begin SUB_GROUP /end SUB_GROUP /begin FUNCTION_LIST /end FUNCTION_LIST /begin REF_CHARACTERISTIC VehSigCdng.VehSigCdngDftLatA.Val /end REF_CHARACTERISTIC /begin REF_MEASUREMENT /end REF_MEASUREMENT /end GROUP
/begin GROUP VehSigCdng.VehSigCdngDftLgtA.Val "MICROSAR RTE" /begin SUB_GROUP /end SUB_GROUP /begin FUNCTION_LIST /end FUNCTION_LIST /begin REF_CHARACTERISTIC VehSigCdng.VehSigCdngDftLgtA.Val /end REF_CHARACTERISTIC /begin REF_MEASUREMENT /end REF_MEASUREMENT /end GROUP
/begin GROUP VehSigCdng.VehSigCdngDftVehSpd.Val "MICROSAR RTE" /begin SUB_GROUP /end SUB_GROUP /begin FUNCTION_LIST /end FUNCTION_LIST /begin REF_CHARACTERISTIC VehSigCdng.VehSigCdngDftVehSpd.Val /end REF_CHARACTERISTIC /begin REF_MEASUREMENT /end REF_MEASUREMENT /end GROUP
/begin GROUP VehSigCdng.VehSigCdngDftYawRate.Val "MICROSAR RTE" /begin SUB_GROUP /end SUB_GROUP /begin FUNCTION_LIST /end FUNCTION_LIST /begin REF_CHARACTERISTIC VehSigCdng.VehSigCdngDftYawRate.Val /end REF_CHARACTERISTIC /begin REF_MEASUREMENT /end REF_MEASUREMENT /end GROUP
/begin GROUP VehSigCdng.VehSigCdngLatADifThd.Val "MICROSAR RTE" /begin SUB_GROUP /end SUB_GROUP /begin FUNCTION_LIST /end FUNCTION_LIST /begin REF_CHARACTERISTIC VehSigCdng.VehSigCdngLatADifThd.Val /end REF_CHARACTERISTIC /begin REF_MEASUREMENT /end REF_MEASUREMENT /end GROUP
/begin GROUP VehSigCdng.VehSigCdngLatAFilFrq.Val "MICROSAR RTE" /begin SUB_GROUP /end SUB_GROUP /begin FUNCTION_LIST /end FUNCTION_LIST /begin REF_CHARACTERISTIC VehSigCdng.VehSigCdngLatAFilFrq.Val /end REF_CHARACTERISTIC /begin REF_MEASUREMENT /end REF_MEASUREMENT /end GROUP
/begin GROUP VehSigCdng.VehSigCdngLatASlewRate.Val "MICROSAR RTE" /begin SUB_GROUP /end SUB_GROUP /begin FUNCTION_LIST /end FUNCTION_LIST /begin REF_CHARACTERISTIC VehSigCdng.VehSigCdngLatASlewRate.Val /end REF_CHARACTERISTIC /begin REF_MEASUREMENT /end REF_MEASUREMENT /end GROUP
/begin GROUP VehSigCdng.VehSigCdngLtgADifThd.Val "MICROSAR RTE" /begin SUB_GROUP /end SUB_GROUP /begin FUNCTION_LIST /end FUNCTION_LIST /begin REF_CHARACTERISTIC VehSigCdng.VehSigCdngLtgADifThd.Val /end REF_CHARACTERISTIC /begin REF_MEASUREMENT /end REF_MEASUREMENT /end GROUP
/begin GROUP VehSigCdng.VehSigCdngLtgASlewRate.Val "MICROSAR RTE" /begin SUB_GROUP /end SUB_GROUP /begin FUNCTION_LIST /end FUNCTION_LIST /begin REF_CHARACTERISTIC VehSigCdng.VehSigCdngLtgASlewRate.Val /end REF_CHARACTERISTIC /begin REF_MEASUREMENT /end REF_MEASUREMENT /end GROUP
/begin GROUP VehSigCdng.VehSigCdngVehSpdDifThd.Val "MICROSAR RTE" /begin SUB_GROUP /end SUB_GROUP /begin FUNCTION_LIST /end FUNCTION_LIST /begin REF_CHARACTERISTIC VehSigCdng.VehSigCdngVehSpdDifThd.Val /end REF_CHARACTERISTIC /begin REF_MEASUREMENT /end REF_MEASUREMENT /end GROUP
/begin GROUP VehSigCdng.VehSigCdngVehSpdSlewRate.Val "MICROSAR RTE" /begin SUB_GROUP /end SUB_GROUP /begin FUNCTION_LIST /end FUNCTION_LIST /begin REF_CHARACTERISTIC VehSigCdng.VehSigCdngVehSpdSlewRate.Val /end REF_CHARACTERISTIC /begin REF_MEASUREMENT /end REF_MEASUREMENT /end GROUP
/begin GROUP VehSigCdng.VehSigCdngVehYawSlewRate.Val "MICROSAR RTE" /begin SUB_GROUP /end SUB_GROUP /begin FUNCTION_LIST /end FUNCTION_LIST /begin REF_CHARACTERISTIC VehSigCdng.VehSigCdngVehYawSlewRate.Val /end REF_CHARACTERISTIC /begin REF_MEASUREMENT /end REF_MEASUREMENT /end GROUP
/begin GROUP VehSigCdng.VehSigCdngYawRateDifThd.Val "MICROSAR RTE" /begin SUB_GROUP /end SUB_GROUP /begin FUNCTION_LIST /end FUNCTION_LIST /begin REF_CHARACTERISTIC VehSigCdng.VehSigCdngYawRateDifThd.Val /end REF_CHARACTERISTIC /begin REF_MEASUREMENT /end REF_MEASUREMENT /end GROUP
/begin GROUP VehSigCdng.VehSpd.Val "MICROSAR RTE" /begin SUB_GROUP /end SUB_GROUP /begin FUNCTION_LIST /end FUNCTION_LIST /begin REF_CHARACTERISTIC /end REF_CHARACTERISTIC /begin REF_MEASUREMENT VehSigCdng.VehSpd.Val /end REF_MEASUREMENT /end GROUP
/begin GROUP VehSigCdng.VehSpdOvrd.Val "MICROSAR RTE" /begin SUB_GROUP /end SUB_GROUP /begin FUNCTION_LIST /end FUNCTION_LIST /begin REF_CHARACTERISTIC /end REF_CHARACTERISTIC /begin REF_MEASUREMENT VehSigCdng.VehSpdOvrd.Val /end REF_MEASUREMENT /end GROUP
/begin GROUP VehSigCdng.VehSpdOvrdEna.Logl "MICROSAR RTE" /begin SUB_GROUP /end SUB_GROUP /begin FUNCTION_LIST /end FUNCTION_LIST /begin REF_CHARACTERISTIC /end REF_CHARACTERISTIC /begin REF_MEASUREMENT VehSigCdng.VehSpdOvrdEna.Logl /end REF_MEASUREMENT /end GROUP
/begin GROUP VehSigCdng.VehSpdSerlCom.Val "MICROSAR RTE" /begin SUB_GROUP /end SUB_GROUP /begin FUNCTION_LIST /end FUNCTION_LIST /begin REF_CHARACTERISTIC /end REF_CHARACTERISTIC /begin REF_MEASUREMENT VehSigCdng.VehSpdSerlCom.Val /end REF_MEASUREMENT /end GROUP
/begin GROUP VehSigCdng.VehSpdVld.Logl "MICROSAR RTE" /begin SUB_GROUP /end SUB_GROUP /begin FUNCTION_LIST /end FUNCTION_LIST /begin REF_CHARACTERISTIC /end REF_CHARACTERISTIC /begin REF_MEASUREMENT VehSigCdng.VehSpdVld.Logl /end REF_MEASUREMENT /end GROUP
/begin GROUP VehSigCdng.VehSpdVldSerlCom.Logl "MICROSAR RTE" /begin SUB_GROUP /end SUB_GROUP /begin FUNCTION_LIST /end FUNCTION_LIST /begin REF_CHARACTERISTIC /end REF_CHARACTERISTIC /begin REF_MEASUREMENT VehSigCdng.VehSpdVldSerlCom.Logl /end REF_MEASUREMENT /end GROUP
/begin GROUP VehSigCdng.VehYawRate.Val "MICROSAR RTE" /begin SUB_GROUP /end SUB_GROUP /begin FUNCTION_LIST /end FUNCTION_LIST /begin REF_CHARACTERISTIC /end REF_CHARACTERISTIC /begin REF_MEASUREMENT VehSigCdng.VehYawRate.Val /end REF_MEASUREMENT /end GROUP
/begin GROUP VehSigCdng.VehYawRateSerlCom.Val "MICROSAR RTE" /begin SUB_GROUP /end SUB_GROUP /begin FUNCTION_LIST /end FUNCTION_LIST /begin REF_CHARACTERISTIC /end REF_CHARACTERISTIC /begin REF_MEASUREMENT VehSigCdng.VehYawRateSerlCom.Val /end REF_MEASUREMENT /end GROUP
/begin GROUP VehSigCdng.VehYawRateVld.Logl "MICROSAR RTE" /begin SUB_GROUP /end SUB_GROUP /begin FUNCTION_LIST /end FUNCTION_LIST /begin REF_CHARACTERISTIC /end REF_CHARACTERISTIC /begin REF_MEASUREMENT VehSigCdng.VehYawRateVld.Logl /end REF_MEASUREMENT /end GROUP
/begin GROUP VehSigCdng.VehYawRateVldSerlCom.Logl "MICROSAR RTE" /begin SUB_GROUP /end SUB_GROUP /begin FUNCTION_LIST /end FUNCTION_LIST /begin REF_CHARACTERISTIC /end REF_CHARACTERISTIC /begin REF_MEASUREMENT VehSigCdng.VehYawRateVldSerlCom.Logl /end REF_MEASUREMENT /end GROUP
/begin GROUP VehSpdLimr "MICROSAR RTE"
 /begin SUB_GROUP VehSpdLimr.CalibrationPorts VehSpdLimr.PerInstanceMemories VehSpdLimr.ReceiverPorts VehSpdLimr.SenderPorts /end SUB_GROUP
 /begin FUNCTION_LIST /end FUNCTION_LIST
 /begin REF_CHARACTERISTIC /end REF_CHARACTERISTIC
 /begin REF_MEASUREMENT /end REF_MEASUREMENT
/end GROUP
/begin GROUP VehSpdLimr.CalibrationPorts "MICROSAR RTE"
 /begin SUB_GROUP VehSpdLimr.VehSpdLimrMaxAssiX.Ary1D VehSpdLimr.VehSpdLimrMaxAssiY.Ary1D VehSpdLimr.VehSpdLimrPosMaxOffs1.Val VehSpdLimr.VehSpdLimrPosMaxOffs2.Val /end SUB_GROUP
 /begin FUNCTION_LIST /end FUNCTION_LIST
 /begin REF_CHARACTERISTIC /end REF_CHARACTERISTIC
 /begin REF_MEASUREMENT /end REF_MEASUREMENT
/end GROUP
/begin GROUP VehSpdLimr.HwAg.Val "MICROSAR RTE" /begin SUB_GROUP /end SUB_GROUP /begin FUNCTION_LIST /end FUNCTION_LIST /begin REF_CHARACTERISTIC /end REF_CHARACTERISTIC /begin REF_MEASUREMENT VehSpdLimr.HwAg.Val /end REF_MEASUREMENT /end GROUP
/begin GROUP VehSpdLimr.HwAgAuthy.Val "MICROSAR RTE" /begin SUB_GROUP /end SUB_GROUP /begin FUNCTION_LIST /end FUNCTION_LIST /begin REF_CHARACTERISTIC /end REF_CHARACTERISTIC /begin REF_MEASUREMENT VehSpdLimr.HwAgAuthy.Val /end REF_MEASUREMENT /end GROUP
/begin GROUP VehSpdLimr.HwAgEotCcw.Val "MICROSAR RTE" /begin SUB_GROUP /end SUB_GROUP /begin FUNCTION_LIST /end FUNCTION_LIST /begin REF_CHARACTERISTIC /end REF_CHARACTERISTIC /begin REF_MEASUREMENT VehSpdLimr.HwAgEotCcw.Val /end REF_MEASUREMENT /end GROUP
/begin GROUP VehSpdLimr.HwAgEotCw.Val "MICROSAR RTE" /begin SUB_GROUP /end SUB_GROUP /begin FUNCTION_LIST /end FUNCTION_LIST /begin REF_CHARACTERISTIC /end REF_CHARACTERISTIC /begin REF_MEASUREMENT VehSpdLimr.HwAgEotCw.Val /end REF_MEASUREMENT /end GROUP
/begin GROUP VehSpdLimr.PerInstanceMemories "MICROSAR RTE"
 /begin SUB_GROUP VehSpdLimr.dVehSpdLimrBreakPt1 VehSpdLimr.dVehSpdLimrBreakPt2 VehSpdLimr.dVehSpdLimrLimTerm VehSpdLimr.dVehSpdLimrZeroVehSpd /end SUB_GROUP
 /begin FUNCTION_LIST /end FUNCTION_LIST
 /begin REF_CHARACTERISTIC /end REF_CHARACTERISTIC
 /begin REF_MEASUREMENT /end REF_MEASUREMENT
/end GROUP
/begin GROUP VehSpdLimr.ReceiverPorts "MICROSAR RTE"
 /begin SUB_GROUP VehSpdLimr.HwAg.Val VehSpdLimr.HwAgAuthy.Val VehSpdLimr.HwAgEotCcw.Val VehSpdLimr.HwAgEotCw.Val VehSpdLimr.VehSpd.Val /end SUB_GROUP
 /begin FUNCTION_LIST /end FUNCTION_LIST
 /begin REF_CHARACTERISTIC /end REF_CHARACTERISTIC
 /begin REF_MEASUREMENT /end REF_MEASUREMENT
/end GROUP
/begin GROUP VehSpdLimr.SenderPorts "MICROSAR RTE" /begin SUB_GROUP VehSpdLimr.VehSpdMotTqLim.Val /end SUB_GROUP /begin FUNCTION_LIST /end FUNCTION_LIST /begin REF_CHARACTERISTIC /end REF_CHARACTERISTIC /begin REF_MEASUREMENT /end REF_MEASUREMENT /end GROUP
/begin GROUP VehSpdLimr.VehSpd.Val "MICROSAR RTE" /begin SUB_GROUP /end SUB_GROUP /begin FUNCTION_LIST /end FUNCTION_LIST /begin REF_CHARACTERISTIC /end REF_CHARACTERISTIC /begin REF_MEASUREMENT VehSpdLimr.VehSpd.Val /end REF_MEASUREMENT /end GROUP
/begin GROUP VehSpdLimr.VehSpdLimrMaxAssiX.Ary1D "MICROSAR RTE" /begin SUB_GROUP /end SUB_GROUP /begin FUNCTION_LIST /end FUNCTION_LIST /begin REF_CHARACTERISTIC VehSpdLimr.VehSpdLimrMaxAssiX.Ary1D /end REF_CHARACTERISTIC /begin REF_MEASUREMENT /end REF_MEASUREMENT /end GROUP
/begin GROUP VehSpdLimr.VehSpdLimrMaxAssiY.Ary1D "MICROSAR RTE" /begin SUB_GROUP /end SUB_GROUP /begin FUNCTION_LIST /end FUNCTION_LIST /begin REF_CHARACTERISTIC VehSpdLimr.VehSpdLimrMaxAssiY.Ary1D /end REF_CHARACTERISTIC /begin REF_MEASUREMENT /end REF_MEASUREMENT /end GROUP
/begin GROUP VehSpdLimr.VehSpdLimrPosMaxOffs1.Val "MICROSAR RTE" /begin SUB_GROUP /end SUB_GROUP /begin FUNCTION_LIST /end FUNCTION_LIST /begin REF_CHARACTERISTIC VehSpdLimr.VehSpdLimrPosMaxOffs1.Val /end REF_CHARACTERISTIC /begin REF_MEASUREMENT /end REF_MEASUREMENT /end GROUP
/begin GROUP VehSpdLimr.VehSpdLimrPosMaxOffs2.Val "MICROSAR RTE" /begin SUB_GROUP /end SUB_GROUP /begin FUNCTION_LIST /end FUNCTION_LIST /begin REF_CHARACTERISTIC VehSpdLimr.VehSpdLimrPosMaxOffs2.Val /end REF_CHARACTERISTIC /begin REF_MEASUREMENT /end REF_MEASUREMENT /end GROUP
/begin GROUP VehSpdLimr.VehSpdMotTqLim.Val "MICROSAR RTE" /begin SUB_GROUP /end SUB_GROUP /begin FUNCTION_LIST /end FUNCTION_LIST /begin REF_CHARACTERISTIC /end REF_CHARACTERISTIC /begin REF_MEASUREMENT VehSpdLimr.VehSpdMotTqLim.Val /end REF_MEASUREMENT /end GROUP
/begin GROUP VehSpdLimr.dVehSpdLimrBreakPt1 "MICROSAR RTE" /begin SUB_GROUP /end SUB_GROUP /begin FUNCTION_LIST /end FUNCTION_LIST /begin REF_CHARACTERISTIC /end REF_CHARACTERISTIC /begin REF_MEASUREMENT VehSpdLimr.dVehSpdLimrBreakPt1 /end REF_MEASUREMENT /end GROUP
/begin GROUP VehSpdLimr.dVehSpdLimrBreakPt2 "MICROSAR RTE" /begin SUB_GROUP /end SUB_GROUP /begin FUNCTION_LIST /end FUNCTION_LIST /begin REF_CHARACTERISTIC /end REF_CHARACTERISTIC /begin REF_MEASUREMENT VehSpdLimr.dVehSpdLimrBreakPt2 /end REF_MEASUREMENT /end GROUP
/begin GROUP VehSpdLimr.dVehSpdLimrLimTerm "MICROSAR RTE" /begin SUB_GROUP /end SUB_GROUP /begin FUNCTION_LIST /end FUNCTION_LIST /begin REF_CHARACTERISTIC /end REF_CHARACTERISTIC /begin REF_MEASUREMENT VehSpdLimr.dVehSpdLimrLimTerm /end REF_MEASUREMENT /end GROUP
/begin GROUP VehSpdLimr.dVehSpdLimrZeroVehSpd "MICROSAR RTE" /begin SUB_GROUP /end SUB_GROUP /begin FUNCTION_LIST /end FUNCTION_LIST /begin REF_CHARACTERISTIC /end REF_CHARACTERISTIC /begin REF_MEASUREMENT VehSpdLimr.dVehSpdLimrZeroVehSpd /end REF_MEASUREMENT /end GROUP
/begin GROUP WhlImbRejctn "MICROSAR RTE"
 /begin SUB_GROUP WhlImbRejctn.CalibrationParameters WhlImbRejctn.CalibrationPorts WhlImbRejctn.PerInstanceMemories WhlImbRejctn.ReceiverPorts WhlImbRejctn.SenderPorts /end SUB_GROUP
 /begin FUNCTION_LIST /end FUNCTION_LIST
 /begin REF_CHARACTERISTIC /end REF_CHARACTERISTIC
 /begin REF_MEASUREMENT /end REF_MEASUREMENT
/end GROUP
/begin GROUP WhlImbRejctn.ActvCmpBand1Dft "MICROSAR RTE" /begin SUB_GROUP /end SUB_GROUP /begin FUNCTION_LIST /end FUNCTION_LIST /begin REF_CHARACTERISTIC WhlImbRejctn.ActvCmpBand1Dft /end REF_CHARACTERISTIC /begin REF_MEASUREMENT /end REF_MEASUREMENT /end GROUP
/begin GROUP WhlImbRejctn.ActvCmpBand2Dft "MICROSAR RTE" /begin SUB_GROUP /end SUB_GROUP /begin FUNCTION_LIST /end FUNCTION_LIST /begin REF_CHARACTERISTIC WhlImbRejctn.ActvCmpBand2Dft /end REF_CHARACTERISTIC /begin REF_MEASUREMENT /end REF_MEASUREMENT /end GROUP
/begin GROUP WhlImbRejctn.ActvCmpBand3Dft "MICROSAR RTE" /begin SUB_GROUP /end SUB_GROUP /begin FUNCTION_LIST /end FUNCTION_LIST /begin REF_CHARACTERISTIC WhlImbRejctn.ActvCmpBand3Dft /end REF_CHARACTERISTIC /begin REF_MEASUREMENT /end REF_MEASUREMENT /end GROUP
/begin GROUP WhlImbRejctn.BlndCmdMgnLp1Fil "MICROSAR RTE" /begin SUB_GROUP /end SUB_GROUP /begin FUNCTION_LIST /end FUNCTION_LIST /begin REF_CHARACTERISTIC /end REF_CHARACTERISTIC
 /begin REF_MEASUREMENT WhlImbRejctn.BlndCmdMgnLp1Fil.FilGain WhlImbRejctn.BlndCmdMgnLp1Fil.FilSt /end REF_MEASUREMENT
/end GROUP
/begin GROUP WhlImbRejctn.BlndCmdMgnLp2Fil "MICROSAR RTE" /begin SUB_GROUP /end SUB_GROUP /begin FUNCTION_LIST /end FUNCTION_LIST /begin REF_CHARACTERISTIC /end REF_CHARACTERISTIC
 /begin REF_MEASUREMENT WhlImbRejctn.BlndCmdMgnLp2Fil.FilGain WhlImbRejctn.BlndCmdMgnLp2Fil.FilSt /end REF_MEASUREMENT
/end GROUP
/begin GROUP WhlImbRejctn.CalibrationParameters "MICROSAR RTE"
 /begin SUB_GROUP WhlImbRejctn.ActvCmpBand1Dft WhlImbRejctn.ActvCmpBand2Dft WhlImbRejctn.ActvCmpBand3Dft WhlImbRejctn.LePeakPrevDft WhlImbRejctn.MaxCompPercDft WhlImbRejctn.RiPeakPrevDft /end SUB_GROUP
 /begin FUNCTION_LIST /end FUNCTION_LIST
 /begin REF_CHARACTERISTIC /end REF_CHARACTERISTIC
 /begin REF_MEASUREMENT /end REF_MEASUREMENT
/end GROUP
/begin GROUP WhlImbRejctn.CalibrationPorts "MICROSAR RTE"
 /begin SUB_GROUP WhlImbRejctn.WhlImbRejctnAdpvFac.Val WhlImbRejctn.WhlImbRejctnAutScaEna.Logl WhlImbRejctn.WhlImbRejctnAutScaTar.Val WhlImbRejctn.WhlImbRejctnBlndCmdMgnLp1FilFrq.Val WhlImbRejctn.WhlImbRejctnBlndCmdMgnLp2FilFrq.Val WhlImbRejctn.WhlImbRejctnCmdMgnLp1FilFrq.Val WhlImbRejctn.WhlImbRejctnCmdMgnLp2FilFrq.Val WhlImbRejctn.WhlImbRejctnCurrMgnSlewPerLoop.Val WhlImbRejctn.WhlImbRejctnDcTrendFltRcvryDly.Val WhlImbRejctn.WhlImbRejctnDcTrendFltRcvryNegStep.Val WhlImbRejctn.WhlImbRejctnDcTrendFltRcvryPosStep.Val WhlImbRejctn.WhlImbRejctnDcTrendFltRcvryThd.Val WhlImbRejctn.WhlImbRejctnDcTrendLpFil.Val WhlImbRejctn.WhlImbRejctnDcTrendTh2Tq.Val WhlImbRejctn.WhlImbRejctnDcTrendThTq.Val WhlImbRejctn.WhlImbRejctnDcTrendTi2Sec.Val WhlImbRejctn.WhlImbRejctnDcTrendTiSec.Val WhlImbRejctn.WhlImbRejctnDistbnMgnLpFil.Val WhlImbRejctn.WhlImbRejctnEnaSlewPerLoop.Val WhlImbRejctn.WhlImbRejctnFctEna.Logl WhlImbRejctn.WhlImbRejctnFrqDiagcAmpThd.Val WhlImbRejctn.WhlImbRejctnFrqDiagcEna.Logl WhlImbRejctn.WhlImbRejctnFrqDiagcFltRcvryDly.Val WhlImbRejctn.WhlImbRejctnFrqDiagcFltRcvryNegStep.Val WhlImbRejctn.WhlImbRejctnFrqDiagcFltRcvryPosStep.Val WhlImbRejctn.WhlImbRejctnFrqDiagcFltRcvryThd.Val WhlImbRejctn.WhlImbRejctnFrqDiagcLpFil.Val WhlImbRejctn.WhlImbRejctnFrqDiagcThd.Val WhlImbRejctn.WhlImbRejctnFrqDiagcTout.Val WhlImbRejctn.WhlImbRejctnFrqDiagcUgrPoleMgn.Val WhlImbRejctn.WhlImbRejctnFrqScaTblX.Ary1D WhlImbRejctn.WhlImbRejctnFrqScaTblY.Ary1D WhlImbRejctn.WhlImbRejctnMaxDurn.Val WhlImbRejctn.WhlImbRejctnMaxMgn.Val WhlImbRejctn.WhlImbRejctnMaxMgnFltNegStep.Val WhlImbRejctn.WhlImbRejctnMaxMgnFltPosStep.Val WhlImbRejctn.WhlImbRejctnMaxMgnFltRcvryDly.Val WhlImbRejctn.WhlImbRejctnMaxMgnFltRcvryNegStep.Val WhlImbRejctn.WhlImbRejctnMaxMgnFltRcvryPosStep.Val WhlImbRejctn.WhlImbRejctnMaxMgnFltRcvryThd.Val WhlImbRejctn.WhlImbRejctnMaxMgnFltThd.Val WhlImbRejctn.WhlImbRejctnMgnEstimnDeltaSca.Val WhlImbRejctn.WhlImbRejctnMgnEstimnDiThd.Val WhlImbRejctn.WhlImbRejctnMgnEstimnEnaThd.Val WhlImbRejctn.WhlImbRejctnMgnEstimnFrq.Val WhlImbRejctn.WhlImbRejctnMgnEstimnFrqDelta.Val WhlImbRejctn.WhlImbRejctnMgnEstimnLeak.Val WhlImbRejctn.WhlImbRejctnPhaAdjX.Ary1D WhlImbRejctn.WhlImbRejctnPhaAdjY.Ary1D WhlImbRejctn.WhlImbRejctnRampDwnTi.Val WhlImbRejctn.WhlImbRejctnScaCncl.Val WhlImbRejctn.WhlImbRejctnUgrPoleMgn.Val WhlImbRejctn.WhlImbRejctnVehSpdEna.Val WhlImbRejctn.WhlImbRejctnWhlSpdCorrlnFltRcvryDly.Val WhlImbRejctn.WhlImbRejctnWhlSpdCorrlnFltRcvryNegStep.Val WhlImbRejctn.WhlImbRejctnWhlSpdCorrlnFltRcvryPosStep.Val WhlImbRejctn.WhlImbRejctnWhlSpdCorrlnFltRcvryThd.Val WhlImbRejctn.WhlImbRejctnWhlSpdCorrlnThd.Val WhlImbRejctn.WhlImbRejctnWhlSpdCorrlnTi.Val WhlImbRejctn.WhlImbRejctnWhlSpdLpFil.Val /end SUB_GROUP
 /begin FUNCTION_LIST /end FUNCTION_LIST
 /begin REF_CHARACTERISTIC /end REF_CHARACTERISTIC
 /begin REF_MEASUREMENT /end REF_MEASUREMENT
/end GROUP
/begin GROUP WhlImbRejctn.CmdMgnLp1Fil "MICROSAR RTE" /begin SUB_GROUP /end SUB_GROUP /begin FUNCTION_LIST /end FUNCTION_LIST /begin REF_CHARACTERISTIC /end REF_CHARACTERISTIC
 /begin REF_MEASUREMENT WhlImbRejctn.CmdMgnLp1Fil.FilGain WhlImbRejctn.CmdMgnLp1Fil.FilSt /end REF_MEASUREMENT
/end GROUP
/begin GROUP WhlImbRejctn.CmdMgnLp2Fil "MICROSAR RTE" /begin SUB_GROUP /end SUB_GROUP /begin FUNCTION_LIST /end FUNCTION_LIST /begin REF_CHARACTERISTIC /end REF_CHARACTERISTIC
 /begin REF_MEASUREMENT WhlImbRejctn.CmdMgnLp2Fil.FilGain WhlImbRejctn.CmdMgnLp2Fil.FilSt /end REF_MEASUREMENT
/end GROUP
/begin GROUP WhlImbRejctn.CmpPeakData "MICROSAR RTE" /begin SUB_GROUP /end SUB_GROUP /begin FUNCTION_LIST /end FUNCTION_LIST /begin REF_CHARACTERISTIC /end REF_CHARACTERISTIC
 /begin REF_MEASUREMENT WhlImbRejctn.CmpPeakData.ActvCmpBand1 WhlImbRejctn.CmpPeakData.ActvCmpBand2 WhlImbRejctn.CmpPeakData.ActvCmpBand3 WhlImbRejctn.CmpPeakData.LePeakPrev WhlImbRejctn.CmpPeakData.MaxCompPerc WhlImbRejctn.CmpPeakData.RiPeakPrev /end REF_MEASUREMENT
/end GROUP
/begin GROUP WhlImbRejctn.DcTrendFltFaild "MICROSAR RTE" /begin SUB_GROUP /end SUB_GROUP /begin FUNCTION_LIST /end FUNCTION_LIST /begin REF_CHARACTERISTIC /end REF_CHARACTERISTIC /begin REF_MEASUREMENT WhlImbRejctn.DcTrendFltFaild /end REF_MEASUREMENT /end GROUP
/begin GROUP WhlImbRejctn.DcTrendFltRcvry "MICROSAR RTE" /begin SUB_GROUP /end SUB_GROUP /begin FUNCTION_LIST /end FUNCTION_LIST /begin REF_CHARACTERISTIC /end REF_CHARACTERISTIC
 /begin REF_MEASUREMENT WhlImbRejctn.DcTrendFltRcvry.Cntr WhlImbRejctn.DcTrendFltRcvry.NegStep WhlImbRejctn.DcTrendFltRcvry.PosStep WhlImbRejctn.DcTrendFltRcvry.Sts WhlImbRejctn.DcTrendFltRcvry.Thd /end REF_MEASUREMENT
/end GROUP
/begin GROUP WhlImbRejctn.DcTrendFltRst "MICROSAR RTE" /begin SUB_GROUP /end SUB_GROUP /begin FUNCTION_LIST /end FUNCTION_LIST /begin REF_CHARACTERISTIC /end REF_CHARACTERISTIC /begin REF_MEASUREMENT WhlImbRejctn.DcTrendFltRst /end REF_MEASUREMENT /end GROUP
/begin GROUP WhlImbRejctn.DcTrendLpFil "MICROSAR RTE" /begin SUB_GROUP /end SUB_GROUP /begin FUNCTION_LIST /end FUNCTION_LIST /begin REF_CHARACTERISTIC /end REF_CHARACTERISTIC
 /begin REF_MEASUREMENT WhlImbRejctn.DcTrendLpFil.FilGain WhlImbRejctn.DcTrendLpFil.FilSt /end REF_MEASUREMENT
/end GROUP
/begin GROUP WhlImbRejctn.DcTrendLrngEnaPrev "MICROSAR RTE" /begin SUB_GROUP /end SUB_GROUP /begin FUNCTION_LIST /end FUNCTION_LIST /begin REF_CHARACTERISTIC /end REF_CHARACTERISTIC /begin REF_MEASUREMENT WhlImbRejctn.DcTrendLrngEnaPrev /end REF_MEASUREMENT /end GROUP
/begin GROUP WhlImbRejctn.DcTrendLrngEnaPrevTmr1 "MICROSAR RTE" /begin SUB_GROUP /end SUB_GROUP /begin FUNCTION_LIST /end FUNCTION_LIST /begin REF_CHARACTERISTIC /end REF_CHARACTERISTIC /begin REF_MEASUREMENT WhlImbRejctn.DcTrendLrngEnaPrevTmr1 /end REF_MEASUREMENT /end GROUP
/begin GROUP WhlImbRejctn.DcTrendLrngEnaPrevTmr2 "MICROSAR RTE" /begin SUB_GROUP /end SUB_GROUP /begin FUNCTION_LIST /end FUNCTION_LIST /begin REF_CHARACTERISTIC /end REF_CHARACTERISTIC /begin REF_MEASUREMENT WhlImbRejctn.DcTrendLrngEnaPrevTmr2 /end REF_MEASUREMENT /end GROUP
/begin GROUP WhlImbRejctn.DcTrendRefTiEnaLrng "MICROSAR RTE" /begin SUB_GROUP /end SUB_GROUP /begin FUNCTION_LIST /end FUNCTION_LIST /begin REF_CHARACTERISTIC /end REF_CHARACTERISTIC /begin REF_MEASUREMENT WhlImbRejctn.DcTrendRefTiEnaLrng /end REF_MEASUREMENT /end GROUP
/begin GROUP WhlImbRejctn.DcTrendRefTiEnaLrngTmr1 "MICROSAR RTE" /begin SUB_GROUP /end SUB_GROUP /begin FUNCTION_LIST /end FUNCTION_LIST /begin REF_CHARACTERISTIC /end REF_CHARACTERISTIC /begin REF_MEASUREMENT WhlImbRejctn.DcTrendRefTiEnaLrngTmr1 /end REF_MEASUREMENT /end GROUP
/begin GROUP WhlImbRejctn.DcTrendRefTiEnaLrngTmr2 "MICROSAR RTE" /begin SUB_GROUP /end SUB_GROUP /begin FUNCTION_LIST /end FUNCTION_LIST /begin REF_CHARACTERISTIC /end REF_CHARACTERISTIC /begin REF_MEASUREMENT WhlImbRejctn.DcTrendRefTiEnaLrngTmr2 /end REF_MEASUREMENT /end GROUP
/begin GROUP WhlImbRejctn.DistbnMagEnadPrev "MICROSAR RTE" /begin SUB_GROUP /end SUB_GROUP /begin FUNCTION_LIST /end FUNCTION_LIST /begin REF_CHARACTERISTIC /end REF_CHARACTERISTIC /begin REF_MEASUREMENT WhlImbRejctn.DistbnMagEnadPrev /end REF_MEASUREMENT /end GROUP
/begin GROUP WhlImbRejctn.DistbnMgnLeLpFil "MICROSAR RTE" /begin SUB_GROUP /end SUB_GROUP /begin FUNCTION_LIST /end FUNCTION_LIST /begin REF_CHARACTERISTIC /end REF_CHARACTERISTIC
 /begin REF_MEASUREMENT WhlImbRejctn.DistbnMgnLeLpFil.FilGain WhlImbRejctn.DistbnMgnLeLpFil.FilSt /end REF_MEASUREMENT
/end GROUP
/begin GROUP WhlImbRejctn.DistbnMgnRiLpFil "MICROSAR RTE" /begin SUB_GROUP /end SUB_GROUP /begin FUNCTION_LIST /end FUNCTION_LIST /begin REF_CHARACTERISTIC /end REF_CHARACTERISTIC
 /begin REF_MEASUREMENT WhlImbRejctn.DistbnMgnRiLpFil.FilGain WhlImbRejctn.DistbnMgnRiLpFil.FilSt /end REF_MEASUREMENT
/end GROUP
/begin GROUP WhlImbRejctn.EnaSlewPerLoop "MICROSAR RTE" /begin SUB_GROUP /end SUB_GROUP /begin FUNCTION_LIST /end FUNCTION_LIST /begin REF_CHARACTERISTIC /end REF_CHARACTERISTIC /begin REF_MEASUREMENT WhlImbRejctn.EnaSlewPerLoop /end REF_MEASUREMENT /end GROUP
/begin GROUP WhlImbRejctn.FrqDiagcFltFaild "MICROSAR RTE" /begin SUB_GROUP /end SUB_GROUP /begin FUNCTION_LIST /end FUNCTION_LIST /begin REF_CHARACTERISTIC /end REF_CHARACTERISTIC /begin REF_MEASUREMENT WhlImbRejctn.FrqDiagcFltFaild /end REF_MEASUREMENT /end GROUP
/begin GROUP WhlImbRejctn.FrqDiagcFltRcvry "MICROSAR RTE" /begin SUB_GROUP /end SUB_GROUP /begin FUNCTION_LIST /end FUNCTION_LIST /begin REF_CHARACTERISTIC /end REF_CHARACTERISTIC
 /begin REF_MEASUREMENT WhlImbRejctn.FrqDiagcFltRcvry.Cntr WhlImbRejctn.FrqDiagcFltRcvry.NegStep WhlImbRejctn.FrqDiagcFltRcvry.PosStep WhlImbRejctn.FrqDiagcFltRcvry.Sts WhlImbRejctn.FrqDiagcFltRcvry.Thd /end REF_MEASUREMENT
/end GROUP
/begin GROUP WhlImbRejctn.FrqDiagcFltRst "MICROSAR RTE" /begin SUB_GROUP /end SUB_GROUP /begin FUNCTION_LIST /end FUNCTION_LIST /begin REF_CHARACTERISTIC /end REF_CHARACTERISTIC /begin REF_MEASUREMENT WhlImbRejctn.FrqDiagcFltRst /end REF_MEASUREMENT /end GROUP
/begin GROUP WhlImbRejctn.FrqDiagcLpFil "MICROSAR RTE" /begin SUB_GROUP /end SUB_GROUP /begin FUNCTION_LIST /end FUNCTION_LIST /begin REF_CHARACTERISTIC /end REF_CHARACTERISTIC
 /begin REF_MEASUREMENT WhlImbRejctn.FrqDiagcLpFil.FilGain WhlImbRejctn.FrqDiagcLpFil.FilSt /end REF_MEASUREMENT
/end GROUP
/begin GROUP WhlImbRejctn.FrqDiagcLrngEnaPrev "MICROSAR RTE" /begin SUB_GROUP /end SUB_GROUP /begin FUNCTION_LIST /end FUNCTION_LIST /begin REF_CHARACTERISTIC /end REF_CHARACTERISTIC /begin REF_MEASUREMENT WhlImbRejctn.FrqDiagcLrngEnaPrev /end REF_MEASUREMENT /end GROUP
/begin GROUP WhlImbRejctn.FrqDiagcLrngEnaPrevTiOut "MICROSAR RTE" /begin SUB_GROUP /end SUB_GROUP /begin FUNCTION_LIST /end FUNCTION_LIST /begin REF_CHARACTERISTIC /end REF_CHARACTERISTIC /begin REF_MEASUREMENT WhlImbRejctn.FrqDiagcLrngEnaPrevTiOut /end REF_MEASUREMENT /end GROUP
/begin GROUP WhlImbRejctn.FrqDiagcRefTiEnaLrng "MICROSAR RTE" /begin SUB_GROUP /end SUB_GROUP /begin FUNCTION_LIST /end FUNCTION_LIST /begin REF_CHARACTERISTIC /end REF_CHARACTERISTIC /begin REF_MEASUREMENT WhlImbRejctn.FrqDiagcRefTiEnaLrng /end REF_MEASUREMENT /end GROUP
/begin GROUP WhlImbRejctn.FrqDiagcRefTiEnaLrngTiOut "MICROSAR RTE" /begin SUB_GROUP /end SUB_GROUP /begin FUNCTION_LIST /end FUNCTION_LIST /begin REF_CHARACTERISTIC /end REF_CHARACTERISTIC /begin REF_MEASUREMENT WhlImbRejctn.FrqDiagcRefTiEnaLrngTiOut /end REF_MEASUREMENT /end GROUP
/begin GROUP WhlImbRejctn.FrqDiagcUgr1 "MICROSAR RTE" /begin SUB_GROUP /end SUB_GROUP /begin FUNCTION_LIST /end FUNCTION_LIST /begin REF_CHARACTERISTIC /end REF_CHARACTERISTIC /begin REF_MEASUREMENT WhlImbRejctn.FrqDiagcUgr1 /end REF_MEASUREMENT /end GROUP
/begin GROUP WhlImbRejctn.FrqDiagcUgr2 "MICROSAR RTE" /begin SUB_GROUP /end SUB_GROUP /begin FUNCTION_LIST /end FUNCTION_LIST /begin REF_CHARACTERISTIC /end REF_CHARACTERISTIC /begin REF_MEASUREMENT WhlImbRejctn.FrqDiagcUgr2 /end REF_MEASUREMENT /end GROUP
/begin GROUP WhlImbRejctn.HwTq.Val "MICROSAR RTE" /begin SUB_GROUP /end SUB_GROUP /begin FUNCTION_LIST /end FUNCTION_LIST /begin REF_CHARACTERISTIC /end REF_CHARACTERISTIC /begin REF_MEASUREMENT WhlImbRejctn.HwTq.Val /end REF_MEASUREMENT /end GROUP
/begin GROUP WhlImbRejctn.LeCurrMgnSlewPerLoop "MICROSAR RTE" /begin SUB_GROUP /end SUB_GROUP /begin FUNCTION_LIST /end FUNCTION_LIST /begin REF_CHARACTERISTIC /end REF_CHARACTERISTIC /begin REF_MEASUREMENT WhlImbRejctn.LeCurrMgnSlewPerLoop /end REF_MEASUREMENT /end GROUP
/begin GROUP WhlImbRejctn.LePeakPrevDft "MICROSAR RTE" /begin SUB_GROUP /end SUB_GROUP /begin FUNCTION_LIST /end FUNCTION_LIST /begin REF_CHARACTERISTIC WhlImbRejctn.LePeakPrevDft /end REF_CHARACTERISTIC /begin REF_MEASUREMENT /end REF_MEASUREMENT /end GROUP
/begin GROUP WhlImbRejctn.LeStDlyUpd "MICROSAR RTE" /begin SUB_GROUP /end SUB_GROUP /begin FUNCTION_LIST /end FUNCTION_LIST /begin REF_CHARACTERISTIC /end REF_CHARACTERISTIC /begin REF_MEASUREMENT WhlImbRejctn.LeStDlyUpd /end REF_MEASUREMENT /end GROUP
/begin GROUP WhlImbRejctn.LeStVariUpd "MICROSAR RTE" /begin SUB_GROUP /end SUB_GROUP /begin FUNCTION_LIST /end FUNCTION_LIST /begin REF_CHARACTERISTIC /end REF_CHARACTERISTIC /begin REF_MEASUREMENT WhlImbRejctn.LeStVariUpd /end REF_MEASUREMENT /end GROUP
/begin GROUP WhlImbRejctn.MaxCompPercDft "MICROSAR RTE" /begin SUB_GROUP /end SUB_GROUP /begin FUNCTION_LIST /end FUNCTION_LIST /begin REF_CHARACTERISTIC WhlImbRejctn.MaxCompPercDft /end REF_CHARACTERISTIC /begin REF_MEASUREMENT /end REF_MEASUREMENT /end GROUP
/begin GROUP WhlImbRejctn.MaxMgnFltFaild "MICROSAR RTE" /begin SUB_GROUP /end SUB_GROUP /begin FUNCTION_LIST /end FUNCTION_LIST /begin REF_CHARACTERISTIC /end REF_CHARACTERISTIC /begin REF_MEASUREMENT WhlImbRejctn.MaxMgnFltFaild /end REF_MEASUREMENT /end GROUP
/begin GROUP WhlImbRejctn.MaxMgnFltRcvry "MICROSAR RTE" /begin SUB_GROUP /end SUB_GROUP /begin FUNCTION_LIST /end FUNCTION_LIST /begin REF_CHARACTERISTIC /end REF_CHARACTERISTIC
 /begin REF_MEASUREMENT WhlImbRejctn.MaxMgnFltRcvry.Cntr WhlImbRejctn.MaxMgnFltRcvry.NegStep WhlImbRejctn.MaxMgnFltRcvry.PosStep WhlImbRejctn.MaxMgnFltRcvry.Sts WhlImbRejctn.MaxMgnFltRcvry.Thd /end REF_MEASUREMENT
/end GROUP
/begin GROUP WhlImbRejctn.MaxMgnFltRst "MICROSAR RTE" /begin SUB_GROUP /end SUB_GROUP /begin FUNCTION_LIST /end FUNCTION_LIST /begin REF_CHARACTERISTIC /end REF_CHARACTERISTIC /begin REF_MEASUREMENT WhlImbRejctn.MaxMgnFltRst /end REF_MEASUREMENT /end GROUP
/begin GROUP WhlImbRejctn.MaxMgnLrngEnaPrev "MICROSAR RTE" /begin SUB_GROUP /end SUB_GROUP /begin FUNCTION_LIST /end FUNCTION_LIST /begin REF_CHARACTERISTIC /end REF_CHARACTERISTIC /begin REF_MEASUREMENT WhlImbRejctn.MaxMgnLrngEnaPrev /end REF_MEASUREMENT /end GROUP
/begin GROUP WhlImbRejctn.MaxMgnRefTiEnaLrng "MICROSAR RTE" /begin SUB_GROUP /end SUB_GROUP /begin FUNCTION_LIST /end FUNCTION_LIST /begin REF_CHARACTERISTIC /end REF_CHARACTERISTIC /begin REF_MEASUREMENT WhlImbRejctn.MaxMgnRefTiEnaLrng /end REF_MEASUREMENT /end GROUP
/begin GROUP WhlImbRejctn.PerInstanceMemories "MICROSAR RTE"
 /begin SUB_GROUP WhlImbRejctn.BlndCmdMgnLp1Fil WhlImbRejctn.BlndCmdMgnLp2Fil WhlImbRejctn.CmdMgnLp1Fil WhlImbRejctn.CmdMgnLp2Fil WhlImbRejctn.CmpPeakData WhlImbRejctn.DcTrendFltFaild WhlImbRejctn.DcTrendFltRcvry WhlImbRejctn.DcTrendFltRst WhlImbRejctn.DcTrendLpFil WhlImbRejctn.DcTrendLrngEnaPrev WhlImbRejctn.DcTrendLrngEnaPrevTmr1 WhlImbRejctn.DcTrendLrngEnaPrevTmr2 WhlImbRejctn.DcTrendRefTiEnaLrng WhlImbRejctn.DcTrendRefTiEnaLrngTmr1 WhlImbRejctn.DcTrendRefTiEnaLrngTmr2 WhlImbRejctn.DistbnMagEnadPrev WhlImbRejctn.DistbnMgnLeLpFil WhlImbRejctn.DistbnMgnRiLpFil WhlImbRejctn.EnaSlewPerLoop WhlImbRejctn.FrqDiagcFltFaild WhlImbRejctn.FrqDiagcFltRcvry WhlImbRejctn.FrqDiagcFltRst WhlImbRejctn.FrqDiagcLpFil WhlImbRejctn.FrqDiagcLrngEnaPrev WhlImbRejctn.FrqDiagcLrngEnaPrevTiOut WhlImbRejctn.FrqDiagcRefTiEnaLrng WhlImbRejctn.FrqDiagcRefTiEnaLrngTiOut WhlImbRejctn.FrqDiagcUgr1 WhlImbRejctn.FrqDiagcUgr2 WhlImbRejctn.LeCurrMgnSlewPerLoop WhlImbRejctn.LeStDlyUpd WhlImbRejctn.LeStVariUpd WhlImbRejctn.MaxMgnFltFaild WhlImbRejctn.MaxMgnFltRcvry WhlImbRejctn.MaxMgnFltRst WhlImbRejctn.MaxMgnLrngEnaPrev WhlImbRejctn.MaxMgnRefTiEnaLrng WhlImbRejctn.PhaAdjFil1Coeff1 WhlImbRejctn.PhaAdjFil1Coeff2 WhlImbRejctn.PhaAdjFil2Coeff1 WhlImbRejctn.PhaAdjFil2Coeff2 WhlImbRejctn.PrevFlt WhlImbRejctn.PrevHwTq WhlImbRejctn.PrevSts WhlImbRejctn.RampNo WhlImbRejctn.RampYes WhlImbRejctn.RiCurrMgnSlewPerLoop WhlImbRejctn.RiStDlyUpd WhlImbRejctn.RiStVariUpd WhlImbRejctn.ScaLe WhlImbRejctn.ScaRi WhlImbRejctn.SlowSpdDiagcLrngEnaPrevTmr WhlImbRejctn.SlowSpdDiagcRefTiEnaLrngTmr WhlImbRejctn.StordValLe WhlImbRejctn.StordValRi WhlImbRejctn.UgrLe1 WhlImbRejctn.UgrLe2 WhlImbRejctn.UgrRi1 WhlImbRejctn.UgrRi2 WhlImbRejctn.WhlSpdCorrFltFaild WhlImbRejctn.WhlSpdCorrFltRst WhlImbRejctn.WhlSpdCorrlnDiagcLrngEnaPrev WhlImbRejctn.WhlSpdCorrlnDiagcRefTiEnaLrng WhlImbRejctn.WhlSpdCorrlnFltRcvry WhlImbRejctn.WhlSpdCorrlnLrngEnaPrevTmr WhlImbRejctn.WhlSpdCorrlnRefTiEnaLrngTmr WhlImbRejctn.WhlSpdLeLpFil WhlImbRejctn.WhlSpdRiLpFil WhlImbRejctn.dWhlImbRejctnCnclTqOutp WhlImbRejctn.dWhlImbRejctnCurrMgnLe WhlImbRejctn.dWhlImbRejctnCurrMgnRi WhlImbRejctn.dWhlImbRejctnFildWhlSpdLe WhlImbRejctn.dWhlImbRejctnFildWhlSpdRi WhlImbRejctn.dWhlImbRejctnLMSqdOutLe WhlImbRejctn.dWhlImbRejctnLMSqdOutRi WhlImbRejctn.dWhlImbRejctnScaLe WhlImbRejctn.dWhlImbRejctnScaRi WhlImbRejctn.dWhlImbRejctnWhlSpdCorrPerc /end SUB_GROUP
 /begin FUNCTION_LIST /end FUNCTION_LIST
 /begin REF_CHARACTERISTIC /end REF_CHARACTERISTIC
 /begin REF_MEASUREMENT /end REF_MEASUREMENT
/end GROUP
/begin GROUP WhlImbRejctn.PhaAdjFil1Coeff1 "MICROSAR RTE" /begin SUB_GROUP /end SUB_GROUP /begin FUNCTION_LIST /end FUNCTION_LIST /begin REF_CHARACTERISTIC /end REF_CHARACTERISTIC /begin REF_MEASUREMENT WhlImbRejctn.PhaAdjFil1Coeff1 /end REF_MEASUREMENT /end GROUP
/begin GROUP WhlImbRejctn.PhaAdjFil1Coeff2 "MICROSAR RTE" /begin SUB_GROUP /end SUB_GROUP /begin FUNCTION_LIST /end FUNCTION_LIST /begin REF_CHARACTERISTIC /end REF_CHARACTERISTIC /begin REF_MEASUREMENT WhlImbRejctn.PhaAdjFil1Coeff2 /end REF_MEASUREMENT /end GROUP
/begin GROUP WhlImbRejctn.PhaAdjFil2Coeff1 "MICROSAR RTE" /begin SUB_GROUP /end SUB_GROUP /begin FUNCTION_LIST /end FUNCTION_LIST /begin REF_CHARACTERISTIC /end REF_CHARACTERISTIC /begin REF_MEASUREMENT WhlImbRejctn.PhaAdjFil2Coeff1 /end REF_MEASUREMENT /end GROUP
/begin GROUP WhlImbRejctn.PhaAdjFil2Coeff2 "MICROSAR RTE" /begin SUB_GROUP /end SUB_GROUP /begin FUNCTION_LIST /end FUNCTION_LIST /begin REF_CHARACTERISTIC /end REF_CHARACTERISTIC /begin REF_MEASUREMENT WhlImbRejctn.PhaAdjFil2Coeff2 /end REF_MEASUREMENT /end GROUP
/begin GROUP WhlImbRejctn.PrevFlt "MICROSAR RTE" /begin SUB_GROUP /end SUB_GROUP /begin FUNCTION_LIST /end FUNCTION_LIST /begin REF_CHARACTERISTIC /end REF_CHARACTERISTIC /begin REF_MEASUREMENT WhlImbRejctn.PrevFlt /end REF_MEASUREMENT /end GROUP
/begin GROUP WhlImbRejctn.PrevHwTq "MICROSAR RTE" /begin SUB_GROUP /end SUB_GROUP /begin FUNCTION_LIST /end FUNCTION_LIST /begin REF_CHARACTERISTIC /end REF_CHARACTERISTIC /begin REF_MEASUREMENT WhlImbRejctn.PrevHwTq /end REF_MEASUREMENT /end GROUP
/begin GROUP WhlImbRejctn.PrevSts "MICROSAR RTE" /begin SUB_GROUP /end SUB_GROUP /begin FUNCTION_LIST /end FUNCTION_LIST /begin REF_CHARACTERISTIC /end REF_CHARACTERISTIC /begin REF_MEASUREMENT WhlImbRejctn.PrevSts /end REF_MEASUREMENT /end GROUP
/begin GROUP WhlImbRejctn.RampNo "MICROSAR RTE" /begin SUB_GROUP /end SUB_GROUP /begin FUNCTION_LIST /end FUNCTION_LIST /begin REF_CHARACTERISTIC /end REF_CHARACTERISTIC /begin REF_MEASUREMENT WhlImbRejctn.RampNo /end REF_MEASUREMENT /end GROUP
/begin GROUP WhlImbRejctn.RampYes "MICROSAR RTE" /begin SUB_GROUP /end SUB_GROUP /begin FUNCTION_LIST /end FUNCTION_LIST /begin REF_CHARACTERISTIC /end REF_CHARACTERISTIC /begin REF_MEASUREMENT WhlImbRejctn.RampYes /end REF_MEASUREMENT /end GROUP
/begin GROUP WhlImbRejctn.ReceiverPorts "MICROSAR RTE"
 /begin SUB_GROUP WhlImbRejctn.HwTq.Val WhlImbRejctn.SysSt.Val WhlImbRejctn.VehSpd.Val WhlImbRejctn.VehSpdVld.Logl WhlImbRejctn.WhlFrqVld.Logl WhlImbRejctn.WhlImbRejctnCustEna.Logl WhlImbRejctn.WhlImbRejctnDi.Logl WhlImbRejctn.WhlLeFrq.Val WhlImbRejctn.WhlRiFrq.Val /end SUB_GROUP
 /begin FUNCTION_LIST /end FUNCTION_LIST
 /begin REF_CHARACTERISTIC /end REF_CHARACTERISTIC
 /begin REF_MEASUREMENT /end REF_MEASUREMENT
/end GROUP
/begin GROUP WhlImbRejctn.RiCurrMgnSlewPerLoop "MICROSAR RTE" /begin SUB_GROUP /end SUB_GROUP /begin FUNCTION_LIST /end FUNCTION_LIST /begin REF_CHARACTERISTIC /end REF_CHARACTERISTIC /begin REF_MEASUREMENT WhlImbRejctn.RiCurrMgnSlewPerLoop /end REF_MEASUREMENT /end GROUP
/begin GROUP WhlImbRejctn.RiPeakPrevDft "MICROSAR RTE" /begin SUB_GROUP /end SUB_GROUP /begin FUNCTION_LIST /end FUNCTION_LIST /begin REF_CHARACTERISTIC WhlImbRejctn.RiPeakPrevDft /end REF_CHARACTERISTIC /begin REF_MEASUREMENT /end REF_MEASUREMENT /end GROUP
/begin GROUP WhlImbRejctn.RiStDlyUpd "MICROSAR RTE" /begin SUB_GROUP /end SUB_GROUP /begin FUNCTION_LIST /end FUNCTION_LIST /begin REF_CHARACTERISTIC /end REF_CHARACTERISTIC /begin REF_MEASUREMENT WhlImbRejctn.RiStDlyUpd /end REF_MEASUREMENT /end GROUP
/begin GROUP WhlImbRejctn.RiStVariUpd "MICROSAR RTE" /begin SUB_GROUP /end SUB_GROUP /begin FUNCTION_LIST /end FUNCTION_LIST /begin REF_CHARACTERISTIC /end REF_CHARACTERISTIC /begin REF_MEASUREMENT WhlImbRejctn.RiStVariUpd /end REF_MEASUREMENT /end GROUP
/begin GROUP WhlImbRejctn.ScaLe "MICROSAR RTE" /begin SUB_GROUP /end SUB_GROUP /begin FUNCTION_LIST /end FUNCTION_LIST /begin REF_CHARACTERISTIC /end REF_CHARACTERISTIC /begin REF_MEASUREMENT WhlImbRejctn.ScaLe /end REF_MEASUREMENT /end GROUP
/begin GROUP WhlImbRejctn.ScaRi "MICROSAR RTE" /begin SUB_GROUP /end SUB_GROUP /begin FUNCTION_LIST /end FUNCTION_LIST /begin REF_CHARACTERISTIC /end REF_CHARACTERISTIC /begin REF_MEASUREMENT WhlImbRejctn.ScaRi /end REF_MEASUREMENT /end GROUP
/begin GROUP WhlImbRejctn.SenderPorts "MICROSAR RTE"
 /begin SUB_GROUP WhlImbRejctn.WhlImbRejctnActv.Logl WhlImbRejctn.WhlImbRejctnAmp.Val WhlImbRejctn.WhlImbRejctnCmd.Val /end SUB_GROUP
 /begin FUNCTION_LIST /end FUNCTION_LIST
 /begin REF_CHARACTERISTIC /end REF_CHARACTERISTIC
 /begin REF_MEASUREMENT /end REF_MEASUREMENT
/end GROUP
/begin GROUP WhlImbRejctn.SlowSpdDiagcLrngEnaPrevTmr "MICROSAR RTE" /begin SUB_GROUP /end SUB_GROUP /begin FUNCTION_LIST /end FUNCTION_LIST /begin REF_CHARACTERISTIC /end REF_CHARACTERISTIC /begin REF_MEASUREMENT WhlImbRejctn.SlowSpdDiagcLrngEnaPrevTmr /end REF_MEASUREMENT /end GROUP
/begin GROUP WhlImbRejctn.SlowSpdDiagcRefTiEnaLrngTmr "MICROSAR RTE" /begin SUB_GROUP /end SUB_GROUP /begin FUNCTION_LIST /end FUNCTION_LIST /begin REF_CHARACTERISTIC /end REF_CHARACTERISTIC /begin REF_MEASUREMENT WhlImbRejctn.SlowSpdDiagcRefTiEnaLrngTmr /end REF_MEASUREMENT /end GROUP
/begin GROUP WhlImbRejctn.StordValLe "MICROSAR RTE" /begin SUB_GROUP /end SUB_GROUP /begin FUNCTION_LIST /end FUNCTION_LIST /begin REF_CHARACTERISTIC /end REF_CHARACTERISTIC /begin REF_MEASUREMENT WhlImbRejctn.StordValLe /end REF_MEASUREMENT /end GROUP
/begin GROUP WhlImbRejctn.StordValRi "MICROSAR RTE" /begin SUB_GROUP /end SUB_GROUP /begin FUNCTION_LIST /end FUNCTION_LIST /begin REF_CHARACTERISTIC /end REF_CHARACTERISTIC /begin REF_MEASUREMENT WhlImbRejctn.StordValRi /end REF_MEASUREMENT /end GROUP
/begin GROUP WhlImbRejctn.SysSt.Val "MICROSAR RTE" /begin SUB_GROUP /end SUB_GROUP /begin FUNCTION_LIST /end FUNCTION_LIST /begin REF_CHARACTERISTIC /end REF_CHARACTERISTIC /begin REF_MEASUREMENT WhlImbRejctn.SysSt.Val /end REF_MEASUREMENT /end GROUP
/begin GROUP WhlImbRejctn.UgrLe1 "MICROSAR RTE" /begin SUB_GROUP /end SUB_GROUP /begin FUNCTION_LIST /end FUNCTION_LIST /begin REF_CHARACTERISTIC /end REF_CHARACTERISTIC /begin REF_MEASUREMENT WhlImbRejctn.UgrLe1 /end REF_MEASUREMENT /end GROUP
/begin GROUP WhlImbRejctn.UgrLe2 "MICROSAR RTE" /begin SUB_GROUP /end SUB_GROUP /begin FUNCTION_LIST /end FUNCTION_LIST /begin REF_CHARACTERISTIC /end REF_CHARACTERISTIC /begin REF_MEASUREMENT WhlImbRejctn.UgrLe2 /end REF_MEASUREMENT /end GROUP
/begin GROUP WhlImbRejctn.UgrRi1 "MICROSAR RTE" /begin SUB_GROUP /end SUB_GROUP /begin FUNCTION_LIST /end FUNCTION_LIST /begin REF_CHARACTERISTIC /end REF_CHARACTERISTIC /begin REF_MEASUREMENT WhlImbRejctn.UgrRi1 /end REF_MEASUREMENT /end GROUP
/begin GROUP WhlImbRejctn.UgrRi2 "MICROSAR RTE" /begin SUB_GROUP /end SUB_GROUP /begin FUNCTION_LIST /end FUNCTION_LIST /begin REF_CHARACTERISTIC /end REF_CHARACTERISTIC /begin REF_MEASUREMENT WhlImbRejctn.UgrRi2 /end REF_MEASUREMENT /end GROUP
/begin GROUP WhlImbRejctn.VehSpd.Val "MICROSAR RTE" /begin SUB_GROUP /end SUB_GROUP /begin FUNCTION_LIST /end FUNCTION_LIST /begin REF_CHARACTERISTIC /end REF_CHARACTERISTIC /begin REF_MEASUREMENT WhlImbRejctn.VehSpd.Val /end REF_MEASUREMENT /end GROUP
/begin GROUP WhlImbRejctn.VehSpdVld.Logl "MICROSAR RTE" /begin SUB_GROUP /end SUB_GROUP /begin FUNCTION_LIST /end FUNCTION_LIST /begin REF_CHARACTERISTIC /end REF_CHARACTERISTIC /begin REF_MEASUREMENT WhlImbRejctn.VehSpdVld.Logl /end REF_MEASUREMENT /end GROUP
/begin GROUP WhlImbRejctn.WhlFrqVld.Logl "MICROSAR RTE" /begin SUB_GROUP /end SUB_GROUP /begin FUNCTION_LIST /end FUNCTION_LIST /begin REF_CHARACTERISTIC /end REF_CHARACTERISTIC /begin REF_MEASUREMENT WhlImbRejctn.WhlFrqVld.Logl /end REF_MEASUREMENT /end GROUP
/begin GROUP WhlImbRejctn.WhlImbRejctnActv.Logl "MICROSAR RTE" /begin SUB_GROUP /end SUB_GROUP /begin FUNCTION_LIST /end FUNCTION_LIST /begin REF_CHARACTERISTIC /end REF_CHARACTERISTIC /begin REF_MEASUREMENT WhlImbRejctn.WhlImbRejctnActv.Logl /end REF_MEASUREMENT /end GROUP
/begin GROUP WhlImbRejctn.WhlImbRejctnAdpvFac.Val "MICROSAR RTE" /begin SUB_GROUP /end SUB_GROUP /begin FUNCTION_LIST /end FUNCTION_LIST /begin REF_CHARACTERISTIC WhlImbRejctn.WhlImbRejctnAdpvFac.Val /end REF_CHARACTERISTIC /begin REF_MEASUREMENT /end REF_MEASUREMENT /end GROUP
/begin GROUP WhlImbRejctn.WhlImbRejctnAmp.Val "MICROSAR RTE" /begin SUB_GROUP /end SUB_GROUP /begin FUNCTION_LIST /end FUNCTION_LIST /begin REF_CHARACTERISTIC /end REF_CHARACTERISTIC /begin REF_MEASUREMENT WhlImbRejctn.WhlImbRejctnAmp.Val /end REF_MEASUREMENT /end GROUP
/begin GROUP WhlImbRejctn.WhlImbRejctnAutScaEna.Logl "MICROSAR RTE" /begin SUB_GROUP /end SUB_GROUP /begin FUNCTION_LIST /end FUNCTION_LIST /begin REF_CHARACTERISTIC WhlImbRejctn.WhlImbRejctnAutScaEna.Logl /end REF_CHARACTERISTIC /begin REF_MEASUREMENT /end REF_MEASUREMENT /end GROUP
/begin GROUP WhlImbRejctn.WhlImbRejctnAutScaTar.Val "MICROSAR RTE" /begin SUB_GROUP /end SUB_GROUP /begin FUNCTION_LIST /end FUNCTION_LIST /begin REF_CHARACTERISTIC WhlImbRejctn.WhlImbRejctnAutScaTar.Val /end REF_CHARACTERISTIC /begin REF_MEASUREMENT /end REF_MEASUREMENT /end GROUP
/begin GROUP WhlImbRejctn.WhlImbRejctnBlndCmdMgnLp1FilFrq.Val "MICROSAR RTE" /begin SUB_GROUP /end SUB_GROUP /begin FUNCTION_LIST /end FUNCTION_LIST /begin REF_CHARACTERISTIC WhlImbRejctn.WhlImbRejctnBlndCmdMgnLp1FilFrq.Val /end REF_CHARACTERISTIC /begin REF_MEASUREMENT /end REF_MEASUREMENT /end GROUP
/begin GROUP WhlImbRejctn.WhlImbRejctnBlndCmdMgnLp2FilFrq.Val "MICROSAR RTE" /begin SUB_GROUP /end SUB_GROUP /begin FUNCTION_LIST /end FUNCTION_LIST /begin REF_CHARACTERISTIC WhlImbRejctn.WhlImbRejctnBlndCmdMgnLp2FilFrq.Val /end REF_CHARACTERISTIC /begin REF_MEASUREMENT /end REF_MEASUREMENT /end GROUP
/begin GROUP WhlImbRejctn.WhlImbRejctnCmd.Val "MICROSAR RTE" /begin SUB_GROUP /end SUB_GROUP /begin FUNCTION_LIST /end FUNCTION_LIST /begin REF_CHARACTERISTIC /end REF_CHARACTERISTIC /begin REF_MEASUREMENT WhlImbRejctn.WhlImbRejctnCmd.Val /end REF_MEASUREMENT /end GROUP
/begin GROUP WhlImbRejctn.WhlImbRejctnCmdMgnLp1FilFrq.Val "MICROSAR RTE" /begin SUB_GROUP /end SUB_GROUP /begin FUNCTION_LIST /end FUNCTION_LIST /begin REF_CHARACTERISTIC WhlImbRejctn.WhlImbRejctnCmdMgnLp1FilFrq.Val /end REF_CHARACTERISTIC /begin REF_MEASUREMENT /end REF_MEASUREMENT /end GROUP
/begin GROUP WhlImbRejctn.WhlImbRejctnCmdMgnLp2FilFrq.Val "MICROSAR RTE" /begin SUB_GROUP /end SUB_GROUP /begin FUNCTION_LIST /end FUNCTION_LIST /begin REF_CHARACTERISTIC WhlImbRejctn.WhlImbRejctnCmdMgnLp2FilFrq.Val /end REF_CHARACTERISTIC /begin REF_MEASUREMENT /end REF_MEASUREMENT /end GROUP
/begin GROUP WhlImbRejctn.WhlImbRejctnCurrMgnSlewPerLoop.Val "MICROSAR RTE" /begin SUB_GROUP /end SUB_GROUP /begin FUNCTION_LIST /end FUNCTION_LIST /begin REF_CHARACTERISTIC WhlImbRejctn.WhlImbRejctnCurrMgnSlewPerLoop.Val /end REF_CHARACTERISTIC /begin REF_MEASUREMENT /end REF_MEASUREMENT /end GROUP
/begin GROUP WhlImbRejctn.WhlImbRejctnCustEna.Logl "MICROSAR RTE" /begin SUB_GROUP /end SUB_GROUP /begin FUNCTION_LIST /end FUNCTION_LIST /begin REF_CHARACTERISTIC /end REF_CHARACTERISTIC /begin REF_MEASUREMENT WhlImbRejctn.WhlImbRejctnCustEna.Logl /end REF_MEASUREMENT /end GROUP
/begin GROUP WhlImbRejctn.WhlImbRejctnDcTrendFltRcvryDly.Val "MICROSAR RTE" /begin SUB_GROUP /end SUB_GROUP /begin FUNCTION_LIST /end FUNCTION_LIST /begin REF_CHARACTERISTIC WhlImbRejctn.WhlImbRejctnDcTrendFltRcvryDly.Val /end REF_CHARACTERISTIC /begin REF_MEASUREMENT /end REF_MEASUREMENT /end GROUP
/begin GROUP WhlImbRejctn.WhlImbRejctnDcTrendFltRcvryNegStep.Val "MICROSAR RTE" /begin SUB_GROUP /end SUB_GROUP /begin FUNCTION_LIST /end FUNCTION_LIST /begin REF_CHARACTERISTIC WhlImbRejctn.WhlImbRejctnDcTrendFltRcvryNegStep.Val /end REF_CHARACTERISTIC /begin REF_MEASUREMENT /end REF_MEASUREMENT /end GROUP
/begin GROUP WhlImbRejctn.WhlImbRejctnDcTrendFltRcvryPosStep.Val "MICROSAR RTE" /begin SUB_GROUP /end SUB_GROUP /begin FUNCTION_LIST /end FUNCTION_LIST /begin REF_CHARACTERISTIC WhlImbRejctn.WhlImbRejctnDcTrendFltRcvryPosStep.Val /end REF_CHARACTERISTIC /begin REF_MEASUREMENT /end REF_MEASUREMENT /end GROUP
/begin GROUP WhlImbRejctn.WhlImbRejctnDcTrendFltRcvryThd.Val "MICROSAR RTE" /begin SUB_GROUP /end SUB_GROUP /begin FUNCTION_LIST /end FUNCTION_LIST /begin REF_CHARACTERISTIC WhlImbRejctn.WhlImbRejctnDcTrendFltRcvryThd.Val /end REF_CHARACTERISTIC /begin REF_MEASUREMENT /end REF_MEASUREMENT /end GROUP
/begin GROUP WhlImbRejctn.WhlImbRejctnDcTrendLpFil.Val "MICROSAR RTE" /begin SUB_GROUP /end SUB_GROUP /begin FUNCTION_LIST /end FUNCTION_LIST /begin REF_CHARACTERISTIC WhlImbRejctn.WhlImbRejctnDcTrendLpFil.Val /end REF_CHARACTERISTIC /begin REF_MEASUREMENT /end REF_MEASUREMENT /end GROUP
/begin GROUP WhlImbRejctn.WhlImbRejctnDcTrendTh2Tq.Val "MICROSAR RTE" /begin SUB_GROUP /end SUB_GROUP /begin FUNCTION_LIST /end FUNCTION_LIST /begin REF_CHARACTERISTIC WhlImbRejctn.WhlImbRejctnDcTrendTh2Tq.Val /end REF_CHARACTERISTIC /begin REF_MEASUREMENT /end REF_MEASUREMENT /end GROUP
/begin GROUP WhlImbRejctn.WhlImbRejctnDcTrendThTq.Val "MICROSAR RTE" /begin SUB_GROUP /end SUB_GROUP /begin FUNCTION_LIST /end FUNCTION_LIST /begin REF_CHARACTERISTIC WhlImbRejctn.WhlImbRejctnDcTrendThTq.Val /end REF_CHARACTERISTIC /begin REF_MEASUREMENT /end REF_MEASUREMENT /end GROUP
/begin GROUP WhlImbRejctn.WhlImbRejctnDcTrendTi2Sec.Val "MICROSAR RTE" /begin SUB_GROUP /end SUB_GROUP /begin FUNCTION_LIST /end FUNCTION_LIST /begin REF_CHARACTERISTIC WhlImbRejctn.WhlImbRejctnDcTrendTi2Sec.Val /end REF_CHARACTERISTIC /begin REF_MEASUREMENT /end REF_MEASUREMENT /end GROUP
/begin GROUP WhlImbRejctn.WhlImbRejctnDcTrendTiSec.Val "MICROSAR RTE" /begin SUB_GROUP /end SUB_GROUP /begin FUNCTION_LIST /end FUNCTION_LIST /begin REF_CHARACTERISTIC WhlImbRejctn.WhlImbRejctnDcTrendTiSec.Val /end REF_CHARACTERISTIC /begin REF_MEASUREMENT /end REF_MEASUREMENT /end GROUP
/begin GROUP WhlImbRejctn.WhlImbRejctnDi.Logl "MICROSAR RTE" /begin SUB_GROUP /end SUB_GROUP /begin FUNCTION_LIST /end FUNCTION_LIST /begin REF_CHARACTERISTIC /end REF_CHARACTERISTIC /begin REF_MEASUREMENT WhlImbRejctn.WhlImbRejctnDi.Logl /end REF_MEASUREMENT /end GROUP
/begin GROUP WhlImbRejctn.WhlImbRejctnDistbnMgnLpFil.Val "MICROSAR RTE" /begin SUB_GROUP /end SUB_GROUP /begin FUNCTION_LIST /end FUNCTION_LIST /begin REF_CHARACTERISTIC WhlImbRejctn.WhlImbRejctnDistbnMgnLpFil.Val /end REF_CHARACTERISTIC /begin REF_MEASUREMENT /end REF_MEASUREMENT /end GROUP
/begin GROUP WhlImbRejctn.WhlImbRejctnEnaSlewPerLoop.Val "MICROSAR RTE" /begin SUB_GROUP /end SUB_GROUP /begin FUNCTION_LIST /end FUNCTION_LIST /begin REF_CHARACTERISTIC WhlImbRejctn.WhlImbRejctnEnaSlewPerLoop.Val /end REF_CHARACTERISTIC /begin REF_MEASUREMENT /end REF_MEASUREMENT /end GROUP
/begin GROUP WhlImbRejctn.WhlImbRejctnFctEna.Logl "MICROSAR RTE" /begin SUB_GROUP /end SUB_GROUP /begin FUNCTION_LIST /end FUNCTION_LIST /begin REF_CHARACTERISTIC WhlImbRejctn.WhlImbRejctnFctEna.Logl /end REF_CHARACTERISTIC /begin REF_MEASUREMENT /end REF_MEASUREMENT /end GROUP
/begin GROUP WhlImbRejctn.WhlImbRejctnFrqDiagcAmpThd.Val "MICROSAR RTE" /begin SUB_GROUP /end SUB_GROUP /begin FUNCTION_LIST /end FUNCTION_LIST /begin REF_CHARACTERISTIC WhlImbRejctn.WhlImbRejctnFrqDiagcAmpThd.Val /end REF_CHARACTERISTIC /begin REF_MEASUREMENT /end REF_MEASUREMENT /end GROUP
/begin GROUP WhlImbRejctn.WhlImbRejctnFrqDiagcEna.Logl "MICROSAR RTE" /begin SUB_GROUP /end SUB_GROUP /begin FUNCTION_LIST /end FUNCTION_LIST /begin REF_CHARACTERISTIC WhlImbRejctn.WhlImbRejctnFrqDiagcEna.Logl /end REF_CHARACTERISTIC /begin REF_MEASUREMENT /end REF_MEASUREMENT /end GROUP
/begin GROUP WhlImbRejctn.WhlImbRejctnFrqDiagcFltRcvryDly.Val "MICROSAR RTE" /begin SUB_GROUP /end SUB_GROUP /begin FUNCTION_LIST /end FUNCTION_LIST /begin REF_CHARACTERISTIC WhlImbRejctn.WhlImbRejctnFrqDiagcFltRcvryDly.Val /end REF_CHARACTERISTIC /begin REF_MEASUREMENT /end REF_MEASUREMENT /end GROUP
/begin GROUP WhlImbRejctn.WhlImbRejctnFrqDiagcFltRcvryNegStep.Val "MICROSAR RTE" /begin SUB_GROUP /end SUB_GROUP /begin FUNCTION_LIST /end FUNCTION_LIST /begin REF_CHARACTERISTIC WhlImbRejctn.WhlImbRejctnFrqDiagcFltRcvryNegStep.Val /end REF_CHARACTERISTIC /begin REF_MEASUREMENT /end REF_MEASUREMENT /end GROUP
/begin GROUP WhlImbRejctn.WhlImbRejctnFrqDiagcFltRcvryPosStep.Val "MICROSAR RTE" /begin SUB_GROUP /end SUB_GROUP /begin FUNCTION_LIST /end FUNCTION_LIST /begin REF_CHARACTERISTIC WhlImbRejctn.WhlImbRejctnFrqDiagcFltRcvryPosStep.Val /end REF_CHARACTERISTIC /begin REF_MEASUREMENT /end REF_MEASUREMENT /end GROUP
/begin GROUP WhlImbRejctn.WhlImbRejctnFrqDiagcFltRcvryThd.Val "MICROSAR RTE" /begin SUB_GROUP /end SUB_GROUP /begin FUNCTION_LIST /end FUNCTION_LIST /begin REF_CHARACTERISTIC WhlImbRejctn.WhlImbRejctnFrqDiagcFltRcvryThd.Val /end REF_CHARACTERISTIC /begin REF_MEASUREMENT /end REF_MEASUREMENT /end GROUP
/begin GROUP WhlImbRejctn.WhlImbRejctnFrqDiagcLpFil.Val "MICROSAR RTE" /begin SUB_GROUP /end SUB_GROUP /begin FUNCTION_LIST /end FUNCTION_LIST /begin REF_CHARACTERISTIC WhlImbRejctn.WhlImbRejctnFrqDiagcLpFil.Val /end REF_CHARACTERISTIC /begin REF_MEASUREMENT /end REF_MEASUREMENT /end GROUP
/begin GROUP WhlImbRejctn.WhlImbRejctnFrqDiagcThd.Val "MICROSAR RTE" /begin SUB_GROUP /end SUB_GROUP /begin FUNCTION_LIST /end FUNCTION_LIST /begin REF_CHARACTERISTIC WhlImbRejctn.WhlImbRejctnFrqDiagcThd.Val /end REF_CHARACTERISTIC /begin REF_MEASUREMENT /end REF_MEASUREMENT /end GROUP
/begin GROUP WhlImbRejctn.WhlImbRejctnFrqDiagcTout.Val "MICROSAR RTE" /begin SUB_GROUP /end SUB_GROUP /begin FUNCTION_LIST /end FUNCTION_LIST /begin REF_CHARACTERISTIC WhlImbRejctn.WhlImbRejctnFrqDiagcTout.Val /end REF_CHARACTERISTIC /begin REF_MEASUREMENT /end REF_MEASUREMENT /end GROUP
/begin GROUP WhlImbRejctn.WhlImbRejctnFrqDiagcUgrPoleMgn.Val "MICROSAR RTE" /begin SUB_GROUP /end SUB_GROUP /begin FUNCTION_LIST /end FUNCTION_LIST /begin REF_CHARACTERISTIC WhlImbRejctn.WhlImbRejctnFrqDiagcUgrPoleMgn.Val /end REF_CHARACTERISTIC /begin REF_MEASUREMENT /end REF_MEASUREMENT /end GROUP
/begin GROUP WhlImbRejctn.WhlImbRejctnFrqScaTblX.Ary1D "MICROSAR RTE" /begin SUB_GROUP /end SUB_GROUP /begin FUNCTION_LIST /end FUNCTION_LIST /begin REF_CHARACTERISTIC WhlImbRejctn.WhlImbRejctnFrqScaTblX.Ary1D /end REF_CHARACTERISTIC /begin REF_MEASUREMENT /end REF_MEASUREMENT /end GROUP
/begin GROUP WhlImbRejctn.WhlImbRejctnFrqScaTblY.Ary1D "MICROSAR RTE" /begin SUB_GROUP /end SUB_GROUP /begin FUNCTION_LIST /end FUNCTION_LIST /begin REF_CHARACTERISTIC WhlImbRejctn.WhlImbRejctnFrqScaTblY.Ary1D /end REF_CHARACTERISTIC /begin REF_MEASUREMENT /end REF_MEASUREMENT /end GROUP
/begin GROUP WhlImbRejctn.WhlImbRejctnMaxDurn.Val "MICROSAR RTE" /begin SUB_GROUP /end SUB_GROUP /begin FUNCTION_LIST /end FUNCTION_LIST /begin REF_CHARACTERISTIC WhlImbRejctn.WhlImbRejctnMaxDurn.Val /end REF_CHARACTERISTIC /begin REF_MEASUREMENT /end REF_MEASUREMENT /end GROUP
/begin GROUP WhlImbRejctn.WhlImbRejctnMaxMgn.Val "MICROSAR RTE" /begin SUB_GROUP /end SUB_GROUP /begin FUNCTION_LIST /end FUNCTION_LIST /begin REF_CHARACTERISTIC WhlImbRejctn.WhlImbRejctnMaxMgn.Val /end REF_CHARACTERISTIC /begin REF_MEASUREMENT /end REF_MEASUREMENT /end GROUP
/begin GROUP WhlImbRejctn.WhlImbRejctnMaxMgnFltNegStep.Val "MICROSAR RTE" /begin SUB_GROUP /end SUB_GROUP /begin FUNCTION_LIST /end FUNCTION_LIST /begin REF_CHARACTERISTIC WhlImbRejctn.WhlImbRejctnMaxMgnFltNegStep.Val /end REF_CHARACTERISTIC /begin REF_MEASUREMENT /end REF_MEASUREMENT /end GROUP
/begin GROUP WhlImbRejctn.WhlImbRejctnMaxMgnFltPosStep.Val "MICROSAR RTE" /begin SUB_GROUP /end SUB_GROUP /begin FUNCTION_LIST /end FUNCTION_LIST /begin REF_CHARACTERISTIC WhlImbRejctn.WhlImbRejctnMaxMgnFltPosStep.Val /end REF_CHARACTERISTIC /begin REF_MEASUREMENT /end REF_MEASUREMENT /end GROUP
/begin GROUP WhlImbRejctn.WhlImbRejctnMaxMgnFltRcvryDly.Val "MICROSAR RTE" /begin SUB_GROUP /end SUB_GROUP /begin FUNCTION_LIST /end FUNCTION_LIST /begin REF_CHARACTERISTIC WhlImbRejctn.WhlImbRejctnMaxMgnFltRcvryDly.Val /end REF_CHARACTERISTIC /begin REF_MEASUREMENT /end REF_MEASUREMENT /end GROUP
/begin GROUP WhlImbRejctn.WhlImbRejctnMaxMgnFltRcvryNegStep.Val "MICROSAR RTE" /begin SUB_GROUP /end SUB_GROUP /begin FUNCTION_LIST /end FUNCTION_LIST /begin REF_CHARACTERISTIC WhlImbRejctn.WhlImbRejctnMaxMgnFltRcvryNegStep.Val /end REF_CHARACTERISTIC /begin REF_MEASUREMENT /end REF_MEASUREMENT /end GROUP
/begin GROUP WhlImbRejctn.WhlImbRejctnMaxMgnFltRcvryPosStep.Val "MICROSAR RTE" /begin SUB_GROUP /end SUB_GROUP /begin FUNCTION_LIST /end FUNCTION_LIST /begin REF_CHARACTERISTIC WhlImbRejctn.WhlImbRejctnMaxMgnFltRcvryPosStep.Val /end REF_CHARACTERISTIC /begin REF_MEASUREMENT /end REF_MEASUREMENT /end GROUP
/begin GROUP WhlImbRejctn.WhlImbRejctnMaxMgnFltRcvryThd.Val "MICROSAR RTE" /begin SUB_GROUP /end SUB_GROUP /begin FUNCTION_LIST /end FUNCTION_LIST /begin REF_CHARACTERISTIC WhlImbRejctn.WhlImbRejctnMaxMgnFltRcvryThd.Val /end REF_CHARACTERISTIC /begin REF_MEASUREMENT /end REF_MEASUREMENT /end GROUP
/begin GROUP WhlImbRejctn.WhlImbRejctnMaxMgnFltThd.Val "MICROSAR RTE" /begin SUB_GROUP /end SUB_GROUP /begin FUNCTION_LIST /end FUNCTION_LIST /begin REF_CHARACTERISTIC WhlImbRejctn.WhlImbRejctnMaxMgnFltThd.Val /end REF_CHARACTERISTIC /begin REF_MEASUREMENT /end REF_MEASUREMENT /end GROUP
/begin GROUP WhlImbRejctn.WhlImbRejctnMgnEstimnDeltaSca.Val "MICROSAR RTE" /begin SUB_GROUP /end SUB_GROUP /begin FUNCTION_LIST /end FUNCTION_LIST /begin REF_CHARACTERISTIC WhlImbRejctn.WhlImbRejctnMgnEstimnDeltaSca.Val /end REF_CHARACTERISTIC /begin REF_MEASUREMENT /end REF_MEASUREMENT /end GROUP
/begin GROUP WhlImbRejctn.WhlImbRejctnMgnEstimnDiThd.Val "MICROSAR RTE" /begin SUB_GROUP /end SUB_GROUP /begin FUNCTION_LIST /end FUNCTION_LIST /begin REF_CHARACTERISTIC WhlImbRejctn.WhlImbRejctnMgnEstimnDiThd.Val /end REF_CHARACTERISTIC /begin REF_MEASUREMENT /end REF_MEASUREMENT /end GROUP
/begin GROUP WhlImbRejctn.WhlImbRejctnMgnEstimnEnaThd.Val "MICROSAR RTE" /begin SUB_GROUP /end SUB_GROUP /begin FUNCTION_LIST /end FUNCTION_LIST /begin REF_CHARACTERISTIC WhlImbRejctn.WhlImbRejctnMgnEstimnEnaThd.Val /end REF_CHARACTERISTIC /begin REF_MEASUREMENT /end REF_MEASUREMENT /end GROUP
/begin GROUP WhlImbRejctn.WhlImbRejctnMgnEstimnFrq.Val "MICROSAR RTE" /begin SUB_GROUP /end SUB_GROUP /begin FUNCTION_LIST /end FUNCTION_LIST /begin REF_CHARACTERISTIC WhlImbRejctn.WhlImbRejctnMgnEstimnFrq.Val /end REF_CHARACTERISTIC /begin REF_MEASUREMENT /end REF_MEASUREMENT /end GROUP
/begin GROUP WhlImbRejctn.WhlImbRejctnMgnEstimnFrqDelta.Val "MICROSAR RTE" /begin SUB_GROUP /end SUB_GROUP /begin FUNCTION_LIST /end FUNCTION_LIST /begin REF_CHARACTERISTIC WhlImbRejctn.WhlImbRejctnMgnEstimnFrqDelta.Val /end REF_CHARACTERISTIC /begin REF_MEASUREMENT /end REF_MEASUREMENT /end GROUP
/begin GROUP WhlImbRejctn.WhlImbRejctnMgnEstimnLeak.Val "MICROSAR RTE" /begin SUB_GROUP /end SUB_GROUP /begin FUNCTION_LIST /end FUNCTION_LIST /begin REF_CHARACTERISTIC WhlImbRejctn.WhlImbRejctnMgnEstimnLeak.Val /end REF_CHARACTERISTIC /begin REF_MEASUREMENT /end REF_MEASUREMENT /end GROUP
/begin GROUP WhlImbRejctn.WhlImbRejctnPhaAdjX.Ary1D "MICROSAR RTE" /begin SUB_GROUP /end SUB_GROUP /begin FUNCTION_LIST /end FUNCTION_LIST /begin REF_CHARACTERISTIC WhlImbRejctn.WhlImbRejctnPhaAdjX.Ary1D /end REF_CHARACTERISTIC /begin REF_MEASUREMENT /end REF_MEASUREMENT /end GROUP
/begin GROUP WhlImbRejctn.WhlImbRejctnPhaAdjY.Ary1D "MICROSAR RTE" /begin SUB_GROUP /end SUB_GROUP /begin FUNCTION_LIST /end FUNCTION_LIST /begin REF_CHARACTERISTIC WhlImbRejctn.WhlImbRejctnPhaAdjY.Ary1D /end REF_CHARACTERISTIC /begin REF_MEASUREMENT /end REF_MEASUREMENT /end GROUP
/begin GROUP WhlImbRejctn.WhlImbRejctnRampDwnTi.Val "MICROSAR RTE" /begin SUB_GROUP /end SUB_GROUP /begin FUNCTION_LIST /end FUNCTION_LIST /begin REF_CHARACTERISTIC WhlImbRejctn.WhlImbRejctnRampDwnTi.Val /end REF_CHARACTERISTIC /begin REF_MEASUREMENT /end REF_MEASUREMENT /end GROUP
/begin GROUP WhlImbRejctn.WhlImbRejctnScaCncl.Val "MICROSAR RTE" /begin SUB_GROUP /end SUB_GROUP /begin FUNCTION_LIST /end FUNCTION_LIST /begin REF_CHARACTERISTIC WhlImbRejctn.WhlImbRejctnScaCncl.Val /end REF_CHARACTERISTIC /begin REF_MEASUREMENT /end REF_MEASUREMENT /end GROUP
/begin GROUP WhlImbRejctn.WhlImbRejctnUgrPoleMgn.Val "MICROSAR RTE" /begin SUB_GROUP /end SUB_GROUP /begin FUNCTION_LIST /end FUNCTION_LIST /begin REF_CHARACTERISTIC WhlImbRejctn.WhlImbRejctnUgrPoleMgn.Val /end REF_CHARACTERISTIC /begin REF_MEASUREMENT /end REF_MEASUREMENT /end GROUP
/begin GROUP WhlImbRejctn.WhlImbRejctnVehSpdEna.Val "MICROSAR RTE" /begin SUB_GROUP /end SUB_GROUP /begin FUNCTION_LIST /end FUNCTION_LIST /begin REF_CHARACTERISTIC WhlImbRejctn.WhlImbRejctnVehSpdEna.Val /end REF_CHARACTERISTIC /begin REF_MEASUREMENT /end REF_MEASUREMENT /end GROUP
/begin GROUP WhlImbRejctn.WhlImbRejctnWhlSpdCorrlnFltRcvryDly.Val "MICROSAR RTE" /begin SUB_GROUP /end SUB_GROUP /begin FUNCTION_LIST /end FUNCTION_LIST /begin REF_CHARACTERISTIC WhlImbRejctn.WhlImbRejctnWhlSpdCorrlnFltRcvryDly.Val /end REF_CHARACTERISTIC /begin REF_MEASUREMENT /end REF_MEASUREMENT /end GROUP
/begin GROUP WhlImbRejctn.WhlImbRejctnWhlSpdCorrlnFltRcvryNegStep.Val "MICROSAR RTE" /begin SUB_GROUP /end SUB_GROUP /begin FUNCTION_LIST /end FUNCTION_LIST /begin REF_CHARACTERISTIC WhlImbRejctn.WhlImbRejctnWhlSpdCorrlnFltRcvryNegStep.Val /end REF_CHARACTERISTIC /begin REF_MEASUREMENT /end REF_MEASUREMENT /end GROUP
/begin GROUP WhlImbRejctn.WhlImbRejctnWhlSpdCorrlnFltRcvryPosStep.Val "MICROSAR RTE" /begin SUB_GROUP /end SUB_GROUP /begin FUNCTION_LIST /end FUNCTION_LIST /begin REF_CHARACTERISTIC WhlImbRejctn.WhlImbRejctnWhlSpdCorrlnFltRcvryPosStep.Val /end REF_CHARACTERISTIC /begin REF_MEASUREMENT /end REF_MEASUREMENT /end GROUP
/begin GROUP WhlImbRejctn.WhlImbRejctnWhlSpdCorrlnFltRcvryThd.Val "MICROSAR RTE" /begin SUB_GROUP /end SUB_GROUP /begin FUNCTION_LIST /end FUNCTION_LIST /begin REF_CHARACTERISTIC WhlImbRejctn.WhlImbRejctnWhlSpdCorrlnFltRcvryThd.Val /end REF_CHARACTERISTIC /begin REF_MEASUREMENT /end REF_MEASUREMENT /end GROUP
/begin GROUP WhlImbRejctn.WhlImbRejctnWhlSpdCorrlnThd.Val "MICROSAR RTE" /begin SUB_GROUP /end SUB_GROUP /begin FUNCTION_LIST /end FUNCTION_LIST /begin REF_CHARACTERISTIC WhlImbRejctn.WhlImbRejctnWhlSpdCorrlnThd.Val /end REF_CHARACTERISTIC /begin REF_MEASUREMENT /end REF_MEASUREMENT /end GROUP
/begin GROUP WhlImbRejctn.WhlImbRejctnWhlSpdCorrlnTi.Val "MICROSAR RTE" /begin SUB_GROUP /end SUB_GROUP /begin FUNCTION_LIST /end FUNCTION_LIST /begin REF_CHARACTERISTIC WhlImbRejctn.WhlImbRejctnWhlSpdCorrlnTi.Val /end REF_CHARACTERISTIC /begin REF_MEASUREMENT /end REF_MEASUREMENT /end GROUP
/begin GROUP WhlImbRejctn.WhlImbRejctnWhlSpdLpFil.Val "MICROSAR RTE" /begin SUB_GROUP /end SUB_GROUP /begin FUNCTION_LIST /end FUNCTION_LIST /begin REF_CHARACTERISTIC WhlImbRejctn.WhlImbRejctnWhlSpdLpFil.Val /end REF_CHARACTERISTIC /begin REF_MEASUREMENT /end REF_MEASUREMENT /end GROUP
/begin GROUP WhlImbRejctn.WhlLeFrq.Val "MICROSAR RTE" /begin SUB_GROUP /end SUB_GROUP /begin FUNCTION_LIST /end FUNCTION_LIST /begin REF_CHARACTERISTIC /end REF_CHARACTERISTIC /begin REF_MEASUREMENT WhlImbRejctn.WhlLeFrq.Val /end REF_MEASUREMENT /end GROUP
/begin GROUP WhlImbRejctn.WhlRiFrq.Val "MICROSAR RTE" /begin SUB_GROUP /end SUB_GROUP /begin FUNCTION_LIST /end FUNCTION_LIST /begin REF_CHARACTERISTIC /end REF_CHARACTERISTIC /begin REF_MEASUREMENT WhlImbRejctn.WhlRiFrq.Val /end REF_MEASUREMENT /end GROUP
/begin GROUP WhlImbRejctn.WhlSpdCorrFltFaild "MICROSAR RTE" /begin SUB_GROUP /end SUB_GROUP /begin FUNCTION_LIST /end FUNCTION_LIST /begin REF_CHARACTERISTIC /end REF_CHARACTERISTIC /begin REF_MEASUREMENT WhlImbRejctn.WhlSpdCorrFltFaild /end REF_MEASUREMENT /end GROUP
/begin GROUP WhlImbRejctn.WhlSpdCorrFltRst "MICROSAR RTE" /begin SUB_GROUP /end SUB_GROUP /begin FUNCTION_LIST /end FUNCTION_LIST /begin REF_CHARACTERISTIC /end REF_CHARACTERISTIC /begin REF_MEASUREMENT WhlImbRejctn.WhlSpdCorrFltRst /end REF_MEASUREMENT /end GROUP
/begin GROUP WhlImbRejctn.WhlSpdCorrlnDiagcLrngEnaPrev "MICROSAR RTE" /begin SUB_GROUP /end SUB_GROUP /begin FUNCTION_LIST /end FUNCTION_LIST /begin REF_CHARACTERISTIC /end REF_CHARACTERISTIC /begin REF_MEASUREMENT WhlImbRejctn.WhlSpdCorrlnDiagcLrngEnaPrev /end REF_MEASUREMENT /end GROUP
/begin GROUP WhlImbRejctn.WhlSpdCorrlnDiagcRefTiEnaLrng "MICROSAR RTE" /begin SUB_GROUP /end SUB_GROUP /begin FUNCTION_LIST /end FUNCTION_LIST /begin REF_CHARACTERISTIC /end REF_CHARACTERISTIC /begin REF_MEASUREMENT WhlImbRejctn.WhlSpdCorrlnDiagcRefTiEnaLrng /end REF_MEASUREMENT /end GROUP
/begin GROUP WhlImbRejctn.WhlSpdCorrlnFltRcvry "MICROSAR RTE" /begin SUB_GROUP /end SUB_GROUP /begin FUNCTION_LIST /end FUNCTION_LIST /begin REF_CHARACTERISTIC /end REF_CHARACTERISTIC
 /begin REF_MEASUREMENT WhlImbRejctn.WhlSpdCorrlnFltRcvry.Cntr WhlImbRejctn.WhlSpdCorrlnFltRcvry.NegStep WhlImbRejctn.WhlSpdCorrlnFltRcvry.PosStep WhlImbRejctn.WhlSpdCorrlnFltRcvry.Sts WhlImbRejctn.WhlSpdCorrlnFltRcvry.Thd /end REF_MEASUREMENT
/end GROUP
/begin GROUP WhlImbRejctn.WhlSpdCorrlnLrngEnaPrevTmr "MICROSAR RTE" /begin SUB_GROUP /end SUB_GROUP /begin FUNCTION_LIST /end FUNCTION_LIST /begin REF_CHARACTERISTIC /end REF_CHARACTERISTIC /begin REF_MEASUREMENT WhlImbRejctn.WhlSpdCorrlnLrngEnaPrevTmr /end REF_MEASUREMENT /end GROUP
/begin GROUP WhlImbRejctn.WhlSpdCorrlnRefTiEnaLrngTmr "MICROSAR RTE" /begin SUB_GROUP /end SUB_GROUP /begin FUNCTION_LIST /end FUNCTION_LIST /begin REF_CHARACTERISTIC /end REF_CHARACTERISTIC /begin REF_MEASUREMENT WhlImbRejctn.WhlSpdCorrlnRefTiEnaLrngTmr /end REF_MEASUREMENT /end GROUP
/begin GROUP WhlImbRejctn.WhlSpdLeLpFil "MICROSAR RTE" /begin SUB_GROUP /end SUB_GROUP /begin FUNCTION_LIST /end FUNCTION_LIST /begin REF_CHARACTERISTIC /end REF_CHARACTERISTIC
 /begin REF_MEASUREMENT WhlImbRejctn.WhlSpdLeLpFil.FilGain WhlImbRejctn.WhlSpdLeLpFil.FilSt /end REF_MEASUREMENT
/end GROUP
/begin GROUP WhlImbRejctn.WhlSpdRiLpFil "MICROSAR RTE" /begin SUB_GROUP /end SUB_GROUP /begin FUNCTION_LIST /end FUNCTION_LIST /begin REF_CHARACTERISTIC /end REF_CHARACTERISTIC
 /begin REF_MEASUREMENT WhlImbRejctn.WhlSpdRiLpFil.FilGain WhlImbRejctn.WhlSpdRiLpFil.FilSt /end REF_MEASUREMENT
/end GROUP
/begin GROUP WhlImbRejctn.dWhlImbRejctnCnclTqOutp "MICROSAR RTE" /begin SUB_GROUP /end SUB_GROUP /begin FUNCTION_LIST /end FUNCTION_LIST /begin REF_CHARACTERISTIC /end REF_CHARACTERISTIC /begin REF_MEASUREMENT WhlImbRejctn.dWhlImbRejctnCnclTqOutp /end REF_MEASUREMENT /end GROUP
/begin GROUP WhlImbRejctn.dWhlImbRejctnCurrMgnLe "MICROSAR RTE" /begin SUB_GROUP /end SUB_GROUP /begin FUNCTION_LIST /end FUNCTION_LIST /begin REF_CHARACTERISTIC /end REF_CHARACTERISTIC /begin REF_MEASUREMENT WhlImbRejctn.dWhlImbRejctnCurrMgnLe /end REF_MEASUREMENT /end GROUP
/begin GROUP WhlImbRejctn.dWhlImbRejctnCurrMgnRi "MICROSAR RTE" /begin SUB_GROUP /end SUB_GROUP /begin FUNCTION_LIST /end FUNCTION_LIST /begin REF_CHARACTERISTIC /end REF_CHARACTERISTIC /begin REF_MEASUREMENT WhlImbRejctn.dWhlImbRejctnCurrMgnRi /end REF_MEASUREMENT /end GROUP
/begin GROUP WhlImbRejctn.dWhlImbRejctnFildWhlSpdLe "MICROSAR RTE" /begin SUB_GROUP /end SUB_GROUP /begin FUNCTION_LIST /end FUNCTION_LIST /begin REF_CHARACTERISTIC /end REF_CHARACTERISTIC /begin REF_MEASUREMENT WhlImbRejctn.dWhlImbRejctnFildWhlSpdLe /end REF_MEASUREMENT /end GROUP
/begin GROUP WhlImbRejctn.dWhlImbRejctnFildWhlSpdRi "MICROSAR RTE" /begin SUB_GROUP /end SUB_GROUP /begin FUNCTION_LIST /end FUNCTION_LIST /begin REF_CHARACTERISTIC /end REF_CHARACTERISTIC /begin REF_MEASUREMENT WhlImbRejctn.dWhlImbRejctnFildWhlSpdRi /end REF_MEASUREMENT /end GROUP
/begin GROUP WhlImbRejctn.dWhlImbRejctnLMSqdOutLe "MICROSAR RTE" /begin SUB_GROUP /end SUB_GROUP /begin FUNCTION_LIST /end FUNCTION_LIST /begin REF_CHARACTERISTIC /end REF_CHARACTERISTIC /begin REF_MEASUREMENT WhlImbRejctn.dWhlImbRejctnLMSqdOutLe /end REF_MEASUREMENT /end GROUP
/begin GROUP WhlImbRejctn.dWhlImbRejctnLMSqdOutRi "MICROSAR RTE" /begin SUB_GROUP /end SUB_GROUP /begin FUNCTION_LIST /end FUNCTION_LIST /begin REF_CHARACTERISTIC /end REF_CHARACTERISTIC /begin REF_MEASUREMENT WhlImbRejctn.dWhlImbRejctnLMSqdOutRi /end REF_MEASUREMENT /end GROUP
/begin GROUP WhlImbRejctn.dWhlImbRejctnScaLe "MICROSAR RTE" /begin SUB_GROUP /end SUB_GROUP /begin FUNCTION_LIST /end FUNCTION_LIST /begin REF_CHARACTERISTIC /end REF_CHARACTERISTIC /begin REF_MEASUREMENT WhlImbRejctn.dWhlImbRejctnScaLe /end REF_MEASUREMENT /end GROUP
/begin GROUP WhlImbRejctn.dWhlImbRejctnScaRi "MICROSAR RTE" /begin SUB_GROUP /end SUB_GROUP /begin FUNCTION_LIST /end FUNCTION_LIST /begin REF_CHARACTERISTIC /end REF_CHARACTERISTIC /begin REF_MEASUREMENT WhlImbRejctn.dWhlImbRejctnScaRi /end REF_MEASUREMENT /end GROUP
/begin GROUP WhlImbRejctn.dWhlImbRejctnWhlSpdCorrPerc "MICROSAR RTE" /begin SUB_GROUP /end SUB_GROUP /begin FUNCTION_LIST /end FUNCTION_LIST /begin REF_CHARACTERISTIC /end REF_CHARACTERISTIC /begin REF_MEASUREMENT WhlImbRejctn.dWhlImbRejctnWhlSpdCorrPerc /end REF_MEASUREMENT /end GROUP
/begin RECORD_LAYOUT RTE_RL_UWORD FNC_VALUES 1 UWORD ROW_DIR DIRECT /end RECORD_LAYOUT
/begin RECORD_LAYOUT RTE_RL_ULONG FNC_VALUES 1 ULONG ROW_DIR DIRECT /end RECORD_LAYOUT
/begin RECORD_LAYOUT RTE_RL_SWORD FNC_VALUES 1 SWORD ROW_DIR DIRECT /end RECORD_LAYOUT
/begin RECORD_LAYOUT RTE_RL_FLOAT32_IEEE FNC_VALUES 1 FLOAT32_IEEE ROW_DIR DIRECT /end RECORD_LAYOUT
/begin RECORD_LAYOUT RTE_RL_BOOLEAN FNC_VALUES 1 UBYTE ROW_DIR DIRECT /end RECORD_LAYOUT
/**********************************************************************************************************************
* COMPU_METHOD / COMPU_VTAB_RANGE
*********************************************************************************************************************/
/begin COMPU_METHOD RTE_CM_BOOLEAN "" TAB_VERB "%3.1" "" COMPU_TAB_REF RTE_CM_BOOLEAN /end COMPU_METHOD
/begin COMPU_VTAB_RANGE RTE_CM_BOOLEAN "" 2 0 0 "false" 1 255 "true" /end COMPU_VTAB_RANGE
/begin COMPU_METHOD RTE_CM_STRING "" TAB_VERB "%.1" "" COMPU_TAB_REF RTE_CM_STRING /end COMPU_METHOD
/begin COMPU_VTAB_RANGE RTE_CM_STRING "" 97 0 31 "UNDEFINED" 32 32 " " 33 33 "!" 34 34 "\"" 35 35 "#" 36 36 "$" 37 37 "%" 38 38 "&" 39 39 "'" 40 40 "(" 41 41 ")" 42 42 "*" 43 43 "+" 44 44 "," 45 45 "-" 46 46 "." 47 47 "/" 48 48 "0" 49 49 "1" 50 50 "2" 51 51 "3" 52 52 "4" 53 53 "5" 54 54 "6" 55 55 "7" 56 56 "8" 57 57 "9" 58 58 ":" 59 59 ";" 60 60 "<" 61 61 "=" 62 62 ">" 63 63 "?" 64 64 "@" 65 65 "A" 66 66 "B" 67 67 "C" 68 68 "D" 69 69 "E" 70 70 "F" 71 71 "G" 72 72 "H" 73 73 "I" 74 74 "J" 75 75 "K" 76 76 "L" 77 77 "M" 78 78 "N" 79 79 "O" 80 80 "P" 81 81 "Q" 82 82 "R" 83 83 "S" 84 84 "T" 85 85 "U" 86 86 "V" 87 87 "W" 88 88 "X" 89 89 "Y" 90 90 "Z" 91 91 "[" 92 92 "\\" 93 93 "]" 94 94 "^" 95 95 "_" 96 96 "`" 97 97 "a" 98 98 "b" 99 99 "c" 100 100 "d" 101 101 "e" 102 102 "f" 103 103 "g" 104 104 "h" 105 105 "i" 106 106 "j" 107 107 "k" 108 108 "l" 109 109 "m" 110 110 "n" 111 111 "o" 112 112 "p" 113 113 "q" 114 114 "r" 115 115 "s" 116 116 "t" 117 117 "u" 118 118 "v" 119 119 "w" 120 120 "x" 121 121 "y" 122 122 "z" 123 123 "{" 124 124 "|" 125 125 "}" 126 126 "~" 127 255 "UNDEFINED" /end COMPU_VTAB_RANGE
/begin COMPU_METHOD RTE_CM_ENUM_SysSt1 "" TAB_VERB "%.1" "" COMPU_TAB_REF RTE_CM_ENUM_SysSt1 /end COMPU_METHOD
/begin COMPU_VTAB_RANGE RTE_CM_ENUM_SysSt1 "" 4 0 0 "SYSST_DI" 1 1 "SYSST_OFF" 2 2 "SYSST_ENA" 3 3 "SYSST_WRMININ" /end COMPU_VTAB_RANGE
/begin COMPU_METHOD RTE_CM_ENUM_SigQlfr1 "" TAB_VERB "%.1" "" COMPU_TAB_REF RTE_CM_ENUM_SigQlfr1 /end COMPU_METHOD
/begin COMPU_VTAB_RANGE RTE_CM_ENUM_SigQlfr1 "" 3 0 0 "SIGQLFR_NORES" 1 1 "SIGQLFR_PASSD" 2 2 "SIGQLFR_FAILD" /end COMPU_VTAB_RANGE
