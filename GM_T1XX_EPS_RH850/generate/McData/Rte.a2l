/begin CHARACTERISTIC HwAg1Meas.HwAg1MeasHwAg1Snsr0PrtclFltPassStep.Val "MICROSAR RTE" VALUE 0x0 RTE_RL_UWORD 0 NO_COMPU_METHOD 0 65535 SYMBOL_LINK "Rte_CalprmRom_CalRegn01Inin00_DEFAULT_RTE_CALPRM_GROUP.HwAg1MeasHwAg1Snsr0PrtclFltPassStep_Val" 0 DISPLAY_IDENTIFIER HwAg1Meas.CalibrationPorts.HwAg1MeasHwAg1Snsr0PrtclFltPassStep.Val /end CHARACTERISTIC
/begin CHARACTERISTIC HwAg1Meas.HwAg1MeasHwAg1Snsr1PrtclFltFailStep.Val "MICROSAR RTE" VALUE 0x0 RTE_RL_UWORD 0 NO_COMPU_METHOD 0 65535 SYMBOL_LINK "Rte_CalprmRom_CalRegn01Inin00_DEFAULT_RTE_CALPRM_GROUP.HwAg1MeasHwAg1Snsr1PrtclFltFailStep_Val" 0 DISPLAY_IDENTIFIER HwAg1Meas.CalibrationPorts.HwAg1MeasHwAg1Snsr1PrtclFltFailStep.Val /end CHARACTERISTIC
/begin CHARACTERISTIC HwAg1Meas.HwAg1MeasHwAg1Snsr1PrtclFltPassStep.Val "MICROSAR RTE" VALUE 0x0 RTE_RL_UWORD 0 NO_COMPU_METHOD 0 65535 SYMBOL_LINK "Rte_CalprmRom_CalRegn01Inin00_DEFAULT_RTE_CALPRM_GROUP.HwAg1MeasHwAg1Snsr1PrtclFltPassStep_Val" 0 DISPLAY_IDENTIFIER HwAg1Meas.CalibrationPorts.HwAg1MeasHwAg1Snsr1PrtclFltPassStep.Val /end CHARACTERISTIC
/begin CHARACTERISTIC HwAg1Meas.HwAg1MeasSnsr0Rev.Ary1D "MICROSAR RTE" VAL_BLK 0x0 RTE_RL_UBYTE 0 NO_COMPU_METHOD 0.0 255.0 MATRIX_DIM 22 1 1 SYMBOL_LINK "Rte_CalprmRom_CalRegn01Inin00_DEFAULT_RTE_CALPRM_GROUP.HwAg1MeasSnsr0Rev_Ary1D" 0 DISPLAY_IDENTIFIER HwAg1Meas.CalibrationPorts.HwAg1MeasSnsr0Rev.Ary1D /end CHARACTERISTIC
/begin CHARACTERISTIC HwAg1Meas.HwAg1MeasSnsr1Rev.Ary1D "MICROSAR RTE" VAL_BLK 0x0 RTE_RL_UBYTE 0 NO_COMPU_METHOD 0.0 255.0 MATRIX_DIM 22 1 1 SYMBOL_LINK "Rte_CalprmRom_CalRegn01Inin00_DEFAULT_RTE_CALPRM_GROUP.HwAg1MeasSnsr1Rev_Ary1D" 0 DISPLAY_IDENTIFIER HwAg1Meas.CalibrationPorts.HwAg1MeasSnsr1Rev.Ary1D /end CHARACTERISTIC
/begin CHARACTERISTIC HwAg1Meas.HwAg1MeasStep.Ary1D "MICROSAR RTE" VAL_BLK 0x0 RTE_RL_SWORD 0 NO_COMPU_METHOD -500.0 500.0 MATRIX_DIM 22 1 1 SYMBOL_LINK "Rte_CalprmRom_CalRegn01Inin00_DEFAULT_RTE_CALPRM_GROUP.HwAg1MeasStep_Ary1D" 0 DISPLAY_IDENTIFIER HwAg1Meas.CalibrationPorts.HwAg1MeasStep.Ary1D /end CHARACTERISTIC
/begin CHARACTERISTIC HwAg1Meas.HwAg1MeasVrnrErrThd.Val "MICROSAR RTE" VALUE 0x0 RTE_RL_UBYTE 0 NO_COMPU_METHOD 0.0 20.0 SYMBOL_LINK "Rte_CalprmRom_CalRegn01Inin00_DEFAULT_RTE_CALPRM_GROUP.HwAg1MeasVrnrErrThd_Val" 0 DISPLAY_IDENTIFIER HwAg1Meas.CalibrationPorts.HwAg1MeasVrnrErrThd.Val /end CHARACTERISTIC
/begin CHARACTERISTIC HwAg1Meas.HwAg1OffsDft.OffsTrim "MICROSAR RTE" VALUE 0x0 RTE_RL_FLOAT32_IEEE 0 NO_COMPU_METHOD -900.0 900.0 SYMBOL_LINK "Rte_CalprmRom_HwAg1Meas_DEFAULT_RTE_CDATA_GROUP.HwAg1OffsDft.OffsTrim" 0 DISPLAY_IDENTIFIER HwAg1Meas.CalibrationParameters.HwAg1OffsDft.OffsTrim /end CHARACTERISTIC
/begin CHARACTERISTIC HwAg1Meas.HwAg1OffsDft.OffsTrimPrfmdSts "MICROSAR RTE" VALUE 0x0 RTE_RL_BOOLEAN 0 RTE_CM_BOOLEAN 0 255 SYMBOL_LINK "Rte_CalprmRom_HwAg1Meas_DEFAULT_RTE_CDATA_GROUP.HwAg1OffsDft.OffsTrimPrfmdSts" 0 DISPLAY_IDENTIFIER HwAg1Meas.CalibrationParameters.HwAg1OffsDft.OffsTrimPrfmdSts /end CHARACTERISTIC
/begin CHARACTERISTIC HwAgArbn.HwAgArbnHwAgMaxStall.Val "MICROSAR RTE" VALUE 0x0 RTE_RL_UBYTE 0 NO_COMPU_METHOD 0 255 SYMBOL_LINK "Rte_CalprmRom_CalRegn01Cmn_DEFAULT_RTE_CALPRM_GROUP.HwAgArbnHwAgMaxStall_Val" 0 DISPLAY_IDENTIFIER HwAgArbn.CalibrationPorts.HwAgArbnHwAgMaxStall.Val /end CHARACTERISTIC
/begin CHARACTERISTIC HwAgCorrln.HwAgCorrlnHwAgAbsltDif.Val "MICROSAR RTE" VALUE 0x0 RTE_RL_FLOAT32_IEEE 0 NO_COMPU_METHOD -3.402823466e+38 3.402823466e+38 SYMBOL_LINK "Rte_CalprmRom_CalRegn01Cmn_DEFAULT_RTE_CALPRM_GROUP.HwAgCorrlnHwAgAbsltDif_Val" 0 DISPLAY_IDENTIFIER HwAgCorrln.CalibrationPorts.HwAgCorrlnHwAgAbsltDif.Val /end CHARACTERISTIC
/begin CHARACTERISTIC HwAgCorrln.HwAgCorrlnHwAgMaxStall.Val "MICROSAR RTE" VALUE 0x0 RTE_RL_UBYTE 0 NO_COMPU_METHOD 0 255 SYMBOL_LINK "Rte_CalprmRom_CalRegn01Cmn_DEFAULT_RTE_CALPRM_GROUP.HwAgCorrlnHwAgMaxStall_Val" 0 DISPLAY_IDENTIFIER HwAgCorrln.CalibrationPorts.HwAgCorrlnHwAgMaxStall.Val /end CHARACTERISTIC
/begin CHARACTERISTIC HwAgCorrln.HwAgCorrlnNtc0x092FailStep.Val "MICROSAR RTE" VALUE 0x0 RTE_RL_UWORD 0 NO_COMPU_METHOD 0 65535 SYMBOL_LINK "Rte_CalprmRom_CalRegn01Cmn_DEFAULT_RTE_CALPRM_GROUP.HwAgCorrlnNtc0x092FailStep_Val" 0 DISPLAY_IDENTIFIER HwAgCorrln.CalibrationPorts.HwAgCorrlnNtc0x092FailStep.Val /end CHARACTERISTIC
/begin CHARACTERISTIC HwAgCorrln.HwAgCorrlnNtc0x092PassStep.Val "MICROSAR RTE" VALUE 0x0 RTE_RL_UWORD 0 NO_COMPU_METHOD 0 65535 SYMBOL_LINK "Rte_CalprmRom_CalRegn01Cmn_DEFAULT_RTE_CALPRM_GROUP.HwAgCorrlnNtc0x092PassStep_Val" 0 DISPLAY_IDENTIFIER HwAgCorrln.CalibrationPorts.HwAgCorrlnNtc0x092PassStep.Val /end CHARACTERISTIC
/begin CHARACTERISTIC HwAgSnsrls.HwAgSnsrlsCorrdPinionAgHwConf.Val "MICROSAR RTE" VALUE 0x0 RTE_RL_FLOAT32_IEEE 0 NO_COMPU_METHOD -3.402823466e+38 3.402823466e+38 SYMBOL_LINK "Rte_CalprmRom_CalRegn01Cmn_DEFAULT_RTE_CALPRM_GROUP.HwAgSnsrlsCorrdPinionAgHwConf_Val" 0 DISPLAY_IDENTIFIER HwAgSnsrls.CalibrationPorts.HwAgSnsrlsCorrdPinionAgHwConf.Val /end CHARACTERISTIC
/begin CHARACTERISTIC HwAgSnsrls.HwAgSnsrlsFCentrHwConf.Val "MICROSAR RTE" VALUE 0x0 RTE_RL_FLOAT32_IEEE 0 NO_COMPU_METHOD -3.402823466e+38 3.402823466e+38 SYMBOL_LINK "Rte_CalprmRom_CalRegn01Cmn_DEFAULT_RTE_CALPRM_GROUP.HwAgSnsrlsFCentrHwConf_Val" 0 DISPLAY_IDENTIFIER HwAgSnsrls.CalibrationPorts.HwAgSnsrlsFCentrHwConf.Val /end CHARACTERISTIC
/begin CHARACTERISTIC HwAgSnsrls.HwAgSnsrlsPinionTqFilFrq.Val "MICROSAR RTE" VALUE 0x0 RTE_RL_FLOAT32_IEEE 0 NO_COMPU_METHOD -3.402823466e+38 3.402823466e+38 SYMBOL_LINK "Rte_CalprmRom_CalRegn01Cmn_DEFAULT_RTE_CALPRM_GROUP.HwAgSnsrlsPinionTqFilFrq_Val" 0 DISPLAY_IDENTIFIER HwAgSnsrls.CalibrationPorts.HwAgSnsrlsPinionTqFilFrq.Val /end CHARACTERISTIC
/begin CHARACTERISTIC HwAgSnsrls.HwAgSnsrlsRelHwAgFil1Frq.Val "MICROSAR RTE" VALUE 0x0 RTE_RL_FLOAT32_IEEE 0 NO_COMPU_METHOD -3.402823466e+38 3.402823466e+38 SYMBOL_LINK "Rte_CalprmRom_CalRegn01Cmn_DEFAULT_RTE_CALPRM_GROUP.HwAgSnsrlsRelHwAgFil1Frq_Val" 0 DISPLAY_IDENTIFIER HwAgSnsrls.CalibrationPorts.HwAgSnsrlsRelHwAgFil1Frq.Val /end CHARACTERISTIC
/begin CHARACTERISTIC HwAgSnsrls.HwAgSnsrlsRelHwAgFil2Frq.Val "MICROSAR RTE" VALUE 0x0 RTE_RL_FLOAT32_IEEE 0 NO_COMPU_METHOD -3.402823466e+38 3.402823466e+38 SYMBOL_LINK "Rte_CalprmRom_CalRegn01Cmn_DEFAULT_RTE_CALPRM_GROUP.HwAgSnsrlsRelHwAgFil2Frq_Val" 0 DISPLAY_IDENTIFIER HwAgSnsrls.CalibrationPorts.HwAgSnsrlsRelHwAgFil2Frq.Val /end CHARACTERISTIC
/begin CHARACTERISTIC HwAgSnsrls.HwAgSnsrlsSmotngCoeff.Val "MICROSAR RTE" VALUE 0x0 RTE_RL_FLOAT32_IEEE 0 NO_COMPU_METHOD -3.402823466e+38 3.402823466e+38 SYMBOL_LINK "Rte_CalprmRom_CalRegn01Cmn_DEFAULT_RTE_CALPRM_GROUP.HwAgSnsrlsSmotngCoeff_Val" 0 DISPLAY_IDENTIFIER HwAgSnsrls.CalibrationPorts.HwAgSnsrlsSmotngCoeff.Val /end CHARACTERISTIC
/begin CHARACTERISTIC HwAgSnsrls.HwAgSnsrlsSmotngStepThd.Val "MICROSAR RTE" VALUE 0x0 RTE_RL_FLOAT32_IEEE 0 NO_COMPU_METHOD -3.402823466e+38 3.402823466e+38 SYMBOL_LINK "Rte_CalprmRom_CalRegn01Cmn_DEFAULT_RTE_CALPRM_GROUP.HwAgSnsrlsSmotngStepThd_Val" 0 DISPLAY_IDENTIFIER HwAgSnsrls.CalibrationPorts.HwAgSnsrlsSmotngStepThd.Val /end CHARACTERISTIC
/begin CHARACTERISTIC HwAgSnsrls.HwAgSnsrlsStordPinionConf.Val "MICROSAR RTE" VALUE 0x0 RTE_RL_FLOAT32_IEEE 0 NO_COMPU_METHOD -3.402823466e+38 3.402823466e+38 SYMBOL_LINK "Rte_CalprmRom_CalRegn01Cmn_DEFAULT_RTE_CALPRM_GROUP.HwAgSnsrlsStordPinionConf_Val" 0 DISPLAY_IDENTIFIER HwAgSnsrls.CalibrationPorts.HwAgSnsrlsStordPinionConf.Val /end CHARACTERISTIC
/begin CHARACTERISTIC HwAgSnsrls.HwAgSnsrlsStordPinionConfThd.Val "MICROSAR RTE" VALUE 0x0 RTE_RL_FLOAT32_IEEE 0 NO_COMPU_METHOD -3.402823466e+38 3.402823466e+38 SYMBOL_LINK "Rte_CalprmRom_CalRegn01Cmn_DEFAULT_RTE_CALPRM_GROUP.HwAgSnsrlsStordPinionConfThd_Val" 0 DISPLAY_IDENTIFIER HwAgSnsrls.CalibrationPorts.HwAgSnsrlsStordPinionConfThd.Val /end CHARACTERISTIC
/begin CHARACTERISTIC HwAgSnsrls.HwAgSnsrlsVehDynDifThd.Val "MICROSAR RTE" VALUE 0x0 RTE_RL_FLOAT32_IEEE 0 NO_COMPU_METHOD -3.402823466e+38 3.402823466e+38 SYMBOL_LINK "Rte_CalprmRom_CalRegn01Cmn_DEFAULT_RTE_CALPRM_GROUP.HwAgSnsrlsVehDynDifThd_Val" 0 DISPLAY_IDENTIFIER HwAgSnsrls.CalibrationPorts.HwAgSnsrlsVehDynDifThd.Val /end CHARACTERISTIC
/begin CHARACTERISTIC HwAgSnsrls.HwAgSnsrlsVehDynHwConf.Val "MICROSAR RTE" VALUE 0x0 RTE_RL_FLOAT32_IEEE 0 NO_COMPU_METHOD -3.402823466e+38 3.402823466e+38 SYMBOL_LINK "Rte_CalprmRom_CalRegn01Cmn_DEFAULT_RTE_CALPRM_GROUP.HwAgSnsrlsVehDynHwConf_Val" 0 DISPLAY_IDENTIFIER HwAgSnsrls.CalibrationPorts.HwAgSnsrlsVehDynHwConf.Val /end CHARACTERISTIC
/begin CHARACTERISTIC HwAgSnsrls.HwAgSnsrlsVehDynMotVelThd.Val "MICROSAR RTE" VALUE 0x0 RTE_RL_FLOAT32_IEEE 0 NO_COMPU_METHOD -3.402823466e+38 3.402823466e+38 SYMBOL_LINK "Rte_CalprmRom_CalRegn01Cmn_DEFAULT_RTE_CALPRM_GROUP.HwAgSnsrlsVehDynMotVelThd_Val" 0 DISPLAY_IDENTIFIER HwAgSnsrls.CalibrationPorts.HwAgSnsrlsVehDynMotVelThd.Val /end CHARACTERISTIC
/begin CHARACTERISTIC HwAgSnsrls.HwAgSnsrlsVehDynPinionTqThd.Val "MICROSAR RTE" VALUE 0x0 RTE_RL_FLOAT32_IEEE 0 NO_COMPU_METHOD -3.402823466e+38 3.402823466e+38 SYMBOL_LINK "Rte_CalprmRom_CalRegn01Cmn_DEFAULT_RTE_CALPRM_GROUP.HwAgSnsrlsVehDynPinionTqThd_Val" 0 DISPLAY_IDENTIFIER HwAgSnsrls.CalibrationPorts.HwAgSnsrlsVehDynPinionTqThd.Val /end CHARACTERISTIC
/begin CHARACTERISTIC HwAgSnsrls.HwAgSnsrlsVehDynTmr1Thd.Val "MICROSAR RTE" VALUE 0x0 RTE_RL_ULONG 0 NO_COMPU_METHOD 0 4294967295 SYMBOL_LINK "Rte_CalprmRom_CalRegn01Cmn_DEFAULT_RTE_CALPRM_GROUP.HwAgSnsrlsVehDynTmr1Thd_Val" 0 DISPLAY_IDENTIFIER HwAgSnsrls.CalibrationPorts.HwAgSnsrlsVehDynTmr1Thd.Val /end CHARACTERISTIC
/begin CHARACTERISTIC HwAgSnsrls.HwAgSnsrlsVehDynTmr2Thd.Val "MICROSAR RTE" VALUE 0x0 RTE_RL_ULONG 0 NO_COMPU_METHOD 0 4294967295 SYMBOL_LINK "Rte_CalprmRom_CalRegn01Cmn_DEFAULT_RTE_CALPRM_GROUP.HwAgSnsrlsVehDynTmr2Thd_Val" 0 DISPLAY_IDENTIFIER HwAgSnsrls.CalibrationPorts.HwAgSnsrlsVehDynTmr2Thd.Val /end CHARACTERISTIC
/begin CHARACTERISTIC HwAgSnsrls.HwAgSnsrlsVehDynVehSpdThd.Val "MICROSAR RTE" VALUE 0x0 RTE_RL_FLOAT32_IEEE 0 NO_COMPU_METHOD -3.402823466e+38 3.402823466e+38 SYMBOL_LINK "Rte_CalprmRom_CalRegn01Inin00_DEFAULT_RTE_CALPRM_GROUP.HwAgSnsrlsVehDynVehSpdThd_Val" 0 DISPLAY_IDENTIFIER HwAgSnsrls.CalibrationPorts.HwAgSnsrlsVehDynVehSpdThd.Val /end CHARACTERISTIC
/begin CHARACTERISTIC HwAgSnsrls.HwAgSnsrlsVehDynYawRateThd.Val "MICROSAR RTE" VALUE 0x0 RTE_RL_FLOAT32_IEEE 0 NO_COMPU_METHOD -3.402823466e+38 3.402823466e+38 SYMBOL_LINK "Rte_CalprmRom_CalRegn01Inin00_DEFAULT_RTE_CALPRM_GROUP.HwAgSnsrlsVehDynYawRateThd_Val" 0 DISPLAY_IDENTIFIER HwAgSnsrls.CalibrationPorts.HwAgSnsrlsVehDynYawRateThd.Val /end CHARACTERISTIC
/begin CHARACTERISTIC HwAgSnsrls.HwAgSnsrlsWhlFrqThd.Val "MICROSAR RTE" VALUE 0x0 RTE_RL_FLOAT32_IEEE 0 NO_COMPU_METHOD -3.402823466e+38 3.402823466e+38 SYMBOL_LINK "Rte_CalprmRom_CalRegn01Cmn_DEFAULT_RTE_CALPRM_GROUP.HwAgSnsrlsWhlFrqThd_Val" 0 DISPLAY_IDENTIFIER HwAgSnsrls.CalibrationPorts.HwAgSnsrlsWhlFrqThd.Val /end CHARACTERISTIC
/begin CHARACTERISTIC HwAgSnsrls.HwAgSnsrlsWhlSpdHwAgCoeff1.Val "MICROSAR RTE" VALUE 0x0 RTE_RL_FLOAT32_IEEE 0 NO_COMPU_METHOD -3.402823466e+38 3.402823466e+38 SYMBOL_LINK "Rte_CalprmRom_CalRegn01Cmn_DEFAULT_RTE_CALPRM_GROUP.HwAgSnsrlsWhlSpdHwAgCoeff1_Val" 0 DISPLAY_IDENTIFIER HwAgSnsrls.CalibrationPorts.HwAgSnsrlsWhlSpdHwAgCoeff1.Val /end CHARACTERISTIC
/begin CHARACTERISTIC HwAgSnsrls.HwAgSnsrlsWhlSpdHwAgCoeff2.Val "MICROSAR RTE" VALUE 0x0 RTE_RL_FLOAT32_IEEE 0 NO_COMPU_METHOD -3.402823466e+38 3.402823466e+38 SYMBOL_LINK "Rte_CalprmRom_CalRegn01Cmn_DEFAULT_RTE_CALPRM_GROUP.HwAgSnsrlsWhlSpdHwAgCoeff2_Val" 0 DISPLAY_IDENTIFIER HwAgSnsrls.CalibrationPorts.HwAgSnsrlsWhlSpdHwAgCoeff2.Val /end CHARACTERISTIC
/begin CHARACTERISTIC HwAgSnsrls.HwAgSnsrlsWhlSpdHwAgThd.Val "MICROSAR RTE" VALUE 0x0 RTE_RL_FLOAT32_IEEE 0 NO_COMPU_METHOD -3.402823466e+38 3.402823466e+38 SYMBOL_LINK "Rte_CalprmRom_CalRegn01Cmn_DEFAULT_RTE_CALPRM_GROUP.HwAgSnsrlsWhlSpdHwAgThd_Val" 0 DISPLAY_IDENTIFIER HwAgSnsrls.CalibrationPorts.HwAgSnsrlsWhlSpdHwAgThd.Val /end CHARACTERISTIC
/begin CHARACTERISTIC HwAgSnsrls.HwAgSnsrlsWhlSpdHwConf.Val "MICROSAR RTE" VALUE 0x0 RTE_RL_FLOAT32_IEEE 0 NO_COMPU_METHOD -3.402823466e+38 3.402823466e+38 SYMBOL_LINK "Rte_CalprmRom_CalRegn01Cmn_DEFAULT_RTE_CALPRM_GROUP.HwAgSnsrlsWhlSpdHwConf_Val" 0 DISPLAY_IDENTIFIER HwAgSnsrls.CalibrationPorts.HwAgSnsrlsWhlSpdHwConf.Val /end CHARACTERISTIC
/begin CHARACTERISTIC HwAgSnsrls.HwAgSnsrlsWhlSpdRatThd.Val "MICROSAR RTE" VALUE 0x0 RTE_RL_FLOAT32_IEEE 0 NO_COMPU_METHOD -3.402823466e+38 3.402823466e+38 SYMBOL_LINK "Rte_CalprmRom_CalRegn01Cmn_DEFAULT_RTE_CALPRM_GROUP.HwAgSnsrlsWhlSpdRatThd_Val" 0 DISPLAY_IDENTIFIER HwAgSnsrls.CalibrationPorts.HwAgSnsrlsWhlSpdRatThd.Val /end CHARACTERISTIC
/begin CHARACTERISTIC HwAgSnsrls.HwAgSnsrlsWhlSpdTmrThd.Val "MICROSAR RTE" VALUE 0x0 RTE_RL_ULONG 0 NO_COMPU_METHOD 0 4294967295 SYMBOL_LINK "Rte_CalprmRom_CalRegn01Cmn_DEFAULT_RTE_CALPRM_GROUP.HwAgSnsrlsWhlSpdTmrThd_Val" 0 DISPLAY_IDENTIFIER HwAgSnsrls.CalibrationPorts.HwAgSnsrlsWhlSpdTmrThd.Val /end CHARACTERISTIC
/begin CHARACTERISTIC HwAgSnsrls.HwAgSnsrlsWhlSpdVehSpdThd.Val "MICROSAR RTE" VALUE 0x0 RTE_RL_FLOAT32_IEEE 0 NO_COMPU_METHOD -3.402823466e+38 3.402823466e+38 SYMBOL_LINK "Rte_CalprmRom_CalRegn01Cmn_DEFAULT_RTE_CALPRM_GROUP.HwAgSnsrlsWhlSpdVehSpdThd_Val" 0 DISPLAY_IDENTIFIER HwAgSnsrls.CalibrationPorts.HwAgSnsrlsWhlSpdVehSpdThd.Val /end CHARACTERISTIC
/begin CHARACTERISTIC HwAgSnsrls.HwAgSnsrlsYawRateFilFrq.Val "MICROSAR RTE" VALUE 0x0 RTE_RL_FLOAT32_IEEE 0 NO_COMPU_METHOD -3.402823466e+38 3.402823466e+38 SYMBOL_LINK "Rte_CalprmRom_CalRegn01Inin00_DEFAULT_RTE_CALPRM_GROUP.HwAgSnsrlsYawRateFilFrq_Val" 0 DISPLAY_IDENTIFIER HwAgSnsrls.CalibrationPorts.HwAgSnsrlsYawRateFilFrq.Val /end CHARACTERISTIC
/begin CHARACTERISTIC HwAgSnsrls.StordLstPrmDft.PinionAg "MICROSAR RTE" VALUE 0x0 RTE_RL_FLOAT32_IEEE 0 NO_COMPU_METHOD -3.402823466e+38 3.402823466e+38 SYMBOL_LINK "Rte_CalprmRom_HwAgSnsrls_DEFAULT_RTE_CDATA_GROUP.StordLstPrmDft.PinionAg" 0 DISPLAY_IDENTIFIER HwAgSnsrls.CalibrationParameters.StordLstPrmDft.PinionAg /end CHARACTERISTIC
/begin CHARACTERISTIC HwAgSnsrls.StordLstPrmDft.PinionAgVld "MICROSAR RTE" VALUE 0x0 RTE_RL_BOOLEAN 0 RTE_CM_BOOLEAN 0 255 SYMBOL_LINK "Rte_CalprmRom_HwAgSnsrls_DEFAULT_RTE_CDATA_GROUP.StordLstPrmDft.PinionAgVld" 0 DISPLAY_IDENTIFIER HwAgSnsrls.CalibrationParameters.StordLstPrmDft.PinionAgVld /end CHARACTERISTIC
/begin CHARACTERISTIC HwAgSnsrls.SysGlbPrmSysKineRat.Val "MICROSAR RTE" VALUE 0x0 RTE_RL_FLOAT32_IEEE 0 NO_COMPU_METHOD -3.402823466e+38 3.402823466e+38 SYMBOL_LINK "Rte_CalprmRom_CalRegn03Inin00_DEFAULT_RTE_CALPRM_GROUP.SysGlbPrmSysKineRat_Val" 0 DISPLAY_IDENTIFIER HwAgSnsrls.CalibrationPorts.SysGlbPrmSysKineRat.Val /end CHARACTERISTIC
/begin CHARACTERISTIC HwAgSnsrls.SysGlbPrmSysTqRat.Val "MICROSAR RTE" VALUE 0x0 RTE_RL_FLOAT32_IEEE 0 NO_COMPU_METHOD -3.402823466e+38 3.402823466e+38 SYMBOL_LINK "Rte_CalprmRom_CalRegn03Inin00_DEFAULT_RTE_CALPRM_GROUP.SysGlbPrmSysTqRat_Val" 0 DISPLAY_IDENTIFIER HwAgSnsrls.CalibrationPorts.SysGlbPrmSysTqRat.Val /end CHARACTERISTIC
/begin CHARACTERISTIC HwAgSysArbn.HwAgSysArbnHwAgConf1Snsr.Val "MICROSAR RTE" VALUE 0x0 RTE_RL_FLOAT32_IEEE 0 NO_COMPU_METHOD -3.402823466e+38 3.402823466e+38 SYMBOL_LINK "Rte_CalprmRom_CalRegn01Cmn_DEFAULT_RTE_CALPRM_GROUP.HwAgSysArbnHwAgConf1Snsr_Val" 0 DISPLAY_IDENTIFIER HwAgSysArbn.CalibrationPorts.HwAgSysArbnHwAgConf1Snsr.Val /end CHARACTERISTIC
/begin CHARACTERISTIC HwAgSysArbn.HwAgSysArbnHwAgConf2Snsr.Val "MICROSAR RTE" VALUE 0x0 RTE_RL_FLOAT32_IEEE 0 NO_COMPU_METHOD -3.402823466e+38 3.402823466e+38 SYMBOL_LINK "Rte_CalprmRom_CalRegn01Cmn_DEFAULT_RTE_CALPRM_GROUP.HwAgSysArbnHwAgConf2Snsr_Val" 0 DISPLAY_IDENTIFIER HwAgSysArbn.CalibrationPorts.HwAgSysArbnHwAgConf2Snsr.Val /end CHARACTERISTIC
/begin CHARACTERISTIC HwAgSysArbn.HwAgSysArbnHwAgConfNoSnsr.Val "MICROSAR RTE" VALUE 0x0 RTE_RL_FLOAT32_IEEE 0 NO_COMPU_METHOD -3.402823466e+38 3.402823466e+38 SYMBOL_LINK "Rte_CalprmRom_CalRegn01Cmn_DEFAULT_RTE_CALPRM_GROUP.HwAgSysArbnHwAgConfNoSnsr_Val" 0 DISPLAY_IDENTIFIER HwAgSysArbn.CalibrationPorts.HwAgSysArbnHwAgConfNoSnsr.Val /end CHARACTERISTIC
/begin CHARACTERISTIC HwAgSysArbn.HwAgSysArbnHwAgCorrdCorrlnThd.Val "MICROSAR RTE" VALUE 0x0 RTE_RL_FLOAT32_IEEE 0 NO_COMPU_METHOD -3.402823466e+38 3.402823466e+38 SYMBOL_LINK "Rte_CalprmRom_CalRegn01Cmn_DEFAULT_RTE_CALPRM_GROUP.HwAgSysArbnHwAgCorrdCorrlnThd_Val" 0 DISPLAY_IDENTIFIER HwAgSysArbn.CalibrationPorts.HwAgSysArbnHwAgCorrdCorrlnThd.Val /end CHARACTERISTIC
/begin CHARACTERISTIC HwAgSysArbn.HwAgSysArbnHwAgCorrlnFailDebStep.Val "MICROSAR RTE" VALUE 0x0 RTE_RL_UWORD 0 NO_COMPU_METHOD 0 65535 SYMBOL_LINK "Rte_CalprmRom_CalRegn01Cmn_DEFAULT_RTE_CALPRM_GROUP.HwAgSysArbnHwAgCorrlnFailDebStep_Val" 0 DISPLAY_IDENTIFIER HwAgSysArbn.CalibrationPorts.HwAgSysArbnHwAgCorrlnFailDebStep.Val /end CHARACTERISTIC
/begin CHARACTERISTIC HwAgSysArbn.HwAgSysArbnHwAgCorrlnPassDebStep.Val "MICROSAR RTE" VALUE 0x0 RTE_RL_UWORD 0 NO_COMPU_METHOD 0 65535 SYMBOL_LINK "Rte_CalprmRom_CalRegn01Cmn_DEFAULT_RTE_CALPRM_GROUP.HwAgSysArbnHwAgCorrlnPassDebStep_Val" 0 DISPLAY_IDENTIFIER HwAgSysArbn.CalibrationPorts.HwAgSysArbnHwAgCorrlnPassDebStep.Val /end CHARACTERISTIC
/begin CHARACTERISTIC HwAgSysArbn.HwAgSysArbnHwAgCorrlnRng.Val "MICROSAR RTE" VALUE 0x0 RTE_RL_FLOAT32_IEEE 0 NO_COMPU_METHOD -3.402823466e+38 3.402823466e+38 SYMBOL_LINK "Rte_CalprmRom_CalRegn01Cmn_DEFAULT_RTE_CALPRM_GROUP.HwAgSysArbnHwAgCorrlnRng_Val" 0 DISPLAY_IDENTIFIER HwAgSysArbn.CalibrationPorts.HwAgSysArbnHwAgCorrlnRng.Val /end CHARACTERISTIC
/begin CHARACTERISTIC HwAgSysArbn.HwAgSysArbnHwAgSlewRate.Val "MICROSAR RTE" VALUE 0x0 RTE_RL_FLOAT32_IEEE 0 NO_COMPU_METHOD -3.402823466e+38 3.402823466e+38 SYMBOL_LINK "Rte_CalprmRom_CalRegn01Cmn_DEFAULT_RTE_CALPRM_GROUP.HwAgSysArbnHwAgSlewRate_Val" 0 DISPLAY_IDENTIFIER HwAgSysArbn.CalibrationPorts.HwAgSysArbnHwAgSlewRate.Val /end CHARACTERISTIC
/begin CHARACTERISTIC HwAgSysArbn.HwAgSysArbnHwAgSnsrlsCorrlnThd.Val "MICROSAR RTE" VALUE 0x0 RTE_RL_FLOAT32_IEEE 0 NO_COMPU_METHOD -3.402823466e+38 3.402823466e+38 SYMBOL_LINK "Rte_CalprmRom_CalRegn01Cmn_DEFAULT_RTE_CALPRM_GROUP.HwAgSysArbnHwAgSnsrlsCorrlnThd_Val" 0 DISPLAY_IDENTIFIER HwAgSysArbn.CalibrationPorts.HwAgSysArbnHwAgSnsrlsCorrlnThd.Val /end CHARACTERISTIC
/begin CHARACTERISTIC HwAgSysArbn.HwAgSysArbnHwAgSnsrlsKineThd.Val "MICROSAR RTE" VALUE 0x0 RTE_RL_FLOAT32_IEEE 0 NO_COMPU_METHOD -3.402823466e+38 3.402823466e+38 SYMBOL_LINK "Rte_CalprmRom_CalRegn01Cmn_DEFAULT_RTE_CALPRM_GROUP.HwAgSysArbnHwAgSnsrlsKineThd_Val" 0 DISPLAY_IDENTIFIER HwAgSysArbn.CalibrationPorts.HwAgSysArbnHwAgSnsrlsKineThd.Val /end CHARACTERISTIC
/begin CHARACTERISTIC HwAgSysArbn.HwAgSysArbnHwAgToMotAgCorrlnElpdTiLim.Val "MICROSAR RTE" VALUE 0x0 RTE_RL_ULONG 0 NO_COMPU_METHOD 0 4294967295 SYMBOL_LINK "Rte_CalprmRom_CalRegn01Cmn_DEFAULT_RTE_CALPRM_GROUP.HwAgSysArbnHwAgToMotAgCorrlnElpdTiLim_Val" 0 DISPLAY_IDENTIFIER HwAgSysArbn.CalibrationPorts.HwAgSysArbnHwAgToMotAgCorrlnElpdTiLim.Val /end CHARACTERISTIC
/begin CHARACTERISTIC HwAgSysArbn.HwAgSysArbnSerlComHwAgCorrdConf.Val "MICROSAR RTE" VALUE 0x0 RTE_RL_FLOAT32_IEEE 0 NO_COMPU_METHOD -3.402823466e+38 3.402823466e+38 SYMBOL_LINK "Rte_CalprmRom_CalRegn01Cmn_DEFAULT_RTE_CALPRM_GROUP.HwAgSysArbnSerlComHwAgCorrdConf_Val" 0 DISPLAY_IDENTIFIER HwAgSysArbn.CalibrationPorts.HwAgSysArbnSerlComHwAgCorrdConf.Val /end CHARACTERISTIC
/begin CHARACTERISTIC HwAgSysArbn.HwAgSysArbnSerlComHwAgSnsrlsConf.Val "MICROSAR RTE" VALUE 0x0 RTE_RL_FLOAT32_IEEE 0 NO_COMPU_METHOD -3.402823466e+38 3.402823466e+38 SYMBOL_LINK "Rte_CalprmRom_CalRegn01Cmn_DEFAULT_RTE_CALPRM_GROUP.HwAgSysArbnSerlComHwAgSnsrlsConf_Val" 0 DISPLAY_IDENTIFIER HwAgSysArbn.CalibrationPorts.HwAgSysArbnSerlComHwAgSnsrlsConf.Val /end CHARACTERISTIC
/begin CHARACTERISTIC HwAgSysArbn.HwAgSysArbnSlewRateTmr.Val "MICROSAR RTE" VALUE 0x0 RTE_RL_FLOAT32_IEEE 0 NO_COMPU_METHOD -3.402823466e+38 3.402823466e+38 SYMBOL_LINK "Rte_CalprmRom_CalRegn01Cmn_DEFAULT_RTE_CALPRM_GROUP.HwAgSysArbnSlewRateTmr_Val" 0 DISPLAY_IDENTIFIER HwAgSysArbn.CalibrationPorts.HwAgSysArbnSlewRateTmr.Val /end CHARACTERISTIC
/begin CHARACTERISTIC HwAgSysArbn.HwAgSysArbnTqSnsrVelFilFrq.Val "MICROSAR RTE" VALUE 0x0 RTE_RL_FLOAT32_IEEE 0 NO_COMPU_METHOD -3.402823466e+38 3.402823466e+38 SYMBOL_LINK "Rte_CalprmRom_CalRegn01Inin00_DEFAULT_RTE_CALPRM_GROUP.HwAgSysArbnTqSnsrVelFilFrq_Val" 0 DISPLAY_IDENTIFIER HwAgSysArbn.CalibrationPorts.HwAgSysArbnTqSnsrVelFilFrq.Val /end CHARACTERISTIC
/begin CHARACTERISTIC HwAgSysArbn.SysGlbPrmSysKineRat.Val "MICROSAR RTE" VALUE 0x0 RTE_RL_FLOAT32_IEEE 0 NO_COMPU_METHOD -3.402823466e+38 3.402823466e+38 SYMBOL_LINK "Rte_CalprmRom_CalRegn03Inin00_DEFAULT_RTE_CALPRM_GROUP.SysGlbPrmSysKineRat_Val" 0 DISPLAY_IDENTIFIER HwAgSysArbn.CalibrationPorts.SysGlbPrmSysKineRat.Val /end CHARACTERISTIC
/begin CHARACTERISTIC HwAgSysArbn.SysGlbPrmTorsBarStfn.Val "MICROSAR RTE" VALUE 0x0 RTE_RL_FLOAT32_IEEE 0 NO_COMPU_METHOD -3.402823466e+38 3.402823466e+38 SYMBOL_LINK "Rte_CalprmRom_CalRegn01Inin00_DEFAULT_RTE_CALPRM_GROUP.SysGlbPrmTorsBarStfn_Val" 0 DISPLAY_IDENTIFIER HwAgSysArbn.CalibrationPorts.SysGlbPrmTorsBarStfn.Val /end CHARACTERISTIC
/begin CHARACTERISTIC HwAgTrajGenn.HwAgTrajGennAMax.Val "MICROSAR RTE" VALUE 0x0 RTE_RL_FLOAT32_IEEE 0 NO_COMPU_METHOD -3.402823466e+38 3.402823466e+38 SYMBOL_LINK "Rte_CalprmRom_CalRegn01Cmn_DEFAULT_RTE_CALPRM_GROUP.HwAgTrajGennAMax_Val" 0 DISPLAY_IDENTIFIER HwAgTrajGenn.CalibrationPorts.HwAgTrajGennAMax.Val /end CHARACTERISTIC
/begin CHARACTERISTIC HwAgTrajGenn.HwAgTrajGennAgMax.Val "MICROSAR RTE" VALUE 0x0 RTE_RL_FLOAT32_IEEE 0 NO_COMPU_METHOD -3.402823466e+38 3.402823466e+38 SYMBOL_LINK "Rte_CalprmRom_CalRegn01Cmn_DEFAULT_RTE_CALPRM_GROUP.HwAgTrajGennAgMax_Val" 0 DISPLAY_IDENTIFIER HwAgTrajGenn.CalibrationPorts.HwAgTrajGennAgMax.Val /end CHARACTERISTIC
/begin CHARACTERISTIC HwAgTrajGenn.HwAgTrajGennVelMax.Val "MICROSAR RTE" VALUE 0x0 RTE_RL_FLOAT32_IEEE 0 NO_COMPU_METHOD -3.402823466e+38 3.402823466e+38 SYMBOL_LINK "Rte_CalprmRom_CalRegn01Cmn_DEFAULT_RTE_CALPRM_GROUP.HwAgTrajGennVelMax_Val" 0 DISPLAY_IDENTIFIER HwAgTrajGenn.CalibrationPorts.HwAgTrajGennVelMax.Val /end CHARACTERISTIC
/begin CHARACTERISTIC HwAgTrakgServo.HwAgTrakgServoDampgTqX.Ary1D "MICROSAR RTE" VAL_BLK 0x0 RTE_RL_UWORD 0 NO_COMPU_METHOD 0 65535 MATRIX_DIM 13 1 1 SYMBOL_LINK "Rte_CalprmRom_CalRegn03Inin00GroupC_DEFAULT_RTE_CALPRM_GROUP.HwAgTrakgServoDampgTqX_Ary1D" 0 DISPLAY_IDENTIFIER HwAgTrakgServo.CalibrationPorts.HwAgTrakgServoDampgTqX.Ary1D /end CHARACTERISTIC
/begin CHARACTERISTIC HwAgTrakgServo.HwAgTrakgServoDampgTqY.Ary2D "MICROSAR RTE" VAL_BLK 0x0 RTE_RL_UWORD 0 NO_COMPU_METHOD 0 65535 MATRIX_DIM 13 3 1 SYMBOL_LINK "Rte_CalprmRom_CalRegn03Inin00GroupC_DEFAULT_RTE_CALPRM_GROUP.HwAgTrakgServoDampgTqY_Ary2D" 0 DISPLAY_IDENTIFIER HwAgTrakgServo.CalibrationPorts.HwAgTrakgServoDampgTqY.Ary2D /end CHARACTERISTIC
/begin CHARACTERISTIC HwAgTrakgServo.HwAgTrakgServoDftlGainY.Ary1D "MICROSAR RTE" VAL_BLK 0x0 RTE_RL_UWORD 0 NO_COMPU_METHOD 0 65535 MATRIX_DIM 3 1 1 SYMBOL_LINK "Rte_CalprmRom_CalRegn03Inin00GroupC_DEFAULT_RTE_CALPRM_GROUP.HwAgTrakgServoDftlGainY_Ary1D" 0 DISPLAY_IDENTIFIER HwAgTrakgServo.CalibrationPorts.HwAgTrakgServoDftlGainY.Ary1D /end CHARACTERISTIC
/begin CHARACTERISTIC HwAgTrakgServo.HwAgTrakgServoDftlTermLpFilFrq.Val "MICROSAR RTE" VALUE 0x0 RTE_RL_FLOAT32_IEEE 0 NO_COMPU_METHOD -3.402823466e+38 3.402823466e+38 SYMBOL_LINK "Rte_CalprmRom_CalRegn03Inin00_DEFAULT_RTE_CALPRM_GROUP.HwAgTrakgServoDftlTermLpFilFrq_Val" 0 DISPLAY_IDENTIFIER HwAgTrakgServo.CalibrationPorts.HwAgTrakgServoDftlTermLpFilFrq.Val /end CHARACTERISTIC
/begin CHARACTERISTIC HwAgTrakgServo.HwAgTrakgServoDiRateX.Ary1D "MICROSAR RTE" VAL_BLK 0x0 RTE_RL_UWORD 0 NO_COMPU_METHOD 0 65535 MATRIX_DIM 6 1 1 SYMBOL_LINK "Rte_CalprmRom_CalRegn03Cmn_DEFAULT_RTE_CALPRM_GROUP.HwAgTrakgServoDiRateX_Ary1D" 0 DISPLAY_IDENTIFIER HwAgTrakgServo.CalibrationPorts.HwAgTrakgServoDiRateX.Ary1D /end CHARACTERISTIC
/begin CHARACTERISTIC HwAgTrakgServo.HwAgTrakgServoDiRateY.Ary1D "MICROSAR RTE" VAL_BLK 0x0 RTE_RL_UWORD 0 NO_COMPU_METHOD 0 65535 MATRIX_DIM 6 1 1 SYMBOL_LINK "Rte_CalprmRom_CalRegn03Cmn_DEFAULT_RTE_CALPRM_GROUP.HwAgTrakgServoDiRateY_Ary1D" 0 DISPLAY_IDENTIFIER HwAgTrakgServo.CalibrationPorts.HwAgTrakgServoDiRateY.Ary1D /end CHARACTERISTIC
/begin CHARACTERISTIC HwAgTrakgServo.HwAgTrakgServoEnaRate.Val "MICROSAR RTE" VALUE 0x0 RTE_RL_FLOAT32_IEEE 0 NO_COMPU_METHOD -3.402823466e+38 3.402823466e+38 SYMBOL_LINK "Rte_CalprmRom_CalRegn03Cmn_DEFAULT_RTE_CALPRM_GROUP.HwAgTrakgServoEnaRate_Val" 0 DISPLAY_IDENTIFIER HwAgTrakgServo.CalibrationPorts.HwAgTrakgServoEnaRate.Val /end CHARACTERISTIC
/begin CHARACTERISTIC HwAgTrakgServo.HwAgTrakgServoExecRate.Val "MICROSAR RTE" VALUE 0x0 RTE_RL_FLOAT32_IEEE 0 NO_COMPU_METHOD -3.402823466e+38 3.402823466e+38 SYMBOL_LINK "Rte_CalprmRom_CalRegn03Cmn_DEFAULT_RTE_CALPRM_GROUP.HwAgTrakgServoExecRate_Val" 0 DISPLAY_IDENTIFIER HwAgTrakgServo.CalibrationPorts.HwAgTrakgServoExecRate.Val /end CHARACTERISTIC
/begin CHARACTERISTIC HwAgTrakgServo.HwAgTrakgServoHwAgLpFilFrq.Val "MICROSAR RTE" VALUE 0x0 RTE_RL_FLOAT32_IEEE 0 NO_COMPU_METHOD -3.402823466e+38 3.402823466e+38 SYMBOL_LINK "Rte_CalprmRom_CalRegn03Inin00_DEFAULT_RTE_CALPRM_GROUP.HwAgTrakgServoHwAgLpFilFrq_Val" 0 DISPLAY_IDENTIFIER HwAgTrakgServo.CalibrationPorts.HwAgTrakgServoHwAgLpFilFrq.Val /end CHARACTERISTIC
/begin CHARACTERISTIC HwAgTrakgServo.HwAgTrakgServoHwAgRateLim.Ary1D "MICROSAR RTE" VAL_BLK 0x0 RTE_RL_UWORD 0 NO_COMPU_METHOD 0 65535 MATRIX_DIM 3 1 1 SYMBOL_LINK "Rte_CalprmRom_CalRegn03Cmn_DEFAULT_RTE_CALPRM_GROUP.HwAgTrakgServoHwAgRateLim_Ary1D" 0 DISPLAY_IDENTIFIER HwAgTrakgServo.CalibrationPorts.HwAgTrakgServoHwAgRateLim.Ary1D /end CHARACTERISTIC
/begin CHARACTERISTIC HwAgTrakgServo.HwAgTrakgServoHwTqLpFilFrq.Val "MICROSAR RTE" VALUE 0x0 RTE_RL_FLOAT32_IEEE 0 NO_COMPU_METHOD -3.402823466e+38 3.402823466e+38 SYMBOL_LINK "Rte_CalprmRom_CalRegn03Inin00_DEFAULT_RTE_CALPRM_GROUP.HwAgTrakgServoHwTqLpFilFrq_Val" 0 DISPLAY_IDENTIFIER HwAgTrakgServo.CalibrationPorts.HwAgTrakgServoHwTqLpFilFrq.Val /end CHARACTERISTIC
/begin CHARACTERISTIC HwAgTrakgServo.HwAgTrakgServoIntglGainY.Ary1D "MICROSAR RTE" VAL_BLK 0x0 RTE_RL_UWORD 0 NO_COMPU_METHOD 0 65535 MATRIX_DIM 3 1 1 SYMBOL_LINK "Rte_CalprmRom_CalRegn03Inin00GroupC_DEFAULT_RTE_CALPRM_GROUP.HwAgTrakgServoIntglGainY_Ary1D" 0 DISPLAY_IDENTIFIER HwAgTrakgServo.CalibrationPorts.HwAgTrakgServoIntglGainY.Ary1D /end CHARACTERISTIC
/begin CHARACTERISTIC HwAgTrakgServo.HwAgTrakgServoIntglTermAntiWdupLimY.Ary1D "MICROSAR RTE" VAL_BLK 0x0 RTE_RL_UWORD 0 NO_COMPU_METHOD 0 65535 MATRIX_DIM 3 1 1 SYMBOL_LINK "Rte_CalprmRom_CalRegn03Inin00GroupC_DEFAULT_RTE_CALPRM_GROUP.HwAgTrakgServoIntglTermAntiWdupLimY_Ary1D" 0 DISPLAY_IDENTIFIER HwAgTrakgServo.CalibrationPorts.HwAgTrakgServoIntglTermAntiWdupLimY.Ary1D /end CHARACTERISTIC
/begin CHARACTERISTIC HwAgTrakgServo.HwAgTrakgServoMaxCmdX.Ary1D "MICROSAR RTE" VAL_BLK 0x0 RTE_RL_UWORD 0 NO_COMPU_METHOD 0 65535 MATRIX_DIM 4 1 1 SYMBOL_LINK "Rte_CalprmRom_CalRegn03Cmn_DEFAULT_RTE_CALPRM_GROUP.HwAgTrakgServoMaxCmdX_Ary1D" 0 DISPLAY_IDENTIFIER HwAgTrakgServo.CalibrationPorts.HwAgTrakgServoMaxCmdX.Ary1D /end CHARACTERISTIC
/begin CHARACTERISTIC HwAgTrakgServo.HwAgTrakgServoMaxCmdY.Ary1D "MICROSAR RTE" VAL_BLK 0x0 RTE_RL_UWORD 0 NO_COMPU_METHOD 0 65535 MATRIX_DIM 4 1 1 SYMBOL_LINK "Rte_CalprmRom_CalRegn03Cmn_DEFAULT_RTE_CALPRM_GROUP.HwAgTrakgServoMaxCmdY_Ary1D" 0 DISPLAY_IDENTIFIER HwAgTrakgServo.CalibrationPorts.HwAgTrakgServoMaxCmdY.Ary1D /end CHARACTERISTIC
/begin CHARACTERISTIC HwAgTrakgServo.HwAgTrakgServoMaxRamp.Val "MICROSAR RTE" VALUE 0x0 RTE_RL_FLOAT32_IEEE 0 NO_COMPU_METHOD -3.402823466e+38 3.402823466e+38 SYMBOL_LINK "Rte_CalprmRom_CalRegn03Cmn_DEFAULT_RTE_CALPRM_GROUP.HwAgTrakgServoMaxRamp_Val" 0 DISPLAY_IDENTIFIER HwAgTrakgServo.CalibrationPorts.HwAgTrakgServoMaxRamp.Val /end CHARACTERISTIC
/begin CHARACTERISTIC HwAgTrakgServo.HwAgTrakgServoMinRamp.Val "MICROSAR RTE" VALUE 0x0 RTE_RL_FLOAT32_IEEE 0 NO_COMPU_METHOD -3.402823466e+38 3.402823466e+38 SYMBOL_LINK "Rte_CalprmRom_CalRegn03Cmn_DEFAULT_RTE_CALPRM_GROUP.HwAgTrakgServoMinRamp_Val" 0 DISPLAY_IDENTIFIER HwAgTrakgServo.CalibrationPorts.HwAgTrakgServoMinRamp.Val /end CHARACTERISTIC
/begin CHARACTERISTIC HwAgTrakgServo.HwAgTrakgServoPidLim.Val "MICROSAR RTE" VALUE 0x0 RTE_RL_FLOAT32_IEEE 0 NO_COMPU_METHOD -3.402823466e+38 3.402823466e+38 SYMBOL_LINK "Rte_CalprmRom_CalRegn03Cmn_DEFAULT_RTE_CALPRM_GROUP.HwAgTrakgServoPidLim_Val" 0 DISPLAY_IDENTIFIER HwAgTrakgServo.CalibrationPorts.HwAgTrakgServoPidLim.Val /end CHARACTERISTIC
/begin CHARACTERISTIC HwAgTrakgServo.HwAgTrakgServoPropGainX.Ary1D "MICROSAR RTE" VAL_BLK 0x0 RTE_RL_UWORD 0 NO_COMPU_METHOD 0 65535 MATRIX_DIM 7 1 1 SYMBOL_LINK "Rte_CalprmRom_CalRegn03Inin00GroupC_DEFAULT_RTE_CALPRM_GROUP.HwAgTrakgServoPropGainX_Ary1D" 0 DISPLAY_IDENTIFIER HwAgTrakgServo.CalibrationPorts.HwAgTrakgServoPropGainX.Ary1D /end CHARACTERISTIC
/begin CHARACTERISTIC HwAgTrakgServo.HwAgTrakgServoPropGainY.Ary2D "MICROSAR RTE" VAL_BLK 0x0 RTE_RL_UWORD 0 NO_COMPU_METHOD 0 65535 MATRIX_DIM 7 3 1 SYMBOL_LINK "Rte_CalprmRom_CalRegn03Inin00GroupC_DEFAULT_RTE_CALPRM_GROUP.HwAgTrakgServoPropGainY_Ary2D" 0 DISPLAY_IDENTIFIER HwAgTrakgServo.CalibrationPorts.HwAgTrakgServoPropGainY.Ary2D /end CHARACTERISTIC
/begin CHARACTERISTIC HwAgTrakgServo.HwAgTrakgServoRampCmpl.Val "MICROSAR RTE" VALUE 0x0 RTE_RL_FLOAT32_IEEE 0 NO_COMPU_METHOD -3.402823466e+38 3.402823466e+38 SYMBOL_LINK "Rte_CalprmRom_CalRegn03Cmn_DEFAULT_RTE_CALPRM_GROUP.HwAgTrakgServoRampCmpl_Val" 0 DISPLAY_IDENTIFIER HwAgTrakgServo.CalibrationPorts.HwAgTrakgServoRampCmpl.Val /end CHARACTERISTIC
/begin CHARACTERISTIC HwAgTrakgServo.HwAgTrakgServoSmotngX.Ary1D "MICROSAR RTE" VAL_BLK 0x0 RTE_RL_UWORD 0 NO_COMPU_METHOD 0 65535 MATRIX_DIM 10 1 1 SYMBOL_LINK "Rte_CalprmRom_CalRegn03Inin00GroupC_DEFAULT_RTE_CALPRM_GROUP.HwAgTrakgServoSmotngX_Ary1D" 0 DISPLAY_IDENTIFIER HwAgTrakgServo.CalibrationPorts.HwAgTrakgServoSmotngX.Ary1D /end CHARACTERISTIC
/begin CHARACTERISTIC HwAgTrakgServo.HwAgTrakgServoSmotngY.Ary1D "MICROSAR RTE" VAL_BLK 0x0 RTE_RL_UWORD 0 NO_COMPU_METHOD 0 65535 MATRIX_DIM 10 1 1 SYMBOL_LINK "Rte_CalprmRom_CalRegn03Inin00_DEFAULT_RTE_CALPRM_GROUP.HwAgTrakgServoSmotngY_Ary1D" 0 DISPLAY_IDENTIFIER HwAgTrakgServo.CalibrationPorts.HwAgTrakgServoSmotngY.Ary1D /end CHARACTERISTIC
/begin CHARACTERISTIC HwAgTrakgServo.HwAgTrakgServoVehSpdBasd.Ary1D "MICROSAR RTE" VAL_BLK 0x0 RTE_RL_UWORD 0 NO_COMPU_METHOD 0 65535 MATRIX_DIM 3 1 1 SYMBOL_LINK "Rte_CalprmRom_CalRegn03Cmn_DEFAULT_RTE_CALPRM_GROUP.HwAgTrakgServoVehSpdBasd_Ary1D" 0 DISPLAY_IDENTIFIER HwAgTrakgServo.CalibrationPorts.HwAgTrakgServoVehSpdBasd.Ary1D /end CHARACTERISTIC
/begin CHARACTERISTIC HwAgVehCentrTrim.HwAgTrimDataDft.TrimPrfmd "MICROSAR RTE" VALUE 0x0 RTE_RL_BOOLEAN 0 RTE_CM_BOOLEAN 0 255 SYMBOL_LINK "Rte_CalprmRom_HwAgVehCentrTrim_DEFAULT_RTE_CDATA_GROUP.HwAgTrimDataDft.TrimPrfmd" 0 DISPLAY_IDENTIFIER HwAgVehCentrTrim.CalibrationParameters.HwAgTrimDataDft.TrimPrfmd /end CHARACTERISTIC
/begin CHARACTERISTIC HwAgVehCentrTrim.HwAgTrimDataDft.TrimVal "MICROSAR RTE" VALUE 0x0 RTE_RL_FLOAT32_IEEE 0 NO_COMPU_METHOD -3.402823466e+38 3.402823466e+38 SYMBOL_LINK "Rte_CalprmRom_HwAgVehCentrTrim_DEFAULT_RTE_CDATA_GROUP.HwAgTrimDataDft.TrimVal" 0 DISPLAY_IDENTIFIER HwAgVehCentrTrim.CalibrationParameters.HwAgTrimDataDft.TrimVal /end CHARACTERISTIC
/begin CHARACTERISTIC HwAgVehCentrTrim.HwAgVehCentrTrimHwAgLim.Val "MICROSAR RTE" VALUE 0x0 RTE_RL_FLOAT32_IEEE 0 NO_COMPU_METHOD -3.402823466e+38 3.402823466e+38 SYMBOL_LINK "Rte_CalprmRom_CalRegn01CmnGroupC_DEFAULT_RTE_CALPRM_GROUP.HwAgVehCentrTrimHwAgLim_Val" 0 DISPLAY_IDENTIFIER HwAgVehCentrTrim.CalibrationPorts.HwAgVehCentrTrimHwAgLim.Val /end CHARACTERISTIC
/begin CHARACTERISTIC HwAgVehCentrTrim.HwAgVehCentrTrimVehSpdMaxThd.Val "MICROSAR RTE" VALUE 0x0 RTE_RL_FLOAT32_IEEE 0 NO_COMPU_METHOD -3.402823466e+38 3.402823466e+38 SYMBOL_LINK "Rte_CalprmRom_CalRegn01CmnGroupC_DEFAULT_RTE_CALPRM_GROUP.HwAgVehCentrTrimVehSpdMaxThd_Val" 0 DISPLAY_IDENTIFIER HwAgVehCentrTrim.CalibrationPorts.HwAgVehCentrTrimVehSpdMaxThd.Val /end CHARACTERISTIC
/begin CHARACTERISTIC HwTqArbn.HwTqArbnMaxStallTqA.Val "MICROSAR RTE" VALUE 0x0 RTE_RL_UBYTE 0 NO_COMPU_METHOD 0 255 SYMBOL_LINK "Rte_CalprmRom_CalRegn01Cmn_DEFAULT_RTE_CALPRM_GROUP.HwTqArbnMaxStallTqA_Val" 0 DISPLAY_IDENTIFIER HwTqArbn.CalibrationPorts.HwTqArbnMaxStallTqA.Val /end CHARACTERISTIC
/begin CHARACTERISTIC HwTqArbn.HwTqArbnMaxStallTqB.Val "MICROSAR RTE" VALUE 0x0 RTE_RL_UBYTE 0 NO_COMPU_METHOD 0 255 SYMBOL_LINK "Rte_CalprmRom_CalRegn01Cmn_DEFAULT_RTE_CALPRM_GROUP.HwTqArbnMaxStallTqB_Val" 0 DISPLAY_IDENTIFIER HwTqArbn.CalibrationPorts.HwTqArbnMaxStallTqB.Val /end CHARACTERISTIC
/begin CHARACTERISTIC HwTqArbn.HwTqArbnMaxStallTqC.Val "MICROSAR RTE" VALUE 0x0 RTE_RL_UBYTE 0 NO_COMPU_METHOD 0 255 SYMBOL_LINK "Rte_CalprmRom_CalRegn01Cmn_DEFAULT_RTE_CALPRM_GROUP.HwTqArbnMaxStallTqC_Val" 0 DISPLAY_IDENTIFIER HwTqArbn.CalibrationPorts.HwTqArbnMaxStallTqC.Val /end CHARACTERISTIC
/begin CHARACTERISTIC HwTqArbn.HwTqArbnMaxStallTqD.Val "MICROSAR RTE" VALUE 0x0 RTE_RL_UBYTE 0 NO_COMPU_METHOD 0 255 SYMBOL_LINK "Rte_CalprmRom_CalRegn01Cmn_DEFAULT_RTE_CALPRM_GROUP.HwTqArbnMaxStallTqD_Val" 0 DISPLAY_IDENTIFIER HwTqArbn.CalibrationPorts.HwTqArbnMaxStallTqD.Val /end CHARACTERISTIC
/begin MEASUREMENT HwAg1Meas.HwAg1Offs.OffsTrim "MICROSAR RTE" FLOAT32_IEEE NO_COMPU_METHOD 0 0 -900.0 900.0 ECU_ADDRESS 0 SYMBOL_LINK "Rte_HwAg1Meas_HwAg1Offs.OffsTrim" 0 DISPLAY_IDENTIFIER HwAg1Meas.PerInstanceMemories.HwAg1Offs.OffsTrim /end MEASUREMENT
/begin MEASUREMENT HwAg1Meas.HwAg1Offs.OffsTrimPrfmdSts "MICROSAR RTE" UBYTE RTE_CM_BOOLEAN 0 0 0 255 ECU_ADDRESS 0 SYMBOL_LINK "Rte_HwAg1Meas_HwAg1Offs.OffsTrimPrfmdSts" 0 DISPLAY_IDENTIFIER HwAg1Meas.PerInstanceMemories.HwAg1Offs.OffsTrimPrfmdSts /end MEASUREMENT
/begin MEASUREMENT HwAg1Meas.HwAg1Polarity.Val "MICROSAR RTE" SBYTE NO_COMPU_METHOD 0 0 -1.0 1.0 ECU_ADDRESS 0 SYMBOL_LINK "Rte_PolarityCfg_HwAg1Polarity_Val" 0 DISPLAY_IDENTIFIER HwAg1Meas.ReceiverPorts.HwAg1Polarity.Val /end MEASUREMENT
/begin MEASUREMENT HwAg1Meas.HwAg1PrevHwAg1 "MICROSAR RTE" FLOAT32_IEEE NO_COMPU_METHOD 0 0 -900.0 900.0 ECU_ADDRESS 0 SYMBOL_LINK "Rte_HwAg1Meas_HwAg1PrevHwAg1" 0 DISPLAY_IDENTIFIER HwAg1Meas.PerInstanceMemories.HwAg1PrevHwAg1 /end MEASUREMENT
/begin MEASUREMENT HwAg1Meas.HwAg1PrevRollCnt "MICROSAR RTE" UBYTE NO_COMPU_METHOD 0 0 0.0 255.0 ECU_ADDRESS 0 SYMBOL_LINK "Rte_HwAg1Meas_HwAg1PrevRollCnt" 0 DISPLAY_IDENTIFIER HwAg1Meas.PerInstanceMemories.HwAg1PrevRollCnt /end MEASUREMENT
/begin MEASUREMENT HwAg1Meas.HwAg1PrevStepSeqNr "MICROSAR RTE" UBYTE NO_COMPU_METHOD 0 0 0.0 22.0 ECU_ADDRESS 0 SYMBOL_LINK "Rte_HwAg1Meas_HwAg1PrevStepSeqNr" 0 DISPLAY_IDENTIFIER HwAg1Meas.PerInstanceMemories.HwAg1PrevStepSeqNr /end MEASUREMENT
/begin MEASUREMENT HwAg1Meas.HwAg1Qlfr.Val "MICROSAR RTE" UBYTE RTE_CM_ENUM_SigQlfr1 0 0 0 255 ECU_ADDRESS 0 SYMBOL_LINK "Rte_HwAg1Meas_HwAg1Qlfr_Val" 0 DISPLAY_IDENTIFIER HwAg1Meas.SenderPorts.HwAg1Qlfr.Val /end MEASUREMENT
/begin MEASUREMENT HwAg1Meas.HwAg1RawDataAvlStrtTi "MICROSAR RTE" ULONG NO_COMPU_METHOD 0 0 0 4294967295 ECU_ADDRESS 0 SYMBOL_LINK "Rte_HwAg1Meas_HwAg1RawDataAvlStrtTi" 0 DISPLAY_IDENTIFIER HwAg1Meas.PerInstanceMemories.HwAg1RawDataAvlStrtTi /end MEASUREMENT
/begin MEASUREMENT HwAg1Meas.HwAg1RollgCntr.Val "MICROSAR RTE" UBYTE NO_COMPU_METHOD 0 0 0.0 255.0 ECU_ADDRESS 0 SYMBOL_LINK "Rte_HwAg1Meas_HwAg1RollgCntr_Val" 0 DISPLAY_IDENTIFIER HwAg1Meas.SenderPorts.HwAg1RollgCntr.Val /end MEASUREMENT
/begin MEASUREMENT HwAg1Meas.HwAg1Snsr0ComStsErrCntr "MICROSAR RTE" UBYTE NO_COMPU_METHOD 0 0 0 255 ECU_ADDRESS 0 SYMBOL_LINK "Rte_HwAg1Meas_HwAg1Snsr0ComStsErrCntr" 0 DISPLAY_IDENTIFIER HwAg1Meas.PerInstanceMemories.HwAg1Snsr0ComStsErrCntr /end MEASUREMENT
/begin MEASUREMENT HwAg1Meas.HwAg1Snsr0IdErrCntr "MICROSAR RTE" UBYTE NO_COMPU_METHOD 0 0 0 255 ECU_ADDRESS 0 SYMBOL_LINK "Rte_HwAg1Meas_HwAg1Snsr0IdErrCntr" 0 DISPLAY_IDENTIFIER HwAg1Meas.PerInstanceMemories.HwAg1Snsr0IdErrCntr /end MEASUREMENT
/begin MEASUREMENT HwAg1Meas.HwAg1Snsr0IntSnsrErrCntr "MICROSAR RTE" UBYTE NO_COMPU_METHOD 0 0 0 255 ECU_ADDRESS 0 SYMBOL_LINK "Rte_HwAg1Meas_HwAg1Snsr0IntSnsrErrCntr" 0 DISPLAY_IDENTIFIER HwAg1Meas.PerInstanceMemories.HwAg1Snsr0IntSnsrErrCntr /end MEASUREMENT
/begin MEASUREMENT HwAg1Meas.HwAg1Snsr0NoMsgErrCntr "MICROSAR RTE" UBYTE NO_COMPU_METHOD 0 0 0 255 ECU_ADDRESS 0 SYMBOL_LINK "Rte_HwAg1Meas_HwAg1Snsr0NoMsgErrCntr" 0 DISPLAY_IDENTIFIER HwAg1Meas.PerInstanceMemories.HwAg1Snsr0NoMsgErrCntr /end MEASUREMENT
/begin MEASUREMENT HwAg1Meas.HwAg1Snsr1ComStsErrCntr "MICROSAR RTE" UBYTE NO_COMPU_METHOD 0 0 0 255 ECU_ADDRESS 0 SYMBOL_LINK "Rte_HwAg1Meas_HwAg1Snsr1ComStsErrCntr" 0 DISPLAY_IDENTIFIER HwAg1Meas.PerInstanceMemories.HwAg1Snsr1ComStsErrCntr /end MEASUREMENT
/begin MEASUREMENT HwAg1Meas.HwAg1Snsr1IdErrCntr "MICROSAR RTE" UBYTE NO_COMPU_METHOD 0 0 0 255 ECU_ADDRESS 0 SYMBOL_LINK "Rte_HwAg1Meas_HwAg1Snsr1IdErrCntr" 0 DISPLAY_IDENTIFIER HwAg1Meas.PerInstanceMemories.HwAg1Snsr1IdErrCntr /end MEASUREMENT
/begin MEASUREMENT HwAg1Meas.HwAg1Snsr1IntSnsrErrCntr "MICROSAR RTE" UBYTE NO_COMPU_METHOD 0 0 0 255 ECU_ADDRESS 0 SYMBOL_LINK "Rte_HwAg1Meas_HwAg1Snsr1IntSnsrErrCntr" 0 DISPLAY_IDENTIFIER HwAg1Meas.PerInstanceMemories.HwAg1Snsr1IntSnsrErrCntr /end MEASUREMENT
/begin MEASUREMENT HwAg1Meas.HwAg1Snsr1NoMsgErrCntr "MICROSAR RTE" UBYTE NO_COMPU_METHOD 0 0 0 255 ECU_ADDRESS 0 SYMBOL_LINK "Rte_HwAg1Meas_HwAg1Snsr1NoMsgErrCntr" 0 DISPLAY_IDENTIFIER HwAg1Meas.PerInstanceMemories.HwAg1Snsr1NoMsgErrCntr /end MEASUREMENT
/begin MEASUREMENT HwAg1Meas.HwAg1SnsrTrigNr "MICROSAR RTE" UBYTE NO_COMPU_METHOD 0 0 0 255 ECU_ADDRESS 0 SYMBOL_LINK "Rte_HwAg1Meas_HwAg1SnsrTrigNr" 0 DISPLAY_IDENTIFIER HwAg1Meas.PerInstanceMemories.HwAg1SnsrTrigNr /end MEASUREMENT
/begin MEASUREMENT HwAg1Meas.PrevHwAg1 "MICROSAR RTE" FLOAT32_IEEE NO_COMPU_METHOD 0 0 -3.402823466e+38 3.402823466e+38 ECU_ADDRESS 0 SYMBOL_LINK "Rte_HwAg1Meas_PrevHwAg1" 0 DISPLAY_IDENTIFIER HwAg1Meas.PerInstanceMemories.PrevHwAg1 /end MEASUREMENT
/begin MEASUREMENT HwAg1Meas.PrevHwAg1Qlfr "MICROSAR RTE" UBYTE RTE_CM_ENUM_SigQlfr1 0 0 0 255 ECU_ADDRESS 0 SYMBOL_LINK "Rte_HwAg1Meas_PrevHwAg1Qlfr" 0 DISPLAY_IDENTIFIER HwAg1Meas.PerInstanceMemories.PrevHwAg1Qlfr /end MEASUREMENT
/begin MEASUREMENT HwAg1Meas.PrevHwAg1Snsr0Raw "MICROSAR RTE" UWORD NO_COMPU_METHOD 0 0 0 65535 ECU_ADDRESS 0 SYMBOL_LINK "Rte_HwAg1Meas_PrevHwAg1Snsr0Raw" 0 DISPLAY_IDENTIFIER HwAg1Meas.PerInstanceMemories.PrevHwAg1Snsr0Raw /end MEASUREMENT
/begin MEASUREMENT HwAg1Meas.PrevHwAg1Snsr0TestOk "MICROSAR RTE" UBYTE NO_COMPU_METHOD 0 0 0 255 ECU_ADDRESS 0 SYMBOL_LINK "Rte_HwAg1Meas_PrevHwAg1Snsr0TestOk" 0 DISPLAY_IDENTIFIER HwAg1Meas.PerInstanceMemories.PrevHwAg1Snsr0TestOk /end MEASUREMENT
/begin MEASUREMENT HwAg1Meas.PrevHwAg1Snsr1Raw "MICROSAR RTE" UWORD NO_COMPU_METHOD 0 0 0 65535 ECU_ADDRESS 0 SYMBOL_LINK "Rte_HwAg1Meas_PrevHwAg1Snsr1Raw" 0 DISPLAY_IDENTIFIER HwAg1Meas.PerInstanceMemories.PrevHwAg1Snsr1Raw /end MEASUREMENT
/begin MEASUREMENT HwAg1Meas.PrevHwAg1Snsr1TestOk "MICROSAR RTE" UBYTE NO_COMPU_METHOD 0 0 0 255 ECU_ADDRESS 0 SYMBOL_LINK "Rte_HwAg1Meas_PrevHwAg1Snsr1TestOk" 0 DISPLAY_IDENTIFIER HwAg1Meas.PerInstanceMemories.PrevHwAg1Snsr1TestOk /end MEASUREMENT
/begin MEASUREMENT HwAg1Meas.dHwAg1MeasSnsr0Abs "MICROSAR RTE" FLOAT32_IEEE NO_COMPU_METHOD 0 0 -900.0 900.0 ECU_ADDRESS 0 SYMBOL_LINK "Rte_HwAg1Meas_dHwAg1MeasSnsr0Abs" 0 DISPLAY_IDENTIFIER HwAg1Meas.PerInstanceMemories.dHwAg1MeasSnsr0Abs /end MEASUREMENT
/begin MEASUREMENT HwAg1Meas.dHwAg1MeasSnsr0CS "MICROSAR RTE" ULONG NO_COMPU_METHOD 0 0 0 4294967295 ECU_ADDRESS 0 SYMBOL_LINK "Rte_HwAg1Meas_dHwAg1MeasSnsr0CS" 0 DISPLAY_IDENTIFIER HwAg1Meas.PerInstanceMemories.dHwAg1MeasSnsr0CS /end MEASUREMENT
/begin MEASUREMENT HwAg1Meas.dHwAg1MeasSnsr0FRXD "MICROSAR RTE" ULONG NO_COMPU_METHOD 0 0 0 4294967295 ECU_ADDRESS 0 SYMBOL_LINK "Rte_HwAg1Meas_dHwAg1MeasSnsr0FRXD" 0 DISPLAY_IDENTIFIER HwAg1Meas.PerInstanceMemories.dHwAg1MeasSnsr0FRXD /end MEASUREMENT
/begin MEASUREMENT HwAg1Meas.dHwAg1MeasSnsr0Rel "MICROSAR RTE" FLOAT32_IEEE NO_COMPU_METHOD 0 0 0.0 360.0 ECU_ADDRESS 0 SYMBOL_LINK "Rte_HwAg1Meas_dHwAg1MeasSnsr0Rel" 0 DISPLAY_IDENTIFIER HwAg1Meas.PerInstanceMemories.dHwAg1MeasSnsr0Rel /end MEASUREMENT
/begin MEASUREMENT HwAg1Meas.dHwAg1MeasSnsr1Abs "MICROSAR RTE" FLOAT32_IEEE NO_COMPU_METHOD 0 0 -900.0 900.0 ECU_ADDRESS 0 SYMBOL_LINK "Rte_HwAg1Meas_dHwAg1MeasSnsr1Abs" 0 DISPLAY_IDENTIFIER HwAg1Meas.PerInstanceMemories.dHwAg1MeasSnsr1Abs /end MEASUREMENT
/begin MEASUREMENT HwAg1Meas.dHwAg1MeasSnsr1CS "MICROSAR RTE" ULONG NO_COMPU_METHOD 0 0 0 4294967295 ECU_ADDRESS 0 SYMBOL_LINK "Rte_HwAg1Meas_dHwAg1MeasSnsr1CS" 0 DISPLAY_IDENTIFIER HwAg1Meas.PerInstanceMemories.dHwAg1MeasSnsr1CS /end MEASUREMENT
/begin MEASUREMENT HwAg1Meas.dHwAg1MeasSnsr1FRXD "MICROSAR RTE" ULONG NO_COMPU_METHOD 0 0 0 4294967295 ECU_ADDRESS 0 SYMBOL_LINK "Rte_HwAg1Meas_dHwAg1MeasSnsr1FRXD" 0 DISPLAY_IDENTIFIER HwAg1Meas.PerInstanceMemories.dHwAg1MeasSnsr1FRXD /end MEASUREMENT
/begin MEASUREMENT HwAg1Meas.dHwAg1MeasSnsr1Rel "MICROSAR RTE" FLOAT32_IEEE NO_COMPU_METHOD 0 0 0.0 360.0 ECU_ADDRESS 0 SYMBOL_LINK "Rte_HwAg1Meas_dHwAg1MeasSnsr1Rel" 0 DISPLAY_IDENTIFIER HwAg1Meas.PerInstanceMemories.dHwAg1MeasSnsr1Rel /end MEASUREMENT
/begin MEASUREMENT HwAgArbn.HwAg.Val "MICROSAR RTE" FLOAT32_IEEE NO_COMPU_METHOD 0 0 -3.402823466e+38 3.402823466e+38 ECU_ADDRESS 0 SYMBOL_LINK "Rte_HwAgArbn_HwAg_Val" 0 DISPLAY_IDENTIFIER HwAgArbn.SenderPorts.HwAg.Val /end MEASUREMENT
/begin MEASUREMENT HwAgArbn.HwAgA.Val "MICROSAR RTE" FLOAT32_IEEE NO_COMPU_METHOD 0 0 -3.402823466e+38 3.402823466e+38 ECU_ADDRESS 0 SYMBOL_LINK "Rte_HwAg0Meas_HwAg0_Val" 0 DISPLAY_IDENTIFIER HwAgArbn.ReceiverPorts.HwAgA.Val /end MEASUREMENT
/begin MEASUREMENT HwAgArbn.HwAgAQlfr.Val "MICROSAR RTE" UBYTE RTE_CM_ENUM_SigQlfr1 0 0 0 255 ECU_ADDRESS 0 SYMBOL_LINK "Rte_HwAg0Meas_HwAg0Qlfr_Val" 0 DISPLAY_IDENTIFIER HwAgArbn.ReceiverPorts.HwAgAQlfr.Val /end MEASUREMENT
/begin MEASUREMENT HwAgArbn.HwAgARollgCntr.Val "MICROSAR RTE" UBYTE NO_COMPU_METHOD 0 0 0 255 ECU_ADDRESS 0 SYMBOL_LINK "Rte_HwAg0Meas_HwAg0RollgCntr_Val" 0 DISPLAY_IDENTIFIER HwAgArbn.ReceiverPorts.HwAgARollgCntr.Val /end MEASUREMENT
/begin MEASUREMENT HwAgArbn.HwAgARollgCntrPrev "MICROSAR RTE" UBYTE NO_COMPU_METHOD 0 0 0 255 ECU_ADDRESS 0 SYMBOL_LINK "Rte_HwAgArbn_HwAgARollgCntrPrev" 0 DISPLAY_IDENTIFIER HwAgArbn.PerInstanceMemories.HwAgARollgCntrPrev /end MEASUREMENT
/begin MEASUREMENT HwAgArbn.HwAgAStallCntrPrev "MICROSAR RTE" UBYTE NO_COMPU_METHOD 0 0 0 255 ECU_ADDRESS 0 SYMBOL_LINK "Rte_HwAgArbn_HwAgAStallCntrPrev" 0 DISPLAY_IDENTIFIER HwAgArbn.PerInstanceMemories.HwAgAStallCntrPrev /end MEASUREMENT
/begin MEASUREMENT HwAgArbn.HwAgB.Val "MICROSAR RTE" FLOAT32_IEEE NO_COMPU_METHOD 0 0 -3.402823466e+38 3.402823466e+38 ECU_ADDRESS 0 SYMBOL_LINK "Rte_HwAg1Meas_HwAg1_Val" 0 DISPLAY_IDENTIFIER HwAgArbn.ReceiverPorts.HwAgB.Val /end MEASUREMENT
/begin MEASUREMENT HwAgArbn.HwAgBQlfr.Val "MICROSAR RTE" UBYTE RTE_CM_ENUM_SigQlfr1 0 0 0 255 ECU_ADDRESS 0 SYMBOL_LINK "Rte_HwAg1Meas_HwAg1Qlfr_Val" 0 DISPLAY_IDENTIFIER HwAgArbn.ReceiverPorts.HwAgBQlfr.Val /end MEASUREMENT
/begin MEASUREMENT HwAgArbn.HwAgBRollgCntr.Val "MICROSAR RTE" UBYTE NO_COMPU_METHOD 0 0 0 255 ECU_ADDRESS 0 SYMBOL_LINK "Rte_HwAg1Meas_HwAg1RollgCntr_Val" 0 DISPLAY_IDENTIFIER HwAgArbn.ReceiverPorts.HwAgBRollgCntr.Val /end MEASUREMENT
/begin MEASUREMENT HwAgArbn.HwAgBRollgCntrPrev "MICROSAR RTE" UBYTE NO_COMPU_METHOD 0 0 0 255 ECU_ADDRESS 0 SYMBOL_LINK "Rte_HwAgArbn_HwAgBRollgCntrPrev" 0 DISPLAY_IDENTIFIER HwAgArbn.PerInstanceMemories.HwAgBRollgCntrPrev /end MEASUREMENT
/begin MEASUREMENT HwAgArbn.HwAgBStallCntrPrev "MICROSAR RTE" UBYTE NO_COMPU_METHOD 0 0 0 255 ECU_ADDRESS 0 SYMBOL_LINK "Rte_HwAgArbn_HwAgBStallCntrPrev" 0 DISPLAY_IDENTIFIER HwAgArbn.PerInstanceMemories.HwAgBStallCntrPrev /end MEASUREMENT
/begin MEASUREMENT HwAgArbn.HwAgCorrlnSt.Val "MICROSAR RTE" UBYTE NO_COMPU_METHOD 0 0 0 255 ECU_ADDRESS 0 SYMBOL_LINK "Rte_HwAgCorrln_HwAgCorrlnSt_Val" 0 DISPLAY_IDENTIFIER HwAgArbn.ReceiverPorts.HwAgCorrlnSt.Val /end MEASUREMENT
/begin MEASUREMENT HwAgArbn.HwAgPrev "MICROSAR RTE" FLOAT32_IEEE NO_COMPU_METHOD 0 0 -3.402823466e+38 3.402823466e+38 ECU_ADDRESS 0 SYMBOL_LINK "Rte_HwAgArbn_HwAgPrev" 0 DISPLAY_IDENTIFIER HwAgArbn.PerInstanceMemories.HwAgPrev /end MEASUREMENT
/begin MEASUREMENT HwAgArbn.dHwAgArbnAgAAvl "MICROSAR RTE" UBYTE RTE_CM_BOOLEAN 0 0 0 255 ECU_ADDRESS 0 SYMBOL_LINK "Rte_HwAgArbn_dHwAgArbnAgAAvl" 0 DISPLAY_IDENTIFIER HwAgArbn.PerInstanceMemories.dHwAgArbnAgAAvl /end MEASUREMENT
/begin MEASUREMENT HwAgArbn.dHwAgArbnAgBAvl "MICROSAR RTE" UBYTE RTE_CM_BOOLEAN 0 0 0 255 ECU_ADDRESS 0 SYMBOL_LINK "Rte_HwAgArbn_dHwAgArbnAgBAvl" 0 DISPLAY_IDENTIFIER HwAgArbn.PerInstanceMemories.dHwAgArbnAgBAvl /end MEASUREMENT
/begin MEASUREMENT HwAgCorrln.HwAgA.Val "MICROSAR RTE" FLOAT32_IEEE NO_COMPU_METHOD 0 0 -3.402823466e+38 3.402823466e+38 ECU_ADDRESS 0 SYMBOL_LINK "Rte_HwAg0Meas_HwAg0_Val" 0 DISPLAY_IDENTIFIER HwAgCorrln.ReceiverPorts.HwAgA.Val /end MEASUREMENT
/begin MEASUREMENT HwAgCorrln.HwAgAQlfr.Val "MICROSAR RTE" UBYTE RTE_CM_ENUM_SigQlfr1 0 0 0 255 ECU_ADDRESS 0 SYMBOL_LINK "Rte_HwAg0Meas_HwAg0Qlfr_Val" 0 DISPLAY_IDENTIFIER HwAgCorrln.ReceiverPorts.HwAgAQlfr.Val /end MEASUREMENT
/begin MEASUREMENT HwAgCorrln.HwAgARollgCntPrev "MICROSAR RTE" UBYTE NO_COMPU_METHOD 0 0 0 255 ECU_ADDRESS 0 SYMBOL_LINK "Rte_HwAgCorrln_HwAgARollgCntPrev" 0 DISPLAY_IDENTIFIER HwAgCorrln.PerInstanceMemories.HwAgARollgCntPrev /end MEASUREMENT
/begin MEASUREMENT HwAgCorrln.HwAgARollgCntr.Val "MICROSAR RTE" UBYTE NO_COMPU_METHOD 0 0 0 255 ECU_ADDRESS 0 SYMBOL_LINK "Rte_HwAg0Meas_HwAg0RollgCntr_Val" 0 DISPLAY_IDENTIFIER HwAgCorrln.ReceiverPorts.HwAgARollgCntr.Val /end MEASUREMENT
/begin MEASUREMENT HwAgCorrln.HwAgAStallCntPrev "MICROSAR RTE" UBYTE NO_COMPU_METHOD 0 0 0 255 ECU_ADDRESS 0 SYMBOL_LINK "Rte_HwAgCorrln_HwAgAStallCntPrev" 0 DISPLAY_IDENTIFIER HwAgCorrln.PerInstanceMemories.HwAgAStallCntPrev /end MEASUREMENT
/begin MEASUREMENT HwAgCorrln.HwAgB.Val "MICROSAR RTE" FLOAT32_IEEE NO_COMPU_METHOD 0 0 -3.402823466e+38 3.402823466e+38 ECU_ADDRESS 0 SYMBOL_LINK "Rte_HwAg1Meas_HwAg1_Val" 0 DISPLAY_IDENTIFIER HwAgCorrln.ReceiverPorts.HwAgB.Val /end MEASUREMENT
/begin MEASUREMENT HwAgCorrln.HwAgBARollgCntr.Val "MICROSAR RTE" UBYTE NO_COMPU_METHOD 0 0 0 255 ECU_ADDRESS 0 SYMBOL_LINK "Rte_HwAg1Meas_HwAg1RollgCntr_Val" 0 DISPLAY_IDENTIFIER HwAgCorrln.ReceiverPorts.HwAgBARollgCntr.Val /end MEASUREMENT
/begin MEASUREMENT HwAgCorrln.HwAgBQlfr.Val "MICROSAR RTE" UBYTE RTE_CM_ENUM_SigQlfr1 0 0 0 255 ECU_ADDRESS 0 SYMBOL_LINK "Rte_HwAg1Meas_HwAg1Qlfr_Val" 0 DISPLAY_IDENTIFIER HwAgCorrln.ReceiverPorts.HwAgBQlfr.Val /end MEASUREMENT
/begin MEASUREMENT HwAgCorrln.HwAgBRollgCntPrev "MICROSAR RTE" UBYTE NO_COMPU_METHOD 0 0 0 255 ECU_ADDRESS 0 SYMBOL_LINK "Rte_HwAgCorrln_HwAgBRollgCntPrev" 0 DISPLAY_IDENTIFIER HwAgCorrln.PerInstanceMemories.HwAgBRollgCntPrev /end MEASUREMENT
/begin MEASUREMENT HwAgCorrln.HwAgBStallCntPrev "MICROSAR RTE" UBYTE NO_COMPU_METHOD 0 0 0 255 ECU_ADDRESS 0 SYMBOL_LINK "Rte_HwAgCorrln_HwAgBStallCntPrev" 0 DISPLAY_IDENTIFIER HwAgCorrln.PerInstanceMemories.HwAgBStallCntPrev /end MEASUREMENT
/begin MEASUREMENT HwAgCorrln.HwAgCorrlnSt.Val "MICROSAR RTE" UBYTE NO_COMPU_METHOD 0 0 0 255 ECU_ADDRESS 0 SYMBOL_LINK "Rte_HwAgCorrln_HwAgCorrlnSt_Val" 0 DISPLAY_IDENTIFIER HwAgCorrln.SenderPorts.HwAgCorrlnSt.Val /end MEASUREMENT
/begin MEASUREMENT HwAgCorrln.HwAgIdptSig.Val "MICROSAR RTE" UBYTE NO_COMPU_METHOD 0 0 0 255 ECU_ADDRESS 0 SYMBOL_LINK "Rte_HwAgCorrln_HwAgIdptSig_Val" 0 DISPLAY_IDENTIFIER HwAgCorrln.SenderPorts.HwAgIdptSig.Val /end MEASUREMENT
/begin MEASUREMENT HwAgCorrln.dHwAgCorrlnAgAAvl "MICROSAR RTE" UBYTE RTE_CM_BOOLEAN 0 0 0 255 ECU_ADDRESS 0 SYMBOL_LINK "Rte_HwAgCorrln_dHwAgCorrlnAgAAvl" 0 DISPLAY_IDENTIFIER HwAgCorrln.PerInstanceMemories.dHwAgCorrlnAgAAvl /end MEASUREMENT
/begin MEASUREMENT HwAgCorrln.dHwAgCorrlnAgBAvl "MICROSAR RTE" UBYTE RTE_CM_BOOLEAN 0 0 0 255 ECU_ADDRESS 0 SYMBOL_LINK "Rte_HwAgCorrln_dHwAgCorrlnAgBAvl" 0 DISPLAY_IDENTIFIER HwAgCorrln.PerInstanceMemories.dHwAgCorrlnAgBAvl /end MEASUREMENT
/begin MEASUREMENT HwAgSnsrls.CmplncErrMotToPinion.Val "MICROSAR RTE" FLOAT32_IEEE NO_COMPU_METHOD 0 0 -3.402823466e+38 3.402823466e+38 ECU_ADDRESS 0 SYMBOL_LINK "Rte_CmplncErr_CmplncErrMotToPinion_Val" 0 DISPLAY_IDENTIFIER HwAgSnsrls.ReceiverPorts.CmplncErrMotToPinion.Val /end MEASUREMENT
/begin MEASUREMENT HwAgSnsrls.CorrdPinionAgHwAgOffs "MICROSAR RTE" FLOAT32_IEEE NO_COMPU_METHOD 0 0 -3.402823466e+38 3.402823466e+38 ECU_ADDRESS 0 SYMBOL_LINK "Rte_HwAgSnsrls_CorrdPinionAgHwAgOffs" 0 DISPLAY_IDENTIFIER HwAgSnsrls.PerInstanceMemories.CorrdPinionAgHwAgOffs /end MEASUREMENT
/begin MEASUREMENT HwAgSnsrls.CorrdPinionAgHwConf "MICROSAR RTE" FLOAT32_IEEE NO_COMPU_METHOD 0 0 -3.402823466e+38 3.402823466e+38 ECU_ADDRESS 0 SYMBOL_LINK "Rte_HwAgSnsrls_CorrdPinionAgHwConf" 0 DISPLAY_IDENTIFIER HwAgSnsrls.PerInstanceMemories.CorrdPinionAgHwConf /end MEASUREMENT
/begin MEASUREMENT HwAgSnsrls.FCentrHwAgEna "MICROSAR RTE" UBYTE RTE_CM_BOOLEAN 0 0 0 255 ECU_ADDRESS 0 SYMBOL_LINK "Rte_HwAgSnsrls_FCentrHwAgEna" 0 DISPLAY_IDENTIFIER HwAgSnsrls.PerInstanceMemories.FCentrHwAgEna /end MEASUREMENT
/begin MEASUREMENT HwAgSnsrls.FCentrHwAgOffs "MICROSAR RTE" FLOAT32_IEEE NO_COMPU_METHOD 0 0 -3.402823466e+38 3.402823466e+38 ECU_ADDRESS 0 SYMBOL_LINK "Rte_HwAgSnsrls_FCentrHwAgOffs" 0 DISPLAY_IDENTIFIER HwAgSnsrls.PerInstanceMemories.FCentrHwAgOffs /end MEASUREMENT
/begin MEASUREMENT HwAgSnsrls.FCentrHwConf "MICROSAR RTE" FLOAT32_IEEE NO_COMPU_METHOD 0 0 -3.402823466e+38 3.402823466e+38 ECU_ADDRESS 0 SYMBOL_LINK "Rte_HwAgSnsrls_FCentrHwConf" 0 DISPLAY_IDENTIFIER HwAgSnsrls.PerInstanceMemories.FCentrHwConf /end MEASUREMENT
/begin MEASUREMENT HwAgSnsrls.HwAgSnsrls.Val "MICROSAR RTE" FLOAT32_IEEE NO_COMPU_METHOD 0 0 -3.402823466e+38 3.402823466e+38 ECU_ADDRESS 0 SYMBOL_LINK "Rte_HwAgSnsrls_HwAgSnsrls_Val" 0 DISPLAY_IDENTIFIER HwAgSnsrls.SenderPorts.HwAgSnsrls.Val /end MEASUREMENT
/begin MEASUREMENT HwAgSnsrls.HwAgSnsrlsConf.Val "MICROSAR RTE" FLOAT32_IEEE NO_COMPU_METHOD 0 0 -3.402823466e+38 3.402823466e+38 ECU_ADDRESS 0 SYMBOL_LINK "Rte_HwAgSnsrls_HwAgSnsrlsConf_Val" 0 DISPLAY_IDENTIFIER HwAgSnsrls.SenderPorts.HwAgSnsrlsConf.Val /end MEASUREMENT
/begin MEASUREMENT HwAgSnsrls.HwTq.Val "MICROSAR RTE" FLOAT32_IEEE NO_COMPU_METHOD 0 0 -3.402823466e+38 3.402823466e+38 ECU_ADDRESS 0 SYMBOL_LINK "Rte_Swp_HwTqSwp_Val" 0 DISPLAY_IDENTIFIER HwAgSnsrls.ReceiverPorts.HwTq.Val /end MEASUREMENT
/begin MEASUREMENT HwAgSnsrls.MotAgCumvAlgndCrf.Val "MICROSAR RTE" SLONG NO_COMPU_METHOD 0 0 -2147483648 2147483647 ECU_ADDRESS 0 SYMBOL_LINK "Rte_CDD_MotAgCmp_MotAgCumvAlgndCrf_Val" 0 DISPLAY_IDENTIFIER HwAgSnsrls.ReceiverPorts.MotAgCumvAlgndCrf.Val /end MEASUREMENT
/begin MEASUREMENT HwAgSnsrls.MotAgCumvAlgndVld.Logl "MICROSAR RTE" UBYTE RTE_CM_BOOLEAN 0 0 0 255 ECU_ADDRESS 0 SYMBOL_LINK "Rte_CDD_MotAgCmp_MotAgCumvAlgndVld_Logl" 0 DISPLAY_IDENTIFIER HwAgSnsrls.ReceiverPorts.MotAgCumvAlgndVld.Logl /end MEASUREMENT
/begin MEASUREMENT HwAgSnsrls.MotAgOffs "MICROSAR RTE" FLOAT32_IEEE NO_COMPU_METHOD 0 0 -3.402823466e+38 3.402823466e+38 ECU_ADDRESS 0 SYMBOL_LINK "Rte_HwAgSnsrls_MotAgOffs" 0 DISPLAY_IDENTIFIER HwAgSnsrls.PerInstanceMemories.MotAgOffs /end MEASUREMENT
/begin MEASUREMENT HwAgSnsrls.MotAgOffsEna "MICROSAR RTE" UBYTE RTE_CM_BOOLEAN 0 0 0 255 ECU_ADDRESS 0 SYMBOL_LINK "Rte_HwAgSnsrls_MotAgOffsEna" 0 DISPLAY_IDENTIFIER HwAgSnsrls.PerInstanceMemories.MotAgOffsEna /end MEASUREMENT
/begin MEASUREMENT HwAgSnsrls.MotTqCmdCrf.Val "MICROSAR RTE" FLOAT32_IEEE NO_COMPU_METHOD 0 0 -3.402823466e+38 3.402823466e+38 ECU_ADDRESS 0 SYMBOL_LINK "Rte_MotTqTranlDampg_MotTqCmdCrfDampd_Val" 0 DISPLAY_IDENTIFIER HwAgSnsrls.ReceiverPorts.MotTqCmdCrf.Val /end MEASUREMENT
/begin MEASUREMENT HwAgSnsrls.MotVelCrf.Val "MICROSAR RTE" FLOAT32_IEEE NO_COMPU_METHOD 0 0 -3.402823466e+38 3.402823466e+38 ECU_ADDRESS 0 SYMBOL_LINK "Rte_CDD_MotVel_MotVelCrf_Val" 0 DISPLAY_IDENTIFIER HwAgSnsrls.ReceiverPorts.MotVelCrf.Val /end MEASUREMENT
/begin MEASUREMENT HwAgSnsrls.PinionAg.Val "MICROSAR RTE" FLOAT32_IEEE NO_COMPU_METHOD 0 0 -3.402823466e+38 3.402823466e+38 ECU_ADDRESS 0 SYMBOL_LINK "Rte_HwAgSysArbn_PinionAg_Val" 0 DISPLAY_IDENTIFIER HwAgSnsrls.ReceiverPorts.PinionAg.Val /end MEASUREMENT
/begin MEASUREMENT HwAgSnsrls.PinionAgConf.Val "MICROSAR RTE" FLOAT32_IEEE NO_COMPU_METHOD 0 0 -3.402823466e+38 3.402823466e+38 ECU_ADDRESS 0 SYMBOL_LINK "Rte_HwAgSysArbn_PinionAgConf_Val" 0 DISPLAY_IDENTIFIER HwAgSnsrls.ReceiverPorts.PinionAgConf.Val /end MEASUREMENT
/begin MEASUREMENT HwAgSnsrls.PinionTqFil.FilGain "MICROSAR RTE" FLOAT32_IEEE NO_COMPU_METHOD 0 0 -3.402823466e+38 3.402823466e+38 ECU_ADDRESS 0 SYMBOL_LINK "Rte_HwAgSnsrls_PinionTqFil.FilGain" 0 DISPLAY_IDENTIFIER HwAgSnsrls.PerInstanceMemories.PinionTqFil.FilGain /end MEASUREMENT
/begin MEASUREMENT HwAgSnsrls.PinionTqFil.FilSt "MICROSAR RTE" FLOAT32_IEEE NO_COMPU_METHOD 0 0 -3.402823466e+38 3.402823466e+38 ECU_ADDRESS 0 SYMBOL_LINK "Rte_HwAgSnsrls_PinionTqFil.FilSt" 0 DISPLAY_IDENTIFIER HwAgSnsrls.PerInstanceMemories.PinionTqFil.FilSt /end MEASUREMENT
/begin MEASUREMENT HwAgSnsrls.PrevFildRelHwAg1 "MICROSAR RTE" FLOAT32_IEEE NO_COMPU_METHOD 0 0 -3.402823466e+38 3.402823466e+38 ECU_ADDRESS 0 SYMBOL_LINK "Rte_HwAgSnsrls_PrevFildRelHwAg1" 0 DISPLAY_IDENTIFIER HwAgSnsrls.PerInstanceMemories.PrevFildRelHwAg1 /end MEASUREMENT
/begin MEASUREMENT HwAgSnsrls.PrevHwAgOffs "MICROSAR RTE" FLOAT32_IEEE NO_COMPU_METHOD 0 0 -3.402823466e+38 3.402823466e+38 ECU_ADDRESS 0 SYMBOL_LINK "Rte_HwAgSnsrls_PrevHwAgOffs" 0 DISPLAY_IDENTIFIER HwAgSnsrls.PerInstanceMemories.PrevHwAgOffs /end MEASUREMENT
/begin MEASUREMENT HwAgSnsrls.PrevMaxHwConf "MICROSAR RTE" FLOAT32_IEEE NO_COMPU_METHOD 0 0 -3.402823466e+38 3.402823466e+38 ECU_ADDRESS 0 SYMBOL_LINK "Rte_HwAgSnsrls_PrevMaxHwConf" 0 DISPLAY_IDENTIFIER HwAgSnsrls.PerInstanceMemories.PrevMaxHwConf /end MEASUREMENT
/begin MEASUREMENT HwAgSnsrls.PrevSmotngHwAg "MICROSAR RTE" FLOAT32_IEEE NO_COMPU_METHOD 0 0 -3.402823466e+38 3.402823466e+38 ECU_ADDRESS 0 SYMBOL_LINK "Rte_HwAgSnsrls_PrevSmotngHwAg" 0 DISPLAY_IDENTIFIER HwAgSnsrls.PerInstanceMemories.PrevSmotngHwAg /end MEASUREMENT
/begin MEASUREMENT HwAgSnsrls.PrevSmotngSt "MICROSAR RTE" UBYTE RTE_CM_BOOLEAN 0 0 0 255 ECU_ADDRESS 0 SYMBOL_LINK "Rte_HwAgSnsrls_PrevSmotngSt" 0 DISPLAY_IDENTIFIER HwAgSnsrls.PerInstanceMemories.PrevSmotngSt /end MEASUREMENT
/begin MEASUREMENT HwAgSnsrls.PrevVehDynFil1Ena "MICROSAR RTE" UBYTE RTE_CM_BOOLEAN 0 0 0 255 ECU_ADDRESS 0 SYMBOL_LINK "Rte_HwAgSnsrls_PrevVehDynFil1Ena" 0 DISPLAY_IDENTIFIER HwAgSnsrls.PerInstanceMemories.PrevVehDynFil1Ena /end MEASUREMENT
/begin MEASUREMENT HwAgSnsrls.PrevVehDynFil2Ena "MICROSAR RTE" UBYTE RTE_CM_BOOLEAN 0 0 0 255 ECU_ADDRESS 0 SYMBOL_LINK "Rte_HwAgSnsrls_PrevVehDynFil2Ena" 0 DISPLAY_IDENTIFIER HwAgSnsrls.PerInstanceMemories.PrevVehDynFil2Ena /end MEASUREMENT
/begin MEASUREMENT HwAgSnsrls.RelHwAgFil1.FilGain "MICROSAR RTE" FLOAT32_IEEE NO_COMPU_METHOD 0 0 -3.402823466e+38 3.402823466e+38 ECU_ADDRESS 0 SYMBOL_LINK "Rte_HwAgSnsrls_RelHwAgFil1.FilGain" 0 DISPLAY_IDENTIFIER HwAgSnsrls.PerInstanceMemories.RelHwAgFil1.FilGain /end MEASUREMENT
/begin MEASUREMENT HwAgSnsrls.RelHwAgFil1.FilSt "MICROSAR RTE" FLOAT32_IEEE NO_COMPU_METHOD 0 0 -3.402823466e+38 3.402823466e+38 ECU_ADDRESS 0 SYMBOL_LINK "Rte_HwAgSnsrls_RelHwAgFil1.FilSt" 0 DISPLAY_IDENTIFIER HwAgSnsrls.PerInstanceMemories.RelHwAgFil1.FilSt /end MEASUREMENT
/begin MEASUREMENT HwAgSnsrls.RelHwAgFil2.FilGain "MICROSAR RTE" FLOAT32_IEEE NO_COMPU_METHOD 0 0 -3.402823466e+38 3.402823466e+38 ECU_ADDRESS 0 SYMBOL_LINK "Rte_HwAgSnsrls_RelHwAgFil2.FilGain" 0 DISPLAY_IDENTIFIER HwAgSnsrls.PerInstanceMemories.RelHwAgFil2.FilGain /end MEASUREMENT
/begin MEASUREMENT HwAgSnsrls.RelHwAgFil2.FilSt "MICROSAR RTE" FLOAT32_IEEE NO_COMPU_METHOD 0 0 -3.402823466e+38 3.402823466e+38 ECU_ADDRESS 0 SYMBOL_LINK "Rte_HwAgSnsrls_RelHwAgFil2.FilSt" 0 DISPLAY_IDENTIFIER HwAgSnsrls.PerInstanceMemories.RelHwAgFil2.FilSt /end MEASUREMENT
/begin MEASUREMENT HwAgSnsrls.SelnCaseSt "MICROSAR RTE" UBYTE NO_COMPU_METHOD 0 0 0 255 ECU_ADDRESS 0 SYMBOL_LINK "Rte_HwAgSnsrls_SelnCaseSt" 0 DISPLAY_IDENTIFIER HwAgSnsrls.PerInstanceMemories.SelnCaseSt /end MEASUREMENT
/begin MEASUREMENT HwAgSnsrls.StordLstPrm.PinionAg "MICROSAR RTE" FLOAT32_IEEE NO_COMPU_METHOD 0 0 -3.402823466e+38 3.402823466e+38 ECU_ADDRESS 0 SYMBOL_LINK "Rte_HwAgSnsrls_StordLstPrm.PinionAg" 0 DISPLAY_IDENTIFIER HwAgSnsrls.PerInstanceMemories.StordLstPrm.PinionAg /end MEASUREMENT
/begin MEASUREMENT HwAgSnsrls.StordLstPrm.PinionAgVld "MICROSAR RTE" UBYTE RTE_CM_BOOLEAN 0 0 0 255 ECU_ADDRESS 0 SYMBOL_LINK "Rte_HwAgSnsrls_StordLstPrm.PinionAgVld" 0 DISPLAY_IDENTIFIER HwAgSnsrls.PerInstanceMemories.StordLstPrm.PinionAgVld /end MEASUREMENT
/begin MEASUREMENT HwAgSnsrls.VehDynHwAgOffs "MICROSAR RTE" FLOAT32_IEEE NO_COMPU_METHOD 0 0 -3.402823466e+38 3.402823466e+38 ECU_ADDRESS 0 SYMBOL_LINK "Rte_HwAgSnsrls_VehDynHwAgOffs" 0 DISPLAY_IDENTIFIER HwAgSnsrls.PerInstanceMemories.VehDynHwAgOffs /end MEASUREMENT
/begin MEASUREMENT HwAgSnsrls.VehDynRefTmr1 "MICROSAR RTE" ULONG NO_COMPU_METHOD 0 0 0 4294967295 ECU_ADDRESS 0 SYMBOL_LINK "Rte_HwAgSnsrls_VehDynRefTmr1" 0 DISPLAY_IDENTIFIER HwAgSnsrls.PerInstanceMemories.VehDynRefTmr1 /end MEASUREMENT
/begin MEASUREMENT HwAgSnsrls.VehDynRefTmr2 "MICROSAR RTE" ULONG NO_COMPU_METHOD 0 0 0 4294967295 ECU_ADDRESS 0 SYMBOL_LINK "Rte_HwAgSnsrls_VehDynRefTmr2" 0 DISPLAY_IDENTIFIER HwAgSnsrls.PerInstanceMemories.VehDynRefTmr2 /end MEASUREMENT
/begin MEASUREMENT HwAgSnsrls.VehSpd.Val "MICROSAR RTE" FLOAT32_IEEE NO_COMPU_METHOD 0 0 -3.402823466e+38 3.402823466e+38 ECU_ADDRESS 0 SYMBOL_LINK "Rte_VehSigCdng_VehSpd_Val" 0 DISPLAY_IDENTIFIER HwAgSnsrls.ReceiverPorts.VehSpd.Val /end MEASUREMENT
/begin MEASUREMENT HwAgSnsrls.VehSpdVld.Logl "MICROSAR RTE" UBYTE RTE_CM_BOOLEAN 0 0 0 255 ECU_ADDRESS 0 SYMBOL_LINK "Rte_VehSigCdng_VehSpdVld_Logl" 0 DISPLAY_IDENTIFIER HwAgSnsrls.ReceiverPorts.VehSpdVld.Logl /end MEASUREMENT
/begin MEASUREMENT HwAgSnsrls.VehYawRate.Val "MICROSAR RTE" FLOAT32_IEEE NO_COMPU_METHOD 0 0 -3.402823466e+38 3.402823466e+38 ECU_ADDRESS 0 SYMBOL_LINK "Rte_VehSigCdng_VehYawRate_Val" 0 DISPLAY_IDENTIFIER HwAgSnsrls.ReceiverPorts.VehYawRate.Val /end MEASUREMENT
/begin MEASUREMENT HwAgSnsrls.WhlFrqVld.Logl "MICROSAR RTE" UBYTE RTE_CM_BOOLEAN 0 0 0 255 ECU_ADDRESS 0 SYMBOL_LINK "Rte_GmRoadWhlInQlfr_WhlFrqVld_Logl" 0 DISPLAY_IDENTIFIER HwAgSnsrls.ReceiverPorts.WhlFrqVld.Logl /end MEASUREMENT
/begin MEASUREMENT HwAgSnsrls.WhlLeFrq.Val "MICROSAR RTE" FLOAT32_IEEE NO_COMPU_METHOD 0 0 -3.402823466e+38 3.402823466e+38 ECU_ADDRESS 0 SYMBOL_LINK "Rte_GmRoadWhlInQlfr_WhlLeFrq_Val" 0 DISPLAY_IDENTIFIER HwAgSnsrls.ReceiverPorts.WhlLeFrq.Val /end MEASUREMENT
/begin MEASUREMENT HwAgSnsrls.WhlRiFrq.Val "MICROSAR RTE" FLOAT32_IEEE NO_COMPU_METHOD 0 0 -3.402823466e+38 3.402823466e+38 ECU_ADDRESS 0 SYMBOL_LINK "Rte_GmRoadWhlInQlfr_WhlRiFrq_Val" 0 DISPLAY_IDENTIFIER HwAgSnsrls.ReceiverPorts.WhlRiFrq.Val /end MEASUREMENT
/begin MEASUREMENT HwAgSnsrls.WhlSpdHwAgLrndEna "MICROSAR RTE" UBYTE RTE_CM_BOOLEAN 0 0 0 255 ECU_ADDRESS 0 SYMBOL_LINK "Rte_HwAgSnsrls_WhlSpdHwAgLrndEna" 0 DISPLAY_IDENTIFIER HwAgSnsrls.PerInstanceMemories.WhlSpdHwAgLrndEna /end MEASUREMENT
/begin MEASUREMENT HwAgSnsrls.WhlSpdHwAgOffs "MICROSAR RTE" FLOAT32_IEEE NO_COMPU_METHOD 0 0 -3.402823466e+38 3.402823466e+38 ECU_ADDRESS 0 SYMBOL_LINK "Rte_HwAgSnsrls_WhlSpdHwAgOffs" 0 DISPLAY_IDENTIFIER HwAgSnsrls.PerInstanceMemories.WhlSpdHwAgOffs /end MEASUREMENT
/begin MEASUREMENT HwAgSnsrls.WhlSpdHwConf "MICROSAR RTE" FLOAT32_IEEE NO_COMPU_METHOD 0 0 -3.402823466e+38 3.402823466e+38 ECU_ADDRESS 0 SYMBOL_LINK "Rte_HwAgSnsrls_WhlSpdHwConf" 0 DISPLAY_IDENTIFIER HwAgSnsrls.PerInstanceMemories.WhlSpdHwConf /end MEASUREMENT
/begin MEASUREMENT HwAgSnsrls.WhlSpdRefTmr "MICROSAR RTE" ULONG NO_COMPU_METHOD 0 0 0 4294967295 ECU_ADDRESS 0 SYMBOL_LINK "Rte_HwAgSnsrls_WhlSpdRefTmr" 0 DISPLAY_IDENTIFIER HwAgSnsrls.PerInstanceMemories.WhlSpdRefTmr /end MEASUREMENT
/begin MEASUREMENT HwAgSnsrls.YawRateFil.FilGain "MICROSAR RTE" FLOAT32_IEEE NO_COMPU_METHOD 0 0 -3.402823466e+38 3.402823466e+38 ECU_ADDRESS 0 SYMBOL_LINK "Rte_HwAgSnsrls_YawRateFil.FilGain" 0 DISPLAY_IDENTIFIER HwAgSnsrls.PerInstanceMemories.YawRateFil.FilGain /end MEASUREMENT
/begin MEASUREMENT HwAgSnsrls.YawRateFil.FilSt "MICROSAR RTE" FLOAT32_IEEE NO_COMPU_METHOD 0 0 -3.402823466e+38 3.402823466e+38 ECU_ADDRESS 0 SYMBOL_LINK "Rte_HwAgSnsrls_YawRateFil.FilSt" 0 DISPLAY_IDENTIFIER HwAgSnsrls.PerInstanceMemories.YawRateFil.FilSt /end MEASUREMENT
/begin MEASUREMENT HwAgSnsrls.dHwAgSnsrlsStordHwAg "MICROSAR RTE" FLOAT32_IEEE NO_COMPU_METHOD 0 0 -3.402823466e+38 3.402823466e+38 ECU_ADDRESS 0 SYMBOL_LINK "Rte_HwAgSnsrls_dHwAgSnsrlsStordHwAg" 0 DISPLAY_IDENTIFIER HwAgSnsrls.PerInstanceMemories.dHwAgSnsrlsStordHwAg /end MEASUREMENT
/begin MEASUREMENT HwAgSnsrls.dHwAgSnsrlsStordHwConf "MICROSAR RTE" FLOAT32_IEEE NO_COMPU_METHOD 0 0 -3.402823466e+38 3.402823466e+38 ECU_ADDRESS 0 SYMBOL_LINK "Rte_HwAgSnsrls_dHwAgSnsrlsStordHwConf" 0 DISPLAY_IDENTIFIER HwAgSnsrls.PerInstanceMemories.dHwAgSnsrlsStordHwConf /end MEASUREMENT
/begin MEASUREMENT HwAgSnsrls.dHwAgSnsrlsVehDynHwConf "MICROSAR RTE" FLOAT32_IEEE NO_COMPU_METHOD 0 0 -3.402823466e+38 3.402823466e+38 ECU_ADDRESS 0 SYMBOL_LINK "Rte_HwAgSnsrls_dHwAgSnsrlsVehDynHwConf" 0 DISPLAY_IDENTIFIER HwAgSnsrls.PerInstanceMemories.dHwAgSnsrlsVehDynHwConf /end MEASUREMENT
/begin MEASUREMENT HwAgSnsrls.dHwAgSnsrlsWhlSpdHwConf "MICROSAR RTE" FLOAT32_IEEE NO_COMPU_METHOD 0 0 -3.402823466e+38 3.402823466e+38 ECU_ADDRESS 0 SYMBOL_LINK "Rte_HwAgSnsrls_dHwAgSnsrlsWhlSpdHwConf" 0 DISPLAY_IDENTIFIER HwAgSnsrls.PerInstanceMemories.dHwAgSnsrlsWhlSpdHwConf /end MEASUREMENT
/begin MEASUREMENT HwAgSysArbn.CmplncErrMotToPinion.Val "MICROSAR RTE" FLOAT32_IEEE NO_COMPU_METHOD 0 0 -3.402823466e+38 3.402823466e+38 ECU_ADDRESS 0 SYMBOL_LINK "Rte_CmplncErr_CmplncErrMotToPinion_Val" 0 DISPLAY_IDENTIFIER HwAgSysArbn.ReceiverPorts.CmplncErrMotToPinion.Val /end MEASUREMENT
/begin MEASUREMENT HwAgSysArbn.CmplncErrPinionToHw.Val "MICROSAR RTE" FLOAT32_IEEE NO_COMPU_METHOD 0 0 -3.402823466e+38 3.402823466e+38 ECU_ADDRESS 0 SYMBOL_LINK "Rte_CmplncErr_CmplncErrPinionToHw_Val" 0 DISPLAY_IDENTIFIER HwAgSysArbn.ReceiverPorts.CmplncErrPinionToHw.Val /end MEASUREMENT
/begin MEASUREMENT HwAgSysArbn.HwAg.Val "MICROSAR RTE" FLOAT32_IEEE NO_COMPU_METHOD 0 0 -3.402823466e+38 3.402823466e+38 ECU_ADDRESS 0 SYMBOL_LINK "Rte_HwAgArbn_HwAg_Val" 0 DISPLAY_IDENTIFIER HwAgSysArbn.ReceiverPorts.HwAg.Val /end MEASUREMENT
/begin MEASUREMENT HwAgSysArbn.HwAgCorrd.Val "MICROSAR RTE" FLOAT32_IEEE NO_COMPU_METHOD 0 0 -3.402823466e+38 3.402823466e+38 ECU_ADDRESS 0 SYMBOL_LINK "Rte_SnsrOffsCorrn_HwAgCorrd_Val" 0 DISPLAY_IDENTIFIER HwAgSysArbn.ReceiverPorts.HwAgCorrd.Val /end MEASUREMENT
/begin MEASUREMENT HwAgSysArbn.HwAgCorrdLtch "MICROSAR RTE" UBYTE RTE_CM_BOOLEAN 0 0 0 255 ECU_ADDRESS 0 SYMBOL_LINK "Rte_HwAgSysArbn_HwAgCorrdLtch" 0 DISPLAY_IDENTIFIER HwAgSysArbn.PerInstanceMemories.HwAgCorrdLtch /end MEASUREMENT
/begin MEASUREMENT HwAgSysArbn.HwAgFinal.Val "MICROSAR RTE" FLOAT32_IEEE NO_COMPU_METHOD 0 0 -3.402823466e+38 3.402823466e+38 ECU_ADDRESS 0 SYMBOL_LINK "Rte_HwAgSysArbn_HwAgFinal_Val" 0 DISPLAY_IDENTIFIER HwAgSysArbn.SenderPorts.HwAgFinal.Val /end MEASUREMENT
/begin MEASUREMENT HwAgSysArbn.HwAgIdptSig.Val "MICROSAR RTE" UBYTE NO_COMPU_METHOD 0 0 0 255 ECU_ADDRESS 0 SYMBOL_LINK "Rte_HwAgCorrln_HwAgIdptSig_Val" 0 DISPLAY_IDENTIFIER HwAgSysArbn.ReceiverPorts.HwAgIdptSig.Val /end MEASUREMENT
/begin MEASUREMENT HwAgSysArbn.HwAgKineFlt "MICROSAR RTE" UBYTE RTE_CM_BOOLEAN 0 0 0 255 ECU_ADDRESS 0 SYMBOL_LINK "Rte_HwAgSysArbn_HwAgKineFlt" 0 DISPLAY_IDENTIFIER HwAgSysArbn.PerInstanceMemories.HwAgKineFlt /end MEASUREMENT
/begin MEASUREMENT HwAgSysArbn.HwAgNotCorrd.Val "MICROSAR RTE" FLOAT32_IEEE NO_COMPU_METHOD 0 0 -3.402823466e+38 3.402823466e+38 ECU_ADDRESS 0 SYMBOL_LINK "Rte_HwAgSysArbn_HwAgNotCorrd_Val" 0 DISPLAY_IDENTIFIER HwAgSysArbn.SenderPorts.HwAgNotCorrd.Val /end MEASUREMENT
/begin MEASUREMENT HwAgSysArbn.HwAgPrev "MICROSAR RTE" FLOAT32_IEEE NO_COMPU_METHOD 0 0 -3.402823466e+38 3.402823466e+38 ECU_ADDRESS 0 SYMBOL_LINK "Rte_HwAgSysArbn_HwAgPrev" 0 DISPLAY_IDENTIFIER HwAgSysArbn.PerInstanceMemories.HwAgPrev /end MEASUREMENT
/begin MEASUREMENT HwAgSysArbn.HwAgSnsrls.Val "MICROSAR RTE" FLOAT32_IEEE NO_COMPU_METHOD 0 0 -3.402823466e+38 3.402823466e+38 ECU_ADDRESS 0 SYMBOL_LINK "Rte_HwAgSnsrls_HwAgSnsrls_Val" 0 DISPLAY_IDENTIFIER HwAgSysArbn.ReceiverPorts.HwAgSnsrls.Val /end MEASUREMENT
/begin MEASUREMENT HwAgSysArbn.HwAgSnsrlsConf.Val "MICROSAR RTE" FLOAT32_IEEE NO_COMPU_METHOD 0 0 -3.402823466e+38 3.402823466e+38 ECU_ADDRESS 0 SYMBOL_LINK "Rte_HwAgSnsrls_HwAgSnsrlsConf_Val" 0 DISPLAY_IDENTIFIER HwAgSysArbn.ReceiverPorts.HwAgSnsrlsConf.Val /end MEASUREMENT
/begin MEASUREMENT HwAgSysArbn.HwAgToMotAgCorrln "MICROSAR RTE" UBYTE RTE_CM_BOOLEAN 0 0 0 255 ECU_ADDRESS 0 SYMBOL_LINK "Rte_HwAgSysArbn_HwAgToMotAgCorrln" 0 DISPLAY_IDENTIFIER HwAgSysArbn.PerInstanceMemories.HwAgToMotAgCorrln /end MEASUREMENT
/begin MEASUREMENT HwAgSysArbn.HwAgToMotAgCorrlnDurnRefTmr "MICROSAR RTE" ULONG NO_COMPU_METHOD 0 0 0 4294967295 ECU_ADDRESS 0 SYMBOL_LINK "Rte_HwAgSysArbn_HwAgToMotAgCorrlnDurnRefTmr" 0 DISPLAY_IDENTIFIER HwAgSysArbn.PerInstanceMemories.HwAgToMotAgCorrlnDurnRefTmr /end MEASUREMENT
/begin MEASUREMENT HwAgSysArbn.HwAgToSerlCom.Val "MICROSAR RTE" FLOAT32_IEEE NO_COMPU_METHOD 0 0 -3.402823466e+38 3.402823466e+38 ECU_ADDRESS 0 SYMBOL_LINK "Rte_HwAgSysArbn_HwAgToSerlCom_Val" 0 DISPLAY_IDENTIFIER HwAgSysArbn.SenderPorts.HwAgToSerlCom.Val /end MEASUREMENT
/begin MEASUREMENT HwAgSysArbn.HwAgVldToSerlCom.Logl "MICROSAR RTE" UBYTE RTE_CM_BOOLEAN 0 0 0 255 ECU_ADDRESS 0 SYMBOL_LINK "Rte_HwAgSysArbn_HwAgVldToSerlCom_Logl" 0 DISPLAY_IDENTIFIER HwAgSysArbn.SenderPorts.HwAgVldToSerlCom.Logl /end MEASUREMENT
/begin MEASUREMENT HwAgSysArbn.HwTq.Val "MICROSAR RTE" FLOAT32_IEEE NO_COMPU_METHOD 0 0 -3.402823466e+38 3.402823466e+38 ECU_ADDRESS 0 SYMBOL_LINK "Rte_HwTqArbn_HwTq_Val" 0 DISPLAY_IDENTIFIER HwAgSysArbn.ReceiverPorts.HwTq.Val /end MEASUREMENT
/begin MEASUREMENT HwAgSysArbn.HwVel.Val "MICROSAR RTE" FLOAT32_IEEE NO_COMPU_METHOD 0 0 -3.402823466e+38 3.402823466e+38 ECU_ADDRESS 0 SYMBOL_LINK "Rte_HwAgSysArbn_HwVel_Val" 0 DISPLAY_IDENTIFIER HwAgSysArbn.SenderPorts.HwVel.Val /end MEASUREMENT
/begin MEASUREMENT HwAgSysArbn.HwVelToSerlCom.Val "MICROSAR RTE" FLOAT32_IEEE NO_COMPU_METHOD 0 0 -3.402823466e+38 3.402823466e+38 ECU_ADDRESS 0 SYMBOL_LINK "Rte_HwAgSysArbn_HwVelToSerlCom_Val" 0 DISPLAY_IDENTIFIER HwAgSysArbn.SenderPorts.HwVelToSerlCom.Val /end MEASUREMENT
/begin MEASUREMENT HwAgSysArbn.MotVelCrf.Val "MICROSAR RTE" FLOAT32_IEEE NO_COMPU_METHOD 0 0 -3.402823466e+38 3.402823466e+38 ECU_ADDRESS 0 SYMBOL_LINK "Rte_CDD_MotVel_MotVelCrf_Val" 0 DISPLAY_IDENTIFIER HwAgSysArbn.ReceiverPorts.MotVelCrf.Val /end MEASUREMENT
/begin MEASUREMENT HwAgSysArbn.MotVelVld.Logl "MICROSAR RTE" UBYTE RTE_CM_BOOLEAN 0 0 0 255 ECU_ADDRESS 0 SYMBOL_LINK "Rte_CDD_MotVel_MotVelVld_Logl" 0 DISPLAY_IDENTIFIER HwAgSysArbn.ReceiverPorts.MotVelVld.Logl /end MEASUREMENT
/begin MEASUREMENT HwAgSysArbn.PinionAg.Val "MICROSAR RTE" FLOAT32_IEEE NO_COMPU_METHOD 0 0 -3.402823466e+38 3.402823466e+38 ECU_ADDRESS 0 SYMBOL_LINK "Rte_HwAgSysArbn_PinionAg_Val" 0 DISPLAY_IDENTIFIER HwAgSysArbn.SenderPorts.PinionAg.Val /end MEASUREMENT
/begin MEASUREMENT HwAgSysArbn.PinionAgConf.Val "MICROSAR RTE" FLOAT32_IEEE NO_COMPU_METHOD 0 0 -3.402823466e+38 3.402823466e+38 ECU_ADDRESS 0 SYMBOL_LINK "Rte_HwAgSysArbn_PinionAgConf_Val" 0 DISPLAY_IDENTIFIER HwAgSysArbn.SenderPorts.PinionAgConf.Val /end MEASUREMENT
/begin MEASUREMENT HwAgSysArbn.PinionVel.Val "MICROSAR RTE" FLOAT32_IEEE NO_COMPU_METHOD 0 0 -3.402823466e+38 3.402823466e+38 ECU_ADDRESS 0 SYMBOL_LINK "Rte_HwAgSysArbn_PinionVel_Val" 0 DISPLAY_IDENTIFIER HwAgSysArbn.SenderPorts.PinionVel.Val /end MEASUREMENT
/begin MEASUREMENT HwAgSysArbn.PinionVelConf.Val "MICROSAR RTE" FLOAT32_IEEE NO_COMPU_METHOD 0 0 -3.402823466e+38 3.402823466e+38 ECU_ADDRESS 0 SYMBOL_LINK "Rte_HwAgSysArbn_PinionVelConf_Val" 0 DISPLAY_IDENTIFIER HwAgSysArbn.SenderPorts.PinionVelConf.Val /end MEASUREMENT
/begin MEASUREMENT HwAgSysArbn.PrevHwAgNotCorrd "MICROSAR RTE" FLOAT32_IEEE NO_COMPU_METHOD 0 0 -3.402823466e+38 3.402823466e+38 ECU_ADDRESS 0 SYMBOL_LINK "Rte_HwAgSysArbn_PrevHwAgNotCorrd" 0 DISPLAY_IDENTIFIER HwAgSysArbn.PerInstanceMemories.PrevHwAgNotCorrd /end MEASUREMENT
/begin MEASUREMENT HwAgSysArbn.PrevPinionAgConf "MICROSAR RTE" FLOAT32_IEEE NO_COMPU_METHOD 0 0 -3.402823466e+38 3.402823466e+38 ECU_ADDRESS 0 SYMBOL_LINK "Rte_HwAgSysArbn_PrevPinionAgConf" 0 DISPLAY_IDENTIFIER HwAgSysArbn.PerInstanceMemories.PrevPinionAgConf /end MEASUREMENT
/begin MEASUREMENT HwAgSysArbn.PrevSeldHwAg "MICROSAR RTE" FLOAT32_IEEE NO_COMPU_METHOD 0 0 -3.402823466e+38 3.402823466e+38 ECU_ADDRESS 0 SYMBOL_LINK "Rte_HwAgSysArbn_PrevSeldHwAg" 0 DISPLAY_IDENTIFIER HwAgSysArbn.PerInstanceMemories.PrevSeldHwAg /end MEASUREMENT
/begin MEASUREMENT HwAgSysArbn.PrevSrcSeln "MICROSAR RTE" SBYTE NO_COMPU_METHOD 0 0 -128 127 ECU_ADDRESS 0 SYMBOL_LINK "Rte_HwAgSysArbn_PrevSrcSeln" 0 DISPLAY_IDENTIFIER HwAgSysArbn.PerInstanceMemories.PrevSrcSeln /end MEASUREMENT
/begin MEASUREMENT HwAgSysArbn.SeldHwAgConf "MICROSAR RTE" FLOAT32_IEEE NO_COMPU_METHOD 0 0 -3.402823466e+38 3.402823466e+38 ECU_ADDRESS 0 SYMBOL_LINK "Rte_HwAgSysArbn_SeldHwAgConf" 0 DISPLAY_IDENTIFIER HwAgSysArbn.PerInstanceMemories.SeldHwAgConf /end MEASUREMENT
/begin MEASUREMENT HwAgSysArbn.SlewElpdRefTmr "MICROSAR RTE" ULONG NO_COMPU_METHOD 0 0 0 4294967295 ECU_ADDRESS 0 SYMBOL_LINK "Rte_HwAgSysArbn_SlewElpdRefTmr" 0 DISPLAY_IDENTIFIER HwAgSysArbn.PerInstanceMemories.SlewElpdRefTmr /end MEASUREMENT
/begin MEASUREMENT HwAgSysArbn.SlewSts "MICROSAR RTE" UBYTE RTE_CM_BOOLEAN 0 0 0 255 ECU_ADDRESS 0 SYMBOL_LINK "Rte_HwAgSysArbn_SlewSts" 0 DISPLAY_IDENTIFIER HwAgSysArbn.PerInstanceMemories.SlewSts /end MEASUREMENT
/begin MEASUREMENT HwAgSysArbn.TqSnsrAgPrev "MICROSAR RTE" FLOAT32_IEEE NO_COMPU_METHOD 0 0 -3.402823466e+38 3.402823466e+38 ECU_ADDRESS 0 SYMBOL_LINK "Rte_HwAgSysArbn_TqSnsrAgPrev" 0 DISPLAY_IDENTIFIER HwAgSysArbn.PerInstanceMemories.TqSnsrAgPrev /end MEASUREMENT
/begin MEASUREMENT HwAgSysArbn.TqSnsrVelFil.FilGain "MICROSAR RTE" FLOAT32_IEEE NO_COMPU_METHOD 0 0 -3.402823466e+38 3.402823466e+38 ECU_ADDRESS 0 SYMBOL_LINK "Rte_HwAgSysArbn_TqSnsrVelFil.FilGain" 0 DISPLAY_IDENTIFIER HwAgSysArbn.PerInstanceMemories.TqSnsrVelFil.FilGain /end MEASUREMENT
/begin MEASUREMENT HwAgSysArbn.TqSnsrVelFil.FilSt "MICROSAR RTE" FLOAT32_IEEE NO_COMPU_METHOD 0 0 -3.402823466e+38 3.402823466e+38 ECU_ADDRESS 0 SYMBOL_LINK "Rte_HwAgSysArbn_TqSnsrVelFil.FilSt" 0 DISPLAY_IDENTIFIER HwAgSysArbn.PerInstanceMemories.TqSnsrVelFil.FilSt /end MEASUREMENT
/begin MEASUREMENT HwAgTrajGenn.AMax "MICROSAR RTE" FLOAT32_IEEE NO_COMPU_METHOD 0 0 -3.402823466e+38 3.402823466e+38 ECU_ADDRESS 0 SYMBOL_LINK "Rte_HwAgTrajGenn_AMax" 0 DISPLAY_IDENTIFIER HwAgTrajGenn.PerInstanceMemories.AMax /end MEASUREMENT
/begin MEASUREMENT HwAgTrajGenn.CalcFlg "MICROSAR RTE" UBYTE RTE_CM_BOOLEAN 0 0 0 255 ECU_ADDRESS 0 SYMBOL_LINK "Rte_HwAgTrajGenn_CalcFlg" 0 DISPLAY_IDENTIFIER HwAgTrajGenn.PerInstanceMemories.CalcFlg /end MEASUREMENT
/begin MEASUREMENT HwAgTrajGenn.CmdSt "MICROSAR RTE" UWORD RTE_CM_ENUM_HwAgTrajCmdSt1 0 0 0 65535 ECU_ADDRESS 0 SYMBOL_LINK "Rte_HwAgTrajGenn_CmdSt" 0 DISPLAY_IDENTIFIER HwAgTrajGenn.PerInstanceMemories.CmdSt /end MEASUREMENT
/begin MEASUREMENT HwAgTrajGenn.HwAg.Val "MICROSAR RTE" FLOAT32_IEEE NO_COMPU_METHOD 0 0 -3.402823466e+38 3.402823466e+38 ECU_ADDRESS 0 SYMBOL_LINK "Rte_HwAgSysArbn_PinionAg_Val" 0 DISPLAY_IDENTIFIER HwAgTrajGenn.ReceiverPorts.HwAg.Val /end MEASUREMENT
/begin MEASUREMENT HwAgTrajGenn.HwAgTrajGennEna.Logl "MICROSAR RTE" UBYTE RTE_CM_BOOLEAN 0 0 0 255 ECU_ADDRESS 0 SYMBOL_LINK "Rte_HwAgTrajGenn_HwAgTrajGennEna_Logl" 0 DISPLAY_IDENTIFIER HwAgTrajGenn.ReceiverPorts.HwAgTrajGennEna.Logl /end MEASUREMENT
/begin MEASUREMENT HwAgTrajGenn.HwAgTrakgServoCmd.Val "MICROSAR RTE" FLOAT32_IEEE NO_COMPU_METHOD 0 0 -3.402823466e+38 3.402823466e+38 ECU_ADDRESS 0 SYMBOL_LINK "Rte_HwAgTrajGenn_HwAgTrakgServoCmd_Val" 0 DISPLAY_IDENTIFIER HwAgTrajGenn.SenderPorts.HwAgTrakgServoCmd.Val /end MEASUREMENT
/begin MEASUREMENT HwAgTrajGenn.HwPosnIni "MICROSAR RTE" FLOAT32_IEEE NO_COMPU_METHOD 0 0 -3.402823466e+38 3.402823466e+38 ECU_ADDRESS 0 SYMBOL_LINK "Rte_HwAgTrajGenn_HwPosnIni" 0 DISPLAY_IDENTIFIER HwAgTrajGenn.PerInstanceMemories.HwPosnIni /end MEASUREMENT
/begin MEASUREMENT HwAgTrajGenn.HwPosnOffs "MICROSAR RTE" FLOAT32_IEEE NO_COMPU_METHOD 0 0 -3.402823466e+38 3.402823466e+38 ECU_ADDRESS 0 SYMBOL_LINK "Rte_HwAgTrajGenn_HwPosnOffs" 0 DISPLAY_IDENTIFIER HwAgTrajGenn.PerInstanceMemories.HwPosnOffs /end MEASUREMENT
/begin MEASUREMENT HwAgTrajGenn.SignHwPosnDelta "MICROSAR RTE" FLOAT32_IEEE NO_COMPU_METHOD 0 0 -3.402823466e+38 3.402823466e+38 ECU_ADDRESS 0 SYMBOL_LINK "Rte_HwAgTrajGenn_SignHwPosnDelta" 0 DISPLAY_IDENTIFIER HwAgTrajGenn.PerInstanceMemories.SignHwPosnDelta /end MEASUREMENT
/begin MEASUREMENT HwAgTrajGenn.TiDeltaA "MICROSAR RTE" FLOAT32_IEEE NO_COMPU_METHOD 0 0 -3.402823466e+38 3.402823466e+38 ECU_ADDRESS 0 SYMBOL_LINK "Rte_HwAgTrajGenn_TiDeltaA" 0 DISPLAY_IDENTIFIER HwAgTrajGenn.PerInstanceMemories.TiDeltaA /end MEASUREMENT
/begin MEASUREMENT HwAgTrajGenn.TiDeltaVel "MICROSAR RTE" FLOAT32_IEEE NO_COMPU_METHOD 0 0 -3.402823466e+38 3.402823466e+38 ECU_ADDRESS 0 SYMBOL_LINK "Rte_HwAgTrajGenn_TiDeltaVel" 0 DISPLAY_IDENTIFIER HwAgTrajGenn.PerInstanceMemories.TiDeltaVel /end MEASUREMENT
/begin MEASUREMENT HwAgTrajGenn.TiSt "MICROSAR RTE" FLOAT32_IEEE NO_COMPU_METHOD 0 0 -3.402823466e+38 3.402823466e+38 ECU_ADDRESS 0 SYMBOL_LINK "Rte_HwAgTrajGenn_TiSt" 0 DISPLAY_IDENTIFIER HwAgTrajGenn.PerInstanceMemories.TiSt /end MEASUREMENT
/begin MEASUREMENT HwAgTrajGenn.VelMax "MICROSAR RTE" FLOAT32_IEEE NO_COMPU_METHOD 0 0 -3.402823466e+38 3.402823466e+38 ECU_ADDRESS 0 SYMBOL_LINK "Rte_HwAgTrajGenn_VelMax" 0 DISPLAY_IDENTIFIER HwAgTrajGenn.PerInstanceMemories.VelMax /end MEASUREMENT
/begin MEASUREMENT HwAgTrakgServo.DftlTermLpFil.FilGain "MICROSAR RTE" FLOAT32_IEEE NO_COMPU_METHOD 0 0 -3.402823466e+38 3.402823466e+38 ECU_ADDRESS 0 SYMBOL_LINK "Rte_HwAgTrakgServo_DftlTermLpFil.FilGain" 0 DISPLAY_IDENTIFIER HwAgTrakgServo.PerInstanceMemories.DftlTermLpFil.FilGain /end MEASUREMENT
/begin MEASUREMENT HwAgTrakgServo.DftlTermLpFil.FilSt "MICROSAR RTE" FLOAT32_IEEE NO_COMPU_METHOD 0 0 -3.402823466e+38 3.402823466e+38 ECU_ADDRESS 0 SYMBOL_LINK "Rte_HwAgTrakgServo_DftlTermLpFil.FilSt" 0 DISPLAY_IDENTIFIER HwAgTrakgServo.PerInstanceMemories.DftlTermLpFil.FilSt /end MEASUREMENT
/begin MEASUREMENT HwAgTrakgServo.HwAg.Val "MICROSAR RTE" FLOAT32_IEEE NO_COMPU_METHOD 0 0 -3.402823466e+38 3.402823466e+38 ECU_ADDRESS 0 SYMBOL_LINK "Rte_HwAgSysArbn_PinionAg_Val" 0 DISPLAY_IDENTIFIER HwAgTrakgServo.ReceiverPorts.HwAg.Val /end MEASUREMENT
/begin MEASUREMENT HwAgTrakgServo.HwAgLpFil.FilGain "MICROSAR RTE" FLOAT32_IEEE NO_COMPU_METHOD 0 0 -3.402823466e+38 3.402823466e+38 ECU_ADDRESS 0 SYMBOL_LINK "Rte_HwAgTrakgServo_HwAgLpFil.FilGain" 0 DISPLAY_IDENTIFIER HwAgTrakgServo.PerInstanceMemories.HwAgLpFil.FilGain /end MEASUREMENT
/begin MEASUREMENT HwAgTrakgServo.HwAgLpFil.FilSt "MICROSAR RTE" FLOAT32_IEEE NO_COMPU_METHOD 0 0 -3.402823466e+38 3.402823466e+38 ECU_ADDRESS 0 SYMBOL_LINK "Rte_HwAgTrakgServo_HwAgLpFil.FilSt" 0 DISPLAY_IDENTIFIER HwAgTrakgServo.PerInstanceMemories.HwAgLpFil.FilSt /end MEASUREMENT
/begin MEASUREMENT HwAgTrakgServo.HwAgTarRateLim "MICROSAR RTE" FLOAT32_IEEE NO_COMPU_METHOD 0 0 -3.402823466e+38 3.402823466e+38 ECU_ADDRESS 0 SYMBOL_LINK "Rte_HwAgTrakgServo_HwAgTarRateLim" 0 DISPLAY_IDENTIFIER HwAgTrakgServo.PerInstanceMemories.HwAgTarRateLim /end MEASUREMENT
/begin MEASUREMENT HwAgTrakgServo.HwAgTrakgServoCmd.Val "MICROSAR RTE" FLOAT32_IEEE NO_COMPU_METHOD 0 0 -3.402823466e+38 3.402823466e+38 ECU_ADDRESS 0 SYMBOL_LINK "Rte_GmOvrlStMgr_HwAgServoCmd_Val" 0 DISPLAY_IDENTIFIER HwAgTrakgServo.ReceiverPorts.HwAgTrakgServoCmd.Val /end MEASUREMENT
/begin MEASUREMENT HwAgTrakgServo.HwAgTrakgServoEna.Logl "MICROSAR RTE" UBYTE RTE_CM_BOOLEAN 0 0 0 255 ECU_ADDRESS 0 SYMBOL_LINK "Rte_GmOvrlStMgr_HwAgServoEna_Logl" 0 DISPLAY_IDENTIFIER HwAgTrakgServo.ReceiverPorts.HwAgTrakgServoEna.Logl /end MEASUREMENT
/begin MEASUREMENT HwAgTrakgServo.HwTq.Val "MICROSAR RTE" FLOAT32_IEEE NO_COMPU_METHOD 0 0 -3.402823466e+38 3.402823466e+38 ECU_ADDRESS 0 SYMBOL_LINK "Rte_Swp_HwTqSwp_Val" 0 DISPLAY_IDENTIFIER HwAgTrakgServo.ReceiverPorts.HwTq.Val /end MEASUREMENT
/begin MEASUREMENT HwAgTrakgServo.HwTqLpFil.FilGain "MICROSAR RTE" FLOAT32_IEEE NO_COMPU_METHOD 0 0 -3.402823466e+38 3.402823466e+38 ECU_ADDRESS 0 SYMBOL_LINK "Rte_HwAgTrakgServo_HwTqLpFil.FilGain" 0 DISPLAY_IDENTIFIER HwAgTrakgServo.PerInstanceMemories.HwTqLpFil.FilGain /end MEASUREMENT
/begin MEASUREMENT HwAgTrakgServo.HwTqLpFil.FilSt "MICROSAR RTE" FLOAT32_IEEE NO_COMPU_METHOD 0 0 -3.402823466e+38 3.402823466e+38 ECU_ADDRESS 0 SYMBOL_LINK "Rte_HwAgTrakgServo_HwTqLpFil.FilSt" 0 DISPLAY_IDENTIFIER HwAgTrakgServo.PerInstanceMemories.HwTqLpFil.FilSt /end MEASUREMENT
/begin MEASUREMENT HwAgTrakgServo.MotTqServoCmd.Val "MICROSAR RTE" FLOAT32_IEEE NO_COMPU_METHOD 0 0 -3.402823466e+38 3.402823466e+38 ECU_ADDRESS 0 SYMBOL_LINK "Rte_HwAgTrakgServo_MotTqServoCmd_Val" 0 DISPLAY_IDENTIFIER HwAgTrakgServo.SenderPorts.MotTqServoCmd.Val /end MEASUREMENT
/begin MEASUREMENT HwAgTrakgServo.MotVelCrf.Val "MICROSAR RTE" FLOAT32_IEEE NO_COMPU_METHOD 0 0 -3.402823466e+38 3.402823466e+38 ECU_ADDRESS 0 SYMBOL_LINK "Rte_CDD_MotVel_MotVelCrf_Val" 0 DISPLAY_IDENTIFIER HwAgTrakgServo.ReceiverPorts.MotVelCrf.Val /end MEASUREMENT
/begin MEASUREMENT HwAgTrakgServo.PrevDftlErr "MICROSAR RTE" FLOAT32_IEEE NO_COMPU_METHOD 0 0 -3.402823466e+38 3.402823466e+38 ECU_ADDRESS 0 SYMBOL_LINK "Rte_HwAgTrakgServo_PrevDftlErr" 0 DISPLAY_IDENTIFIER HwAgTrakgServo.PerInstanceMemories.PrevDftlErr /end MEASUREMENT
/begin MEASUREMENT HwAgTrakgServo.PrevHwAgTar "MICROSAR RTE" FLOAT32_IEEE NO_COMPU_METHOD 0 0 -3.402823466e+38 3.402823466e+38 ECU_ADDRESS 0 SYMBOL_LINK "Rte_HwAgTrakgServo_PrevHwAgTar" 0 DISPLAY_IDENTIFIER HwAgTrakgServo.PerInstanceMemories.PrevHwAgTar /end MEASUREMENT
/begin MEASUREMENT HwAgTrakgServo.PrevIntglErr "MICROSAR RTE" FLOAT32_IEEE NO_COMPU_METHOD 0 0 -3.402823466e+38 3.402823466e+38 ECU_ADDRESS 0 SYMBOL_LINK "Rte_HwAgTrakgServo_PrevIntglErr" 0 DISPLAY_IDENTIFIER HwAgTrakgServo.PerInstanceMemories.PrevIntglErr /end MEASUREMENT
/begin MEASUREMENT HwAgTrakgServo.PrevSmotng "MICROSAR RTE" FLOAT32_IEEE NO_COMPU_METHOD 0 0 -3.402823466e+38 3.402823466e+38 ECU_ADDRESS 0 SYMBOL_LINK "Rte_HwAgTrakgServo_PrevSmotng" 0 DISPLAY_IDENTIFIER HwAgTrakgServo.PerInstanceMemories.PrevSmotng /end MEASUREMENT
/begin MEASUREMENT HwAgTrakgServo.VehSpd.Val "MICROSAR RTE" FLOAT32_IEEE NO_COMPU_METHOD 0 0 -3.402823466e+38 3.402823466e+38 ECU_ADDRESS 0 SYMBOL_LINK "Rte_VehSigCdng_VehSpd_Val" 0 DISPLAY_IDENTIFIER HwAgTrakgServo.ReceiverPorts.VehSpd.Val /end MEASUREMENT
/begin MEASUREMENT HwAgTrakgServo.dHwAgTrakgServoDftlTerm "MICROSAR RTE" FLOAT32_IEEE NO_COMPU_METHOD 0 0 -3.402823466e+38 3.402823466e+38 ECU_ADDRESS 0 SYMBOL_LINK "Rte_HwAgTrakgServo_dHwAgTrakgServoDftlTerm" 0 DISPLAY_IDENTIFIER HwAgTrakgServo.PerInstanceMemories.dHwAgTrakgServoDftlTerm /end MEASUREMENT
/begin MEASUREMENT HwAgTrakgServo.dHwAgTrakgServoHwAgTarFild "MICROSAR RTE" FLOAT32_IEEE NO_COMPU_METHOD 0 0 -3.402823466e+38 3.402823466e+38 ECU_ADDRESS 0 SYMBOL_LINK "Rte_HwAgTrakgServo_dHwAgTrakgServoHwAgTarFild" 0 DISPLAY_IDENTIFIER HwAgTrakgServo.PerInstanceMemories.dHwAgTrakgServoHwAgTarFild /end MEASUREMENT
/begin MEASUREMENT HwAgTrakgServo.dHwAgTrakgServoIntglTerm "MICROSAR RTE" FLOAT32_IEEE NO_COMPU_METHOD 0 0 -3.402823466e+38 3.402823466e+38 ECU_ADDRESS 0 SYMBOL_LINK "Rte_HwAgTrakgServo_dHwAgTrakgServoIntglTerm" 0 DISPLAY_IDENTIFIER HwAgTrakgServo.PerInstanceMemories.dHwAgTrakgServoIntglTerm /end MEASUREMENT
/begin MEASUREMENT HwAgTrakgServo.dHwAgTrakgServoPidCmd "MICROSAR RTE" FLOAT32_IEEE NO_COMPU_METHOD 0 0 -3.402823466e+38 3.402823466e+38 ECU_ADDRESS 0 SYMBOL_LINK "Rte_HwAgTrakgServo_dHwAgTrakgServoPidCmd" 0 DISPLAY_IDENTIFIER HwAgTrakgServo.PerInstanceMemories.dHwAgTrakgServoPidCmd /end MEASUREMENT
/begin MEASUREMENT HwAgTrakgServo.dHwAgTrakgServoPropTerm "MICROSAR RTE" FLOAT32_IEEE NO_COMPU_METHOD 0 0 -3.402823466e+38 3.402823466e+38 ECU_ADDRESS 0 SYMBOL_LINK "Rte_HwAgTrakgServo_dHwAgTrakgServoPropTerm" 0 DISPLAY_IDENTIFIER HwAgTrakgServo.PerInstanceMemories.dHwAgTrakgServoPropTerm /end MEASUREMENT
/begin MEASUREMENT HwAgTrakgServo.dHwAgTrakgServoRampCmpl "MICROSAR RTE" UBYTE RTE_CM_BOOLEAN 0 0 0 255 ECU_ADDRESS 0 SYMBOL_LINK "Rte_HwAgTrakgServo_dHwAgTrakgServoRampCmpl" 0 DISPLAY_IDENTIFIER HwAgTrakgServo.PerInstanceMemories.dHwAgTrakgServoRampCmpl /end MEASUREMENT
/begin MEASUREMENT HwAgTrakgServo.dHwAgTrakgServoRtnScaFac "MICROSAR RTE" FLOAT32_IEEE NO_COMPU_METHOD 0 0 -3.402823466e+38 3.402823466e+38 ECU_ADDRESS 0 SYMBOL_LINK "Rte_HwAgTrakgServo_dHwAgTrakgServoRtnScaFac" 0 DISPLAY_IDENTIFIER HwAgTrakgServo.PerInstanceMemories.dHwAgTrakgServoRtnScaFac /end MEASUREMENT
/begin MEASUREMENT HwAgTrakgServo.dHwAgTrakgServoSmotngEna "MICROSAR RTE" FLOAT32_IEEE NO_COMPU_METHOD 0 0 -3.402823466e+38 3.402823466e+38 ECU_ADDRESS 0 SYMBOL_LINK "Rte_HwAgTrakgServo_dHwAgTrakgServoSmotngEna" 0 DISPLAY_IDENTIFIER HwAgTrakgServo.PerInstanceMemories.dHwAgTrakgServoSmotngEna /end MEASUREMENT
/begin MEASUREMENT HwAgVehCentrTrim.EngRunActv.Logl "MICROSAR RTE" UBYTE RTE_CM_BOOLEAN 0 0 0 255 ECU_ADDRESS 0 SYMBOL_LINK "Rte_GmMsg0C9BusHiSpd_EngRunActv_Logl" 0 DISPLAY_IDENTIFIER HwAgVehCentrTrim.ReceiverPorts.EngRunActv.Logl /end MEASUREMENT
/begin MEASUREMENT HwAgVehCentrTrim.HwAg.Val "MICROSAR RTE" FLOAT32_IEEE NO_COMPU_METHOD 0 0 -3.402823466e+38 3.402823466e+38 ECU_ADDRESS 0 SYMBOL_LINK "Rte_HwAgArbn_HwAg_Val" 0 DISPLAY_IDENTIFIER HwAgVehCentrTrim.ReceiverPorts.HwAg.Val /end MEASUREMENT
/begin MEASUREMENT HwAgVehCentrTrim.HwAgCcwDetd.Logl "MICROSAR RTE" UBYTE RTE_CM_BOOLEAN 0 0 0 255 ECU_ADDRESS 0 SYMBOL_LINK "Rte_EotLrng_HwAgCcwDetd_Logl" 0 DISPLAY_IDENTIFIER HwAgVehCentrTrim.ReceiverPorts.HwAgCcwDetd.Logl /end MEASUREMENT
/begin MEASUREMENT HwAgVehCentrTrim.HwAgCwDetd.Logl "MICROSAR RTE" UBYTE RTE_CM_BOOLEAN 0 0 0 255 ECU_ADDRESS 0 SYMBOL_LINK "Rte_EotLrng_HwAgCwDetd_Logl" 0 DISPLAY_IDENTIFIER HwAgVehCentrTrim.ReceiverPorts.HwAgCwDetd.Logl /end MEASUREMENT
/begin MEASUREMENT HwAgVehCentrTrim.HwAgEotCcw.Val "MICROSAR RTE" FLOAT32_IEEE NO_COMPU_METHOD 0 0 -3.402823466e+38 3.402823466e+38 ECU_ADDRESS 0 SYMBOL_LINK "Rte_EotLrng_HwAgEotCcw_Val" 0 DISPLAY_IDENTIFIER HwAgVehCentrTrim.ReceiverPorts.HwAgEotCcw.Val /end MEASUREMENT
/begin MEASUREMENT HwAgVehCentrTrim.HwAgEotCw.Val "MICROSAR RTE" FLOAT32_IEEE NO_COMPU_METHOD 0 0 -3.402823466e+38 3.402823466e+38 ECU_ADDRESS 0 SYMBOL_LINK "Rte_EotLrng_HwAgEotCw_Val" 0 DISPLAY_IDENTIFIER HwAgVehCentrTrim.ReceiverPorts.HwAgEotCw.Val /end MEASUREMENT
/begin MEASUREMENT HwAgVehCentrTrim.HwAgTrimData.TrimPrfmd "MICROSAR RTE" UBYTE RTE_CM_BOOLEAN 0 0 0 255 ECU_ADDRESS 0 SYMBOL_LINK "Rte_HwAgVehCentrTrim_HwAgTrimData.TrimPrfmd" 0 DISPLAY_IDENTIFIER HwAgVehCentrTrim.PerInstanceMemories.HwAgTrimData.TrimPrfmd /end MEASUREMENT
/begin MEASUREMENT HwAgVehCentrTrim.HwAgTrimData.TrimVal "MICROSAR RTE" FLOAT32_IEEE NO_COMPU_METHOD 0 0 -3.402823466e+38 3.402823466e+38 ECU_ADDRESS 0 SYMBOL_LINK "Rte_HwAgVehCentrTrim_HwAgTrimData.TrimVal" 0 DISPLAY_IDENTIFIER HwAgVehCentrTrim.PerInstanceMemories.HwAgTrimData.TrimVal /end MEASUREMENT
/begin MEASUREMENT HwAgVehCentrTrim.HwAgTrimPrfmd.Logl "MICROSAR RTE" UBYTE RTE_CM_BOOLEAN 0 0 0 255 ECU_ADDRESS 0 SYMBOL_LINK "Rte_HwAgVehCentrTrim_HwAgTrimPrfmd_Logl" 0 DISPLAY_IDENTIFIER HwAgVehCentrTrim.SenderPorts.HwAgTrimPrfmd.Logl /end MEASUREMENT
/begin MEASUREMENT HwAgVehCentrTrim.HwAgVehTrimOffs.Val "MICROSAR RTE" FLOAT32_IEEE NO_COMPU_METHOD 0 0 -3.402823466e+38 3.402823466e+38 ECU_ADDRESS 0 SYMBOL_LINK "Rte_HwAgVehCentrTrim_HwAgVehTrimOffs_Val" 0 DISPLAY_IDENTIFIER HwAgVehCentrTrim.SenderPorts.HwAgVehTrimOffs.Val /end MEASUREMENT
/begin MEASUREMENT HwAgVehCentrTrim.VehSpd.Val "MICROSAR RTE" FLOAT32_IEEE NO_COMPU_METHOD 0 0 -3.402823466e+38 3.402823466e+38 ECU_ADDRESS 0 SYMBOL_LINK "Rte_VehSigCdng_VehSpd_Val" 0 DISPLAY_IDENTIFIER HwAgVehCentrTrim.ReceiverPorts.VehSpd.Val /end MEASUREMENT
/begin MEASUREMENT HwTqArbn.HwTq.Val "MICROSAR RTE" FLOAT32_IEEE NO_COMPU_METHOD 0 0 -10.0 10.0 ECU_ADDRESS 0 SYMBOL_LINK "Rte_HwTqArbn_HwTq_Val" 0 DISPLAY_IDENTIFIER HwTqArbn.SenderPorts.HwTq.Val /end MEASUREMENT
/begin MEASUREMENT HwTqArbn.HwTqA.Val "MICROSAR RTE" FLOAT32_IEEE NO_COMPU_METHOD 0 0 -10.0 10.0 ECU_ADDRESS 0 SYMBOL_LINK "Rte_CDD_HwTq0Meas_HwTq0_Val" 0 DISPLAY_IDENTIFIER HwTqArbn.ReceiverPorts.HwTqA.Val /end MEASUREMENT
/begin MEASUREMENT HwTqArbn.HwTqAQlfr.Val "MICROSAR RTE" UBYTE RTE_CM_ENUM_SigQlfr1 0 0 0 255 ECU_ADDRESS 0 SYMBOL_LINK "Rte_CDD_HwTq0Meas_HwTq0Qlfr_Val" 0 DISPLAY_IDENTIFIER HwTqArbn.ReceiverPorts.HwTqAQlfr.Val /end MEASUREMENT
/begin MEASUREMENT HwTqArbn.HwTqARollgCntr.Val "MICROSAR RTE" UBYTE NO_COMPU_METHOD 0 0 0 255 ECU_ADDRESS 0 SYMBOL_LINK "Rte_CDD_HwTq0Meas_HwTq0RollgCntr_Val" 0 DISPLAY_IDENTIFIER HwTqArbn.ReceiverPorts.HwTqARollgCntr.Val /end MEASUREMENT
/begin MEASUREMENT HwTqArbn.HwTqArbnTqARollgCntrPrev "MICROSAR RTE" UBYTE NO_COMPU_METHOD 0 0 0 255 ECU_ADDRESS 0 SYMBOL_LINK "Rte_HwTqArbn_HwTqArbnTqARollgCntrPrev" 0 DISPLAY_IDENTIFIER HwTqArbn.PerInstanceMemories.HwTqArbnTqARollgCntrPrev /end MEASUREMENT
/begin GROUP HwAg1Meas.HwAg1MeasHwAg1Snsr0PrtclFltPassStep.Val "MICROSAR RTE" /begin SUB_GROUP /end SUB_GROUP /begin FUNCTION_LIST /end FUNCTION_LIST /begin REF_CHARACTERISTIC HwAg1Meas.HwAg1MeasHwAg1Snsr0PrtclFltPassStep.Val /end REF_CHARACTERISTIC /begin REF_MEASUREMENT /end REF_MEASUREMENT /end GROUP
/begin GROUP HwAg1Meas.HwAg1MeasHwAg1Snsr1PrtclFltFailStep.Val "MICROSAR RTE" /begin SUB_GROUP /end SUB_GROUP /begin FUNCTION_LIST /end FUNCTION_LIST /begin REF_CHARACTERISTIC HwAg1Meas.HwAg1MeasHwAg1Snsr1PrtclFltFailStep.Val /end REF_CHARACTERISTIC /begin REF_MEASUREMENT /end REF_MEASUREMENT /end GROUP
/begin GROUP HwAg1Meas.HwAg1MeasHwAg1Snsr1PrtclFltPassStep.Val "MICROSAR RTE" /begin SUB_GROUP /end SUB_GROUP /begin FUNCTION_LIST /end FUNCTION_LIST /begin REF_CHARACTERISTIC HwAg1Meas.HwAg1MeasHwAg1Snsr1PrtclFltPassStep.Val /end REF_CHARACTERISTIC /begin REF_MEASUREMENT /end REF_MEASUREMENT /end GROUP
/begin GROUP HwAg1Meas.HwAg1MeasSnsr0Rev.Ary1D "MICROSAR RTE" /begin SUB_GROUP /end SUB_GROUP /begin FUNCTION_LIST /end FUNCTION_LIST /begin REF_CHARACTERISTIC HwAg1Meas.HwAg1MeasSnsr0Rev.Ary1D /end REF_CHARACTERISTIC /begin REF_MEASUREMENT /end REF_MEASUREMENT /end GROUP
/begin GROUP HwAg1Meas.HwAg1MeasSnsr1Rev.Ary1D "MICROSAR RTE" /begin SUB_GROUP /end SUB_GROUP /begin FUNCTION_LIST /end FUNCTION_LIST /begin REF_CHARACTERISTIC HwAg1Meas.HwAg1MeasSnsr1Rev.Ary1D /end REF_CHARACTERISTIC /begin REF_MEASUREMENT /end REF_MEASUREMENT /end GROUP
/begin GROUP HwAg1Meas.HwAg1MeasStep.Ary1D "MICROSAR RTE" /begin SUB_GROUP /end SUB_GROUP /begin FUNCTION_LIST /end FUNCTION_LIST /begin REF_CHARACTERISTIC HwAg1Meas.HwAg1MeasStep.Ary1D /end REF_CHARACTERISTIC /begin REF_MEASUREMENT /end REF_MEASUREMENT /end GROUP
/begin GROUP HwAg1Meas.HwAg1MeasVrnrErrThd.Val "MICROSAR RTE" /begin SUB_GROUP /end SUB_GROUP /begin FUNCTION_LIST /end FUNCTION_LIST /begin REF_CHARACTERISTIC HwAg1Meas.HwAg1MeasVrnrErrThd.Val /end REF_CHARACTERISTIC /begin REF_MEASUREMENT /end REF_MEASUREMENT /end GROUP
/begin GROUP HwAg1Meas.HwAg1Offs "MICROSAR RTE" /begin SUB_GROUP /end SUB_GROUP /begin FUNCTION_LIST /end FUNCTION_LIST /begin REF_CHARACTERISTIC /end REF_CHARACTERISTIC
 /begin REF_MEASUREMENT HwAg1Meas.HwAg1Offs.OffsTrim HwAg1Meas.HwAg1Offs.OffsTrimPrfmdSts /end REF_MEASUREMENT
/end GROUP
/begin GROUP HwAg1Meas.HwAg1OffsDft "MICROSAR RTE" /begin SUB_GROUP /end SUB_GROUP /begin FUNCTION_LIST /end FUNCTION_LIST
 /begin REF_CHARACTERISTIC HwAg1Meas.HwAg1OffsDft.OffsTrim HwAg1Meas.HwAg1OffsDft.OffsTrimPrfmdSts /end REF_CHARACTERISTIC
 /begin REF_MEASUREMENT /end REF_MEASUREMENT
/end GROUP
/begin GROUP HwAg1Meas.HwAg1Polarity.Val "MICROSAR RTE" /begin SUB_GROUP /end SUB_GROUP /begin FUNCTION_LIST /end FUNCTION_LIST /begin REF_CHARACTERISTIC /end REF_CHARACTERISTIC /begin REF_MEASUREMENT HwAg1Meas.HwAg1Polarity.Val /end REF_MEASUREMENT /end GROUP
/begin GROUP HwAg1Meas.HwAg1PrevHwAg1 "MICROSAR RTE" /begin SUB_GROUP /end SUB_GROUP /begin FUNCTION_LIST /end FUNCTION_LIST /begin REF_CHARACTERISTIC /end REF_CHARACTERISTIC /begin REF_MEASUREMENT HwAg1Meas.HwAg1PrevHwAg1 /end REF_MEASUREMENT /end GROUP
/begin GROUP HwAg1Meas.HwAg1PrevRollCnt "MICROSAR RTE" /begin SUB_GROUP /end SUB_GROUP /begin FUNCTION_LIST /end FUNCTION_LIST /begin REF_CHARACTERISTIC /end REF_CHARACTERISTIC /begin REF_MEASUREMENT HwAg1Meas.HwAg1PrevRollCnt /end REF_MEASUREMENT /end GROUP
/begin GROUP HwAg1Meas.HwAg1PrevStepSeqNr "MICROSAR RTE" /begin SUB_GROUP /end SUB_GROUP /begin FUNCTION_LIST /end FUNCTION_LIST /begin REF_CHARACTERISTIC /end REF_CHARACTERISTIC /begin REF_MEASUREMENT HwAg1Meas.HwAg1PrevStepSeqNr /end REF_MEASUREMENT /end GROUP
/begin GROUP HwAg1Meas.HwAg1Qlfr.Val "MICROSAR RTE" /begin SUB_GROUP /end SUB_GROUP /begin FUNCTION_LIST /end FUNCTION_LIST /begin REF_CHARACTERISTIC /end REF_CHARACTERISTIC /begin REF_MEASUREMENT HwAg1Meas.HwAg1Qlfr.Val /end REF_MEASUREMENT /end GROUP
/begin GROUP HwAg1Meas.HwAg1RawDataAvlStrtTi "MICROSAR RTE" /begin SUB_GROUP /end SUB_GROUP /begin FUNCTION_LIST /end FUNCTION_LIST /begin REF_CHARACTERISTIC /end REF_CHARACTERISTIC /begin REF_MEASUREMENT HwAg1Meas.HwAg1RawDataAvlStrtTi /end REF_MEASUREMENT /end GROUP
/begin GROUP HwAg1Meas.HwAg1RollgCntr.Val "MICROSAR RTE" /begin SUB_GROUP /end SUB_GROUP /begin FUNCTION_LIST /end FUNCTION_LIST /begin REF_CHARACTERISTIC /end REF_CHARACTERISTIC /begin REF_MEASUREMENT HwAg1Meas.HwAg1RollgCntr.Val /end REF_MEASUREMENT /end GROUP
/begin GROUP HwAg1Meas.HwAg1Snsr0ComStsErrCntr "MICROSAR RTE" /begin SUB_GROUP /end SUB_GROUP /begin FUNCTION_LIST /end FUNCTION_LIST /begin REF_CHARACTERISTIC /end REF_CHARACTERISTIC /begin REF_MEASUREMENT HwAg1Meas.HwAg1Snsr0ComStsErrCntr /end REF_MEASUREMENT /end GROUP
/begin GROUP HwAg1Meas.HwAg1Snsr0IdErrCntr "MICROSAR RTE" /begin SUB_GROUP /end SUB_GROUP /begin FUNCTION_LIST /end FUNCTION_LIST /begin REF_CHARACTERISTIC /end REF_CHARACTERISTIC /begin REF_MEASUREMENT HwAg1Meas.HwAg1Snsr0IdErrCntr /end REF_MEASUREMENT /end GROUP
/begin GROUP HwAg1Meas.HwAg1Snsr0IntSnsrErrCntr "MICROSAR RTE" /begin SUB_GROUP /end SUB_GROUP /begin FUNCTION_LIST /end FUNCTION_LIST /begin REF_CHARACTERISTIC /end REF_CHARACTERISTIC /begin REF_MEASUREMENT HwAg1Meas.HwAg1Snsr0IntSnsrErrCntr /end REF_MEASUREMENT /end GROUP
/begin GROUP HwAg1Meas.HwAg1Snsr0NoMsgErrCntr "MICROSAR RTE" /begin SUB_GROUP /end SUB_GROUP /begin FUNCTION_LIST /end FUNCTION_LIST /begin REF_CHARACTERISTIC /end REF_CHARACTERISTIC /begin REF_MEASUREMENT HwAg1Meas.HwAg1Snsr0NoMsgErrCntr /end REF_MEASUREMENT /end GROUP
/begin GROUP HwAg1Meas.HwAg1Snsr1ComStsErrCntr "MICROSAR RTE" /begin SUB_GROUP /end SUB_GROUP /begin FUNCTION_LIST /end FUNCTION_LIST /begin REF_CHARACTERISTIC /end REF_CHARACTERISTIC /begin REF_MEASUREMENT HwAg1Meas.HwAg1Snsr1ComStsErrCntr /end REF_MEASUREMENT /end GROUP
/begin GROUP HwAg1Meas.HwAg1Snsr1IdErrCntr "MICROSAR RTE" /begin SUB_GROUP /end SUB_GROUP /begin FUNCTION_LIST /end FUNCTION_LIST /begin REF_CHARACTERISTIC /end REF_CHARACTERISTIC /begin REF_MEASUREMENT HwAg1Meas.HwAg1Snsr1IdErrCntr /end REF_MEASUREMENT /end GROUP
/begin GROUP HwAg1Meas.HwAg1Snsr1IntSnsrErrCntr "MICROSAR RTE" /begin SUB_GROUP /end SUB_GROUP /begin FUNCTION_LIST /end FUNCTION_LIST /begin REF_CHARACTERISTIC /end REF_CHARACTERISTIC /begin REF_MEASUREMENT HwAg1Meas.HwAg1Snsr1IntSnsrErrCntr /end REF_MEASUREMENT /end GROUP
/begin GROUP HwAg1Meas.HwAg1Snsr1NoMsgErrCntr "MICROSAR RTE" /begin SUB_GROUP /end SUB_GROUP /begin FUNCTION_LIST /end FUNCTION_LIST /begin REF_CHARACTERISTIC /end REF_CHARACTERISTIC /begin REF_MEASUREMENT HwAg1Meas.HwAg1Snsr1NoMsgErrCntr /end REF_MEASUREMENT /end GROUP
/begin GROUP HwAg1Meas.HwAg1SnsrTrigNr "MICROSAR RTE" /begin SUB_GROUP /end SUB_GROUP /begin FUNCTION_LIST /end FUNCTION_LIST /begin REF_CHARACTERISTIC /end REF_CHARACTERISTIC /begin REF_MEASUREMENT HwAg1Meas.HwAg1SnsrTrigNr /end REF_MEASUREMENT /end GROUP
/begin GROUP HwAg1Meas.PerInstanceMemories "MICROSAR RTE"
 /begin SUB_GROUP HwAg1Meas.HwAg1InitStepSeqNrCmpl HwAg1Meas.HwAg1Offs HwAg1Meas.HwAg1PrevHwAg1 HwAg1Meas.HwAg1PrevRollCnt HwAg1Meas.HwAg1PrevStepSeqNr HwAg1Meas.HwAg1RawDataAvlStrtTi HwAg1Meas.HwAg1Snsr0ComStsErrCntr HwAg1Meas.HwAg1Snsr0IdErrCntr HwAg1Meas.HwAg1Snsr0IntSnsrErrCntr HwAg1Meas.HwAg1Snsr0NoMsgErrCntr HwAg1Meas.HwAg1Snsr1ComStsErrCntr HwAg1Meas.HwAg1Snsr1IdErrCntr HwAg1Meas.HwAg1Snsr1IntSnsrErrCntr HwAg1Meas.HwAg1Snsr1NoMsgErrCntr HwAg1Meas.HwAg1SnsrTrigNr HwAg1Meas.PrevHwAg1 HwAg1Meas.PrevHwAg1Qlfr HwAg1Meas.PrevHwAg1Snsr0Raw HwAg1Meas.PrevHwAg1Snsr0TestOk HwAg1Meas.PrevHwAg1Snsr1Raw HwAg1Meas.PrevHwAg1Snsr1TestOk HwAg1Meas.dHwAg1MeasSnsr0Abs HwAg1Meas.dHwAg1MeasSnsr0CS HwAg1Meas.dHwAg1MeasSnsr0FRXD HwAg1Meas.dHwAg1MeasSnsr0Rel HwAg1Meas.dHwAg1MeasSnsr1Abs HwAg1Meas.dHwAg1MeasSnsr1CS HwAg1Meas.dHwAg1MeasSnsr1FRXD HwAg1Meas.dHwAg1MeasSnsr1Rel /end SUB_GROUP
 /begin FUNCTION_LIST /end FUNCTION_LIST
 /begin REF_CHARACTERISTIC /end REF_CHARACTERISTIC
 /begin REF_MEASUREMENT /end REF_MEASUREMENT
/end GROUP
/begin GROUP HwAg1Meas.PrevHwAg1 "MICROSAR RTE" /begin SUB_GROUP /end SUB_GROUP /begin FUNCTION_LIST /end FUNCTION_LIST /begin REF_CHARACTERISTIC /end REF_CHARACTERISTIC /begin REF_MEASUREMENT HwAg1Meas.PrevHwAg1 /end REF_MEASUREMENT /end GROUP
/begin GROUP HwAg1Meas.PrevHwAg1Qlfr "MICROSAR RTE" /begin SUB_GROUP /end SUB_GROUP /begin FUNCTION_LIST /end FUNCTION_LIST /begin REF_CHARACTERISTIC /end REF_CHARACTERISTIC /begin REF_MEASUREMENT HwAg1Meas.PrevHwAg1Qlfr /end REF_MEASUREMENT /end GROUP
/begin GROUP HwAg1Meas.PrevHwAg1Snsr0Raw "MICROSAR RTE" /begin SUB_GROUP /end SUB_GROUP /begin FUNCTION_LIST /end FUNCTION_LIST /begin REF_CHARACTERISTIC /end REF_CHARACTERISTIC /begin REF_MEASUREMENT HwAg1Meas.PrevHwAg1Snsr0Raw /end REF_MEASUREMENT /end GROUP
/begin GROUP HwAg1Meas.PrevHwAg1Snsr0TestOk "MICROSAR RTE" /begin SUB_GROUP /end SUB_GROUP /begin FUNCTION_LIST /end FUNCTION_LIST /begin REF_CHARACTERISTIC /end REF_CHARACTERISTIC /begin REF_MEASUREMENT HwAg1Meas.PrevHwAg1Snsr0TestOk /end REF_MEASUREMENT /end GROUP
/begin GROUP HwAg1Meas.PrevHwAg1Snsr1Raw "MICROSAR RTE" /begin SUB_GROUP /end SUB_GROUP /begin FUNCTION_LIST /end FUNCTION_LIST /begin REF_CHARACTERISTIC /end REF_CHARACTERISTIC /begin REF_MEASUREMENT HwAg1Meas.PrevHwAg1Snsr1Raw /end REF_MEASUREMENT /end GROUP
/begin GROUP HwAg1Meas.PrevHwAg1Snsr1TestOk "MICROSAR RTE" /begin SUB_GROUP /end SUB_GROUP /begin FUNCTION_LIST /end FUNCTION_LIST /begin REF_CHARACTERISTIC /end REF_CHARACTERISTIC /begin REF_MEASUREMENT HwAg1Meas.PrevHwAg1Snsr1TestOk /end REF_MEASUREMENT /end GROUP
/begin GROUP HwAg1Meas.ReceiverPorts "MICROSAR RTE" /begin SUB_GROUP HwAg1Meas.HwAg1Polarity.Val /end SUB_GROUP /begin FUNCTION_LIST /end FUNCTION_LIST /begin REF_CHARACTERISTIC /end REF_CHARACTERISTIC /begin REF_MEASUREMENT /end REF_MEASUREMENT /end GROUP
/begin GROUP HwAg1Meas.SenderPorts "MICROSAR RTE"
 /begin SUB_GROUP HwAg1Meas.HwAg1.Val HwAg1Meas.HwAg1Qlfr.Val HwAg1Meas.HwAg1RollgCntr.Val /end SUB_GROUP
 /begin FUNCTION_LIST /end FUNCTION_LIST
 /begin REF_CHARACTERISTIC /end REF_CHARACTERISTIC
 /begin REF_MEASUREMENT /end REF_MEASUREMENT
/end GROUP
/begin GROUP HwAg1Meas.dHwAg1MeasSnsr0Abs "MICROSAR RTE" /begin SUB_GROUP /end SUB_GROUP /begin FUNCTION_LIST /end FUNCTION_LIST /begin REF_CHARACTERISTIC /end REF_CHARACTERISTIC /begin REF_MEASUREMENT HwAg1Meas.dHwAg1MeasSnsr0Abs /end REF_MEASUREMENT /end GROUP
/begin GROUP HwAg1Meas.dHwAg1MeasSnsr0CS "MICROSAR RTE" /begin SUB_GROUP /end SUB_GROUP /begin FUNCTION_LIST /end FUNCTION_LIST /begin REF_CHARACTERISTIC /end REF_CHARACTERISTIC /begin REF_MEASUREMENT HwAg1Meas.dHwAg1MeasSnsr0CS /end REF_MEASUREMENT /end GROUP
/begin GROUP HwAg1Meas.dHwAg1MeasSnsr0FRXD "MICROSAR RTE" /begin SUB_GROUP /end SUB_GROUP /begin FUNCTION_LIST /end FUNCTION_LIST /begin REF_CHARACTERISTIC /end REF_CHARACTERISTIC /begin REF_MEASUREMENT HwAg1Meas.dHwAg1MeasSnsr0FRXD /end REF_MEASUREMENT /end GROUP
/begin GROUP HwAg1Meas.dHwAg1MeasSnsr0Rel "MICROSAR RTE" /begin SUB_GROUP /end SUB_GROUP /begin FUNCTION_LIST /end FUNCTION_LIST /begin REF_CHARACTERISTIC /end REF_CHARACTERISTIC /begin REF_MEASUREMENT HwAg1Meas.dHwAg1MeasSnsr0Rel /end REF_MEASUREMENT /end GROUP
/begin GROUP HwAg1Meas.dHwAg1MeasSnsr1Abs "MICROSAR RTE" /begin SUB_GROUP /end SUB_GROUP /begin FUNCTION_LIST /end FUNCTION_LIST /begin REF_CHARACTERISTIC /end REF_CHARACTERISTIC /begin REF_MEASUREMENT HwAg1Meas.dHwAg1MeasSnsr1Abs /end REF_MEASUREMENT /end GROUP
/begin GROUP HwAg1Meas.dHwAg1MeasSnsr1CS "MICROSAR RTE" /begin SUB_GROUP /end SUB_GROUP /begin FUNCTION_LIST /end FUNCTION_LIST /begin REF_CHARACTERISTIC /end REF_CHARACTERISTIC /begin REF_MEASUREMENT HwAg1Meas.dHwAg1MeasSnsr1CS /end REF_MEASUREMENT /end GROUP
/begin GROUP HwAg1Meas.dHwAg1MeasSnsr1FRXD "MICROSAR RTE" /begin SUB_GROUP /end SUB_GROUP /begin FUNCTION_LIST /end FUNCTION_LIST /begin REF_CHARACTERISTIC /end REF_CHARACTERISTIC /begin REF_MEASUREMENT HwAg1Meas.dHwAg1MeasSnsr1FRXD /end REF_MEASUREMENT /end GROUP
/begin GROUP HwAg1Meas.dHwAg1MeasSnsr1Rel "MICROSAR RTE" /begin SUB_GROUP /end SUB_GROUP /begin FUNCTION_LIST /end FUNCTION_LIST /begin REF_CHARACTERISTIC /end REF_CHARACTERISTIC /begin REF_MEASUREMENT HwAg1Meas.dHwAg1MeasSnsr1Rel /end REF_MEASUREMENT /end GROUP
/begin GROUP HwAgArbn "MICROSAR RTE"
 /begin SUB_GROUP HwAgArbn.CalibrationPorts HwAgArbn.PerInstanceMemories HwAgArbn.ReceiverPorts HwAgArbn.SenderPorts /end SUB_GROUP
 /begin FUNCTION_LIST /end FUNCTION_LIST
 /begin REF_CHARACTERISTIC /end REF_CHARACTERISTIC
 /begin REF_MEASUREMENT /end REF_MEASUREMENT
/end GROUP
/begin GROUP HwAgArbn.CalibrationPorts "MICROSAR RTE" /begin SUB_GROUP HwAgArbn.HwAgArbnHwAgMaxStall.Val /end SUB_GROUP /begin FUNCTION_LIST /end FUNCTION_LIST /begin REF_CHARACTERISTIC /end REF_CHARACTERISTIC /begin REF_MEASUREMENT /end REF_MEASUREMENT /end GROUP
/begin GROUP HwAgArbn.HwAg.Val "MICROSAR RTE" /begin SUB_GROUP /end SUB_GROUP /begin FUNCTION_LIST /end FUNCTION_LIST /begin REF_CHARACTERISTIC /end REF_CHARACTERISTIC /begin REF_MEASUREMENT HwAgArbn.HwAg.Val /end REF_MEASUREMENT /end GROUP
/begin GROUP HwAgArbn.HwAgA.Val "MICROSAR RTE" /begin SUB_GROUP /end SUB_GROUP /begin FUNCTION_LIST /end FUNCTION_LIST /begin REF_CHARACTERISTIC /end REF_CHARACTERISTIC /begin REF_MEASUREMENT HwAgArbn.HwAgA.Val /end REF_MEASUREMENT /end GROUP
/begin GROUP HwAgArbn.HwAgAQlfr.Val "MICROSAR RTE" /begin SUB_GROUP /end SUB_GROUP /begin FUNCTION_LIST /end FUNCTION_LIST /begin REF_CHARACTERISTIC /end REF_CHARACTERISTIC /begin REF_MEASUREMENT HwAgArbn.HwAgAQlfr.Val /end REF_MEASUREMENT /end GROUP
/begin GROUP HwAgArbn.HwAgARollgCntr.Val "MICROSAR RTE" /begin SUB_GROUP /end SUB_GROUP /begin FUNCTION_LIST /end FUNCTION_LIST /begin REF_CHARACTERISTIC /end REF_CHARACTERISTIC /begin REF_MEASUREMENT HwAgArbn.HwAgARollgCntr.Val /end REF_MEASUREMENT /end GROUP
/begin GROUP HwAgArbn.HwAgARollgCntrPrev "MICROSAR RTE" /begin SUB_GROUP /end SUB_GROUP /begin FUNCTION_LIST /end FUNCTION_LIST /begin REF_CHARACTERISTIC /end REF_CHARACTERISTIC /begin REF_MEASUREMENT HwAgArbn.HwAgARollgCntrPrev /end REF_MEASUREMENT /end GROUP
/begin GROUP HwAgArbn.HwAgAStallCntrPrev "MICROSAR RTE" /begin SUB_GROUP /end SUB_GROUP /begin FUNCTION_LIST /end FUNCTION_LIST /begin REF_CHARACTERISTIC /end REF_CHARACTERISTIC /begin REF_MEASUREMENT HwAgArbn.HwAgAStallCntrPrev /end REF_MEASUREMENT /end GROUP
/begin GROUP HwAgArbn.HwAgArbnHwAgMaxStall.Val "MICROSAR RTE" /begin SUB_GROUP /end SUB_GROUP /begin FUNCTION_LIST /end FUNCTION_LIST /begin REF_CHARACTERISTIC HwAgArbn.HwAgArbnHwAgMaxStall.Val /end REF_CHARACTERISTIC /begin REF_MEASUREMENT /end REF_MEASUREMENT /end GROUP
/begin GROUP HwAgArbn.HwAgB.Val "MICROSAR RTE" /begin SUB_GROUP /end SUB_GROUP /begin FUNCTION_LIST /end FUNCTION_LIST /begin REF_CHARACTERISTIC /end REF_CHARACTERISTIC /begin REF_MEASUREMENT HwAgArbn.HwAgB.Val /end REF_MEASUREMENT /end GROUP
/begin GROUP HwAgArbn.HwAgBQlfr.Val "MICROSAR RTE" /begin SUB_GROUP /end SUB_GROUP /begin FUNCTION_LIST /end FUNCTION_LIST /begin REF_CHARACTERISTIC /end REF_CHARACTERISTIC /begin REF_MEASUREMENT HwAgArbn.HwAgBQlfr.Val /end REF_MEASUREMENT /end GROUP
/begin GROUP HwAgArbn.HwAgBRollgCntr.Val "MICROSAR RTE" /begin SUB_GROUP /end SUB_GROUP /begin FUNCTION_LIST /end FUNCTION_LIST /begin REF_CHARACTERISTIC /end REF_CHARACTERISTIC /begin REF_MEASUREMENT HwAgArbn.HwAgBRollgCntr.Val /end REF_MEASUREMENT /end GROUP
/begin GROUP HwAgArbn.HwAgBRollgCntrPrev "MICROSAR RTE" /begin SUB_GROUP /end SUB_GROUP /begin FUNCTION_LIST /end FUNCTION_LIST /begin REF_CHARACTERISTIC /end REF_CHARACTERISTIC /begin REF_MEASUREMENT HwAgArbn.HwAgBRollgCntrPrev /end REF_MEASUREMENT /end GROUP
/begin GROUP HwAgArbn.HwAgBStallCntrPrev "MICROSAR RTE" /begin SUB_GROUP /end SUB_GROUP /begin FUNCTION_LIST /end FUNCTION_LIST /begin REF_CHARACTERISTIC /end REF_CHARACTERISTIC /begin REF_MEASUREMENT HwAgArbn.HwAgBStallCntrPrev /end REF_MEASUREMENT /end GROUP
/begin GROUP HwAgArbn.HwAgCorrlnSt.Val "MICROSAR RTE" /begin SUB_GROUP /end SUB_GROUP /begin FUNCTION_LIST /end FUNCTION_LIST /begin REF_CHARACTERISTIC /end REF_CHARACTERISTIC /begin REF_MEASUREMENT HwAgArbn.HwAgCorrlnSt.Val /end REF_MEASUREMENT /end GROUP
/begin GROUP HwAgArbn.HwAgPrev "MICROSAR RTE" /begin SUB_GROUP /end SUB_GROUP /begin FUNCTION_LIST /end FUNCTION_LIST /begin REF_CHARACTERISTIC /end REF_CHARACTERISTIC /begin REF_MEASUREMENT HwAgArbn.HwAgPrev /end REF_MEASUREMENT /end GROUP
/begin GROUP HwAgArbn.PerInstanceMemories "MICROSAR RTE"
 /begin SUB_GROUP HwAgArbn.HwAgARollgCntrPrev HwAgArbn.HwAgAStallCntrPrev HwAgArbn.HwAgBRollgCntrPrev HwAgArbn.HwAgBStallCntrPrev HwAgArbn.HwAgPrev HwAgArbn.dHwAgArbnAgAAvl HwAgArbn.dHwAgArbnAgBAvl /end SUB_GROUP
 /begin FUNCTION_LIST /end FUNCTION_LIST
 /begin REF_CHARACTERISTIC /end REF_CHARACTERISTIC
 /begin REF_MEASUREMENT /end REF_MEASUREMENT
/end GROUP
/begin GROUP HwAgArbn.ReceiverPorts "MICROSAR RTE"
 /begin SUB_GROUP HwAgArbn.HwAgA.Val HwAgArbn.HwAgAQlfr.Val HwAgArbn.HwAgARollgCntr.Val HwAgArbn.HwAgB.Val HwAgArbn.HwAgBQlfr.Val HwAgArbn.HwAgBRollgCntr.Val HwAgArbn.HwAgCorrlnSt.Val /end SUB_GROUP
 /begin FUNCTION_LIST /end FUNCTION_LIST
 /begin REF_CHARACTERISTIC /end REF_CHARACTERISTIC
 /begin REF_MEASUREMENT /end REF_MEASUREMENT
/end GROUP
/begin GROUP HwAgArbn.SenderPorts "MICROSAR RTE" /begin SUB_GROUP HwAgArbn.HwAg.Val /end SUB_GROUP /begin FUNCTION_LIST /end FUNCTION_LIST /begin REF_CHARACTERISTIC /end REF_CHARACTERISTIC /begin REF_MEASUREMENT /end REF_MEASUREMENT /end GROUP
/begin GROUP HwAgArbn.dHwAgArbnAgAAvl "MICROSAR RTE" /begin SUB_GROUP /end SUB_GROUP /begin FUNCTION_LIST /end FUNCTION_LIST /begin REF_CHARACTERISTIC /end REF_CHARACTERISTIC /begin REF_MEASUREMENT HwAgArbn.dHwAgArbnAgAAvl /end REF_MEASUREMENT /end GROUP
/begin GROUP HwAgArbn.dHwAgArbnAgBAvl "MICROSAR RTE" /begin SUB_GROUP /end SUB_GROUP /begin FUNCTION_LIST /end FUNCTION_LIST /begin REF_CHARACTERISTIC /end REF_CHARACTERISTIC /begin REF_MEASUREMENT HwAgArbn.dHwAgArbnAgBAvl /end REF_MEASUREMENT /end GROUP
/begin GROUP HwAgCorrln "MICROSAR RTE"
 /begin SUB_GROUP HwAgCorrln.CalibrationPorts HwAgCorrln.PerInstanceMemories HwAgCorrln.ReceiverPorts HwAgCorrln.SenderPorts /end SUB_GROUP
 /begin FUNCTION_LIST /end FUNCTION_LIST
 /begin REF_CHARACTERISTIC /end REF_CHARACTERISTIC
 /begin REF_MEASUREMENT /end REF_MEASUREMENT
/end GROUP
/begin GROUP HwAgCorrln.CalibrationPorts "MICROSAR RTE"
 /begin SUB_GROUP HwAgCorrln.HwAgCorrlnHwAgAbsltDif.Val HwAgCorrln.HwAgCorrlnHwAgMaxStall.Val HwAgCorrln.HwAgCorrlnNtc0x092FailStep.Val HwAgCorrln.HwAgCorrlnNtc0x092PassStep.Val /end SUB_GROUP
 /begin FUNCTION_LIST /end FUNCTION_LIST
 /begin REF_CHARACTERISTIC /end REF_CHARACTERISTIC
 /begin REF_MEASUREMENT /end REF_MEASUREMENT
/end GROUP
/begin GROUP HwAgCorrln.HwAgA.Val "MICROSAR RTE" /begin SUB_GROUP /end SUB_GROUP /begin FUNCTION_LIST /end FUNCTION_LIST /begin REF_CHARACTERISTIC /end REF_CHARACTERISTIC /begin REF_MEASUREMENT HwAgCorrln.HwAgA.Val /end REF_MEASUREMENT /end GROUP
/begin GROUP HwAgCorrln.HwAgAQlfr.Val "MICROSAR RTE" /begin SUB_GROUP /end SUB_GROUP /begin FUNCTION_LIST /end FUNCTION_LIST /begin REF_CHARACTERISTIC /end REF_CHARACTERISTIC /begin REF_MEASUREMENT HwAgCorrln.HwAgAQlfr.Val /end REF_MEASUREMENT /end GROUP
/begin GROUP HwAgCorrln.HwAgARollgCntPrev "MICROSAR RTE" /begin SUB_GROUP /end SUB_GROUP /begin FUNCTION_LIST /end FUNCTION_LIST /begin REF_CHARACTERISTIC /end REF_CHARACTERISTIC /begin REF_MEASUREMENT HwAgCorrln.HwAgARollgCntPrev /end REF_MEASUREMENT /end GROUP
/begin GROUP HwAgCorrln.HwAgARollgCntr.Val "MICROSAR RTE" /begin SUB_GROUP /end SUB_GROUP /begin FUNCTION_LIST /end FUNCTION_LIST /begin REF_CHARACTERISTIC /end REF_CHARACTERISTIC /begin REF_MEASUREMENT HwAgCorrln.HwAgARollgCntr.Val /end REF_MEASUREMENT /end GROUP
/begin GROUP HwAgCorrln.HwAgAStallCntPrev "MICROSAR RTE" /begin SUB_GROUP /end SUB_GROUP /begin FUNCTION_LIST /end FUNCTION_LIST /begin REF_CHARACTERISTIC /end REF_CHARACTERISTIC /begin REF_MEASUREMENT HwAgCorrln.HwAgAStallCntPrev /end REF_MEASUREMENT /end GROUP
/begin GROUP HwAgCorrln.HwAgB.Val "MICROSAR RTE" /begin SUB_GROUP /end SUB_GROUP /begin FUNCTION_LIST /end FUNCTION_LIST /begin REF_CHARACTERISTIC /end REF_CHARACTERISTIC /begin REF_MEASUREMENT HwAgCorrln.HwAgB.Val /end REF_MEASUREMENT /end GROUP
/begin GROUP HwAgCorrln.HwAgBARollgCntr.Val "MICROSAR RTE" /begin SUB_GROUP /end SUB_GROUP /begin FUNCTION_LIST /end FUNCTION_LIST /begin REF_CHARACTERISTIC /end REF_CHARACTERISTIC /begin REF_MEASUREMENT HwAgCorrln.HwAgBARollgCntr.Val /end REF_MEASUREMENT /end GROUP
/begin GROUP HwAgCorrln.HwAgBQlfr.Val "MICROSAR RTE" /begin SUB_GROUP /end SUB_GROUP /begin FUNCTION_LIST /end FUNCTION_LIST /begin REF_CHARACTERISTIC /end REF_CHARACTERISTIC /begin REF_MEASUREMENT HwAgCorrln.HwAgBQlfr.Val /end REF_MEASUREMENT /end GROUP
/begin GROUP HwAgCorrln.HwAgBRollgCntPrev "MICROSAR RTE" /begin SUB_GROUP /end SUB_GROUP /begin FUNCTION_LIST /end FUNCTION_LIST /begin REF_CHARACTERISTIC /end REF_CHARACTERISTIC /begin REF_MEASUREMENT HwAgCorrln.HwAgBRollgCntPrev /end REF_MEASUREMENT /end GROUP
/begin GROUP HwAgCorrln.HwAgBStallCntPrev "MICROSAR RTE" /begin SUB_GROUP /end SUB_GROUP /begin FUNCTION_LIST /end FUNCTION_LIST /begin REF_CHARACTERISTIC /end REF_CHARACTERISTIC /begin REF_MEASUREMENT HwAgCorrln.HwAgBStallCntPrev /end REF_MEASUREMENT /end GROUP
/begin GROUP HwAgCorrln.HwAgCorrlnHwAgAbsltDif.Val "MICROSAR RTE" /begin SUB_GROUP /end SUB_GROUP /begin FUNCTION_LIST /end FUNCTION_LIST /begin REF_CHARACTERISTIC HwAgCorrln.HwAgCorrlnHwAgAbsltDif.Val /end REF_CHARACTERISTIC /begin REF_MEASUREMENT /end REF_MEASUREMENT /end GROUP
/begin GROUP HwAgCorrln.HwAgCorrlnHwAgMaxStall.Val "MICROSAR RTE" /begin SUB_GROUP /end SUB_GROUP /begin FUNCTION_LIST /end FUNCTION_LIST /begin REF_CHARACTERISTIC HwAgCorrln.HwAgCorrlnHwAgMaxStall.Val /end REF_CHARACTERISTIC /begin REF_MEASUREMENT /end REF_MEASUREMENT /end GROUP
/begin GROUP HwAgCorrln.HwAgCorrlnNtc0x092FailStep.Val "MICROSAR RTE" /begin SUB_GROUP /end SUB_GROUP /begin FUNCTION_LIST /end FUNCTION_LIST /begin REF_CHARACTERISTIC HwAgCorrln.HwAgCorrlnNtc0x092FailStep.Val /end REF_CHARACTERISTIC /begin REF_MEASUREMENT /end REF_MEASUREMENT /end GROUP
/begin GROUP HwAgCorrln.HwAgCorrlnNtc0x092PassStep.Val "MICROSAR RTE" /begin SUB_GROUP /end SUB_GROUP /begin FUNCTION_LIST /end FUNCTION_LIST /begin REF_CHARACTERISTIC HwAgCorrln.HwAgCorrlnNtc0x092PassStep.Val /end REF_CHARACTERISTIC /begin REF_MEASUREMENT /end REF_MEASUREMENT /end GROUP
/begin GROUP HwAgCorrln.HwAgCorrlnSt.Val "MICROSAR RTE" /begin SUB_GROUP /end SUB_GROUP /begin FUNCTION_LIST /end FUNCTION_LIST /begin REF_CHARACTERISTIC /end REF_CHARACTERISTIC /begin REF_MEASUREMENT HwAgCorrln.HwAgCorrlnSt.Val /end REF_MEASUREMENT /end GROUP
/begin GROUP HwAgCorrln.HwAgIdptSig.Val "MICROSAR RTE" /begin SUB_GROUP /end SUB_GROUP /begin FUNCTION_LIST /end FUNCTION_LIST /begin REF_CHARACTERISTIC /end REF_CHARACTERISTIC /begin REF_MEASUREMENT HwAgCorrln.HwAgIdptSig.Val /end REF_MEASUREMENT /end GROUP
/begin GROUP HwAgCorrln.PerInstanceMemories "MICROSAR RTE"
 /begin SUB_GROUP HwAgCorrln.HwAgARollgCntPrev HwAgCorrln.HwAgAStallCntPrev HwAgCorrln.HwAgBRollgCntPrev HwAgCorrln.HwAgBStallCntPrev HwAgCorrln.dHwAgCorrlnAgAAvl HwAgCorrln.dHwAgCorrlnAgBAvl /end SUB_GROUP
 /begin FUNCTION_LIST /end FUNCTION_LIST
 /begin REF_CHARACTERISTIC /end REF_CHARACTERISTIC
 /begin REF_MEASUREMENT /end REF_MEASUREMENT
/end GROUP
/begin GROUP HwAgCorrln.ReceiverPorts "MICROSAR RTE"
 /begin SUB_GROUP HwAgCorrln.HwAgA.Val HwAgCorrln.HwAgAQlfr.Val HwAgCorrln.HwAgARollgCntr.Val HwAgCorrln.HwAgB.Val HwAgCorrln.HwAgBARollgCntr.Val HwAgCorrln.HwAgBQlfr.Val /end SUB_GROUP
 /begin FUNCTION_LIST /end FUNCTION_LIST
 /begin REF_CHARACTERISTIC /end REF_CHARACTERISTIC
 /begin REF_MEASUREMENT /end REF_MEASUREMENT
/end GROUP
/begin GROUP HwAgCorrln.SenderPorts "MICROSAR RTE" /begin SUB_GROUP HwAgCorrln.HwAgCorrlnSt.Val HwAgCorrln.HwAgIdptSig.Val /end SUB_GROUP /begin FUNCTION_LIST /end FUNCTION_LIST /begin REF_CHARACTERISTIC /end REF_CHARACTERISTIC /begin REF_MEASUREMENT /end REF_MEASUREMENT /end GROUP
/begin GROUP HwAgCorrln.dHwAgCorrlnAgAAvl "MICROSAR RTE" /begin SUB_GROUP /end SUB_GROUP /begin FUNCTION_LIST /end FUNCTION_LIST /begin REF_CHARACTERISTIC /end REF_CHARACTERISTIC /begin REF_MEASUREMENT HwAgCorrln.dHwAgCorrlnAgAAvl /end REF_MEASUREMENT /end GROUP
/begin GROUP HwAgCorrln.dHwAgCorrlnAgBAvl "MICROSAR RTE" /begin SUB_GROUP /end SUB_GROUP /begin FUNCTION_LIST /end FUNCTION_LIST /begin REF_CHARACTERISTIC /end REF_CHARACTERISTIC /begin REF_MEASUREMENT HwAgCorrln.dHwAgCorrlnAgBAvl /end REF_MEASUREMENT /end GROUP
/begin GROUP HwAgSnsrls "MICROSAR RTE"
 /begin SUB_GROUP HwAgSnsrls.CalibrationParameters HwAgSnsrls.CalibrationPorts HwAgSnsrls.PerInstanceMemories HwAgSnsrls.ReceiverPorts HwAgSnsrls.SenderPorts /end SUB_GROUP
 /begin FUNCTION_LIST /end FUNCTION_LIST
 /begin REF_CHARACTERISTIC /end REF_CHARACTERISTIC
 /begin REF_MEASUREMENT /end REF_MEASUREMENT
/end GROUP
/begin GROUP HwAgSnsrls.CalibrationParameters "MICROSAR RTE" /begin SUB_GROUP HwAgSnsrls.StordLstPrmDft /end SUB_GROUP /begin FUNCTION_LIST /end FUNCTION_LIST /begin REF_CHARACTERISTIC /end REF_CHARACTERISTIC /begin REF_MEASUREMENT /end REF_MEASUREMENT /end GROUP
/begin GROUP HwAgSnsrls.CalibrationPorts "MICROSAR RTE"
 /begin SUB_GROUP HwAgSnsrls.HwAgSnsrlsCorrdPinionAgHwConf.Val HwAgSnsrls.HwAgSnsrlsFCentrHwConf.Val HwAgSnsrls.HwAgSnsrlsPinionTqFilFrq.Val HwAgSnsrls.HwAgSnsrlsRelHwAgFil1Frq.Val HwAgSnsrls.HwAgSnsrlsRelHwAgFil2Frq.Val HwAgSnsrls.HwAgSnsrlsSmotngCoeff.Val HwAgSnsrls.HwAgSnsrlsSmotngStepThd.Val HwAgSnsrls.HwAgSnsrlsStordPinionConf.Val HwAgSnsrls.HwAgSnsrlsStordPinionConfThd.Val HwAgSnsrls.HwAgSnsrlsVehDynDifThd.Val HwAgSnsrls.HwAgSnsrlsVehDynHwConf.Val HwAgSnsrls.HwAgSnsrlsVehDynMotVelThd.Val HwAgSnsrls.HwAgSnsrlsVehDynPinionTqThd.Val HwAgSnsrls.HwAgSnsrlsVehDynTmr1Thd.Val HwAgSnsrls.HwAgSnsrlsVehDynTmr2Thd.Val HwAgSnsrls.HwAgSnsrlsVehDynVehSpdThd.Val HwAgSnsrls.HwAgSnsrlsVehDynYawRateThd.Val HwAgSnsrls.HwAgSnsrlsWhlFrqThd.Val HwAgSnsrls.HwAgSnsrlsWhlSpdHwAgCoeff1.Val HwAgSnsrls.HwAgSnsrlsWhlSpdHwAgCoeff2.Val HwAgSnsrls.HwAgSnsrlsWhlSpdHwAgThd.Val HwAgSnsrls.HwAgSnsrlsWhlSpdHwConf.Val HwAgSnsrls.HwAgSnsrlsWhlSpdRatThd.Val HwAgSnsrls.HwAgSnsrlsWhlSpdTmrThd.Val HwAgSnsrls.HwAgSnsrlsWhlSpdVehSpdThd.Val HwAgSnsrls.HwAgSnsrlsYawRateFilFrq.Val HwAgSnsrls.SysGlbPrmSysKineRat.Val HwAgSnsrls.SysGlbPrmSysTqRat.Val /end SUB_GROUP
 /begin FUNCTION_LIST /end FUNCTION_LIST
 /begin REF_CHARACTERISTIC /end REF_CHARACTERISTIC
 /begin REF_MEASUREMENT /end REF_MEASUREMENT
/end GROUP
/begin GROUP HwAgSnsrls.CmplncErrMotToPinion.Val "MICROSAR RTE" /begin SUB_GROUP /end SUB_GROUP /begin FUNCTION_LIST /end FUNCTION_LIST /begin REF_CHARACTERISTIC /end REF_CHARACTERISTIC /begin REF_MEASUREMENT HwAgSnsrls.CmplncErrMotToPinion.Val /end REF_MEASUREMENT /end GROUP
/begin GROUP HwAgSnsrls.CorrdPinionAgHwAgOffs "MICROSAR RTE" /begin SUB_GROUP /end SUB_GROUP /begin FUNCTION_LIST /end FUNCTION_LIST /begin REF_CHARACTERISTIC /end REF_CHARACTERISTIC /begin REF_MEASUREMENT HwAgSnsrls.CorrdPinionAgHwAgOffs /end REF_MEASUREMENT /end GROUP
/begin GROUP HwAgSnsrls.CorrdPinionAgHwConf "MICROSAR RTE" /begin SUB_GROUP /end SUB_GROUP /begin FUNCTION_LIST /end FUNCTION_LIST /begin REF_CHARACTERISTIC /end REF_CHARACTERISTIC /begin REF_MEASUREMENT HwAgSnsrls.CorrdPinionAgHwConf /end REF_MEASUREMENT /end GROUP
/begin GROUP HwAgSnsrls.FCentrHwAgEna "MICROSAR RTE" /begin SUB_GROUP /end SUB_GROUP /begin FUNCTION_LIST /end FUNCTION_LIST /begin REF_CHARACTERISTIC /end REF_CHARACTERISTIC /begin REF_MEASUREMENT HwAgSnsrls.FCentrHwAgEna /end REF_MEASUREMENT /end GROUP
/begin GROUP HwAgSnsrls.FCentrHwAgOffs "MICROSAR RTE" /begin SUB_GROUP /end SUB_GROUP /begin FUNCTION_LIST /end FUNCTION_LIST /begin REF_CHARACTERISTIC /end REF_CHARACTERISTIC /begin REF_MEASUREMENT HwAgSnsrls.FCentrHwAgOffs /end REF_MEASUREMENT /end GROUP
/begin GROUP HwAgSnsrls.FCentrHwConf "MICROSAR RTE" /begin SUB_GROUP /end SUB_GROUP /begin FUNCTION_LIST /end FUNCTION_LIST /begin REF_CHARACTERISTIC /end REF_CHARACTERISTIC /begin REF_MEASUREMENT HwAgSnsrls.FCentrHwConf /end REF_MEASUREMENT /end GROUP
/begin GROUP HwAgSnsrls.HwAgSnsrls.Val "MICROSAR RTE" /begin SUB_GROUP /end SUB_GROUP /begin FUNCTION_LIST /end FUNCTION_LIST /begin REF_CHARACTERISTIC /end REF_CHARACTERISTIC /begin REF_MEASUREMENT HwAgSnsrls.HwAgSnsrls.Val /end REF_MEASUREMENT /end GROUP
/begin GROUP HwAgSnsrls.HwAgSnsrlsConf.Val "MICROSAR RTE" /begin SUB_GROUP /end SUB_GROUP /begin FUNCTION_LIST /end FUNCTION_LIST /begin REF_CHARACTERISTIC /end REF_CHARACTERISTIC /begin REF_MEASUREMENT HwAgSnsrls.HwAgSnsrlsConf.Val /end REF_MEASUREMENT /end GROUP
/begin GROUP HwAgSnsrls.HwAgSnsrlsCorrdPinionAgHwConf.Val "MICROSAR RTE" /begin SUB_GROUP /end SUB_GROUP /begin FUNCTION_LIST /end FUNCTION_LIST /begin REF_CHARACTERISTIC HwAgSnsrls.HwAgSnsrlsCorrdPinionAgHwConf.Val /end REF_CHARACTERISTIC /begin REF_MEASUREMENT /end REF_MEASUREMENT /end GROUP
/begin GROUP HwAgSnsrls.HwAgSnsrlsFCentrHwConf.Val "MICROSAR RTE" /begin SUB_GROUP /end SUB_GROUP /begin FUNCTION_LIST /end FUNCTION_LIST /begin REF_CHARACTERISTIC HwAgSnsrls.HwAgSnsrlsFCentrHwConf.Val /end REF_CHARACTERISTIC /begin REF_MEASUREMENT /end REF_MEASUREMENT /end GROUP
/begin GROUP HwAgSnsrls.HwAgSnsrlsPinionTqFilFrq.Val "MICROSAR RTE" /begin SUB_GROUP /end SUB_GROUP /begin FUNCTION_LIST /end FUNCTION_LIST /begin REF_CHARACTERISTIC HwAgSnsrls.HwAgSnsrlsPinionTqFilFrq.Val /end REF_CHARACTERISTIC /begin REF_MEASUREMENT /end REF_MEASUREMENT /end GROUP
/begin GROUP HwAgSnsrls.HwAgSnsrlsRelHwAgFil1Frq.Val "MICROSAR RTE" /begin SUB_GROUP /end SUB_GROUP /begin FUNCTION_LIST /end FUNCTION_LIST /begin REF_CHARACTERISTIC HwAgSnsrls.HwAgSnsrlsRelHwAgFil1Frq.Val /end REF_CHARACTERISTIC /begin REF_MEASUREMENT /end REF_MEASUREMENT /end GROUP
/begin GROUP HwAgSnsrls.HwAgSnsrlsRelHwAgFil2Frq.Val "MICROSAR RTE" /begin SUB_GROUP /end SUB_GROUP /begin FUNCTION_LIST /end FUNCTION_LIST /begin REF_CHARACTERISTIC HwAgSnsrls.HwAgSnsrlsRelHwAgFil2Frq.Val /end REF_CHARACTERISTIC /begin REF_MEASUREMENT /end REF_MEASUREMENT /end GROUP
/begin GROUP HwAgSnsrls.HwAgSnsrlsSmotngCoeff.Val "MICROSAR RTE" /begin SUB_GROUP /end SUB_GROUP /begin FUNCTION_LIST /end FUNCTION_LIST /begin REF_CHARACTERISTIC HwAgSnsrls.HwAgSnsrlsSmotngCoeff.Val /end REF_CHARACTERISTIC /begin REF_MEASUREMENT /end REF_MEASUREMENT /end GROUP
/begin GROUP HwAgSnsrls.HwAgSnsrlsSmotngStepThd.Val "MICROSAR RTE" /begin SUB_GROUP /end SUB_GROUP /begin FUNCTION_LIST /end FUNCTION_LIST /begin REF_CHARACTERISTIC HwAgSnsrls.HwAgSnsrlsSmotngStepThd.Val /end REF_CHARACTERISTIC /begin REF_MEASUREMENT /end REF_MEASUREMENT /end GROUP
/begin GROUP HwAgSnsrls.HwAgSnsrlsStordPinionConf.Val "MICROSAR RTE" /begin SUB_GROUP /end SUB_GROUP /begin FUNCTION_LIST /end FUNCTION_LIST /begin REF_CHARACTERISTIC HwAgSnsrls.HwAgSnsrlsStordPinionConf.Val /end REF_CHARACTERISTIC /begin REF_MEASUREMENT /end REF_MEASUREMENT /end GROUP
/begin GROUP HwAgSnsrls.HwAgSnsrlsStordPinionConfThd.Val "MICROSAR RTE" /begin SUB_GROUP /end SUB_GROUP /begin FUNCTION_LIST /end FUNCTION_LIST /begin REF_CHARACTERISTIC HwAgSnsrls.HwAgSnsrlsStordPinionConfThd.Val /end REF_CHARACTERISTIC /begin REF_MEASUREMENT /end REF_MEASUREMENT /end GROUP
/begin GROUP HwAgSnsrls.HwAgSnsrlsVehDynDifThd.Val "MICROSAR RTE" /begin SUB_GROUP /end SUB_GROUP /begin FUNCTION_LIST /end FUNCTION_LIST /begin REF_CHARACTERISTIC HwAgSnsrls.HwAgSnsrlsVehDynDifThd.Val /end REF_CHARACTERISTIC /begin REF_MEASUREMENT /end REF_MEASUREMENT /end GROUP
/begin GROUP HwAgSnsrls.HwAgSnsrlsVehDynHwConf.Val "MICROSAR RTE" /begin SUB_GROUP /end SUB_GROUP /begin FUNCTION_LIST /end FUNCTION_LIST /begin REF_CHARACTERISTIC HwAgSnsrls.HwAgSnsrlsVehDynHwConf.Val /end REF_CHARACTERISTIC /begin REF_MEASUREMENT /end REF_MEASUREMENT /end GROUP
/begin GROUP HwAgSnsrls.HwAgSnsrlsVehDynMotVelThd.Val "MICROSAR RTE" /begin SUB_GROUP /end SUB_GROUP /begin FUNCTION_LIST /end FUNCTION_LIST /begin REF_CHARACTERISTIC HwAgSnsrls.HwAgSnsrlsVehDynMotVelThd.Val /end REF_CHARACTERISTIC /begin REF_MEASUREMENT /end REF_MEASUREMENT /end GROUP
/begin GROUP HwAgSnsrls.HwAgSnsrlsVehDynPinionTqThd.Val "MICROSAR RTE" /begin SUB_GROUP /end SUB_GROUP /begin FUNCTION_LIST /end FUNCTION_LIST /begin REF_CHARACTERISTIC HwAgSnsrls.HwAgSnsrlsVehDynPinionTqThd.Val /end REF_CHARACTERISTIC /begin REF_MEASUREMENT /end REF_MEASUREMENT /end GROUP
/begin GROUP HwAgSnsrls.HwAgSnsrlsVehDynTmr1Thd.Val "MICROSAR RTE" /begin SUB_GROUP /end SUB_GROUP /begin FUNCTION_LIST /end FUNCTION_LIST /begin REF_CHARACTERISTIC HwAgSnsrls.HwAgSnsrlsVehDynTmr1Thd.Val /end REF_CHARACTERISTIC /begin REF_MEASUREMENT /end REF_MEASUREMENT /end GROUP
/begin GROUP HwAgSnsrls.HwAgSnsrlsVehDynTmr2Thd.Val "MICROSAR RTE" /begin SUB_GROUP /end SUB_GROUP /begin FUNCTION_LIST /end FUNCTION_LIST /begin REF_CHARACTERISTIC HwAgSnsrls.HwAgSnsrlsVehDynTmr2Thd.Val /end REF_CHARACTERISTIC /begin REF_MEASUREMENT /end REF_MEASUREMENT /end GROUP
/begin GROUP HwAgSnsrls.HwAgSnsrlsVehDynVehSpdThd.Val "MICROSAR RTE" /begin SUB_GROUP /end SUB_GROUP /begin FUNCTION_LIST /end FUNCTION_LIST /begin REF_CHARACTERISTIC HwAgSnsrls.HwAgSnsrlsVehDynVehSpdThd.Val /end REF_CHARACTERISTIC /begin REF_MEASUREMENT /end REF_MEASUREMENT /end GROUP
/begin GROUP HwAgSnsrls.HwAgSnsrlsVehDynYawRateThd.Val "MICROSAR RTE" /begin SUB_GROUP /end SUB_GROUP /begin FUNCTION_LIST /end FUNCTION_LIST /begin REF_CHARACTERISTIC HwAgSnsrls.HwAgSnsrlsVehDynYawRateThd.Val /end REF_CHARACTERISTIC /begin REF_MEASUREMENT /end REF_MEASUREMENT /end GROUP
/begin GROUP HwAgSnsrls.HwAgSnsrlsWhlFrqThd.Val "MICROSAR RTE" /begin SUB_GROUP /end SUB_GROUP /begin FUNCTION_LIST /end FUNCTION_LIST /begin REF_CHARACTERISTIC HwAgSnsrls.HwAgSnsrlsWhlFrqThd.Val /end REF_CHARACTERISTIC /begin REF_MEASUREMENT /end REF_MEASUREMENT /end GROUP
/begin GROUP HwAgSnsrls.HwAgSnsrlsWhlSpdHwAgCoeff1.Val "MICROSAR RTE" /begin SUB_GROUP /end SUB_GROUP /begin FUNCTION_LIST /end FUNCTION_LIST /begin REF_CHARACTERISTIC HwAgSnsrls.HwAgSnsrlsWhlSpdHwAgCoeff1.Val /end REF_CHARACTERISTIC /begin REF_MEASUREMENT /end REF_MEASUREMENT /end GROUP
/begin GROUP HwAgSnsrls.HwAgSnsrlsWhlSpdHwAgCoeff2.Val "MICROSAR RTE" /begin SUB_GROUP /end SUB_GROUP /begin FUNCTION_LIST /end FUNCTION_LIST /begin REF_CHARACTERISTIC HwAgSnsrls.HwAgSnsrlsWhlSpdHwAgCoeff2.Val /end REF_CHARACTERISTIC /begin REF_MEASUREMENT /end REF_MEASUREMENT /end GROUP
/begin GROUP HwAgSnsrls.HwAgSnsrlsWhlSpdHwAgThd.Val "MICROSAR RTE" /begin SUB_GROUP /end SUB_GROUP /begin FUNCTION_LIST /end FUNCTION_LIST /begin REF_CHARACTERISTIC HwAgSnsrls.HwAgSnsrlsWhlSpdHwAgThd.Val /end REF_CHARACTERISTIC /begin REF_MEASUREMENT /end REF_MEASUREMENT /end GROUP
/begin GROUP HwAgSnsrls.HwAgSnsrlsWhlSpdHwConf.Val "MICROSAR RTE" /begin SUB_GROUP /end SUB_GROUP /begin FUNCTION_LIST /end FUNCTION_LIST /begin REF_CHARACTERISTIC HwAgSnsrls.HwAgSnsrlsWhlSpdHwConf.Val /end REF_CHARACTERISTIC /begin REF_MEASUREMENT /end REF_MEASUREMENT /end GROUP
/begin GROUP HwAgSnsrls.HwAgSnsrlsWhlSpdRatThd.Val "MICROSAR RTE" /begin SUB_GROUP /end SUB_GROUP /begin FUNCTION_LIST /end FUNCTION_LIST /begin REF_CHARACTERISTIC HwAgSnsrls.HwAgSnsrlsWhlSpdRatThd.Val /end REF_CHARACTERISTIC /begin REF_MEASUREMENT /end REF_MEASUREMENT /end GROUP
/begin GROUP HwAgSnsrls.HwAgSnsrlsWhlSpdTmrThd.Val "MICROSAR RTE" /begin SUB_GROUP /end SUB_GROUP /begin FUNCTION_LIST /end FUNCTION_LIST /begin REF_CHARACTERISTIC HwAgSnsrls.HwAgSnsrlsWhlSpdTmrThd.Val /end REF_CHARACTERISTIC /begin REF_MEASUREMENT /end REF_MEASUREMENT /end GROUP
/begin GROUP HwAgSnsrls.HwAgSnsrlsWhlSpdVehSpdThd.Val "MICROSAR RTE" /begin SUB_GROUP /end SUB_GROUP /begin FUNCTION_LIST /end FUNCTION_LIST /begin REF_CHARACTERISTIC HwAgSnsrls.HwAgSnsrlsWhlSpdVehSpdThd.Val /end REF_CHARACTERISTIC /begin REF_MEASUREMENT /end REF_MEASUREMENT /end GROUP
/begin GROUP HwAgSnsrls.HwAgSnsrlsYawRateFilFrq.Val "MICROSAR RTE" /begin SUB_GROUP /end SUB_GROUP /begin FUNCTION_LIST /end FUNCTION_LIST /begin REF_CHARACTERISTIC HwAgSnsrls.HwAgSnsrlsYawRateFilFrq.Val /end REF_CHARACTERISTIC /begin REF_MEASUREMENT /end REF_MEASUREMENT /end GROUP
/begin GROUP HwAgSnsrls.HwTq.Val "MICROSAR RTE" /begin SUB_GROUP /end SUB_GROUP /begin FUNCTION_LIST /end FUNCTION_LIST /begin REF_CHARACTERISTIC /end REF_CHARACTERISTIC /begin REF_MEASUREMENT HwAgSnsrls.HwTq.Val /end REF_MEASUREMENT /end GROUP
/begin GROUP HwAgSnsrls.MotAgCumvAlgndCrf.Val "MICROSAR RTE" /begin SUB_GROUP /end SUB_GROUP /begin FUNCTION_LIST /end FUNCTION_LIST /begin REF_CHARACTERISTIC /end REF_CHARACTERISTIC /begin REF_MEASUREMENT HwAgSnsrls.MotAgCumvAlgndCrf.Val /end REF_MEASUREMENT /end GROUP
/begin GROUP HwAgSnsrls.MotAgCumvAlgndVld.Logl "MICROSAR RTE" /begin SUB_GROUP /end SUB_GROUP /begin FUNCTION_LIST /end FUNCTION_LIST /begin REF_CHARACTERISTIC /end REF_CHARACTERISTIC /begin REF_MEASUREMENT HwAgSnsrls.MotAgCumvAlgndVld.Logl /end REF_MEASUREMENT /end GROUP
/begin GROUP HwAgSnsrls.MotAgOffs "MICROSAR RTE" /begin SUB_GROUP /end SUB_GROUP /begin FUNCTION_LIST /end FUNCTION_LIST /begin REF_CHARACTERISTIC /end REF_CHARACTERISTIC /begin REF_MEASUREMENT HwAgSnsrls.MotAgOffs /end REF_MEASUREMENT /end GROUP
/begin GROUP HwAgSnsrls.MotAgOffsEna "MICROSAR RTE" /begin SUB_GROUP /end SUB_GROUP /begin FUNCTION_LIST /end FUNCTION_LIST /begin REF_CHARACTERISTIC /end REF_CHARACTERISTIC /begin REF_MEASUREMENT HwAgSnsrls.MotAgOffsEna /end REF_MEASUREMENT /end GROUP
/begin GROUP HwAgSnsrls.MotTqCmdCrf.Val "MICROSAR RTE" /begin SUB_GROUP /end SUB_GROUP /begin FUNCTION_LIST /end FUNCTION_LIST /begin REF_CHARACTERISTIC /end REF_CHARACTERISTIC /begin REF_MEASUREMENT HwAgSnsrls.MotTqCmdCrf.Val /end REF_MEASUREMENT /end GROUP
/begin GROUP HwAgSnsrls.MotVelCrf.Val "MICROSAR RTE" /begin SUB_GROUP /end SUB_GROUP /begin FUNCTION_LIST /end FUNCTION_LIST /begin REF_CHARACTERISTIC /end REF_CHARACTERISTIC /begin REF_MEASUREMENT HwAgSnsrls.MotVelCrf.Val /end REF_MEASUREMENT /end GROUP
/begin GROUP HwAgSnsrls.PerInstanceMemories "MICROSAR RTE"
 /begin SUB_GROUP HwAgSnsrls.CorrdPinionAgHwAgOffs HwAgSnsrls.CorrdPinionAgHwConf HwAgSnsrls.FCentrHwAgEna HwAgSnsrls.FCentrHwAgOffs HwAgSnsrls.FCentrHwConf HwAgSnsrls.MotAgOffs HwAgSnsrls.MotAgOffsEna HwAgSnsrls.PinionTqFil HwAgSnsrls.PrevFildRelHwAg1 HwAgSnsrls.PrevHwAgOffs HwAgSnsrls.PrevMaxHwConf HwAgSnsrls.PrevSmotngHwAg HwAgSnsrls.PrevSmotngSt HwAgSnsrls.PrevVehDynFil1Ena HwAgSnsrls.PrevVehDynFil2Ena HwAgSnsrls.RelHwAgFil1 HwAgSnsrls.RelHwAgFil2 HwAgSnsrls.SelnCaseSt HwAgSnsrls.StordLstPrm HwAgSnsrls.VehDynHwAgOffs HwAgSnsrls.VehDynRefTmr1 HwAgSnsrls.VehDynRefTmr2 HwAgSnsrls.WhlSpdHwAgLrndEna HwAgSnsrls.WhlSpdHwAgOffs HwAgSnsrls.WhlSpdHwConf HwAgSnsrls.WhlSpdRefTmr HwAgSnsrls.YawRateFil HwAgSnsrls.dHwAgSnsrlsStordHwAg HwAgSnsrls.dHwAgSnsrlsStordHwConf HwAgSnsrls.dHwAgSnsrlsVehDynHwConf HwAgSnsrls.dHwAgSnsrlsWhlSpdHwConf /end SUB_GROUP
 /begin FUNCTION_LIST /end FUNCTION_LIST
 /begin REF_CHARACTERISTIC /end REF_CHARACTERISTIC
 /begin REF_MEASUREMENT /end REF_MEASUREMENT
/end GROUP
/begin GROUP HwAgSnsrls.PinionAg.Val "MICROSAR RTE" /begin SUB_GROUP /end SUB_GROUP /begin FUNCTION_LIST /end FUNCTION_LIST /begin REF_CHARACTERISTIC /end REF_CHARACTERISTIC /begin REF_MEASUREMENT HwAgSnsrls.PinionAg.Val /end REF_MEASUREMENT /end GROUP
/begin GROUP HwAgSnsrls.PinionAgConf.Val "MICROSAR RTE" /begin SUB_GROUP /end SUB_GROUP /begin FUNCTION_LIST /end FUNCTION_LIST /begin REF_CHARACTERISTIC /end REF_CHARACTERISTIC /begin REF_MEASUREMENT HwAgSnsrls.PinionAgConf.Val /end REF_MEASUREMENT /end GROUP
/begin GROUP HwAgSnsrls.PinionTqFil "MICROSAR RTE" /begin SUB_GROUP /end SUB_GROUP /begin FUNCTION_LIST /end FUNCTION_LIST /begin REF_CHARACTERISTIC /end REF_CHARACTERISTIC
 /begin REF_MEASUREMENT HwAgSnsrls.PinionTqFil.FilGain HwAgSnsrls.PinionTqFil.FilSt /end REF_MEASUREMENT
/end GROUP
/begin GROUP HwAgSnsrls.PrevFildRelHwAg1 "MICROSAR RTE" /begin SUB_GROUP /end SUB_GROUP /begin FUNCTION_LIST /end FUNCTION_LIST /begin REF_CHARACTERISTIC /end REF_CHARACTERISTIC /begin REF_MEASUREMENT HwAgSnsrls.PrevFildRelHwAg1 /end REF_MEASUREMENT /end GROUP
/begin GROUP HwAgSnsrls.PrevHwAgOffs "MICROSAR RTE" /begin SUB_GROUP /end SUB_GROUP /begin FUNCTION_LIST /end FUNCTION_LIST /begin REF_CHARACTERISTIC /end REF_CHARACTERISTIC /begin REF_MEASUREMENT HwAgSnsrls.PrevHwAgOffs /end REF_MEASUREMENT /end GROUP
/begin GROUP HwAgSnsrls.PrevMaxHwConf "MICROSAR RTE" /begin SUB_GROUP /end SUB_GROUP /begin FUNCTION_LIST /end FUNCTION_LIST /begin REF_CHARACTERISTIC /end REF_CHARACTERISTIC /begin REF_MEASUREMENT HwAgSnsrls.PrevMaxHwConf /end REF_MEASUREMENT /end GROUP
/begin GROUP HwAgSnsrls.PrevSmotngHwAg "MICROSAR RTE" /begin SUB_GROUP /end SUB_GROUP /begin FUNCTION_LIST /end FUNCTION_LIST /begin REF_CHARACTERISTIC /end REF_CHARACTERISTIC /begin REF_MEASUREMENT HwAgSnsrls.PrevSmotngHwAg /end REF_MEASUREMENT /end GROUP
/begin GROUP HwAgSnsrls.PrevSmotngSt "MICROSAR RTE" /begin SUB_GROUP /end SUB_GROUP /begin FUNCTION_LIST /end FUNCTION_LIST /begin REF_CHARACTERISTIC /end REF_CHARACTERISTIC /begin REF_MEASUREMENT HwAgSnsrls.PrevSmotngSt /end REF_MEASUREMENT /end GROUP
/begin GROUP HwAgSnsrls.PrevVehDynFil1Ena "MICROSAR RTE" /begin SUB_GROUP /end SUB_GROUP /begin FUNCTION_LIST /end FUNCTION_LIST /begin REF_CHARACTERISTIC /end REF_CHARACTERISTIC /begin REF_MEASUREMENT HwAgSnsrls.PrevVehDynFil1Ena /end REF_MEASUREMENT /end GROUP
/begin GROUP HwAgSnsrls.PrevVehDynFil2Ena "MICROSAR RTE" /begin SUB_GROUP /end SUB_GROUP /begin FUNCTION_LIST /end FUNCTION_LIST /begin REF_CHARACTERISTIC /end REF_CHARACTERISTIC /begin REF_MEASUREMENT HwAgSnsrls.PrevVehDynFil2Ena /end REF_MEASUREMENT /end GROUP
/begin GROUP HwAgSnsrls.ReceiverPorts "MICROSAR RTE"
 /begin SUB_GROUP HwAgSnsrls.CmplncErrMotToPinion.Val HwAgSnsrls.HwTq.Val HwAgSnsrls.MotAgCumvAlgndCrf.Val HwAgSnsrls.MotAgCumvAlgndVld.Logl HwAgSnsrls.MotTqCmdCrf.Val HwAgSnsrls.MotVelCrf.Val HwAgSnsrls.PinionAg.Val HwAgSnsrls.PinionAgConf.Val HwAgSnsrls.VehSpd.Val HwAgSnsrls.VehSpdVld.Logl HwAgSnsrls.VehYawRate.Val HwAgSnsrls.WhlFrqVld.Logl HwAgSnsrls.WhlLeFrq.Val HwAgSnsrls.WhlRiFrq.Val /end SUB_GROUP
 /begin FUNCTION_LIST /end FUNCTION_LIST
 /begin REF_CHARACTERISTIC /end REF_CHARACTERISTIC
 /begin REF_MEASUREMENT /end REF_MEASUREMENT
/end GROUP
/begin GROUP HwAgSnsrls.RelHwAgFil1 "MICROSAR RTE" /begin SUB_GROUP /end SUB_GROUP /begin FUNCTION_LIST /end FUNCTION_LIST /begin REF_CHARACTERISTIC /end REF_CHARACTERISTIC
 /begin REF_MEASUREMENT HwAgSnsrls.RelHwAgFil1.FilGain HwAgSnsrls.RelHwAgFil1.FilSt /end REF_MEASUREMENT
/end GROUP
/begin GROUP HwAgSnsrls.RelHwAgFil2 "MICROSAR RTE" /begin SUB_GROUP /end SUB_GROUP /begin FUNCTION_LIST /end FUNCTION_LIST /begin REF_CHARACTERISTIC /end REF_CHARACTERISTIC
 /begin REF_MEASUREMENT HwAgSnsrls.RelHwAgFil2.FilGain HwAgSnsrls.RelHwAgFil2.FilSt /end REF_MEASUREMENT
/end GROUP
/begin GROUP HwAgSnsrls.SelnCaseSt "MICROSAR RTE" /begin SUB_GROUP /end SUB_GROUP /begin FUNCTION_LIST /end FUNCTION_LIST /begin REF_CHARACTERISTIC /end REF_CHARACTERISTIC /begin REF_MEASUREMENT HwAgSnsrls.SelnCaseSt /end REF_MEASUREMENT /end GROUP
/begin GROUP HwAgSnsrls.SenderPorts "MICROSAR RTE" /begin SUB_GROUP HwAgSnsrls.HwAgSnsrls.Val HwAgSnsrls.HwAgSnsrlsConf.Val /end SUB_GROUP /begin FUNCTION_LIST /end FUNCTION_LIST /begin REF_CHARACTERISTIC /end REF_CHARACTERISTIC /begin REF_MEASUREMENT /end REF_MEASUREMENT /end GROUP
/begin GROUP HwAgSnsrls.StordLstPrm "MICROSAR RTE" /begin SUB_GROUP /end SUB_GROUP /begin FUNCTION_LIST /end FUNCTION_LIST /begin REF_CHARACTERISTIC /end REF_CHARACTERISTIC
 /begin REF_MEASUREMENT HwAgSnsrls.StordLstPrm.PinionAg HwAgSnsrls.StordLstPrm.PinionAgVld /end REF_MEASUREMENT
/end GROUP
/begin GROUP HwAgSnsrls.StordLstPrmDft "MICROSAR RTE" /begin SUB_GROUP /end SUB_GROUP /begin FUNCTION_LIST /end FUNCTION_LIST
 /begin REF_CHARACTERISTIC HwAgSnsrls.StordLstPrmDft.PinionAg HwAgSnsrls.StordLstPrmDft.PinionAgVld /end REF_CHARACTERISTIC
 /begin REF_MEASUREMENT /end REF_MEASUREMENT
/end GROUP
/begin GROUP HwAgSnsrls.SysGlbPrmSysKineRat.Val "MICROSAR RTE" /begin SUB_GROUP /end SUB_GROUP /begin FUNCTION_LIST /end FUNCTION_LIST /begin REF_CHARACTERISTIC HwAgSnsrls.SysGlbPrmSysKineRat.Val /end REF_CHARACTERISTIC /begin REF_MEASUREMENT /end REF_MEASUREMENT /end GROUP
/begin GROUP HwAgSnsrls.SysGlbPrmSysTqRat.Val "MICROSAR RTE" /begin SUB_GROUP /end SUB_GROUP /begin FUNCTION_LIST /end FUNCTION_LIST /begin REF_CHARACTERISTIC HwAgSnsrls.SysGlbPrmSysTqRat.Val /end REF_CHARACTERISTIC /begin REF_MEASUREMENT /end REF_MEASUREMENT /end GROUP
/begin GROUP HwAgSnsrls.VehDynHwAgOffs "MICROSAR RTE" /begin SUB_GROUP /end SUB_GROUP /begin FUNCTION_LIST /end FUNCTION_LIST /begin REF_CHARACTERISTIC /end REF_CHARACTERISTIC /begin REF_MEASUREMENT HwAgSnsrls.VehDynHwAgOffs /end REF_MEASUREMENT /end GROUP
/begin GROUP HwAgSnsrls.VehDynRefTmr1 "MICROSAR RTE" /begin SUB_GROUP /end SUB_GROUP /begin FUNCTION_LIST /end FUNCTION_LIST /begin REF_CHARACTERISTIC /end REF_CHARACTERISTIC /begin REF_MEASUREMENT HwAgSnsrls.VehDynRefTmr1 /end REF_MEASUREMENT /end GROUP
/begin GROUP HwAgSnsrls.VehDynRefTmr2 "MICROSAR RTE" /begin SUB_GROUP /end SUB_GROUP /begin FUNCTION_LIST /end FUNCTION_LIST /begin REF_CHARACTERISTIC /end REF_CHARACTERISTIC /begin REF_MEASUREMENT HwAgSnsrls.VehDynRefTmr2 /end REF_MEASUREMENT /end GROUP
/begin GROUP HwAgSnsrls.VehSpd.Val "MICROSAR RTE" /begin SUB_GROUP /end SUB_GROUP /begin FUNCTION_LIST /end FUNCTION_LIST /begin REF_CHARACTERISTIC /end REF_CHARACTERISTIC /begin REF_MEASUREMENT HwAgSnsrls.VehSpd.Val /end REF_MEASUREMENT /end GROUP
/begin GROUP HwAgSnsrls.VehSpdVld.Logl "MICROSAR RTE" /begin SUB_GROUP /end SUB_GROUP /begin FUNCTION_LIST /end FUNCTION_LIST /begin REF_CHARACTERISTIC /end REF_CHARACTERISTIC /begin REF_MEASUREMENT HwAgSnsrls.VehSpdVld.Logl /end REF_MEASUREMENT /end GROUP
/begin GROUP HwAgSnsrls.VehYawRate.Val "MICROSAR RTE" /begin SUB_GROUP /end SUB_GROUP /begin FUNCTION_LIST /end FUNCTION_LIST /begin REF_CHARACTERISTIC /end REF_CHARACTERISTIC /begin REF_MEASUREMENT HwAgSnsrls.VehYawRate.Val /end REF_MEASUREMENT /end GROUP
/begin GROUP HwAgSnsrls.WhlFrqVld.Logl "MICROSAR RTE" /begin SUB_GROUP /end SUB_GROUP /begin FUNCTION_LIST /end FUNCTION_LIST /begin REF_CHARACTERISTIC /end REF_CHARACTERISTIC /begin REF_MEASUREMENT HwAgSnsrls.WhlFrqVld.Logl /end REF_MEASUREMENT /end GROUP
/begin GROUP HwAgSnsrls.WhlLeFrq.Val "MICROSAR RTE" /begin SUB_GROUP /end SUB_GROUP /begin FUNCTION_LIST /end FUNCTION_LIST /begin REF_CHARACTERISTIC /end REF_CHARACTERISTIC /begin REF_MEASUREMENT HwAgSnsrls.WhlLeFrq.Val /end REF_MEASUREMENT /end GROUP
/begin GROUP HwAgSnsrls.WhlRiFrq.Val "MICROSAR RTE" /begin SUB_GROUP /end SUB_GROUP /begin FUNCTION_LIST /end FUNCTION_LIST /begin REF_CHARACTERISTIC /end REF_CHARACTERISTIC /begin REF_MEASUREMENT HwAgSnsrls.WhlRiFrq.Val /end REF_MEASUREMENT /end GROUP
/begin GROUP HwAgSnsrls.WhlSpdHwAgLrndEna "MICROSAR RTE" /begin SUB_GROUP /end SUB_GROUP /begin FUNCTION_LIST /end FUNCTION_LIST /begin REF_CHARACTERISTIC /end REF_CHARACTERISTIC /begin REF_MEASUREMENT HwAgSnsrls.WhlSpdHwAgLrndEna /end REF_MEASUREMENT /end GROUP
/begin GROUP HwAgSnsrls.WhlSpdHwAgOffs "MICROSAR RTE" /begin SUB_GROUP /end SUB_GROUP /begin FUNCTION_LIST /end FUNCTION_LIST /begin REF_CHARACTERISTIC /end REF_CHARACTERISTIC /begin REF_MEASUREMENT HwAgSnsrls.WhlSpdHwAgOffs /end REF_MEASUREMENT /end GROUP
/begin GROUP HwAgSnsrls.WhlSpdHwConf "MICROSAR RTE" /begin SUB_GROUP /end SUB_GROUP /begin FUNCTION_LIST /end FUNCTION_LIST /begin REF_CHARACTERISTIC /end REF_CHARACTERISTIC /begin REF_MEASUREMENT HwAgSnsrls.WhlSpdHwConf /end REF_MEASUREMENT /end GROUP
/begin GROUP HwAgSnsrls.WhlSpdRefTmr "MICROSAR RTE" /begin SUB_GROUP /end SUB_GROUP /begin FUNCTION_LIST /end FUNCTION_LIST /begin REF_CHARACTERISTIC /end REF_CHARACTERISTIC /begin REF_MEASUREMENT HwAgSnsrls.WhlSpdRefTmr /end REF_MEASUREMENT /end GROUP
/begin GROUP HwAgSnsrls.YawRateFil "MICROSAR RTE" /begin SUB_GROUP /end SUB_GROUP /begin FUNCTION_LIST /end FUNCTION_LIST /begin REF_CHARACTERISTIC /end REF_CHARACTERISTIC /begin REF_MEASUREMENT HwAgSnsrls.YawRateFil.FilGain HwAgSnsrls.YawRateFil.FilSt /end REF_MEASUREMENT /end GROUP
/begin GROUP HwAgSnsrls.dHwAgSnsrlsStordHwAg "MICROSAR RTE" /begin SUB_GROUP /end SUB_GROUP /begin FUNCTION_LIST /end FUNCTION_LIST /begin REF_CHARACTERISTIC /end REF_CHARACTERISTIC /begin REF_MEASUREMENT HwAgSnsrls.dHwAgSnsrlsStordHwAg /end REF_MEASUREMENT /end GROUP
/begin GROUP HwAgSnsrls.dHwAgSnsrlsStordHwConf "MICROSAR RTE" /begin SUB_GROUP /end SUB_GROUP /begin FUNCTION_LIST /end FUNCTION_LIST /begin REF_CHARACTERISTIC /end REF_CHARACTERISTIC /begin REF_MEASUREMENT HwAgSnsrls.dHwAgSnsrlsStordHwConf /end REF_MEASUREMENT /end GROUP
/begin GROUP HwAgSnsrls.dHwAgSnsrlsVehDynHwConf "MICROSAR RTE" /begin SUB_GROUP /end SUB_GROUP /begin FUNCTION_LIST /end FUNCTION_LIST /begin REF_CHARACTERISTIC /end REF_CHARACTERISTIC /begin REF_MEASUREMENT HwAgSnsrls.dHwAgSnsrlsVehDynHwConf /end REF_MEASUREMENT /end GROUP
/begin GROUP HwAgSnsrls.dHwAgSnsrlsWhlSpdHwConf "MICROSAR RTE" /begin SUB_GROUP /end SUB_GROUP /begin FUNCTION_LIST /end FUNCTION_LIST /begin REF_CHARACTERISTIC /end REF_CHARACTERISTIC /begin REF_MEASUREMENT HwAgSnsrls.dHwAgSnsrlsWhlSpdHwConf /end REF_MEASUREMENT /end GROUP
/begin GROUP HwAgSysArbn "MICROSAR RTE"
 /begin SUB_GROUP HwAgSysArbn.CalibrationPorts HwAgSysArbn.PerInstanceMemories HwAgSysArbn.ReceiverPorts HwAgSysArbn.SenderPorts /end SUB_GROUP
 /begin FUNCTION_LIST /end FUNCTION_LIST
 /begin REF_CHARACTERISTIC /end REF_CHARACTERISTIC
 /begin REF_MEASUREMENT /end REF_MEASUREMENT
/end GROUP
/begin GROUP HwAgSysArbn.CalibrationPorts "MICROSAR RTE"
 /begin SUB_GROUP HwAgSysArbn.HwAgSysArbnHwAgConf1Snsr.Val HwAgSysArbn.HwAgSysArbnHwAgConf2Snsr.Val HwAgSysArbn.HwAgSysArbnHwAgConfNoSnsr.Val HwAgSysArbn.HwAgSysArbnHwAgCorrdCorrlnThd.Val HwAgSysArbn.HwAgSysArbnHwAgCorrlnFailDebStep.Val HwAgSysArbn.HwAgSysArbnHwAgCorrlnPassDebStep.Val HwAgSysArbn.HwAgSysArbnHwAgCorrlnRng.Val HwAgSysArbn.HwAgSysArbnHwAgSlewRate.Val HwAgSysArbn.HwAgSysArbnHwAgSnsrlsCorrlnThd.Val HwAgSysArbn.HwAgSysArbnHwAgSnsrlsKineThd.Val HwAgSysArbn.HwAgSysArbnHwAgToMotAgCorrlnElpdTiLim.Val HwAgSysArbn.HwAgSysArbnSerlComHwAgCorrdConf.Val HwAgSysArbn.HwAgSysArbnSerlComHwAgSnsrlsConf.Val HwAgSysArbn.HwAgSysArbnSlewRateTmr.Val HwAgSysArbn.HwAgSysArbnTqSnsrVelFilFrq.Val HwAgSysArbn.SysGlbPrmSysKineRat.Val HwAgSysArbn.SysGlbPrmTorsBarStfn.Val /end SUB_GROUP
 /begin FUNCTION_LIST /end FUNCTION_LIST
 /begin REF_CHARACTERISTIC /end REF_CHARACTERISTIC
 /begin REF_MEASUREMENT /end REF_MEASUREMENT
/end GROUP
/begin GROUP HwAgSysArbn.CmplncErrMotToPinion.Val "MICROSAR RTE" /begin SUB_GROUP /end SUB_GROUP /begin FUNCTION_LIST /end FUNCTION_LIST /begin REF_CHARACTERISTIC /end REF_CHARACTERISTIC /begin REF_MEASUREMENT HwAgSysArbn.CmplncErrMotToPinion.Val /end REF_MEASUREMENT /end GROUP
/begin GROUP HwAgSysArbn.CmplncErrPinionToHw.Val "MICROSAR RTE" /begin SUB_GROUP /end SUB_GROUP /begin FUNCTION_LIST /end FUNCTION_LIST /begin REF_CHARACTERISTIC /end REF_CHARACTERISTIC /begin REF_MEASUREMENT HwAgSysArbn.CmplncErrPinionToHw.Val /end REF_MEASUREMENT /end GROUP
/begin GROUP HwAgSysArbn.HwAg.Val "MICROSAR RTE" /begin SUB_GROUP /end SUB_GROUP /begin FUNCTION_LIST /end FUNCTION_LIST /begin REF_CHARACTERISTIC /end REF_CHARACTERISTIC /begin REF_MEASUREMENT HwAgSysArbn.HwAg.Val /end REF_MEASUREMENT /end GROUP
/begin GROUP HwAgSysArbn.HwAgCorrd.Val "MICROSAR RTE" /begin SUB_GROUP /end SUB_GROUP /begin FUNCTION_LIST /end FUNCTION_LIST /begin REF_CHARACTERISTIC /end REF_CHARACTERISTIC /begin REF_MEASUREMENT HwAgSysArbn.HwAgCorrd.Val /end REF_MEASUREMENT /end GROUP
/begin GROUP HwAgSysArbn.HwAgCorrdLtch "MICROSAR RTE" /begin SUB_GROUP /end SUB_GROUP /begin FUNCTION_LIST /end FUNCTION_LIST /begin REF_CHARACTERISTIC /end REF_CHARACTERISTIC /begin REF_MEASUREMENT HwAgSysArbn.HwAgCorrdLtch /end REF_MEASUREMENT /end GROUP
/begin GROUP HwAgSysArbn.HwAgFinal.Val "MICROSAR RTE" /begin SUB_GROUP /end SUB_GROUP /begin FUNCTION_LIST /end FUNCTION_LIST /begin REF_CHARACTERISTIC /end REF_CHARACTERISTIC /begin REF_MEASUREMENT HwAgSysArbn.HwAgFinal.Val /end REF_MEASUREMENT /end GROUP
/begin GROUP HwAgSysArbn.HwAgIdptSig.Val "MICROSAR RTE" /begin SUB_GROUP /end SUB_GROUP /begin FUNCTION_LIST /end FUNCTION_LIST /begin REF_CHARACTERISTIC /end REF_CHARACTERISTIC /begin REF_MEASUREMENT HwAgSysArbn.HwAgIdptSig.Val /end REF_MEASUREMENT /end GROUP
/begin GROUP HwAgSysArbn.HwAgKineFlt "MICROSAR RTE" /begin SUB_GROUP /end SUB_GROUP /begin FUNCTION_LIST /end FUNCTION_LIST /begin REF_CHARACTERISTIC /end REF_CHARACTERISTIC /begin REF_MEASUREMENT HwAgSysArbn.HwAgKineFlt /end REF_MEASUREMENT /end GROUP
/begin GROUP HwAgSysArbn.HwAgNotCorrd.Val "MICROSAR RTE" /begin SUB_GROUP /end SUB_GROUP /begin FUNCTION_LIST /end FUNCTION_LIST /begin REF_CHARACTERISTIC /end REF_CHARACTERISTIC /begin REF_MEASUREMENT HwAgSysArbn.HwAgNotCorrd.Val /end REF_MEASUREMENT /end GROUP
/begin GROUP HwAgSysArbn.HwAgPrev "MICROSAR RTE" /begin SUB_GROUP /end SUB_GROUP /begin FUNCTION_LIST /end FUNCTION_LIST /begin REF_CHARACTERISTIC /end REF_CHARACTERISTIC /begin REF_MEASUREMENT HwAgSysArbn.HwAgPrev /end REF_MEASUREMENT /end GROUP
/begin GROUP HwAgSysArbn.HwAgSnsrls.Val "MICROSAR RTE" /begin SUB_GROUP /end SUB_GROUP /begin FUNCTION_LIST /end FUNCTION_LIST /begin REF_CHARACTERISTIC /end REF_CHARACTERISTIC /begin REF_MEASUREMENT HwAgSysArbn.HwAgSnsrls.Val /end REF_MEASUREMENT /end GROUP
/begin GROUP HwAgSysArbn.HwAgSnsrlsConf.Val "MICROSAR RTE" /begin SUB_GROUP /end SUB_GROUP /begin FUNCTION_LIST /end FUNCTION_LIST /begin REF_CHARACTERISTIC /end REF_CHARACTERISTIC /begin REF_MEASUREMENT HwAgSysArbn.HwAgSnsrlsConf.Val /end REF_MEASUREMENT /end GROUP
/begin GROUP HwAgSysArbn.HwAgSysArbnHwAgConf1Snsr.Val "MICROSAR RTE" /begin SUB_GROUP /end SUB_GROUP /begin FUNCTION_LIST /end FUNCTION_LIST /begin REF_CHARACTERISTIC HwAgSysArbn.HwAgSysArbnHwAgConf1Snsr.Val /end REF_CHARACTERISTIC /begin REF_MEASUREMENT /end REF_MEASUREMENT /end GROUP
/begin GROUP HwAgSysArbn.HwAgSysArbnHwAgConf2Snsr.Val "MICROSAR RTE" /begin SUB_GROUP /end SUB_GROUP /begin FUNCTION_LIST /end FUNCTION_LIST /begin REF_CHARACTERISTIC HwAgSysArbn.HwAgSysArbnHwAgConf2Snsr.Val /end REF_CHARACTERISTIC /begin REF_MEASUREMENT /end REF_MEASUREMENT /end GROUP
/begin GROUP HwAgSysArbn.HwAgSysArbnHwAgConfNoSnsr.Val "MICROSAR RTE" /begin SUB_GROUP /end SUB_GROUP /begin FUNCTION_LIST /end FUNCTION_LIST /begin REF_CHARACTERISTIC HwAgSysArbn.HwAgSysArbnHwAgConfNoSnsr.Val /end REF_CHARACTERISTIC /begin REF_MEASUREMENT /end REF_MEASUREMENT /end GROUP
/begin GROUP HwAgSysArbn.HwAgSysArbnHwAgCorrdCorrlnThd.Val "MICROSAR RTE" /begin SUB_GROUP /end SUB_GROUP /begin FUNCTION_LIST /end FUNCTION_LIST /begin REF_CHARACTERISTIC HwAgSysArbn.HwAgSysArbnHwAgCorrdCorrlnThd.Val /end REF_CHARACTERISTIC /begin REF_MEASUREMENT /end REF_MEASUREMENT /end GROUP
/begin GROUP HwAgSysArbn.HwAgSysArbnHwAgCorrlnFailDebStep.Val "MICROSAR RTE" /begin SUB_GROUP /end SUB_GROUP /begin FUNCTION_LIST /end FUNCTION_LIST /begin REF_CHARACTERISTIC HwAgSysArbn.HwAgSysArbnHwAgCorrlnFailDebStep.Val /end REF_CHARACTERISTIC /begin REF_MEASUREMENT /end REF_MEASUREMENT /end GROUP
/begin GROUP HwAgSysArbn.HwAgSysArbnHwAgCorrlnPassDebStep.Val "MICROSAR RTE" /begin SUB_GROUP /end SUB_GROUP /begin FUNCTION_LIST /end FUNCTION_LIST /begin REF_CHARACTERISTIC HwAgSysArbn.HwAgSysArbnHwAgCorrlnPassDebStep.Val /end REF_CHARACTERISTIC /begin REF_MEASUREMENT /end REF_MEASUREMENT /end GROUP
/begin GROUP HwAgSysArbn.HwAgSysArbnHwAgCorrlnRng.Val "MICROSAR RTE" /begin SUB_GROUP /end SUB_GROUP /begin FUNCTION_LIST /end FUNCTION_LIST /begin REF_CHARACTERISTIC HwAgSysArbn.HwAgSysArbnHwAgCorrlnRng.Val /end REF_CHARACTERISTIC /begin REF_MEASUREMENT /end REF_MEASUREMENT /end GROUP
/begin GROUP HwAgSysArbn.HwAgSysArbnHwAgSlewRate.Val "MICROSAR RTE" /begin SUB_GROUP /end SUB_GROUP /begin FUNCTION_LIST /end FUNCTION_LIST /begin REF_CHARACTERISTIC HwAgSysArbn.HwAgSysArbnHwAgSlewRate.Val /end REF_CHARACTERISTIC /begin REF_MEASUREMENT /end REF_MEASUREMENT /end GROUP
/begin GROUP HwAgSysArbn.HwAgSysArbnHwAgSnsrlsCorrlnThd.Val "MICROSAR RTE" /begin SUB_GROUP /end SUB_GROUP /begin FUNCTION_LIST /end FUNCTION_LIST /begin REF_CHARACTERISTIC HwAgSysArbn.HwAgSysArbnHwAgSnsrlsCorrlnThd.Val /end REF_CHARACTERISTIC /begin REF_MEASUREMENT /end REF_MEASUREMENT /end GROUP
/begin GROUP HwAgSysArbn.HwAgSysArbnHwAgSnsrlsKineThd.Val "MICROSAR RTE" /begin SUB_GROUP /end SUB_GROUP /begin FUNCTION_LIST /end FUNCTION_LIST /begin REF_CHARACTERISTIC HwAgSysArbn.HwAgSysArbnHwAgSnsrlsKineThd.Val /end REF_CHARACTERISTIC /begin REF_MEASUREMENT /end REF_MEASUREMENT /end GROUP
/begin GROUP HwAgSysArbn.HwAgSysArbnHwAgToMotAgCorrlnElpdTiLim.Val "MICROSAR RTE" /begin SUB_GROUP /end SUB_GROUP /begin FUNCTION_LIST /end FUNCTION_LIST /begin REF_CHARACTERISTIC HwAgSysArbn.HwAgSysArbnHwAgToMotAgCorrlnElpdTiLim.Val /end REF_CHARACTERISTIC /begin REF_MEASUREMENT /end REF_MEASUREMENT /end GROUP
/begin GROUP HwAgSysArbn.HwAgSysArbnSerlComHwAgCorrdConf.Val "MICROSAR RTE" /begin SUB_GROUP /end SUB_GROUP /begin FUNCTION_LIST /end FUNCTION_LIST /begin REF_CHARACTERISTIC HwAgSysArbn.HwAgSysArbnSerlComHwAgCorrdConf.Val /end REF_CHARACTERISTIC /begin REF_MEASUREMENT /end REF_MEASUREMENT /end GROUP
/begin GROUP HwAgSysArbn.HwAgSysArbnSerlComHwAgSnsrlsConf.Val "MICROSAR RTE" /begin SUB_GROUP /end SUB_GROUP /begin FUNCTION_LIST /end FUNCTION_LIST /begin REF_CHARACTERISTIC HwAgSysArbn.HwAgSysArbnSerlComHwAgSnsrlsConf.Val /end REF_CHARACTERISTIC /begin REF_MEASUREMENT /end REF_MEASUREMENT /end GROUP
/begin GROUP HwAgSysArbn.HwAgSysArbnSlewRateTmr.Val "MICROSAR RTE" /begin SUB_GROUP /end SUB_GROUP /begin FUNCTION_LIST /end FUNCTION_LIST /begin REF_CHARACTERISTIC HwAgSysArbn.HwAgSysArbnSlewRateTmr.Val /end REF_CHARACTERISTIC /begin REF_MEASUREMENT /end REF_MEASUREMENT /end GROUP
/begin GROUP HwAgSysArbn.HwAgSysArbnTqSnsrVelFilFrq.Val "MICROSAR RTE" /begin SUB_GROUP /end SUB_GROUP /begin FUNCTION_LIST /end FUNCTION_LIST /begin REF_CHARACTERISTIC HwAgSysArbn.HwAgSysArbnTqSnsrVelFilFrq.Val /end REF_CHARACTERISTIC /begin REF_MEASUREMENT /end REF_MEASUREMENT /end GROUP
/begin GROUP HwAgSysArbn.HwAgToMotAgCorrln "MICROSAR RTE" /begin SUB_GROUP /end SUB_GROUP /begin FUNCTION_LIST /end FUNCTION_LIST /begin REF_CHARACTERISTIC /end REF_CHARACTERISTIC /begin REF_MEASUREMENT HwAgSysArbn.HwAgToMotAgCorrln /end REF_MEASUREMENT /end GROUP
/begin GROUP HwAgSysArbn.HwAgToMotAgCorrlnDurnRefTmr "MICROSAR RTE" /begin SUB_GROUP /end SUB_GROUP /begin FUNCTION_LIST /end FUNCTION_LIST /begin REF_CHARACTERISTIC /end REF_CHARACTERISTIC /begin REF_MEASUREMENT HwAgSysArbn.HwAgToMotAgCorrlnDurnRefTmr /end REF_MEASUREMENT /end GROUP
/begin GROUP HwAgSysArbn.HwAgToSerlCom.Val "MICROSAR RTE" /begin SUB_GROUP /end SUB_GROUP /begin FUNCTION_LIST /end FUNCTION_LIST /begin REF_CHARACTERISTIC /end REF_CHARACTERISTIC /begin REF_MEASUREMENT HwAgSysArbn.HwAgToSerlCom.Val /end REF_MEASUREMENT /end GROUP
/begin GROUP HwAgSysArbn.HwAgVldToSerlCom.Logl "MICROSAR RTE" /begin SUB_GROUP /end SUB_GROUP /begin FUNCTION_LIST /end FUNCTION_LIST /begin REF_CHARACTERISTIC /end REF_CHARACTERISTIC /begin REF_MEASUREMENT HwAgSysArbn.HwAgVldToSerlCom.Logl /end REF_MEASUREMENT /end GROUP
/begin GROUP HwAgSysArbn.HwTq.Val "MICROSAR RTE" /begin SUB_GROUP /end SUB_GROUP /begin FUNCTION_LIST /end FUNCTION_LIST /begin REF_CHARACTERISTIC /end REF_CHARACTERISTIC /begin REF_MEASUREMENT HwAgSysArbn.HwTq.Val /end REF_MEASUREMENT /end GROUP
/begin GROUP HwAgSysArbn.HwVel.Val "MICROSAR RTE" /begin SUB_GROUP /end SUB_GROUP /begin FUNCTION_LIST /end FUNCTION_LIST /begin REF_CHARACTERISTIC /end REF_CHARACTERISTIC /begin REF_MEASUREMENT HwAgSysArbn.HwVel.Val /end REF_MEASUREMENT /end GROUP
/begin GROUP HwAgSysArbn.HwVelToSerlCom.Val "MICROSAR RTE" /begin SUB_GROUP /end SUB_GROUP /begin FUNCTION_LIST /end FUNCTION_LIST /begin REF_CHARACTERISTIC /end REF_CHARACTERISTIC /begin REF_MEASUREMENT HwAgSysArbn.HwVelToSerlCom.Val /end REF_MEASUREMENT /end GROUP
/begin GROUP HwAgSysArbn.MotVelCrf.Val "MICROSAR RTE" /begin SUB_GROUP /end SUB_GROUP /begin FUNCTION_LIST /end FUNCTION_LIST /begin REF_CHARACTERISTIC /end REF_CHARACTERISTIC /begin REF_MEASUREMENT HwAgSysArbn.MotVelCrf.Val /end REF_MEASUREMENT /end GROUP
/begin GROUP HwAgSysArbn.MotVelVld.Logl "MICROSAR RTE" /begin SUB_GROUP /end SUB_GROUP /begin FUNCTION_LIST /end FUNCTION_LIST /begin REF_CHARACTERISTIC /end REF_CHARACTERISTIC /begin REF_MEASUREMENT HwAgSysArbn.MotVelVld.Logl /end REF_MEASUREMENT /end GROUP
/begin GROUP HwAgSysArbn.PerInstanceMemories "MICROSAR RTE"
 /begin SUB_GROUP HwAgSysArbn.HwAgCorrdLtch HwAgSysArbn.HwAgKineFlt HwAgSysArbn.HwAgPrev HwAgSysArbn.HwAgToMotAgCorrln HwAgSysArbn.HwAgToMotAgCorrlnDurnRefTmr HwAgSysArbn.PrevHwAgNotCorrd HwAgSysArbn.PrevPinionAgConf HwAgSysArbn.PrevSeldHwAg HwAgSysArbn.PrevSrcSeln HwAgSysArbn.SeldHwAgConf HwAgSysArbn.SlewElpdRefTmr HwAgSysArbn.SlewSts HwAgSysArbn.TqSnsrAgPrev HwAgSysArbn.TqSnsrVelFil /end SUB_GROUP
 /begin FUNCTION_LIST /end FUNCTION_LIST
 /begin REF_CHARACTERISTIC /end REF_CHARACTERISTIC
 /begin REF_MEASUREMENT /end REF_MEASUREMENT
/end GROUP
/begin GROUP HwAgSysArbn.PinionAg.Val "MICROSAR RTE" /begin SUB_GROUP /end SUB_GROUP /begin FUNCTION_LIST /end FUNCTION_LIST /begin REF_CHARACTERISTIC /end REF_CHARACTERISTIC /begin REF_MEASUREMENT HwAgSysArbn.PinionAg.Val /end REF_MEASUREMENT /end GROUP
/begin GROUP HwAgSysArbn.PinionAgConf.Val "MICROSAR RTE" /begin SUB_GROUP /end SUB_GROUP /begin FUNCTION_LIST /end FUNCTION_LIST /begin REF_CHARACTERISTIC /end REF_CHARACTERISTIC /begin REF_MEASUREMENT HwAgSysArbn.PinionAgConf.Val /end REF_MEASUREMENT /end GROUP
/begin GROUP HwAgSysArbn.PinionVel.Val "MICROSAR RTE" /begin SUB_GROUP /end SUB_GROUP /begin FUNCTION_LIST /end FUNCTION_LIST /begin REF_CHARACTERISTIC /end REF_CHARACTERISTIC /begin REF_MEASUREMENT HwAgSysArbn.PinionVel.Val /end REF_MEASUREMENT /end GROUP
/begin GROUP HwAgSysArbn.PinionVelConf.Val "MICROSAR RTE" /begin SUB_GROUP /end SUB_GROUP /begin FUNCTION_LIST /end FUNCTION_LIST /begin REF_CHARACTERISTIC /end REF_CHARACTERISTIC /begin REF_MEASUREMENT HwAgSysArbn.PinionVelConf.Val /end REF_MEASUREMENT /end GROUP
/begin GROUP HwAgSysArbn.PrevHwAgNotCorrd "MICROSAR RTE" /begin SUB_GROUP /end SUB_GROUP /begin FUNCTION_LIST /end FUNCTION_LIST /begin REF_CHARACTERISTIC /end REF_CHARACTERISTIC /begin REF_MEASUREMENT HwAgSysArbn.PrevHwAgNotCorrd /end REF_MEASUREMENT /end GROUP
/begin GROUP HwAgSysArbn.PrevPinionAgConf "MICROSAR RTE" /begin SUB_GROUP /end SUB_GROUP /begin FUNCTION_LIST /end FUNCTION_LIST /begin REF_CHARACTERISTIC /end REF_CHARACTERISTIC /begin REF_MEASUREMENT HwAgSysArbn.PrevPinionAgConf /end REF_MEASUREMENT /end GROUP
/begin GROUP HwAgSysArbn.PrevSeldHwAg "MICROSAR RTE" /begin SUB_GROUP /end SUB_GROUP /begin FUNCTION_LIST /end FUNCTION_LIST /begin REF_CHARACTERISTIC /end REF_CHARACTERISTIC /begin REF_MEASUREMENT HwAgSysArbn.PrevSeldHwAg /end REF_MEASUREMENT /end GROUP
/begin GROUP HwAgSysArbn.PrevSrcSeln "MICROSAR RTE" /begin SUB_GROUP /end SUB_GROUP /begin FUNCTION_LIST /end FUNCTION_LIST /begin REF_CHARACTERISTIC /end REF_CHARACTERISTIC /begin REF_MEASUREMENT HwAgSysArbn.PrevSrcSeln /end REF_MEASUREMENT /end GROUP
/begin GROUP HwAgSysArbn.ReceiverPorts "MICROSAR RTE"
 /begin SUB_GROUP HwAgSysArbn.CmplncErrMotToPinion.Val HwAgSysArbn.CmplncErrPinionToHw.Val HwAgSysArbn.HwAg.Val HwAgSysArbn.HwAgCorrd.Val HwAgSysArbn.HwAgIdptSig.Val HwAgSysArbn.HwAgSnsrls.Val HwAgSysArbn.HwAgSnsrlsConf.Val HwAgSysArbn.HwTq.Val HwAgSysArbn.MotVelCrf.Val HwAgSysArbn.MotVelVld.Logl /end SUB_GROUP
 /begin FUNCTION_LIST /end FUNCTION_LIST
 /begin REF_CHARACTERISTIC /end REF_CHARACTERISTIC
 /begin REF_MEASUREMENT /end REF_MEASUREMENT
/end GROUP
/begin GROUP HwAgSysArbn.SeldHwAgConf "MICROSAR RTE" /begin SUB_GROUP /end SUB_GROUP /begin FUNCTION_LIST /end FUNCTION_LIST /begin REF_CHARACTERISTIC /end REF_CHARACTERISTIC /begin REF_MEASUREMENT HwAgSysArbn.SeldHwAgConf /end REF_MEASUREMENT /end GROUP
/begin GROUP HwAgSysArbn.SenderPorts "MICROSAR RTE"
 /begin SUB_GROUP HwAgSysArbn.HwAgFinal.Val HwAgSysArbn.HwAgNotCorrd.Val HwAgSysArbn.HwAgToSerlCom.Val HwAgSysArbn.HwAgVldToSerlCom.Logl HwAgSysArbn.HwVel.Val HwAgSysArbn.HwVelToSerlCom.Val HwAgSysArbn.PinionAg.Val HwAgSysArbn.PinionAgConf.Val HwAgSysArbn.PinionVel.Val HwAgSysArbn.PinionVelConf.Val /end SUB_GROUP
 /begin FUNCTION_LIST /end FUNCTION_LIST
 /begin REF_CHARACTERISTIC /end REF_CHARACTERISTIC
 /begin REF_MEASUREMENT /end REF_MEASUREMENT
/end GROUP
/begin GROUP HwAgSysArbn.SlewElpdRefTmr "MICROSAR RTE" /begin SUB_GROUP /end SUB_GROUP /begin FUNCTION_LIST /end FUNCTION_LIST /begin REF_CHARACTERISTIC /end REF_CHARACTERISTIC /begin REF_MEASUREMENT HwAgSysArbn.SlewElpdRefTmr /end REF_MEASUREMENT /end GROUP
/begin GROUP HwAgSysArbn.SlewSts "MICROSAR RTE" /begin SUB_GROUP /end SUB_GROUP /begin FUNCTION_LIST /end FUNCTION_LIST /begin REF_CHARACTERISTIC /end REF_CHARACTERISTIC /begin REF_MEASUREMENT HwAgSysArbn.SlewSts /end REF_MEASUREMENT /end GROUP
/begin GROUP HwAgSysArbn.SysGlbPrmSysKineRat.Val "MICROSAR RTE" /begin SUB_GROUP /end SUB_GROUP /begin FUNCTION_LIST /end FUNCTION_LIST /begin REF_CHARACTERISTIC HwAgSysArbn.SysGlbPrmSysKineRat.Val /end REF_CHARACTERISTIC /begin REF_MEASUREMENT /end REF_MEASUREMENT /end GROUP
/begin GROUP HwAgSysArbn.SysGlbPrmTorsBarStfn.Val "MICROSAR RTE" /begin SUB_GROUP /end SUB_GROUP /begin FUNCTION_LIST /end FUNCTION_LIST /begin REF_CHARACTERISTIC HwAgSysArbn.SysGlbPrmTorsBarStfn.Val /end REF_CHARACTERISTIC /begin REF_MEASUREMENT /end REF_MEASUREMENT /end GROUP
/begin GROUP HwAgSysArbn.TqSnsrAgPrev "MICROSAR RTE" /begin SUB_GROUP /end SUB_GROUP /begin FUNCTION_LIST /end FUNCTION_LIST /begin REF_CHARACTERISTIC /end REF_CHARACTERISTIC /begin REF_MEASUREMENT HwAgSysArbn.TqSnsrAgPrev /end REF_MEASUREMENT /end GROUP
/begin GROUP HwAgSysArbn.TqSnsrVelFil "MICROSAR RTE" /begin SUB_GROUP /end SUB_GROUP /begin FUNCTION_LIST /end FUNCTION_LIST /begin REF_CHARACTERISTIC /end REF_CHARACTERISTIC
 /begin REF_MEASUREMENT HwAgSysArbn.TqSnsrVelFil.FilGain HwAgSysArbn.TqSnsrVelFil.FilSt /end REF_MEASUREMENT
/end GROUP
/begin GROUP HwAgTrajGenn "MICROSAR RTE"
 /begin SUB_GROUP HwAgTrajGenn.CalibrationPorts HwAgTrajGenn.PerInstanceMemories HwAgTrajGenn.ReceiverPorts HwAgTrajGenn.SenderPorts /end SUB_GROUP
 /begin FUNCTION_LIST /end FUNCTION_LIST
 /begin REF_CHARACTERISTIC /end REF_CHARACTERISTIC
 /begin REF_MEASUREMENT /end REF_MEASUREMENT
/end GROUP
/begin GROUP HwAgTrajGenn.AMax "MICROSAR RTE" /begin SUB_GROUP /end SUB_GROUP /begin FUNCTION_LIST /end FUNCTION_LIST /begin REF_CHARACTERISTIC /end REF_CHARACTERISTIC /begin REF_MEASUREMENT HwAgTrajGenn.AMax /end REF_MEASUREMENT /end GROUP
/begin GROUP HwAgTrajGenn.CalcFlg "MICROSAR RTE" /begin SUB_GROUP /end SUB_GROUP /begin FUNCTION_LIST /end FUNCTION_LIST /begin REF_CHARACTERISTIC /end REF_CHARACTERISTIC /begin REF_MEASUREMENT HwAgTrajGenn.CalcFlg /end REF_MEASUREMENT /end GROUP
/begin GROUP HwAgTrajGenn.CalibrationPorts "MICROSAR RTE"
 /begin SUB_GROUP HwAgTrajGenn.HwAgTrajGennAMax.Val HwAgTrajGenn.HwAgTrajGennAgMax.Val HwAgTrajGenn.HwAgTrajGennVelMax.Val /end SUB_GROUP
 /begin FUNCTION_LIST /end FUNCTION_LIST
 /begin REF_CHARACTERISTIC /end REF_CHARACTERISTIC
 /begin REF_MEASUREMENT /end REF_MEASUREMENT
/end GROUP
/begin GROUP HwAgTrajGenn.CmdSt "MICROSAR RTE" /begin SUB_GROUP /end SUB_GROUP /begin FUNCTION_LIST /end FUNCTION_LIST /begin REF_CHARACTERISTIC /end REF_CHARACTERISTIC /begin REF_MEASUREMENT HwAgTrajGenn.CmdSt /end REF_MEASUREMENT /end GROUP
/begin GROUP HwAgTrajGenn.HwAg.Val "MICROSAR RTE" /begin SUB_GROUP /end SUB_GROUP /begin FUNCTION_LIST /end FUNCTION_LIST /begin REF_CHARACTERISTIC /end REF_CHARACTERISTIC /begin REF_MEASUREMENT HwAgTrajGenn.HwAg.Val /end REF_MEASUREMENT /end GROUP
/begin GROUP HwAgTrajGenn.HwAgTrajGennAMax.Val "MICROSAR RTE" /begin SUB_GROUP /end SUB_GROUP /begin FUNCTION_LIST /end FUNCTION_LIST /begin REF_CHARACTERISTIC HwAgTrajGenn.HwAgTrajGennAMax.Val /end REF_CHARACTERISTIC /begin REF_MEASUREMENT /end REF_MEASUREMENT /end GROUP
/begin GROUP HwAgTrajGenn.HwAgTrajGennAgMax.Val "MICROSAR RTE" /begin SUB_GROUP /end SUB_GROUP /begin FUNCTION_LIST /end FUNCTION_LIST /begin REF_CHARACTERISTIC HwAgTrajGenn.HwAgTrajGennAgMax.Val /end REF_CHARACTERISTIC /begin REF_MEASUREMENT /end REF_MEASUREMENT /end GROUP
/begin GROUP HwAgTrajGenn.HwAgTrajGennEna.Logl "MICROSAR RTE" /begin SUB_GROUP /end SUB_GROUP /begin FUNCTION_LIST /end FUNCTION_LIST /begin REF_CHARACTERISTIC /end REF_CHARACTERISTIC /begin REF_MEASUREMENT HwAgTrajGenn.HwAgTrajGennEna.Logl /end REF_MEASUREMENT /end GROUP
/begin GROUP HwAgTrajGenn.HwAgTrajGennVelMax.Val "MICROSAR RTE" /begin SUB_GROUP /end SUB_GROUP /begin FUNCTION_LIST /end FUNCTION_LIST /begin REF_CHARACTERISTIC HwAgTrajGenn.HwAgTrajGennVelMax.Val /end REF_CHARACTERISTIC /begin REF_MEASUREMENT /end REF_MEASUREMENT /end GROUP
/begin GROUP HwAgTrajGenn.HwAgTrakgServoCmd.Val "MICROSAR RTE" /begin SUB_GROUP /end SUB_GROUP /begin FUNCTION_LIST /end FUNCTION_LIST /begin REF_CHARACTERISTIC /end REF_CHARACTERISTIC /begin REF_MEASUREMENT HwAgTrajGenn.HwAgTrakgServoCmd.Val /end REF_MEASUREMENT /end GROUP
/begin GROUP HwAgTrajGenn.HwPosnIni "MICROSAR RTE" /begin SUB_GROUP /end SUB_GROUP /begin FUNCTION_LIST /end FUNCTION_LIST /begin REF_CHARACTERISTIC /end REF_CHARACTERISTIC /begin REF_MEASUREMENT HwAgTrajGenn.HwPosnIni /end REF_MEASUREMENT /end GROUP
/begin GROUP HwAgTrajGenn.HwPosnOffs "MICROSAR RTE" /begin SUB_GROUP /end SUB_GROUP /begin FUNCTION_LIST /end FUNCTION_LIST /begin REF_CHARACTERISTIC /end REF_CHARACTERISTIC /begin REF_MEASUREMENT HwAgTrajGenn.HwPosnOffs /end REF_MEASUREMENT /end GROUP
/begin GROUP HwAgTrajGenn.PerInstanceMemories "MICROSAR RTE"
 /begin SUB_GROUP HwAgTrajGenn.AMax HwAgTrajGenn.CalcFlg HwAgTrajGenn.CmdSt HwAgTrajGenn.HwPosnIni HwAgTrajGenn.HwPosnOffs HwAgTrajGenn.SignHwPosnDelta HwAgTrajGenn.TiDeltaA HwAgTrajGenn.TiDeltaVel HwAgTrajGenn.TiSt HwAgTrajGenn.VelMax /end SUB_GROUP
 /begin FUNCTION_LIST /end FUNCTION_LIST
 /begin REF_CHARACTERISTIC /end REF_CHARACTERISTIC
 /begin REF_MEASUREMENT /end REF_MEASUREMENT
/end GROUP
/begin GROUP HwAgTrajGenn.ReceiverPorts "MICROSAR RTE" /begin SUB_GROUP HwAgTrajGenn.HwAg.Val HwAgTrajGenn.HwAgTrajGennEna.Logl /end SUB_GROUP /begin FUNCTION_LIST /end FUNCTION_LIST /begin REF_CHARACTERISTIC /end REF_CHARACTERISTIC /begin REF_MEASUREMENT /end REF_MEASUREMENT /end GROUP
/begin GROUP HwAgTrajGenn.SenderPorts "MICROSAR RTE" /begin SUB_GROUP HwAgTrajGenn.HwAgTrakgServoCmd.Val /end SUB_GROUP /begin FUNCTION_LIST /end FUNCTION_LIST /begin REF_CHARACTERISTIC /end REF_CHARACTERISTIC /begin REF_MEASUREMENT /end REF_MEASUREMENT /end GROUP
/begin GROUP HwAgTrajGenn.SignHwPosnDelta "MICROSAR RTE" /begin SUB_GROUP /end SUB_GROUP /begin FUNCTION_LIST /end FUNCTION_LIST /begin REF_CHARACTERISTIC /end REF_CHARACTERISTIC /begin REF_MEASUREMENT HwAgTrajGenn.SignHwPosnDelta /end REF_MEASUREMENT /end GROUP
/begin GROUP HwAgTrajGenn.TiDeltaA "MICROSAR RTE" /begin SUB_GROUP /end SUB_GROUP /begin FUNCTION_LIST /end FUNCTION_LIST /begin REF_CHARACTERISTIC /end REF_CHARACTERISTIC /begin REF_MEASUREMENT HwAgTrajGenn.TiDeltaA /end REF_MEASUREMENT /end GROUP
/begin GROUP HwAgTrajGenn.TiDeltaVel "MICROSAR RTE" /begin SUB_GROUP /end SUB_GROUP /begin FUNCTION_LIST /end FUNCTION_LIST /begin REF_CHARACTERISTIC /end REF_CHARACTERISTIC /begin REF_MEASUREMENT HwAgTrajGenn.TiDeltaVel /end REF_MEASUREMENT /end GROUP
/begin GROUP HwAgTrajGenn.TiSt "MICROSAR RTE" /begin SUB_GROUP /end SUB_GROUP /begin FUNCTION_LIST /end FUNCTION_LIST /begin REF_CHARACTERISTIC /end REF_CHARACTERISTIC /begin REF_MEASUREMENT HwAgTrajGenn.TiSt /end REF_MEASUREMENT /end GROUP
/begin GROUP HwAgTrajGenn.VelMax "MICROSAR RTE" /begin SUB_GROUP /end SUB_GROUP /begin FUNCTION_LIST /end FUNCTION_LIST /begin REF_CHARACTERISTIC /end REF_CHARACTERISTIC /begin REF_MEASUREMENT HwAgTrajGenn.VelMax /end REF_MEASUREMENT /end GROUP
/begin GROUP HwAgTrakgServo "MICROSAR RTE"
 /begin SUB_GROUP HwAgTrakgServo.CalibrationPorts HwAgTrakgServo.PerInstanceMemories HwAgTrakgServo.ReceiverPorts HwAgTrakgServo.SenderPorts /end SUB_GROUP
 /begin FUNCTION_LIST /end FUNCTION_LIST
 /begin REF_CHARACTERISTIC /end REF_CHARACTERISTIC
 /begin REF_MEASUREMENT /end REF_MEASUREMENT
/end GROUP
/begin GROUP HwAgTrakgServo.CalibrationPorts "MICROSAR RTE"
 /begin SUB_GROUP HwAgTrakgServo.HwAgTrakgServoDampgTqX.Ary1D HwAgTrakgServo.HwAgTrakgServoDampgTqY.Ary2D HwAgTrakgServo.HwAgTrakgServoDftlGainY.Ary1D HwAgTrakgServo.HwAgTrakgServoDftlTermLpFilFrq.Val HwAgTrakgServo.HwAgTrakgServoDiRateX.Ary1D HwAgTrakgServo.HwAgTrakgServoDiRateY.Ary1D HwAgTrakgServo.HwAgTrakgServoEnaRate.Val HwAgTrakgServo.HwAgTrakgServoExecRate.Val HwAgTrakgServo.HwAgTrakgServoHwAgLpFilFrq.Val HwAgTrakgServo.HwAgTrakgServoHwAgRateLim.Ary1D HwAgTrakgServo.HwAgTrakgServoHwTqLpFilFrq.Val HwAgTrakgServo.HwAgTrakgServoIntglGainY.Ary1D HwAgTrakgServo.HwAgTrakgServoIntglTermAntiWdupLimY.Ary1D HwAgTrakgServo.HwAgTrakgServoMaxCmdX.Ary1D HwAgTrakgServo.HwAgTrakgServoMaxCmdY.Ary1D HwAgTrakgServo.HwAgTrakgServoMaxRamp.Val HwAgTrakgServo.HwAgTrakgServoMinRamp.Val HwAgTrakgServo.HwAgTrakgServoPidLim.Val HwAgTrakgServo.HwAgTrakgServoPropGainX.Ary1D HwAgTrakgServo.HwAgTrakgServoPropGainY.Ary2D HwAgTrakgServo.HwAgTrakgServoRampCmpl.Val HwAgTrakgServo.HwAgTrakgServoSmotngX.Ary1D HwAgTrakgServo.HwAgTrakgServoSmotngY.Ary1D HwAgTrakgServo.HwAgTrakgServoVehSpdBasd.Ary1D /end SUB_GROUP
 /begin FUNCTION_LIST /end FUNCTION_LIST
 /begin REF_CHARACTERISTIC /end REF_CHARACTERISTIC
 /begin REF_MEASUREMENT /end REF_MEASUREMENT
/end GROUP
/begin GROUP HwAgTrakgServo.DftlTermLpFil "MICROSAR RTE" /begin SUB_GROUP /end SUB_GROUP /begin FUNCTION_LIST /end FUNCTION_LIST /begin REF_CHARACTERISTIC /end REF_CHARACTERISTIC
 /begin REF_MEASUREMENT HwAgTrakgServo.DftlTermLpFil.FilGain HwAgTrakgServo.DftlTermLpFil.FilSt /end REF_MEASUREMENT
/end GROUP
/begin GROUP HwAgTrakgServo.HwAg.Val "MICROSAR RTE" /begin SUB_GROUP /end SUB_GROUP /begin FUNCTION_LIST /end FUNCTION_LIST /begin REF_CHARACTERISTIC /end REF_CHARACTERISTIC /begin REF_MEASUREMENT HwAgTrakgServo.HwAg.Val /end REF_MEASUREMENT /end GROUP
/begin GROUP HwAgTrakgServo.HwAgLpFil "MICROSAR RTE" /begin SUB_GROUP /end SUB_GROUP /begin FUNCTION_LIST /end FUNCTION_LIST /begin REF_CHARACTERISTIC /end REF_CHARACTERISTIC
 /begin REF_MEASUREMENT HwAgTrakgServo.HwAgLpFil.FilGain HwAgTrakgServo.HwAgLpFil.FilSt /end REF_MEASUREMENT
/end GROUP
/begin GROUP HwAgTrakgServo.HwAgTarRateLim "MICROSAR RTE" /begin SUB_GROUP /end SUB_GROUP /begin FUNCTION_LIST /end FUNCTION_LIST /begin REF_CHARACTERISTIC /end REF_CHARACTERISTIC /begin REF_MEASUREMENT HwAgTrakgServo.HwAgTarRateLim /end REF_MEASUREMENT /end GROUP
/begin GROUP HwAgTrakgServo.HwAgTrakgServoCmd.Val "MICROSAR RTE" /begin SUB_GROUP /end SUB_GROUP /begin FUNCTION_LIST /end FUNCTION_LIST /begin REF_CHARACTERISTIC /end REF_CHARACTERISTIC /begin REF_MEASUREMENT HwAgTrakgServo.HwAgTrakgServoCmd.Val /end REF_MEASUREMENT /end GROUP
/begin GROUP HwAgTrakgServo.HwAgTrakgServoDampgTqX.Ary1D "MICROSAR RTE" /begin SUB_GROUP /end SUB_GROUP /begin FUNCTION_LIST /end FUNCTION_LIST /begin REF_CHARACTERISTIC HwAgTrakgServo.HwAgTrakgServoDampgTqX.Ary1D /end REF_CHARACTERISTIC /begin REF_MEASUREMENT /end REF_MEASUREMENT /end GROUP
/begin GROUP HwAgTrakgServo.HwAgTrakgServoDampgTqY.Ary2D "MICROSAR RTE" /begin SUB_GROUP /end SUB_GROUP /begin FUNCTION_LIST /end FUNCTION_LIST /begin REF_CHARACTERISTIC HwAgTrakgServo.HwAgTrakgServoDampgTqY.Ary2D /end REF_CHARACTERISTIC /begin REF_MEASUREMENT /end REF_MEASUREMENT /end GROUP
/begin GROUP HwAgTrakgServo.HwAgTrakgServoDftlGainY.Ary1D "MICROSAR RTE" /begin SUB_GROUP /end SUB_GROUP /begin FUNCTION_LIST /end FUNCTION_LIST /begin REF_CHARACTERISTIC HwAgTrakgServo.HwAgTrakgServoDftlGainY.Ary1D /end REF_CHARACTERISTIC /begin REF_MEASUREMENT /end REF_MEASUREMENT /end GROUP
/begin GROUP HwAgTrakgServo.HwAgTrakgServoDftlTermLpFilFrq.Val "MICROSAR RTE" /begin SUB_GROUP /end SUB_GROUP /begin FUNCTION_LIST /end FUNCTION_LIST /begin REF_CHARACTERISTIC HwAgTrakgServo.HwAgTrakgServoDftlTermLpFilFrq.Val /end REF_CHARACTERISTIC /begin REF_MEASUREMENT /end REF_MEASUREMENT /end GROUP
/begin GROUP HwAgTrakgServo.HwAgTrakgServoDiRateX.Ary1D "MICROSAR RTE" /begin SUB_GROUP /end SUB_GROUP /begin FUNCTION_LIST /end FUNCTION_LIST /begin REF_CHARACTERISTIC HwAgTrakgServo.HwAgTrakgServoDiRateX.Ary1D /end REF_CHARACTERISTIC /begin REF_MEASUREMENT /end REF_MEASUREMENT /end GROUP
/begin GROUP HwAgTrakgServo.HwAgTrakgServoDiRateY.Ary1D "MICROSAR RTE" /begin SUB_GROUP /end SUB_GROUP /begin FUNCTION_LIST /end FUNCTION_LIST /begin REF_CHARACTERISTIC HwAgTrakgServo.HwAgTrakgServoDiRateY.Ary1D /end REF_CHARACTERISTIC /begin REF_MEASUREMENT /end REF_MEASUREMENT /end GROUP
/begin GROUP HwAgTrakgServo.HwAgTrakgServoEna.Logl "MICROSAR RTE" /begin SUB_GROUP /end SUB_GROUP /begin FUNCTION_LIST /end FUNCTION_LIST /begin REF_CHARACTERISTIC /end REF_CHARACTERISTIC /begin REF_MEASUREMENT HwAgTrakgServo.HwAgTrakgServoEna.Logl /end REF_MEASUREMENT /end GROUP
/begin GROUP HwAgTrakgServo.HwAgTrakgServoEnaRate.Val "MICROSAR RTE" /begin SUB_GROUP /end SUB_GROUP /begin FUNCTION_LIST /end FUNCTION_LIST /begin REF_CHARACTERISTIC HwAgTrakgServo.HwAgTrakgServoEnaRate.Val /end REF_CHARACTERISTIC /begin REF_MEASUREMENT /end REF_MEASUREMENT /end GROUP
/begin GROUP HwAgTrakgServo.HwAgTrakgServoExecRate.Val "MICROSAR RTE" /begin SUB_GROUP /end SUB_GROUP /begin FUNCTION_LIST /end FUNCTION_LIST /begin REF_CHARACTERISTIC HwAgTrakgServo.HwAgTrakgServoExecRate.Val /end REF_CHARACTERISTIC /begin REF_MEASUREMENT /end REF_MEASUREMENT /end GROUP
/begin GROUP HwAgTrakgServo.HwAgTrakgServoHwAgLpFilFrq.Val "MICROSAR RTE" /begin SUB_GROUP /end SUB_GROUP /begin FUNCTION_LIST /end FUNCTION_LIST /begin REF_CHARACTERISTIC HwAgTrakgServo.HwAgTrakgServoHwAgLpFilFrq.Val /end REF_CHARACTERISTIC /begin REF_MEASUREMENT /end REF_MEASUREMENT /end GROUP
/begin GROUP HwAgTrakgServo.HwAgTrakgServoHwAgRateLim.Ary1D "MICROSAR RTE" /begin SUB_GROUP /end SUB_GROUP /begin FUNCTION_LIST /end FUNCTION_LIST /begin REF_CHARACTERISTIC HwAgTrakgServo.HwAgTrakgServoHwAgRateLim.Ary1D /end REF_CHARACTERISTIC /begin REF_MEASUREMENT /end REF_MEASUREMENT /end GROUP
/begin GROUP HwAgTrakgServo.HwAgTrakgServoHwTqLpFilFrq.Val "MICROSAR RTE" /begin SUB_GROUP /end SUB_GROUP /begin FUNCTION_LIST /end FUNCTION_LIST /begin REF_CHARACTERISTIC HwAgTrakgServo.HwAgTrakgServoHwTqLpFilFrq.Val /end REF_CHARACTERISTIC /begin REF_MEASUREMENT /end REF_MEASUREMENT /end GROUP
/begin GROUP HwAgTrakgServo.HwAgTrakgServoIntglGainY.Ary1D "MICROSAR RTE" /begin SUB_GROUP /end SUB_GROUP /begin FUNCTION_LIST /end FUNCTION_LIST /begin REF_CHARACTERISTIC HwAgTrakgServo.HwAgTrakgServoIntglGainY.Ary1D /end REF_CHARACTERISTIC /begin REF_MEASUREMENT /end REF_MEASUREMENT /end GROUP
/begin GROUP HwAgTrakgServo.HwAgTrakgServoIntglTermAntiWdupLimY.Ary1D "MICROSAR RTE" /begin SUB_GROUP /end SUB_GROUP /begin FUNCTION_LIST /end FUNCTION_LIST /begin REF_CHARACTERISTIC HwAgTrakgServo.HwAgTrakgServoIntglTermAntiWdupLimY.Ary1D /end REF_CHARACTERISTIC /begin REF_MEASUREMENT /end REF_MEASUREMENT /end GROUP
/begin GROUP HwAgTrakgServo.HwAgTrakgServoMaxCmdX.Ary1D "MICROSAR RTE" /begin SUB_GROUP /end SUB_GROUP /begin FUNCTION_LIST /end FUNCTION_LIST /begin REF_CHARACTERISTIC HwAgTrakgServo.HwAgTrakgServoMaxCmdX.Ary1D /end REF_CHARACTERISTIC /begin REF_MEASUREMENT /end REF_MEASUREMENT /end GROUP
/begin GROUP HwAgTrakgServo.HwAgTrakgServoMaxCmdY.Ary1D "MICROSAR RTE" /begin SUB_GROUP /end SUB_GROUP /begin FUNCTION_LIST /end FUNCTION_LIST /begin REF_CHARACTERISTIC HwAgTrakgServo.HwAgTrakgServoMaxCmdY.Ary1D /end REF_CHARACTERISTIC /begin REF_MEASUREMENT /end REF_MEASUREMENT /end GROUP
/begin GROUP HwAgTrakgServo.HwAgTrakgServoMaxRamp.Val "MICROSAR RTE" /begin SUB_GROUP /end SUB_GROUP /begin FUNCTION_LIST /end FUNCTION_LIST /begin REF_CHARACTERISTIC HwAgTrakgServo.HwAgTrakgServoMaxRamp.Val /end REF_CHARACTERISTIC /begin REF_MEASUREMENT /end REF_MEASUREMENT /end GROUP
/begin GROUP HwAgTrakgServo.HwAgTrakgServoMinRamp.Val "MICROSAR RTE" /begin SUB_GROUP /end SUB_GROUP /begin FUNCTION_LIST /end FUNCTION_LIST /begin REF_CHARACTERISTIC HwAgTrakgServo.HwAgTrakgServoMinRamp.Val /end REF_CHARACTERISTIC /begin REF_MEASUREMENT /end REF_MEASUREMENT /end GROUP
/begin GROUP HwAgTrakgServo.HwAgTrakgServoPidLim.Val "MICROSAR RTE" /begin SUB_GROUP /end SUB_GROUP /begin FUNCTION_LIST /end FUNCTION_LIST /begin REF_CHARACTERISTIC HwAgTrakgServo.HwAgTrakgServoPidLim.Val /end REF_CHARACTERISTIC /begin REF_MEASUREMENT /end REF_MEASUREMENT /end GROUP
/begin GROUP HwAgTrakgServo.HwAgTrakgServoPropGainX.Ary1D "MICROSAR RTE" /begin SUB_GROUP /end SUB_GROUP /begin FUNCTION_LIST /end FUNCTION_LIST /begin REF_CHARACTERISTIC HwAgTrakgServo.HwAgTrakgServoPropGainX.Ary1D /end REF_CHARACTERISTIC /begin REF_MEASUREMENT /end REF_MEASUREMENT /end GROUP
/begin GROUP HwAgTrakgServo.HwAgTrakgServoPropGainY.Ary2D "MICROSAR RTE" /begin SUB_GROUP /end SUB_GROUP /begin FUNCTION_LIST /end FUNCTION_LIST /begin REF_CHARACTERISTIC HwAgTrakgServo.HwAgTrakgServoPropGainY.Ary2D /end REF_CHARACTERISTIC /begin REF_MEASUREMENT /end REF_MEASUREMENT /end GROUP
/begin GROUP HwAgTrakgServo.HwAgTrakgServoRampCmpl.Val "MICROSAR RTE" /begin SUB_GROUP /end SUB_GROUP /begin FUNCTION_LIST /end FUNCTION_LIST /begin REF_CHARACTERISTIC HwAgTrakgServo.HwAgTrakgServoRampCmpl.Val /end REF_CHARACTERISTIC /begin REF_MEASUREMENT /end REF_MEASUREMENT /end GROUP
/begin GROUP HwAgTrakgServo.HwAgTrakgServoSmotngX.Ary1D "MICROSAR RTE" /begin SUB_GROUP /end SUB_GROUP /begin FUNCTION_LIST /end FUNCTION_LIST /begin REF_CHARACTERISTIC HwAgTrakgServo.HwAgTrakgServoSmotngX.Ary1D /end REF_CHARACTERISTIC /begin REF_MEASUREMENT /end REF_MEASUREMENT /end GROUP
/begin GROUP HwAgTrakgServo.HwAgTrakgServoSmotngY.Ary1D "MICROSAR RTE" /begin SUB_GROUP /end SUB_GROUP /begin FUNCTION_LIST /end FUNCTION_LIST /begin REF_CHARACTERISTIC HwAgTrakgServo.HwAgTrakgServoSmotngY.Ary1D /end REF_CHARACTERISTIC /begin REF_MEASUREMENT /end REF_MEASUREMENT /end GROUP
/begin GROUP HwAgTrakgServo.HwAgTrakgServoVehSpdBasd.Ary1D "MICROSAR RTE" /begin SUB_GROUP /end SUB_GROUP /begin FUNCTION_LIST /end FUNCTION_LIST /begin REF_CHARACTERISTIC HwAgTrakgServo.HwAgTrakgServoVehSpdBasd.Ary1D /end REF_CHARACTERISTIC /begin REF_MEASUREMENT /end REF_MEASUREMENT /end GROUP
/begin GROUP HwAgTrakgServo.HwTq.Val "MICROSAR RTE" /begin SUB_GROUP /end SUB_GROUP /begin FUNCTION_LIST /end FUNCTION_LIST /begin REF_CHARACTERISTIC /end REF_CHARACTERISTIC /begin REF_MEASUREMENT HwAgTrakgServo.HwTq.Val /end REF_MEASUREMENT /end GROUP
/begin GROUP HwAgTrakgServo.HwTqLpFil "MICROSAR RTE" /begin SUB_GROUP /end SUB_GROUP /begin FUNCTION_LIST /end FUNCTION_LIST /begin REF_CHARACTERISTIC /end REF_CHARACTERISTIC
 /begin REF_MEASUREMENT HwAgTrakgServo.HwTqLpFil.FilGain HwAgTrakgServo.HwTqLpFil.FilSt /end REF_MEASUREMENT
/end GROUP
/begin GROUP HwAgTrakgServo.MotTqServoCmd.Val "MICROSAR RTE" /begin SUB_GROUP /end SUB_GROUP /begin FUNCTION_LIST /end FUNCTION_LIST /begin REF_CHARACTERISTIC /end REF_CHARACTERISTIC /begin REF_MEASUREMENT HwAgTrakgServo.MotTqServoCmd.Val /end REF_MEASUREMENT /end GROUP
/begin GROUP HwAgTrakgServo.MotVelCrf.Val "MICROSAR RTE" /begin SUB_GROUP /end SUB_GROUP /begin FUNCTION_LIST /end FUNCTION_LIST /begin REF_CHARACTERISTIC /end REF_CHARACTERISTIC /begin REF_MEASUREMENT HwAgTrakgServo.MotVelCrf.Val /end REF_MEASUREMENT /end GROUP
/begin GROUP HwAgTrakgServo.PerInstanceMemories "MICROSAR RTE"
 /begin SUB_GROUP HwAgTrakgServo.DftlTermLpFil HwAgTrakgServo.HwAgLpFil HwAgTrakgServo.HwAgTarRateLim HwAgTrakgServo.HwTqLpFil HwAgTrakgServo.PrevDftlErr HwAgTrakgServo.PrevHwAgTar HwAgTrakgServo.PrevIntglErr HwAgTrakgServo.PrevSmotng HwAgTrakgServo.dHwAgTrakgServoDftlTerm HwAgTrakgServo.dHwAgTrakgServoHwAgTarFild HwAgTrakgServo.dHwAgTrakgServoIntglTerm HwAgTrakgServo.dHwAgTrakgServoPidCmd HwAgTrakgServo.dHwAgTrakgServoPropTerm HwAgTrakgServo.dHwAgTrakgServoRampCmpl HwAgTrakgServo.dHwAgTrakgServoRtnScaFac HwAgTrakgServo.dHwAgTrakgServoSmotngEna /end SUB_GROUP
 /begin FUNCTION_LIST /end FUNCTION_LIST
 /begin REF_CHARACTERISTIC /end REF_CHARACTERISTIC
 /begin REF_MEASUREMENT /end REF_MEASUREMENT
/end GROUP
/begin GROUP HwAgTrakgServo.PrevDftlErr "MICROSAR RTE" /begin SUB_GROUP /end SUB_GROUP /begin FUNCTION_LIST /end FUNCTION_LIST /begin REF_CHARACTERISTIC /end REF_CHARACTERISTIC /begin REF_MEASUREMENT HwAgTrakgServo.PrevDftlErr /end REF_MEASUREMENT /end GROUP
/begin GROUP HwAgTrakgServo.PrevHwAgTar "MICROSAR RTE" /begin SUB_GROUP /end SUB_GROUP /begin FUNCTION_LIST /end FUNCTION_LIST /begin REF_CHARACTERISTIC /end REF_CHARACTERISTIC /begin REF_MEASUREMENT HwAgTrakgServo.PrevHwAgTar /end REF_MEASUREMENT /end GROUP
/begin GROUP HwAgTrakgServo.PrevIntglErr "MICROSAR RTE" /begin SUB_GROUP /end SUB_GROUP /begin FUNCTION_LIST /end FUNCTION_LIST /begin REF_CHARACTERISTIC /end REF_CHARACTERISTIC /begin REF_MEASUREMENT HwAgTrakgServo.PrevIntglErr /end REF_MEASUREMENT /end GROUP
/begin GROUP HwAgTrakgServo.PrevSmotng "MICROSAR RTE" /begin SUB_GROUP /end SUB_GROUP /begin FUNCTION_LIST /end FUNCTION_LIST /begin REF_CHARACTERISTIC /end REF_CHARACTERISTIC /begin REF_MEASUREMENT HwAgTrakgServo.PrevSmotng /end REF_MEASUREMENT /end GROUP
/begin GROUP HwAgTrakgServo.ReceiverPorts "MICROSAR RTE"
 /begin SUB_GROUP HwAgTrakgServo.HwAg.Val HwAgTrakgServo.HwAgTrakgServoCmd.Val HwAgTrakgServo.HwAgTrakgServoEna.Logl HwAgTrakgServo.HwTq.Val HwAgTrakgServo.MotVelCrf.Val HwAgTrakgServo.VehSpd.Val /end SUB_GROUP
 /begin FUNCTION_LIST /end FUNCTION_LIST
 /begin REF_CHARACTERISTIC /end REF_CHARACTERISTIC
 /begin REF_MEASUREMENT /end REF_MEASUREMENT
/end GROUP
/begin GROUP HwAgTrakgServo.SenderPorts "MICROSAR RTE" /begin SUB_GROUP HwAgTrakgServo.MotTqServoCmd.Val /end SUB_GROUP /begin FUNCTION_LIST /end FUNCTION_LIST /begin REF_CHARACTERISTIC /end REF_CHARACTERISTIC /begin REF_MEASUREMENT /end REF_MEASUREMENT /end GROUP
/begin GROUP HwAgTrakgServo.VehSpd.Val "MICROSAR RTE" /begin SUB_GROUP /end SUB_GROUP /begin FUNCTION_LIST /end FUNCTION_LIST /begin REF_CHARACTERISTIC /end REF_CHARACTERISTIC /begin REF_MEASUREMENT HwAgTrakgServo.VehSpd.Val /end REF_MEASUREMENT /end GROUP
/begin GROUP HwAgTrakgServo.dHwAgTrakgServoDftlTerm "MICROSAR RTE" /begin SUB_GROUP /end SUB_GROUP /begin FUNCTION_LIST /end FUNCTION_LIST /begin REF_CHARACTERISTIC /end REF_CHARACTERISTIC /begin REF_MEASUREMENT HwAgTrakgServo.dHwAgTrakgServoDftlTerm /end REF_MEASUREMENT /end GROUP
/begin GROUP HwAgTrakgServo.dHwAgTrakgServoHwAgTarFild "MICROSAR RTE" /begin SUB_GROUP /end SUB_GROUP /begin FUNCTION_LIST /end FUNCTION_LIST /begin REF_CHARACTERISTIC /end REF_CHARACTERISTIC /begin REF_MEASUREMENT HwAgTrakgServo.dHwAgTrakgServoHwAgTarFild /end REF_MEASUREMENT /end GROUP
/begin GROUP HwAgTrakgServo.dHwAgTrakgServoIntglTerm "MICROSAR RTE" /begin SUB_GROUP /end SUB_GROUP /begin FUNCTION_LIST /end FUNCTION_LIST /begin REF_CHARACTERISTIC /end REF_CHARACTERISTIC /begin REF_MEASUREMENT HwAgTrakgServo.dHwAgTrakgServoIntglTerm /end REF_MEASUREMENT /end GROUP
/begin GROUP HwAgTrakgServo.dHwAgTrakgServoPidCmd "MICROSAR RTE" /begin SUB_GROUP /end SUB_GROUP /begin FUNCTION_LIST /end FUNCTION_LIST /begin REF_CHARACTERISTIC /end REF_CHARACTERISTIC /begin REF_MEASUREMENT HwAgTrakgServo.dHwAgTrakgServoPidCmd /end REF_MEASUREMENT /end GROUP
/begin GROUP HwAgTrakgServo.dHwAgTrakgServoPropTerm "MICROSAR RTE" /begin SUB_GROUP /end SUB_GROUP /begin FUNCTION_LIST /end FUNCTION_LIST /begin REF_CHARACTERISTIC /end REF_CHARACTERISTIC /begin REF_MEASUREMENT HwAgTrakgServo.dHwAgTrakgServoPropTerm /end REF_MEASUREMENT /end GROUP
/begin GROUP HwAgTrakgServo.dHwAgTrakgServoRampCmpl "MICROSAR RTE" /begin SUB_GROUP /end SUB_GROUP /begin FUNCTION_LIST /end FUNCTION_LIST /begin REF_CHARACTERISTIC /end REF_CHARACTERISTIC /begin REF_MEASUREMENT HwAgTrakgServo.dHwAgTrakgServoRampCmpl /end REF_MEASUREMENT /end GROUP
/begin GROUP HwAgTrakgServo.dHwAgTrakgServoRtnScaFac "MICROSAR RTE" /begin SUB_GROUP /end SUB_GROUP /begin FUNCTION_LIST /end FUNCTION_LIST /begin REF_CHARACTERISTIC /end REF_CHARACTERISTIC /begin REF_MEASUREMENT HwAgTrakgServo.dHwAgTrakgServoRtnScaFac /end REF_MEASUREMENT /end GROUP
/begin GROUP HwAgTrakgServo.dHwAgTrakgServoSmotngEna "MICROSAR RTE" /begin SUB_GROUP /end SUB_GROUP /begin FUNCTION_LIST /end FUNCTION_LIST /begin REF_CHARACTERISTIC /end REF_CHARACTERISTIC /begin REF_MEASUREMENT HwAgTrakgServo.dHwAgTrakgServoSmotngEna /end REF_MEASUREMENT /end GROUP
/begin GROUP HwAgVehCentrTrim "MICROSAR RTE"
 /begin SUB_GROUP HwAgVehCentrTrim.CalibrationParameters HwAgVehCentrTrim.CalibrationPorts HwAgVehCentrTrim.PerInstanceMemories HwAgVehCentrTrim.ReceiverPorts HwAgVehCentrTrim.SenderPorts /end SUB_GROUP
 /begin FUNCTION_LIST /end FUNCTION_LIST
 /begin REF_CHARACTERISTIC /end REF_CHARACTERISTIC
 /begin REF_MEASUREMENT /end REF_MEASUREMENT
/end GROUP
/begin GROUP HwAgVehCentrTrim.CalibrationParameters "MICROSAR RTE" /begin SUB_GROUP HwAgVehCentrTrim.HwAgTrimDataDft /end SUB_GROUP /begin FUNCTION_LIST /end FUNCTION_LIST /begin REF_CHARACTERISTIC /end REF_CHARACTERISTIC /begin REF_MEASUREMENT /end REF_MEASUREMENT /end GROUP
/begin GROUP HwAgVehCentrTrim.CalibrationPorts "MICROSAR RTE"
 /begin SUB_GROUP HwAgVehCentrTrim.HwAgVehCentrTrimHwAgLim.Val HwAgVehCentrTrim.HwAgVehCentrTrimVehSpdMaxThd.Val /end SUB_GROUP
 /begin FUNCTION_LIST /end FUNCTION_LIST
 /begin REF_CHARACTERISTIC /end REF_CHARACTERISTIC
 /begin REF_MEASUREMENT /end REF_MEASUREMENT
/end GROUP
/begin GROUP HwAgVehCentrTrim.EngRunActv.Logl "MICROSAR RTE" /begin SUB_GROUP /end SUB_GROUP /begin FUNCTION_LIST /end FUNCTION_LIST /begin REF_CHARACTERISTIC /end REF_CHARACTERISTIC /begin REF_MEASUREMENT HwAgVehCentrTrim.EngRunActv.Logl /end REF_MEASUREMENT /end GROUP
/begin GROUP HwAgVehCentrTrim.HwAg.Val "MICROSAR RTE" /begin SUB_GROUP /end SUB_GROUP /begin FUNCTION_LIST /end FUNCTION_LIST /begin REF_CHARACTERISTIC /end REF_CHARACTERISTIC /begin REF_MEASUREMENT HwAgVehCentrTrim.HwAg.Val /end REF_MEASUREMENT /end GROUP
/begin GROUP HwAgVehCentrTrim.HwAgCcwDetd.Logl "MICROSAR RTE" /begin SUB_GROUP /end SUB_GROUP /begin FUNCTION_LIST /end FUNCTION_LIST /begin REF_CHARACTERISTIC /end REF_CHARACTERISTIC /begin REF_MEASUREMENT HwAgVehCentrTrim.HwAgCcwDetd.Logl /end REF_MEASUREMENT /end GROUP
/begin GROUP HwAgVehCentrTrim.HwAgCwDetd.Logl "MICROSAR RTE" /begin SUB_GROUP /end SUB_GROUP /begin FUNCTION_LIST /end FUNCTION_LIST /begin REF_CHARACTERISTIC /end REF_CHARACTERISTIC /begin REF_MEASUREMENT HwAgVehCentrTrim.HwAgCwDetd.Logl /end REF_MEASUREMENT /end GROUP
/begin GROUP HwAgVehCentrTrim.HwAgEotCcw.Val "MICROSAR RTE" /begin SUB_GROUP /end SUB_GROUP /begin FUNCTION_LIST /end FUNCTION_LIST /begin REF_CHARACTERISTIC /end REF_CHARACTERISTIC /begin REF_MEASUREMENT HwAgVehCentrTrim.HwAgEotCcw.Val /end REF_MEASUREMENT /end GROUP
/begin GROUP HwAgVehCentrTrim.HwAgEotCw.Val "MICROSAR RTE" /begin SUB_GROUP /end SUB_GROUP /begin FUNCTION_LIST /end FUNCTION_LIST /begin REF_CHARACTERISTIC /end REF_CHARACTERISTIC /begin REF_MEASUREMENT HwAgVehCentrTrim.HwAgEotCw.Val /end REF_MEASUREMENT /end GROUP
/begin GROUP HwAgVehCentrTrim.HwAgTrimData "MICROSAR RTE" /begin SUB_GROUP /end SUB_GROUP /begin FUNCTION_LIST /end FUNCTION_LIST /begin REF_CHARACTERISTIC /end REF_CHARACTERISTIC
 /begin REF_MEASUREMENT HwAgVehCentrTrim.HwAgTrimData.TrimPrfmd HwAgVehCentrTrim.HwAgTrimData.TrimVal /end REF_MEASUREMENT
/end GROUP
/begin GROUP HwAgVehCentrTrim.HwAgTrimDataDft "MICROSAR RTE" /begin SUB_GROUP /end SUB_GROUP /begin FUNCTION_LIST /end FUNCTION_LIST
 /begin REF_CHARACTERISTIC HwAgVehCentrTrim.HwAgTrimDataDft.TrimPrfmd HwAgVehCentrTrim.HwAgTrimDataDft.TrimVal /end REF_CHARACTERISTIC
 /begin REF_MEASUREMENT /end REF_MEASUREMENT
/end GROUP
/begin GROUP HwAgVehCentrTrim.HwAgTrimPrfmd.Logl "MICROSAR RTE" /begin SUB_GROUP /end SUB_GROUP /begin FUNCTION_LIST /end FUNCTION_LIST /begin REF_CHARACTERISTIC /end REF_CHARACTERISTIC /begin REF_MEASUREMENT HwAgVehCentrTrim.HwAgTrimPrfmd.Logl /end REF_MEASUREMENT /end GROUP
/begin GROUP HwAgVehCentrTrim.HwAgVehCentrTrimHwAgLim.Val "MICROSAR RTE" /begin SUB_GROUP /end SUB_GROUP /begin FUNCTION_LIST /end FUNCTION_LIST /begin REF_CHARACTERISTIC HwAgVehCentrTrim.HwAgVehCentrTrimHwAgLim.Val /end REF_CHARACTERISTIC /begin REF_MEASUREMENT /end REF_MEASUREMENT /end GROUP
/begin GROUP HwAgVehCentrTrim.HwAgVehCentrTrimVehSpdMaxThd.Val "MICROSAR RTE" /begin SUB_GROUP /end SUB_GROUP /begin FUNCTION_LIST /end FUNCTION_LIST /begin REF_CHARACTERISTIC HwAgVehCentrTrim.HwAgVehCentrTrimVehSpdMaxThd.Val /end REF_CHARACTERISTIC /begin REF_MEASUREMENT /end REF_MEASUREMENT /end GROUP
/begin GROUP HwAgVehCentrTrim.HwAgVehTrimOffs.Val "MICROSAR RTE" /begin SUB_GROUP /end SUB_GROUP /begin FUNCTION_LIST /end FUNCTION_LIST /begin REF_CHARACTERISTIC /end REF_CHARACTERISTIC /begin REF_MEASUREMENT HwAgVehCentrTrim.HwAgVehTrimOffs.Val /end REF_MEASUREMENT /end GROUP
/begin GROUP HwAgVehCentrTrim.PerInstanceMemories "MICROSAR RTE" /begin SUB_GROUP HwAgVehCentrTrim.HwAgTrimData /end SUB_GROUP /begin FUNCTION_LIST /end FUNCTION_LIST /begin REF_CHARACTERISTIC /end REF_CHARACTERISTIC /begin REF_MEASUREMENT /end REF_MEASUREMENT /end GROUP
/begin GROUP HwAgVehCentrTrim.ReceiverPorts "MICROSAR RTE"
 /begin SUB_GROUP HwAgVehCentrTrim.EngRunActv.Logl HwAgVehCentrTrim.HwAg.Val HwAgVehCentrTrim.HwAgCcwDetd.Logl HwAgVehCentrTrim.HwAgCwDetd.Logl HwAgVehCentrTrim.HwAgEotCcw.Val HwAgVehCentrTrim.HwAgEotCw.Val HwAgVehCentrTrim.VehSpd.Val /end SUB_GROUP
 /begin FUNCTION_LIST /end FUNCTION_LIST
 /begin REF_CHARACTERISTIC /end REF_CHARACTERISTIC
 /begin REF_MEASUREMENT /end REF_MEASUREMENT
/end GROUP
/begin GROUP HwAgVehCentrTrim.SenderPorts "MICROSAR RTE"
 /begin SUB_GROUP HwAgVehCentrTrim.HwAgTrimPrfmd.Logl HwAgVehCentrTrim.HwAgVehTrimOffs.Val /end SUB_GROUP
 /begin FUNCTION_LIST /end FUNCTION_LIST
 /begin REF_CHARACTERISTIC /end REF_CHARACTERISTIC
 /begin REF_MEASUREMENT /end REF_MEASUREMENT
/end GROUP
/begin GROUP HwAgVehCentrTrim.VehSpd.Val "MICROSAR RTE" /begin SUB_GROUP /end SUB_GROUP /begin FUNCTION_LIST /end FUNCTION_LIST /begin REF_CHARACTERISTIC /end REF_CHARACTERISTIC /begin REF_MEASUREMENT HwAgVehCentrTrim.VehSpd.Val /end REF_MEASUREMENT /end GROUP
/begin GROUP HwTqArbn "MICROSAR RTE"
 /begin SUB_GROUP HwTqArbn.CalibrationPorts HwTqArbn.PerInstanceMemories HwTqArbn.ReceiverPorts HwTqArbn.SenderPorts /end SUB_GROUP
 /begin FUNCTION_LIST /end FUNCTION_LIST
 /begin REF_CHARACTERISTIC /end REF_CHARACTERISTIC
 /begin REF_MEASUREMENT /end REF_MEASUREMENT
/end GROUP
/begin GROUP HwTqArbn.CalibrationPorts "MICROSAR RTE"
 /begin SUB_GROUP HwTqArbn.HwTqArbnMaxStallTqA.Val HwTqArbn.HwTqArbnMaxStallTqB.Val HwTqArbn.HwTqArbnMaxStallTqC.Val HwTqArbn.HwTqArbnMaxStallTqD.Val /end SUB_GROUP
 /begin FUNCTION_LIST /end FUNCTION_LIST
 /begin REF_CHARACTERISTIC /end REF_CHARACTERISTIC
 /begin REF_MEASUREMENT /end REF_MEASUREMENT
/end GROUP
/begin GROUP HwTqArbn.HwTq.Val "MICROSAR RTE" /begin SUB_GROUP /end SUB_GROUP /begin FUNCTION_LIST /end FUNCTION_LIST /begin REF_CHARACTERISTIC /end REF_CHARACTERISTIC /begin REF_MEASUREMENT HwTqArbn.HwTq.Val /end REF_MEASUREMENT /end GROUP
/begin GROUP HwTqArbn.HwTqA.Val "MICROSAR RTE" /begin SUB_GROUP /end SUB_GROUP /begin FUNCTION_LIST /end FUNCTION_LIST /begin REF_CHARACTERISTIC /end REF_CHARACTERISTIC /begin REF_MEASUREMENT HwTqArbn.HwTqA.Val /end REF_MEASUREMENT /end GROUP
/begin GROUP HwTqArbn.HwTqAQlfr.Val "MICROSAR RTE" /begin SUB_GROUP /end SUB_GROUP /begin FUNCTION_LIST /end FUNCTION_LIST /begin REF_CHARACTERISTIC /end REF_CHARACTERISTIC /begin REF_MEASUREMENT HwTqArbn.HwTqAQlfr.Val /end REF_MEASUREMENT /end GROUP
/begin GROUP HwTqArbn.HwTqARollgCntr.Val "MICROSAR RTE" /begin SUB_GROUP /end SUB_GROUP /begin FUNCTION_LIST /end FUNCTION_LIST /begin REF_CHARACTERISTIC /end REF_CHARACTERISTIC /begin REF_MEASUREMENT HwTqArbn.HwTqARollgCntr.Val /end REF_MEASUREMENT /end GROUP
/begin GROUP HwTqArbn.HwTqArbnMaxStallTqA.Val "MICROSAR RTE" /begin SUB_GROUP /end SUB_GROUP /begin FUNCTION_LIST /end FUNCTION_LIST /begin REF_CHARACTERISTIC HwTqArbn.HwTqArbnMaxStallTqA.Val /end REF_CHARACTERISTIC /begin REF_MEASUREMENT /end REF_MEASUREMENT /end GROUP
/begin GROUP HwTqArbn.HwTqArbnMaxStallTqB.Val "MICROSAR RTE" /begin SUB_GROUP /end SUB_GROUP /begin FUNCTION_LIST /end FUNCTION_LIST /begin REF_CHARACTERISTIC HwTqArbn.HwTqArbnMaxStallTqB.Val /end REF_CHARACTERISTIC /begin REF_MEASUREMENT /end REF_MEASUREMENT /end GROUP
/begin GROUP HwTqArbn.HwTqArbnMaxStallTqC.Val "MICROSAR RTE" /begin SUB_GROUP /end SUB_GROUP /begin FUNCTION_LIST /end FUNCTION_LIST /begin REF_CHARACTERISTIC HwTqArbn.HwTqArbnMaxStallTqC.Val /end REF_CHARACTERISTIC /begin REF_MEASUREMENT /end REF_MEASUREMENT /end GROUP
/begin GROUP HwTqArbn.HwTqArbnMaxStallTqD.Val "MICROSAR RTE" /begin SUB_GROUP /end SUB_GROUP /begin FUNCTION_LIST /end FUNCTION_LIST /begin REF_CHARACTERISTIC HwTqArbn.HwTqArbnMaxStallTqD.Val /end REF_CHARACTERISTIC /begin REF_MEASUREMENT /end REF_MEASUREMENT /end GROUP
/begin GROUP HwTqArbn.HwTqArbnTqARollgCntrPrev "MICROSAR RTE" /begin SUB_GROUP /end SUB_GROUP /begin FUNCTION_LIST /end FUNCTION_LIST /begin REF_CHARACTERISTIC /end REF_CHARACTERISTIC /begin REF_MEASUREMENT HwTqArbn.HwTqArbnTqARollgCntrPrev /end REF_MEASUREMENT /end GROUP
/**********************************************************************************************************************
* RECORD_LAYOUT
*********************************************************************************************************************/
/begin RECORD_LAYOUT RTE_RL_UBYTE FNC_VALUES 1 UBYTE ROW_DIR DIRECT /end RECORD_LAYOUT
/begin RECORD_LAYOUT RTE_RL_UWORD FNC_VALUES 1 UWORD ROW_DIR DIRECT /end RECORD_LAYOUT
/begin RECORD_LAYOUT RTE_RL_ULONG FNC_VALUES 1 ULONG ROW_DIR DIRECT /end RECORD_LAYOUT
/begin RECORD_LAYOUT RTE_RL_SWORD FNC_VALUES 1 SWORD ROW_DIR DIRECT /end RECORD_LAYOUT
/begin RECORD_LAYOUT RTE_RL_FLOAT32_IEEE FNC_VALUES 1 FLOAT32_IEEE ROW_DIR DIRECT /end RECORD_LAYOUT
/begin RECORD_LAYOUT RTE_RL_BOOLEAN FNC_VALUES 1 UBYTE ROW_DIR DIRECT /end RECORD_LAYOUT
/**********************************************************************************************************************
* COMPU_METHOD / COMPU_VTAB_RANGE
*********************************************************************************************************************/
/begin COMPU_METHOD RTE_CM_BOOLEAN "" TAB_VERB "%3.1" "" COMPU_TAB_REF RTE_CM_BOOLEAN /end COMPU_METHOD
/begin COMPU_VTAB_RANGE RTE_CM_BOOLEAN "" 2 0 0 "false" 1 255 "true" /end COMPU_VTAB_RANGE
/begin COMPU_METHOD RTE_CM_ENUM_SigQlfr1 "" TAB_VERB "%.1" "" COMPU_TAB_REF RTE_CM_ENUM_SigQlfr1 /end COMPU_METHOD
/begin COMPU_VTAB_RANGE RTE_CM_ENUM_SigQlfr1 "" 3 0 0 "SIGQLFR_NORES" 1 1 "SIGQLFR_PASSD" 2 2 "SIGQLFR_FAILD" /end COMPU_VTAB_RANGE
/begin COMPU_METHOD RTE_CM_ENUM_HwAgTrajCmdSt1 "" TAB_VERB "%.1" "" COMPU_TAB_REF RTE_CM_ENUM_HwAgTrajCmdSt1 /end COMPU_METHOD
/begin COMPU_VTAB_RANGE RTE_CM_ENUM_HwAgTrajCmdSt1 "" 5 0 0 "HWAGTRAJCMDST_WAIT" 1 1 "HWAGTRAJCMDST_HWAGA" 2 2 "HWAGTRAJCMDST_CONVEL" 3 3 "HWAGTRAJCMDST_HWAGDECEL" 4 4 "HWAGTRAJCMDST_HLD" /end COMPU_VTAB_RANGE
