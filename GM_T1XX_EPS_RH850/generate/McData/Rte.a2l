/begin CHARACTERISTIC CalRegn02CmnGroupC.GmOvrlStMgrApaHaptcEna.Logl "MICROSAR RTE" VALUE 0x0 RTE_RL_BOOLEAN 0 RTE_CM_BOOLEAN 0 255 SYMBOL_LINK "Rte_CalprmRom_CalRegn02CmnGroupC_DEFAULT_RTE_CALPRM_GROUP.GmOvrlStMgrApaHaptcEna_Logl" 0 DISPLAY_IDENTIFIER CalRegn02CmnGroupC.CalibrationPorts.GmOvrlStMgrApaHaptcEna.Logl /end CHARACTERISTIC
/begin CHARACTERISTIC CalRegn02CmnGroupC.GmOvrlStMgrApaHwTqThd.Val "MICROSAR RTE" VALUE 0x0 RTE_RL_FLOAT32_IEEE 0 NO_COMPU_METHOD -3.402823466e+38 3.402823466e+38 SYMBOL_LINK "Rte_CalprmRom_CalRegn02CmnGroupC_DEFAULT_RTE_CALPRM_GROUP.GmOvrlStMgrApaHwTqThd_Val" 0 DISPLAY_IDENTIFIER CalRegn02CmnGroupC.CalibrationPorts.GmOvrlStMgrApaHwTqThd.Val /end CHARACTERISTIC
/begin CHARACTERISTIC CalRegn02CmnGroupC.GmOvrlStMgrApaVehSpdHiLim.Val "MICROSAR RTE" VALUE 0x0 RTE_RL_FLOAT32_IEEE 0 NO_COMPU_METHOD -3.402823466e+38 3.402823466e+38 SYMBOL_LINK "Rte_CalprmRom_CalRegn02CmnGroupC_DEFAULT_RTE_CALPRM_GROUP.GmOvrlStMgrApaVehSpdHiLim_Val" 0 DISPLAY_IDENTIFIER CalRegn02CmnGroupC.CalibrationPorts.GmOvrlStMgrApaVehSpdHiLim.Val /end CHARACTERISTIC
/begin CHARACTERISTIC CalRegn02CmnGroupC.GmOvrlStMgrEscVehSpdHiLim.Val "MICROSAR RTE" VALUE 0x0 RTE_RL_FLOAT32_IEEE 0 NO_COMPU_METHOD -3.402823466e+38 3.402823466e+38 SYMBOL_LINK "Rte_CalprmRom_CalRegn02CmnGroupC_DEFAULT_RTE_CALPRM_GROUP.GmOvrlStMgrEscVehSpdHiLim_Val" 0 DISPLAY_IDENTIFIER CalRegn02CmnGroupC.CalibrationPorts.GmOvrlStMgrEscVehSpdHiLim.Val /end CHARACTERISTIC
/begin CHARACTERISTIC CalRegn02CmnGroupC.GmOvrlStMgrHaptcAmp.Val "MICROSAR RTE" VALUE 0x0 RTE_RL_FLOAT32_IEEE 0 NO_COMPU_METHOD -3.402823466e+38 3.402823466e+38 SYMBOL_LINK "Rte_CalprmRom_CalRegn02CmnGroupC_DEFAULT_RTE_CALPRM_GROUP.GmOvrlStMgrHaptcAmp_Val" 0 DISPLAY_IDENTIFIER CalRegn02CmnGroupC.CalibrationPorts.GmOvrlStMgrHaptcAmp.Val /end CHARACTERISTIC
/begin CHARACTERISTIC CalRegn02CmnGroupC.GmOvrlStMgrHaptcDurn.Val "MICROSAR RTE" VALUE 0x0 RTE_RL_ULONG 0 NO_COMPU_METHOD 0 4294967295 SYMBOL_LINK "Rte_CalprmRom_CalRegn02CmnGroupC_DEFAULT_RTE_CALPRM_GROUP.GmOvrlStMgrHaptcDurn_Val" 0 DISPLAY_IDENTIFIER CalRegn02CmnGroupC.CalibrationPorts.GmOvrlStMgrHaptcDurn.Val /end CHARACTERISTIC
/begin CHARACTERISTIC CalRegn02CmnGroupC.GmOvrlStMgrLkaVehSpdHiLim.Val "MICROSAR RTE" VALUE 0x0 RTE_RL_FLOAT32_IEEE 0 NO_COMPU_METHOD -3.402823466e+38 3.402823466e+38 SYMBOL_LINK "Rte_CalprmRom_CalRegn02CmnGroupC_DEFAULT_RTE_CALPRM_GROUP.GmOvrlStMgrLkaVehSpdHiLim_Val" 0 DISPLAY_IDENTIFIER CalRegn02CmnGroupC.CalibrationPorts.GmOvrlStMgrLkaVehSpdHiLim.Val /end CHARACTERISTIC
/begin CHARACTERISTIC CalRegn02CmnGroupC.GmOvrlStMgrLkaVehSpdLoLim.Val "MICROSAR RTE" VALUE 0x0 RTE_RL_FLOAT32_IEEE 0 NO_COMPU_METHOD -3.402823466e+38 3.402823466e+38 SYMBOL_LINK "Rte_CalprmRom_CalRegn02CmnGroupC_DEFAULT_RTE_CALPRM_GROUP.GmOvrlStMgrLkaVehSpdLoLim_Val" 0 DISPLAY_IDENTIFIER CalRegn02CmnGroupC.CalibrationPorts.GmOvrlStMgrLkaVehSpdLoLim.Val /end CHARACTERISTIC
/begin CHARACTERISTIC CalRegn02CmnGroupC.HowDetnHiFrqGainY.Ary1D "MICROSAR RTE" VAL_BLK 0x0 RTE_RL_UWORD 0 NO_COMPU_METHOD 0 65535 MATRIX_DIM 9 1 1 SYMBOL_LINK "Rte_CalprmRom_CalRegn02CmnGroupC_DEFAULT_RTE_CALPRM_GROUP.HowDetnHiFrqGainY_Ary1D" 0 DISPLAY_IDENTIFIER CalRegn02CmnGroupC.CalibrationPorts.HowDetnHiFrqGainY.Ary1D /end CHARACTERISTIC
/begin CHARACTERISTIC CalRegn02CmnGroupC.HowDetnHiFrqRateX.Ary2D "MICROSAR RTE" VAL_BLK 0x0 RTE_RL_UWORD 0 NO_COMPU_METHOD 0 65535 MATRIX_DIM 6 9 1 SYMBOL_LINK "Rte_CalprmRom_CalRegn02CmnGroupC_DEFAULT_RTE_CALPRM_GROUP.HowDetnHiFrqRateX_Ary2D" 0 DISPLAY_IDENTIFIER CalRegn02CmnGroupC.CalibrationPorts.HowDetnHiFrqRateX.Ary2D /end CHARACTERISTIC
/begin CHARACTERISTIC CalRegn02CmnGroupC.HowDetnHiFrqRateY.Ary2D "MICROSAR RTE" VAL_BLK 0x0 RTE_RL_SWORD 0 NO_COMPU_METHOD -32768 32767 MATRIX_DIM 6 9 1 SYMBOL_LINK "Rte_CalprmRom_CalRegn02CmnGroupC_DEFAULT_RTE_CALPRM_GROUP.HowDetnHiFrqRateY_Ary2D" 0 DISPLAY_IDENTIFIER CalRegn02CmnGroupC.CalibrationPorts.HowDetnHiFrqRateY.Ary2D /end CHARACTERISTIC
/begin CHARACTERISTIC CalRegn02CmnGroupC.HowDetnLoFrqRateX.Ary2D "MICROSAR RTE" VAL_BLK 0x0 RTE_RL_UWORD 0 NO_COMPU_METHOD 0 65535 MATRIX_DIM 5 9 1 SYMBOL_LINK "Rte_CalprmRom_CalRegn02CmnGroupC_DEFAULT_RTE_CALPRM_GROUP.HowDetnLoFrqRateX_Ary2D" 0 DISPLAY_IDENTIFIER CalRegn02CmnGroupC.CalibrationPorts.HowDetnLoFrqRateX.Ary2D /end CHARACTERISTIC
/begin CHARACTERISTIC CalRegn02CmnGroupC.HowDetnLoFrqRateY.Ary2D "MICROSAR RTE" VAL_BLK 0x0 RTE_RL_SWORD 0 NO_COMPU_METHOD -32768 32767 MATRIX_DIM 5 9 1 SYMBOL_LINK "Rte_CalprmRom_CalRegn02CmnGroupC_DEFAULT_RTE_CALPRM_GROUP.HowDetnLoFrqRateY_Ary2D" 0 DISPLAY_IDENTIFIER CalRegn02CmnGroupC.CalibrationPorts.HowDetnLoFrqRateY.Ary2D /end CHARACTERISTIC
/begin CHARACTERISTIC CalRegn02CmnGroupC.HowDetnMinVehSpd.Val "MICROSAR RTE" VALUE 0x0 RTE_RL_FLOAT32_IEEE 0 NO_COMPU_METHOD -3.402823466e+38 3.402823466e+38 SYMBOL_LINK "Rte_CalprmRom_CalRegn02CmnGroupC_DEFAULT_RTE_CALPRM_GROUP.HowDetnMinVehSpd_Val" 0 DISPLAY_IDENTIFIER CalRegn02CmnGroupC.CalibrationPorts.HowDetnMinVehSpd.Val /end CHARACTERISTIC
/begin CHARACTERISTIC CalRegn02CmnGroupC.HowDetnPercOfPrevHowEstim.Val "MICROSAR RTE" VALUE 0x0 RTE_RL_FLOAT32_IEEE 0 NO_COMPU_METHOD -3.402823466e+38 3.402823466e+38 SYMBOL_LINK "Rte_CalprmRom_CalRegn02CmnGroupC_DEFAULT_RTE_CALPRM_GROUP.HowDetnPercOfPrevHowEstim_Val" 0 DISPLAY_IDENTIFIER CalRegn02CmnGroupC.CalibrationPorts.HowDetnPercOfPrevHowEstim.Val /end CHARACTERISTIC
/begin CHARACTERISTIC CalRegn02CmnGroupC.HowDetnSlewRate.Val "MICROSAR RTE" VALUE 0x0 RTE_RL_FLOAT32_IEEE 0 NO_COMPU_METHOD -3.402823466e+38 3.402823466e+38 SYMBOL_LINK "Rte_CalprmRom_CalRegn02CmnGroupC_DEFAULT_RTE_CALPRM_GROUP.HowDetnSlewRate_Val" 0 DISPLAY_IDENTIFIER CalRegn02CmnGroupC.CalibrationPorts.HowDetnSlewRate.Val /end CHARACTERISTIC
/begin CHARACTERISTIC CalRegn02CmnGroupC.HowDetnStThdX.Ary1D "MICROSAR RTE" VAL_BLK 0x0 RTE_RL_UWORD 0 NO_COMPU_METHOD 0 65535 MATRIX_DIM 7 1 1 SYMBOL_LINK "Rte_CalprmRom_CalRegn02CmnGroupC_DEFAULT_RTE_CALPRM_GROUP.HowDetnStThdX_Ary1D" 0 DISPLAY_IDENTIFIER CalRegn02CmnGroupC.CalibrationPorts.HowDetnStThdX.Ary1D /end CHARACTERISTIC
/begin CHARACTERISTIC CalRegn02CmnGroupC.HowDetnTqHpFilFrq.Val "MICROSAR RTE" VALUE 0x0 RTE_RL_FLOAT32_IEEE 0 NO_COMPU_METHOD -3.402823466e+38 3.402823466e+38 SYMBOL_LINK "Rte_CalprmRom_CalRegn02CmnGroupC_DEFAULT_RTE_CALPRM_GROUP.HowDetnTqHpFilFrq_Val" 0 DISPLAY_IDENTIFIER CalRegn02CmnGroupC.CalibrationPorts.HowDetnTqHpFilFrq.Val /end CHARACTERISTIC
/begin CHARACTERISTIC CalRegn02CmnGroupC.HowDetnVehSpd.Ary1D "MICROSAR RTE" VAL_BLK 0x0 RTE_RL_UWORD 0 NO_COMPU_METHOD 0 65535 MATRIX_DIM 9 1 1 SYMBOL_LINK "Rte_CalprmRom_CalRegn02CmnGroupC_DEFAULT_RTE_CALPRM_GROUP.HowDetnVehSpd_Ary1D" 0 DISPLAY_IDENTIFIER CalRegn02CmnGroupC.CalibrationPorts.HowDetnVehSpd.Ary1D /end CHARACTERISTIC
/begin CHARACTERISTIC CalRegn02CmnGroupC.SnsrOffsLrngFctEna.Logl "MICROSAR RTE" VALUE 0x0 RTE_RL_BOOLEAN 0 RTE_CM_BOOLEAN 0 255 SYMBOL_LINK "Rte_CalprmRom_CalRegn02CmnGroupC_DEFAULT_RTE_CALPRM_GROUP.SnsrOffsLrngFctEna_Logl" 0 DISPLAY_IDENTIFIER CalRegn02CmnGroupC.CalibrationPorts.SnsrOffsLrngFctEna.Logl /end CHARACTERISTIC
/begin CHARACTERISTIC CalRegn02CmnGroupC.SnsrOffsLrngHwAgLrngDrvgDstThd.Val "MICROSAR RTE" VALUE 0x0 RTE_RL_FLOAT32_IEEE 0 NO_COMPU_METHOD -3.402823466e+38 3.402823466e+38 SYMBOL_LINK "Rte_CalprmRom_CalRegn02CmnGroupC_DEFAULT_RTE_CALPRM_GROUP.SnsrOffsLrngHwAgLrngDrvgDstThd_Val" 0 DISPLAY_IDENTIFIER CalRegn02CmnGroupC.CalibrationPorts.SnsrOffsLrngHwAgLrngDrvgDstThd.Val /end CHARACTERISTIC
/begin CHARACTERISTIC CalRegn02CmnGroupC.SnsrOffsLrngHwAgLrngEna.Logl "MICROSAR RTE" VALUE 0x0 RTE_RL_BOOLEAN 0 RTE_CM_BOOLEAN 0 255 SYMBOL_LINK "Rte_CalprmRom_CalRegn02CmnGroupC_DEFAULT_RTE_CALPRM_GROUP.SnsrOffsLrngHwAgLrngEna_Logl" 0 DISPLAY_IDENTIFIER CalRegn02CmnGroupC.CalibrationPorts.SnsrOffsLrngHwAgLrngEna.Logl /end CHARACTERISTIC
/begin CHARACTERISTIC CalRegn02CmnGroupC.SnsrOffsLrngHwAgLrngHwVelThd.Val "MICROSAR RTE" VALUE 0x0 RTE_RL_FLOAT32_IEEE 0 NO_COMPU_METHOD -3.402823466e+38 3.402823466e+38 SYMBOL_LINK "Rte_CalprmRom_CalRegn02CmnGroupC_DEFAULT_RTE_CALPRM_GROUP.SnsrOffsLrngHwAgLrngHwVelThd_Val" 0 DISPLAY_IDENTIFIER CalRegn02CmnGroupC.CalibrationPorts.SnsrOffsLrngHwAgLrngHwVelThd.Val /end CHARACTERISTIC
/begin CHARACTERISTIC CalRegn02CmnGroupC.SnsrOffsLrngHwAgLrngSysTqThd.Val "MICROSAR RTE" VALUE 0x0 RTE_RL_FLOAT32_IEEE 0 NO_COMPU_METHOD -3.402823466e+38 3.402823466e+38 SYMBOL_LINK "Rte_CalprmRom_CalRegn02CmnGroupC_DEFAULT_RTE_CALPRM_GROUP.SnsrOffsLrngHwAgLrngSysTqThd_Val" 0 DISPLAY_IDENTIFIER CalRegn02CmnGroupC.CalibrationPorts.SnsrOffsLrngHwAgLrngSysTqThd.Val /end CHARACTERISTIC
/begin CHARACTERISTIC CalRegn02CmnGroupC.SnsrOffsLrngHwAgLrngSysTqThdMed.Val "MICROSAR RTE" VALUE 0x0 RTE_RL_FLOAT32_IEEE 0 NO_COMPU_METHOD -3.402823466e+38 3.402823466e+38 SYMBOL_LINK "Rte_CalprmRom_CalRegn02CmnGroupC_DEFAULT_RTE_CALPRM_GROUP.SnsrOffsLrngHwAgLrngSysTqThdMed_Val" 0 DISPLAY_IDENTIFIER CalRegn02CmnGroupC.CalibrationPorts.SnsrOffsLrngHwAgLrngSysTqThdMed.Val /end CHARACTERISTIC
/begin CHARACTERISTIC CalRegn02CmnGroupC.SnsrOffsLrngHwAgLrngSysTqThdTrustd.Val "MICROSAR RTE" VALUE 0x0 RTE_RL_FLOAT32_IEEE 0 NO_COMPU_METHOD -3.402823466e+38 3.402823466e+38 SYMBOL_LINK "Rte_CalprmRom_CalRegn02CmnGroupC_DEFAULT_RTE_CALPRM_GROUP.SnsrOffsLrngHwAgLrngSysTqThdTrustd_Val" 0 DISPLAY_IDENTIFIER CalRegn02CmnGroupC.CalibrationPorts.SnsrOffsLrngHwAgLrngSysTqThdTrustd.Val /end CHARACTERISTIC
/begin CHARACTERISTIC CalRegn02CmnGroupC.SnsrOffsLrngHwAgLrngSysTqThdWide.Val "MICROSAR RTE" VALUE 0x0 RTE_RL_FLOAT32_IEEE 0 NO_COMPU_METHOD -3.402823466e+38 3.402823466e+38 SYMBOL_LINK "Rte_CalprmRom_CalRegn02CmnGroupC_DEFAULT_RTE_CALPRM_GROUP.SnsrOffsLrngHwAgLrngSysTqThdWide_Val" 0 DISPLAY_IDENTIFIER CalRegn02CmnGroupC.CalibrationPorts.SnsrOffsLrngHwAgLrngSysTqThdWide.Val /end CHARACTERISTIC
/begin CHARACTERISTIC CalRegn02CmnGroupC.SnsrOffsLrngHwAgLrngVehSpdThd.Val "MICROSAR RTE" VALUE 0x0 RTE_RL_FLOAT32_IEEE 0 NO_COMPU_METHOD -3.402823466e+38 3.402823466e+38 SYMBOL_LINK "Rte_CalprmRom_CalRegn02CmnGroupC_DEFAULT_RTE_CALPRM_GROUP.SnsrOffsLrngHwAgLrngVehSpdThd_Val" 0 DISPLAY_IDENTIFIER CalRegn02CmnGroupC.CalibrationPorts.SnsrOffsLrngHwAgLrngVehSpdThd.Val /end CHARACTERISTIC
/begin CHARACTERISTIC CalRegn02CmnGroupC.SnsrOffsLrngHwAgLrngYawOffsDbnd.Val "MICROSAR RTE" VALUE 0x0 RTE_RL_FLOAT32_IEEE 0 NO_COMPU_METHOD -3.402823466e+38 3.402823466e+38 SYMBOL_LINK "Rte_CalprmRom_CalRegn02CmnGroupC_DEFAULT_RTE_CALPRM_GROUP.SnsrOffsLrngHwAgLrngYawOffsDbnd_Val" 0 DISPLAY_IDENTIFIER CalRegn02CmnGroupC.CalibrationPorts.SnsrOffsLrngHwAgLrngYawOffsDbnd.Val /end CHARACTERISTIC
/begin CHARACTERISTIC CalRegn02CmnGroupC.SnsrOffsLrngHwAgLrngYawRateThd.Val "MICROSAR RTE" VALUE 0x0 RTE_RL_FLOAT32_IEEE 0 NO_COMPU_METHOD -3.402823466e+38 3.402823466e+38 SYMBOL_LINK "Rte_CalprmRom_CalRegn02CmnGroupC_DEFAULT_RTE_CALPRM_GROUP.SnsrOffsLrngHwAgLrngYawRateThd_Val" 0 DISPLAY_IDENTIFIER CalRegn02CmnGroupC.CalibrationPorts.SnsrOffsLrngHwAgLrngYawRateThd.Val /end CHARACTERISTIC
/begin CHARACTERISTIC CalRegn02CmnGroupC.SnsrOffsLrngHwAgOffsLim.Val "MICROSAR RTE" VALUE 0x0 RTE_RL_FLOAT32_IEEE 0 NO_COMPU_METHOD -3.402823466e+38 3.402823466e+38 SYMBOL_LINK "Rte_CalprmRom_CalRegn02CmnGroupC_DEFAULT_RTE_CALPRM_GROUP.SnsrOffsLrngHwAgOffsLim_Val" 0 DISPLAY_IDENTIFIER CalRegn02CmnGroupC.CalibrationPorts.SnsrOffsLrngHwAgOffsLim.Val /end CHARACTERISTIC
/begin CHARACTERISTIC CalRegn02CmnGroupC.SnsrOffsLrngHwTqLrngEna.Logl "MICROSAR RTE" VALUE 0x0 RTE_RL_BOOLEAN 0 RTE_CM_BOOLEAN 0 255 SYMBOL_LINK "Rte_CalprmRom_CalRegn02CmnGroupC_DEFAULT_RTE_CALPRM_GROUP.SnsrOffsLrngHwTqLrngEna_Logl" 0 DISPLAY_IDENTIFIER CalRegn02CmnGroupC.CalibrationPorts.SnsrOffsLrngHwTqLrngEna.Logl /end CHARACTERISTIC
/begin CHARACTERISTIC CalRegn02CmnGroupC.SnsrOffsLrngHwTqLrngEnaTiThd.Val "MICROSAR RTE" VALUE 0x0 RTE_RL_FLOAT32_IEEE 0 NO_COMPU_METHOD -3.402823466e+38 3.402823466e+38 SYMBOL_LINK "Rte_CalprmRom_CalRegn02CmnGroupC_DEFAULT_RTE_CALPRM_GROUP.SnsrOffsLrngHwTqLrngEnaTiThd_Val" 0 DISPLAY_IDENTIFIER CalRegn02CmnGroupC.CalibrationPorts.SnsrOffsLrngHwTqLrngEnaTiThd.Val /end CHARACTERISTIC
/begin CHARACTERISTIC CalRegn02CmnGroupC.SnsrOffsLrngHwTqLrngHwAgDbnd.Val "MICROSAR RTE" VALUE 0x0 RTE_RL_FLOAT32_IEEE 0 NO_COMPU_METHOD -3.402823466e+38 3.402823466e+38 SYMBOL_LINK "Rte_CalprmRom_CalRegn02CmnGroupC_DEFAULT_RTE_CALPRM_GROUP.SnsrOffsLrngHwTqLrngHwAgDbnd_Val" 0 DISPLAY_IDENTIFIER CalRegn02CmnGroupC.CalibrationPorts.SnsrOffsLrngHwTqLrngHwAgDbnd.Val /end CHARACTERISTIC
/begin CHARACTERISTIC CalRegn02CmnGroupC.SnsrOffsLrngHwTqLrngHwAgThd.Val "MICROSAR RTE" VALUE 0x0 RTE_RL_FLOAT32_IEEE 0 NO_COMPU_METHOD -3.402823466e+38 3.402823466e+38 SYMBOL_LINK "Rte_CalprmRom_CalRegn02CmnGroupC_DEFAULT_RTE_CALPRM_GROUP.SnsrOffsLrngHwTqLrngHwAgThd_Val" 0 DISPLAY_IDENTIFIER CalRegn02CmnGroupC.CalibrationPorts.SnsrOffsLrngHwTqLrngHwAgThd.Val /end CHARACTERISTIC
/begin CHARACTERISTIC CalRegn02CmnGroupC.SnsrOffsLrngHwTqLrngHwTqThd.Val "MICROSAR RTE" VALUE 0x0 RTE_RL_FLOAT32_IEEE 0 NO_COMPU_METHOD -3.402823466e+38 3.402823466e+38 SYMBOL_LINK "Rte_CalprmRom_CalRegn02CmnGroupC_DEFAULT_RTE_CALPRM_GROUP.SnsrOffsLrngHwTqLrngHwTqThd_Val" 0 DISPLAY_IDENTIFIER CalRegn02CmnGroupC.CalibrationPorts.SnsrOffsLrngHwTqLrngHwTqThd.Val /end CHARACTERISTIC
/begin CHARACTERISTIC CalRegn02CmnGroupC.SnsrOffsLrngHwTqLrngHwVelThd.Val "MICROSAR RTE" VALUE 0x0 RTE_RL_FLOAT32_IEEE 0 NO_COMPU_METHOD -3.402823466e+38 3.402823466e+38 SYMBOL_LINK "Rte_CalprmRom_CalRegn02CmnGroupC_DEFAULT_RTE_CALPRM_GROUP.SnsrOffsLrngHwTqLrngHwVelThd_Val" 0 DISPLAY_IDENTIFIER CalRegn02CmnGroupC.CalibrationPorts.SnsrOffsLrngHwTqLrngHwVelThd.Val /end CHARACTERISTIC
/begin CHARACTERISTIC CalRegn02CmnGroupC.SnsrOffsLrngHwTqLrngMeasTiScar.Val "MICROSAR RTE" VALUE 0x0 RTE_RL_FLOAT32_IEEE 0 NO_COMPU_METHOD -3.402823466e+38 3.402823466e+38 SYMBOL_LINK "Rte_CalprmRom_CalRegn02CmnGroupC_DEFAULT_RTE_CALPRM_GROUP.SnsrOffsLrngHwTqLrngMeasTiScar_Val" 0 DISPLAY_IDENTIFIER CalRegn02CmnGroupC.CalibrationPorts.SnsrOffsLrngHwTqLrngMeasTiScar.Val /end CHARACTERISTIC
/begin CHARACTERISTIC CalRegn02CmnGroupC.SnsrOffsLrngHwTqLrngVehSpdThd.Val "MICROSAR RTE" VALUE 0x0 RTE_RL_FLOAT32_IEEE 0 NO_COMPU_METHOD -3.402823466e+38 3.402823466e+38 SYMBOL_LINK "Rte_CalprmRom_CalRegn02CmnGroupC_DEFAULT_RTE_CALPRM_GROUP.SnsrOffsLrngHwTqLrngVehSpdThd_Val" 0 DISPLAY_IDENTIFIER CalRegn02CmnGroupC.CalibrationPorts.SnsrOffsLrngHwTqLrngVehSpdThd.Val /end CHARACTERISTIC
/begin CHARACTERISTIC CalRegn02CmnGroupC.SnsrOffsLrngHwTqOffsLim.Val "MICROSAR RTE" VALUE 0x0 RTE_RL_FLOAT32_IEEE 0 NO_COMPU_METHOD -3.402823466e+38 3.402823466e+38 SYMBOL_LINK "Rte_CalprmRom_CalRegn02CmnGroupC_DEFAULT_RTE_CALPRM_GROUP.SnsrOffsLrngHwTqOffsLim_Val" 0 DISPLAY_IDENTIFIER CalRegn02CmnGroupC.CalibrationPorts.SnsrOffsLrngHwTqOffsLim.Val /end CHARACTERISTIC
/begin CHARACTERISTIC CalRegn02CmnGroupC.SnsrOffsLrngTqInpDetnPwrEstimnThd.Val "MICROSAR RTE" VALUE 0x0 RTE_RL_FLOAT32_IEEE 0 NO_COMPU_METHOD -3.402823466e+38 3.402823466e+38 SYMBOL_LINK "Rte_CalprmRom_CalRegn02CmnGroupC_DEFAULT_RTE_CALPRM_GROUP.SnsrOffsLrngTqInpDetnPwrEstimnThd_Val" 0 DISPLAY_IDENTIFIER CalRegn02CmnGroupC.CalibrationPorts.SnsrOffsLrngTqInpDetnPwrEstimnThd.Val /end CHARACTERISTIC
/begin CHARACTERISTIC CalRegn02CmnGroupC.SnsrOffsLrngTqInpDetnSinGenrAmp.Val "MICROSAR RTE" VALUE 0x0 RTE_RL_FLOAT32_IEEE 0 NO_COMPU_METHOD -3.402823466e+38 3.402823466e+38 SYMBOL_LINK "Rte_CalprmRom_CalRegn02CmnGroupC_DEFAULT_RTE_CALPRM_GROUP.SnsrOffsLrngTqInpDetnSinGenrAmp_Val" 0 DISPLAY_IDENTIFIER CalRegn02CmnGroupC.CalibrationPorts.SnsrOffsLrngTqInpDetnSinGenrAmp.Val /end CHARACTERISTIC
/begin CHARACTERISTIC CalRegn02CmnGroupC.SnsrOffsLrngTqInpDetnSinGenrFrq.Val "MICROSAR RTE" VALUE 0x0 RTE_RL_FLOAT32_IEEE 0 NO_COMPU_METHOD -3.402823466e+38 3.402823466e+38 SYMBOL_LINK "Rte_CalprmRom_CalRegn02CmnGroupC_DEFAULT_RTE_CALPRM_GROUP.SnsrOffsLrngTqInpDetnSinGenrFrq_Val" 0 DISPLAY_IDENTIFIER CalRegn02CmnGroupC.CalibrationPorts.SnsrOffsLrngTqInpDetnSinGenrFrq.Val /end CHARACTERISTIC
/begin CHARACTERISTIC CalRegn02CmnGroupC.SnsrOffsLrngTqInpDetnStg1FilGain.Val "MICROSAR RTE" VALUE 0x0 RTE_RL_FLOAT32_IEEE 0 NO_COMPU_METHOD -3.402823466e+38 3.402823466e+38 SYMBOL_LINK "Rte_CalprmRom_CalRegn02CmnGroupC_DEFAULT_RTE_CALPRM_GROUP.SnsrOffsLrngTqInpDetnStg1FilGain_Val" 0 DISPLAY_IDENTIFIER CalRegn02CmnGroupC.CalibrationPorts.SnsrOffsLrngTqInpDetnStg1FilGain.Val /end CHARACTERISTIC
/begin CHARACTERISTIC CalRegn02CmnGroupC.SnsrOffsLrngTqInpDetnStg1WinSize.Val "MICROSAR RTE" VALUE 0x0 RTE_RL_UBYTE 0 NO_COMPU_METHOD 0 255 SYMBOL_LINK "Rte_CalprmRom_CalRegn02CmnGroupC_DEFAULT_RTE_CALPRM_GROUP.SnsrOffsLrngTqInpDetnStg1WinSize_Val" 0 DISPLAY_IDENTIFIER CalRegn02CmnGroupC.CalibrationPorts.SnsrOffsLrngTqInpDetnStg1WinSize.Val /end CHARACTERISTIC
/begin CHARACTERISTIC CalRegn02CmnGroupC.SnsrOffsLrngTqInpDetnStg2FilGainCen.Val "MICROSAR RTE" VALUE 0x0 RTE_RL_FLOAT32_IEEE 0 NO_COMPU_METHOD -3.402823466e+38 3.402823466e+38 SYMBOL_LINK "Rte_CalprmRom_CalRegn02CmnGroupC_DEFAULT_RTE_CALPRM_GROUP.SnsrOffsLrngTqInpDetnStg2FilGainCen_Val" 0 DISPLAY_IDENTIFIER CalRegn02CmnGroupC.CalibrationPorts.SnsrOffsLrngTqInpDetnStg2FilGainCen.Val /end CHARACTERISTIC
/begin CHARACTERISTIC CalRegn02CmnGroupC.SnsrOffsLrngTqInpDetnStg2FilGainDwn.Val "MICROSAR RTE" VALUE 0x0 RTE_RL_FLOAT32_IEEE 0 NO_COMPU_METHOD -3.402823466e+38 3.402823466e+38 SYMBOL_LINK "Rte_CalprmRom_CalRegn02CmnGroupC_DEFAULT_RTE_CALPRM_GROUP.SnsrOffsLrngTqInpDetnStg2FilGainDwn_Val" 0 DISPLAY_IDENTIFIER CalRegn02CmnGroupC.CalibrationPorts.SnsrOffsLrngTqInpDetnStg2FilGainDwn.Val /end CHARACTERISTIC
/begin CHARACTERISTIC CalRegn02CmnGroupC.SnsrOffsLrngTqInpDetnStg2FilGainUp.Val "MICROSAR RTE" VALUE 0x0 RTE_RL_FLOAT32_IEEE 0 NO_COMPU_METHOD -3.402823466e+38 3.402823466e+38 SYMBOL_LINK "Rte_CalprmRom_CalRegn02CmnGroupC_DEFAULT_RTE_CALPRM_GROUP.SnsrOffsLrngTqInpDetnStg2FilGainUp_Val" 0 DISPLAY_IDENTIFIER CalRegn02CmnGroupC.CalibrationPorts.SnsrOffsLrngTqInpDetnStg2FilGainUp.Val /end CHARACTERISTIC
/begin CHARACTERISTIC CalRegn02CmnGroupC.SnsrOffsLrngTqInpDetnStg2WinSize.Val "MICROSAR RTE" VALUE 0x0 RTE_RL_UWORD 0 NO_COMPU_METHOD 0 65535 SYMBOL_LINK "Rte_CalprmRom_CalRegn02CmnGroupC_DEFAULT_RTE_CALPRM_GROUP.SnsrOffsLrngTqInpDetnStg2WinSize_Val" 0 DISPLAY_IDENTIFIER CalRegn02CmnGroupC.CalibrationPorts.SnsrOffsLrngTqInpDetnStg2WinSize.Val /end CHARACTERISTIC
/begin CHARACTERISTIC CalRegn02CmnGroupC.SnsrOffsLrngYawLrngEna.Logl "MICROSAR RTE" VALUE 0x0 RTE_RL_BOOLEAN 0 RTE_CM_BOOLEAN 0 255 SYMBOL_LINK "Rte_CalprmRom_CalRegn02CmnGroupC_DEFAULT_RTE_CALPRM_GROUP.SnsrOffsLrngYawLrngEna_Logl" 0 DISPLAY_IDENTIFIER CalRegn02CmnGroupC.CalibrationPorts.SnsrOffsLrngYawLrngEna.Logl /end CHARACTERISTIC
/begin CHARACTERISTIC CalRegn02CmnGroupC.SnsrOffsLrngYawLrngHwAgThd.Val "MICROSAR RTE" VALUE 0x0 RTE_RL_FLOAT32_IEEE 0 NO_COMPU_METHOD -3.402823466e+38 3.402823466e+38 SYMBOL_LINK "Rte_CalprmRom_CalRegn02CmnGroupC_DEFAULT_RTE_CALPRM_GROUP.SnsrOffsLrngYawLrngHwAgThd_Val" 0 DISPLAY_IDENTIFIER CalRegn02CmnGroupC.CalibrationPorts.SnsrOffsLrngYawLrngHwAgThd.Val /end CHARACTERISTIC
/begin CHARACTERISTIC CalRegn02CmnGroupC.SnsrOffsLrngYawLrngYawAThd.Val "MICROSAR RTE" VALUE 0x0 RTE_RL_FLOAT32_IEEE 0 NO_COMPU_METHOD -3.402823466e+38 3.402823466e+38 SYMBOL_LINK "Rte_CalprmRom_CalRegn02CmnGroupC_DEFAULT_RTE_CALPRM_GROUP.SnsrOffsLrngYawLrngYawAThd_Val" 0 DISPLAY_IDENTIFIER CalRegn02CmnGroupC.CalibrationPorts.SnsrOffsLrngYawLrngYawAThd.Val /end CHARACTERISTIC
/begin CHARACTERISTIC CalRegn02CmnGroupC.SnsrOffsLrngYawOffsFrshTiThd.Val "MICROSAR RTE" VALUE 0x0 RTE_RL_FLOAT32_IEEE 0 NO_COMPU_METHOD -3.402823466e+38 3.402823466e+38 SYMBOL_LINK "Rte_CalprmRom_CalRegn02CmnGroupC_DEFAULT_RTE_CALPRM_GROUP.SnsrOffsLrngYawOffsFrshTiThd_Val" 0 DISPLAY_IDENTIFIER CalRegn02CmnGroupC.CalibrationPorts.SnsrOffsLrngYawOffsFrshTiThd.Val /end CHARACTERISTIC
/begin CHARACTERISTIC CalRegn02CmnGroupC.SnsrOffsLrngYawRateOffsLim.Val "MICROSAR RTE" VALUE 0x0 RTE_RL_FLOAT32_IEEE 0 NO_COMPU_METHOD -3.402823466e+38 3.402823466e+38 SYMBOL_LINK "Rte_CalprmRom_CalRegn02CmnGroupC_DEFAULT_RTE_CALPRM_GROUP.SnsrOffsLrngYawRateOffsLim_Val" 0 DISPLAY_IDENTIFIER CalRegn02CmnGroupC.CalibrationPorts.SnsrOffsLrngYawRateOffsLim.Val /end CHARACTERISTIC
/begin CHARACTERISTIC CalRegn02Inin00.GmOvrlStMgrApaHwTqFilFrq.Val "MICROSAR RTE" VALUE 0x0 RTE_RL_FLOAT32_IEEE 0 NO_COMPU_METHOD -3.402823466e+38 3.402823466e+38 SYMBOL_LINK "Rte_CalprmRom_CalRegn02Inin00_DEFAULT_RTE_CALPRM_GROUP.GmOvrlStMgrApaHwTqFilFrq_Val" 0 DISPLAY_IDENTIFIER CalRegn02Inin00.CalibrationPorts.GmOvrlStMgrApaHwTqFilFrq.Val /end CHARACTERISTIC
/begin CHARACTERISTIC CalRegn02Inin00.GmOvrlStMgrHwTqFilFrq.Val "MICROSAR RTE" VALUE 0x0 RTE_RL_FLOAT32_IEEE 0 NO_COMPU_METHOD -3.402823466e+38 3.402823466e+38 SYMBOL_LINK "Rte_CalprmRom_CalRegn02Inin00_DEFAULT_RTE_CALPRM_GROUP.GmOvrlStMgrHwTqFilFrq_Val" 0 DISPLAY_IDENTIFIER CalRegn02Inin00.CalibrationPorts.GmOvrlStMgrHwTqFilFrq.Val /end CHARACTERISTIC
/begin CHARACTERISTIC CalRegn02Inin00.GmOvrlStMgrLkaHwTqFilFrq.Val "MICROSAR RTE" VALUE 0x0 RTE_RL_FLOAT32_IEEE 0 NO_COMPU_METHOD -3.402823466e+38 3.402823466e+38 SYMBOL_LINK "Rte_CalprmRom_CalRegn02Inin00_DEFAULT_RTE_CALPRM_GROUP.GmOvrlStMgrLkaHwTqFilFrq_Val" 0 DISPLAY_IDENTIFIER CalRegn02Inin00.CalibrationPorts.GmOvrlStMgrLkaHwTqFilFrq.Val /end CHARACTERISTIC
/begin CHARACTERISTIC CalRegn02Inin00.GmOvrlStMgrLkaHwTqTiThd2.Val "MICROSAR RTE" VALUE 0x0 RTE_RL_ULONG 0 NO_COMPU_METHOD 0 4294967295 SYMBOL_LINK "Rte_CalprmRom_CalRegn02Inin00_DEFAULT_RTE_CALPRM_GROUP.GmOvrlStMgrLkaHwTqTiThd2_Val" 0 DISPLAY_IDENTIFIER CalRegn02Inin00.CalibrationPorts.GmOvrlStMgrLkaHwTqTiThd2.Val /end CHARACTERISTIC
/begin CHARACTERISTIC CalRegn02Inin00.GmStrtStopEna.Logl "MICROSAR RTE" VALUE 0x0 RTE_RL_BOOLEAN 0 RTE_CM_BOOLEAN 0 255 SYMBOL_LINK "Rte_CalprmRom_CalRegn02Inin00_DEFAULT_RTE_CALPRM_GROUP.GmStrtStopEna_Logl" 0 DISPLAY_IDENTIFIER CalRegn02Inin00.CalibrationPorts.GmStrtStopEna.Logl /end CHARACTERISTIC
/begin CHARACTERISTIC CalRegn02Inin00.GmTqArbnApaAssiScaEna.Logl "MICROSAR RTE" VALUE 0x0 RTE_RL_BOOLEAN 0 RTE_CM_BOOLEAN 0 255 SYMBOL_LINK "Rte_CalprmRom_CalRegn02Inin00_DEFAULT_RTE_CALPRM_GROUP.GmTqArbnApaAssiScaEna_Logl" 0 DISPLAY_IDENTIFIER CalRegn02Inin00.CalibrationPorts.GmTqArbnApaAssiScaEna.Logl /end CHARACTERISTIC
/begin CHARACTERISTIC CalRegn02Inin00.GmTqArbnApaDampgScaEna.Logl "MICROSAR RTE" VALUE 0x0 RTE_RL_BOOLEAN 0 RTE_CM_BOOLEAN 0 255 SYMBOL_LINK "Rte_CalprmRom_CalRegn02Inin00_DEFAULT_RTE_CALPRM_GROUP.GmTqArbnApaDampgScaEna_Logl" 0 DISPLAY_IDENTIFIER CalRegn02Inin00.CalibrationPorts.GmTqArbnApaDampgScaEna.Logl /end CHARACTERISTIC
/begin CHARACTERISTIC CalRegn02Inin00.GmTqArbnApaRtnScaEna.Logl "MICROSAR RTE" VALUE 0x0 RTE_RL_BOOLEAN 0 RTE_CM_BOOLEAN 0 255 SYMBOL_LINK "Rte_CalprmRom_CalRegn02Inin00_DEFAULT_RTE_CALPRM_GROUP.GmTqArbnApaRtnScaEna_Logl" 0 DISPLAY_IDENTIFIER CalRegn02Inin00.CalibrationPorts.GmTqArbnApaRtnScaEna.Logl /end CHARACTERISTIC
/begin CHARACTERISTIC CalRegn02Inin00.GmTqArbnEscMaxTq.Val "MICROSAR RTE" VALUE 0x0 RTE_RL_FLOAT32_IEEE 0 NO_COMPU_METHOD -3.402823466e+38 3.402823466e+38 SYMBOL_LINK "Rte_CalprmRom_CalRegn02Inin00_DEFAULT_RTE_CALPRM_GROUP.GmTqArbnEscMaxTq_Val" 0 DISPLAY_IDENTIFIER CalRegn02Inin00.CalibrationPorts.GmTqArbnEscMaxTq.Val /end CHARACTERISTIC
/begin CHARACTERISTIC CalRegn02Inin00.GmTqArbnLkaOutpOvrlUpprLim.Val "MICROSAR RTE" VALUE 0x0 RTE_RL_FLOAT32_IEEE 0 NO_COMPU_METHOD -3.402823466e+38 3.402823466e+38 SYMBOL_LINK "Rte_CalprmRom_CalRegn02Inin00_DEFAULT_RTE_CALPRM_GROUP.GmTqArbnLkaOutpOvrlUpprLim_Val" 0 DISPLAY_IDENTIFIER CalRegn02Inin00.CalibrationPorts.GmTqArbnLkaOutpOvrlUpprLim.Val /end CHARACTERISTIC
/begin CHARACTERISTIC CalRegn02Inin00.HowDetnEstimLpFilFrq.Val "MICROSAR RTE" VALUE 0x0 RTE_RL_FLOAT32_IEEE 0 NO_COMPU_METHOD -3.402823466e+38 3.402823466e+38 SYMBOL_LINK "Rte_CalprmRom_CalRegn02Inin00_DEFAULT_RTE_CALPRM_GROUP.HowDetnEstimLpFilFrq_Val" 0 DISPLAY_IDENTIFIER CalRegn02Inin00.CalibrationPorts.HowDetnEstimLpFilFrq.Val /end CHARACTERISTIC
/begin CHARACTERISTIC CalRegn02Inin00.HowDetnStLpFilFrq.Val "MICROSAR RTE" VALUE 0x0 RTE_RL_FLOAT32_IEEE 0 NO_COMPU_METHOD -3.402823466e+38 3.402823466e+38 SYMBOL_LINK "Rte_CalprmRom_CalRegn02Inin00_DEFAULT_RTE_CALPRM_GROUP.HowDetnStLpFilFrq_Val" 0 DISPLAY_IDENTIFIER CalRegn02Inin00.CalibrationPorts.HowDetnStLpFilFrq.Val /end CHARACTERISTIC
/begin CHARACTERISTIC CalRegn02Inin00.HowDetnTqFinalLpFilFrq.Val "MICROSAR RTE" VALUE 0x0 RTE_RL_FLOAT32_IEEE 0 NO_COMPU_METHOD -3.402823466e+38 3.402823466e+38 SYMBOL_LINK "Rte_CalprmRom_CalRegn02Inin00_DEFAULT_RTE_CALPRM_GROUP.HowDetnTqFinalLpFilFrq_Val" 0 DISPLAY_IDENTIFIER CalRegn02Inin00.CalibrationPorts.HowDetnTqFinalLpFilFrq.Val /end CHARACTERISTIC
/begin CHARACTERISTIC CalRegn02Inin00.HowDetnTqInitLpFilFrq.Val "MICROSAR RTE" VALUE 0x0 RTE_RL_FLOAT32_IEEE 0 NO_COMPU_METHOD -3.402823466e+38 3.402823466e+38 SYMBOL_LINK "Rte_CalprmRom_CalRegn02Inin00_DEFAULT_RTE_CALPRM_GROUP.HowDetnTqInitLpFilFrq_Val" 0 DISPLAY_IDENTIFIER CalRegn02Inin00.CalibrationPorts.HowDetnTqInitLpFilFrq.Val /end CHARACTERISTIC
/begin CHARACTERISTIC CalRegn02Inin00.SnsrOffsLrngHwVelFilFrq.Val "MICROSAR RTE" VALUE 0x0 RTE_RL_FLOAT32_IEEE 0 NO_COMPU_METHOD -3.402823466e+38 3.402823466e+38 SYMBOL_LINK "Rte_CalprmRom_CalRegn02Inin00_DEFAULT_RTE_CALPRM_GROUP.SnsrOffsLrngHwVelFilFrq_Val" 0 DISPLAY_IDENTIFIER CalRegn02Inin00.CalibrationPorts.SnsrOffsLrngHwVelFilFrq.Val /end CHARACTERISTIC
/begin CHARACTERISTIC CalRegn02Inin00.SnsrOffsLrngTqAndAgFilFrq.Val "MICROSAR RTE" VALUE 0x0 RTE_RL_FLOAT32_IEEE 0 NO_COMPU_METHOD -3.402823466e+38 3.402823466e+38 SYMBOL_LINK "Rte_CalprmRom_CalRegn02Inin00_DEFAULT_RTE_CALPRM_GROUP.SnsrOffsLrngTqAndAgFilFrq_Val" 0 DISPLAY_IDENTIFIER CalRegn02Inin00.CalibrationPorts.SnsrOffsLrngTqAndAgFilFrq.Val /end CHARACTERISTIC
/begin CHARACTERISTIC CalRegn02Inin00.SnsrOffsLrngTqInpDetnHwTqFilFrq.Val "MICROSAR RTE" VALUE 0x0 RTE_RL_FLOAT32_IEEE 0 NO_COMPU_METHOD -3.402823466e+38 3.402823466e+38 SYMBOL_LINK "Rte_CalprmRom_CalRegn02Inin00_DEFAULT_RTE_CALPRM_GROUP.SnsrOffsLrngTqInpDetnHwTqFilFrq_Val" 0 DISPLAY_IDENTIFIER CalRegn02Inin00.CalibrationPorts.SnsrOffsLrngTqInpDetnHwTqFilFrq.Val /end CHARACTERISTIC
/begin CHARACTERISTIC CalRegn02Inin00.SnsrOffsLrngYawACdngFilFrq.Val "MICROSAR RTE" VALUE 0x0 RTE_RL_FLOAT32_IEEE 0 NO_COMPU_METHOD -3.402823466e+38 3.402823466e+38 SYMBOL_LINK "Rte_CalprmRom_CalRegn02Inin00_DEFAULT_RTE_CALPRM_GROUP.SnsrOffsLrngYawACdngFilFrq_Val" 0 DISPLAY_IDENTIFIER CalRegn02Inin00.CalibrationPorts.SnsrOffsLrngYawACdngFilFrq.Val /end CHARACTERISTIC
/begin CHARACTERISTIC CalRegn02Inin00.SnsrOffsLrngYawRateCdngFilFrq.Val "MICROSAR RTE" VALUE 0x0 RTE_RL_FLOAT32_IEEE 0 NO_COMPU_METHOD -3.402823466e+38 3.402823466e+38 SYMBOL_LINK "Rte_CalprmRom_CalRegn02Inin00_DEFAULT_RTE_CALPRM_GROUP.SnsrOffsLrngYawRateCdngFilFrq_Val" 0 DISPLAY_IDENTIFIER CalRegn02Inin00.CalibrationPorts.SnsrOffsLrngYawRateCdngFilFrq.Val /end CHARACTERISTIC
/begin CHARACTERISTIC CalRegn02Inin00GroupA.GmOvrlStMgrLkaHwTqTiThd1.Val "MICROSAR RTE" VALUE 0x0 RTE_RL_ULONG 0 NO_COMPU_METHOD 0 4294967295 SYMBOL_LINK "Rte_CalprmRom_CalRegn02Inin00GroupA_DEFAULT_RTE_CALPRM_GROUP.GmOvrlStMgrLkaHwTqTiThd1_Val" 0 DISPLAY_IDENTIFIER CalRegn02Inin00GroupA.CalibrationPorts.GmOvrlStMgrLkaHwTqTiThd1.Val /end CHARACTERISTIC
/begin CHARACTERISTIC CalRegn02Inin00GroupC.GmOvrlStMgrApaHwTqTiThd.Val "MICROSAR RTE" VALUE 0x0 RTE_RL_ULONG 0 NO_COMPU_METHOD 0 4294967295 SYMBOL_LINK "Rte_CalprmRom_CalRegn02Inin00GroupC_DEFAULT_RTE_CALPRM_GROUP.GmOvrlStMgrApaHwTqTiThd_Val" 0 DISPLAY_IDENTIFIER CalRegn02Inin00GroupC.CalibrationPorts.GmOvrlStMgrApaHwTqTiThd.Val /end CHARACTERISTIC
/begin CHARACTERISTIC CalRegn02Inin00GroupC.GmOvrlStMgrHaptcFrq.Val "MICROSAR RTE" VALUE 0x0 RTE_RL_FLOAT32_IEEE 0 NO_COMPU_METHOD -3.402823466e+38 3.402823466e+38 SYMBOL_LINK "Rte_CalprmRom_CalRegn02Inin00GroupC_DEFAULT_RTE_CALPRM_GROUP.GmOvrlStMgrHaptcFrq_Val" 0 DISPLAY_IDENTIFIER CalRegn02Inin00GroupC.CalibrationPorts.GmOvrlStMgrHaptcFrq.Val /end CHARACTERISTIC
/begin CHARACTERISTIC CalRegn02Inin00GroupC.GmOvrlStMgrHaptcReactnTi.Val "MICROSAR RTE" VALUE 0x0 RTE_RL_ULONG 0 NO_COMPU_METHOD 0 4294967295 SYMBOL_LINK "Rte_CalprmRom_CalRegn02Inin00GroupC_DEFAULT_RTE_CALPRM_GROUP.GmOvrlStMgrHaptcReactnTi_Val" 0 DISPLAY_IDENTIFIER CalRegn02Inin00GroupC.CalibrationPorts.GmOvrlStMgrHaptcReactnTi.Val /end CHARACTERISTIC
/begin CHARACTERISTIC CalRegn02Inin00GroupC.GmOvrlStMgrHaptcReqTiThd.Val "MICROSAR RTE" VALUE 0x0 RTE_RL_ULONG 0 NO_COMPU_METHOD 0 4294967295 SYMBOL_LINK "Rte_CalprmRom_CalRegn02Inin00GroupC_DEFAULT_RTE_CALPRM_GROUP.GmOvrlStMgrHaptcReqTiThd_Val" 0 DISPLAY_IDENTIFIER CalRegn02Inin00GroupC.CalibrationPorts.GmOvrlStMgrHaptcReqTiThd.Val /end CHARACTERISTIC
/begin CHARACTERISTIC CalRegn02Inin00GroupC.GmStrtStopFltRateLim.Val "MICROSAR RTE" VALUE 0x0 RTE_RL_FLOAT32_IEEE 0 NO_COMPU_METHOD -3.402823466e+38 3.402823466e+38 SYMBOL_LINK "Rte_CalprmRom_CalRegn02Inin00GroupC_DEFAULT_RTE_CALPRM_GROUP.GmStrtStopFltRateLim_Val" 0 DISPLAY_IDENTIFIER CalRegn02Inin00GroupC.CalibrationPorts.GmStrtStopFltRateLim.Val /end CHARACTERISTIC
/begin CHARACTERISTIC CalRegn02Inin00GroupC.GmStrtStopMod1EngTranThd.Val "MICROSAR RTE" VALUE 0x0 RTE_RL_FLOAT32_IEEE 0 NO_COMPU_METHOD -3.402823466e+38 3.402823466e+38 SYMBOL_LINK "Rte_CalprmRom_CalRegn02Inin00GroupC_DEFAULT_RTE_CALPRM_GROUP.GmStrtStopMod1EngTranThd_Val" 0 DISPLAY_IDENTIFIER CalRegn02Inin00GroupC.CalibrationPorts.GmStrtStopMod1EngTranThd.Val /end CHARACTERISTIC
/begin CHARACTERISTIC CalRegn02Inin00GroupC.GmStrtStopMod1Sca.Val "MICROSAR RTE" VALUE 0x0 RTE_RL_FLOAT32_IEEE 0 NO_COMPU_METHOD -3.402823466e+38 3.402823466e+38 SYMBOL_LINK "Rte_CalprmRom_CalRegn02Inin00GroupC_DEFAULT_RTE_CALPRM_GROUP.GmStrtStopMod1Sca_Val" 0 DISPLAY_IDENTIFIER CalRegn02Inin00GroupC.CalibrationPorts.GmStrtStopMod1Sca.Val /end CHARACTERISTIC
/begin CHARACTERISTIC CalRegn02Inin00GroupC.GmStrtStopMod1ToStopRateLim.Val "MICROSAR RTE" VALUE 0x0 RTE_RL_FLOAT32_IEEE 0 NO_COMPU_METHOD -3.402823466e+38 3.402823466e+38 SYMBOL_LINK "Rte_CalprmRom_CalRegn02Inin00GroupC_DEFAULT_RTE_CALPRM_GROUP.GmStrtStopMod1ToStopRateLim_Val" 0 DISPLAY_IDENTIFIER CalRegn02Inin00GroupC.CalibrationPorts.GmStrtStopMod1ToStopRateLim.Val /end CHARACTERISTIC
/begin CHARACTERISTIC CalRegn02Inin00GroupC.GmStrtStopMod1VehSpdTranThd.Val "MICROSAR RTE" VALUE 0x0 RTE_RL_FLOAT32_IEEE 0 NO_COMPU_METHOD -3.402823466e+38 3.402823466e+38 SYMBOL_LINK "Rte_CalprmRom_CalRegn02Inin00GroupC_DEFAULT_RTE_CALPRM_GROUP.GmStrtStopMod1VehSpdTranThd_Val" 0 DISPLAY_IDENTIFIER CalRegn02Inin00GroupC.CalibrationPorts.GmStrtStopMod1VehSpdTranThd.Val /end CHARACTERISTIC
/begin CHARACTERISTIC CalRegn02Inin00GroupC.GmStrtStopMod2Sca.Val "MICROSAR RTE" VALUE 0x0 RTE_RL_FLOAT32_IEEE 0 NO_COMPU_METHOD -3.402823466e+38 3.402823466e+38 SYMBOL_LINK "Rte_CalprmRom_CalRegn02Inin00GroupC_DEFAULT_RTE_CALPRM_GROUP.GmStrtStopMod2Sca_Val" 0 DISPLAY_IDENTIFIER CalRegn02Inin00GroupC.CalibrationPorts.GmStrtStopMod2Sca.Val /end CHARACTERISTIC
/begin CHARACTERISTIC CalRegn02Inin00GroupC.GmStrtStopNormModEngTranThd.Val "MICROSAR RTE" VALUE 0x0 RTE_RL_FLOAT32_IEEE 0 NO_COMPU_METHOD -3.402823466e+38 3.402823466e+38 SYMBOL_LINK "Rte_CalprmRom_CalRegn02Inin00GroupC_DEFAULT_RTE_CALPRM_GROUP.GmStrtStopNormModEngTranThd_Val" 0 DISPLAY_IDENTIFIER CalRegn02Inin00GroupC.CalibrationPorts.GmStrtStopNormModEngTranThd.Val /end CHARACTERISTIC
/begin CHARACTERISTIC CalRegn02Inin00GroupC.GmStrtStopNormModVehSpdTranThd.Val "MICROSAR RTE" VALUE 0x0 RTE_RL_FLOAT32_IEEE 0 NO_COMPU_METHOD -3.402823466e+38 3.402823466e+38 SYMBOL_LINK "Rte_CalprmRom_CalRegn02Inin00GroupC_DEFAULT_RTE_CALPRM_GROUP.GmStrtStopNormModVehSpdTranThd_Val" 0 DISPLAY_IDENTIFIER CalRegn02Inin00GroupC.CalibrationPorts.GmStrtStopNormModVehSpdTranThd.Val /end CHARACTERISTIC
/begin CHARACTERISTIC CalRegn02Inin00GroupC.GmStrtStopNormRateLim.Val "MICROSAR RTE" VALUE 0x0 RTE_RL_FLOAT32_IEEE 0 NO_COMPU_METHOD -3.402823466e+38 3.402823466e+38 SYMBOL_LINK "Rte_CalprmRom_CalRegn02Inin00GroupC_DEFAULT_RTE_CALPRM_GROUP.GmStrtStopNormRateLim_Val" 0 DISPLAY_IDENTIFIER CalRegn02Inin00GroupC.CalibrationPorts.GmStrtStopNormRateLim.Val /end CHARACTERISTIC
/begin CHARACTERISTIC CalRegn02Inin00GroupC.GmStrtStopNormToMod1RateLim.Val "MICROSAR RTE" VALUE 0x0 RTE_RL_FLOAT32_IEEE 0 NO_COMPU_METHOD -3.402823466e+38 3.402823466e+38 SYMBOL_LINK "Rte_CalprmRom_CalRegn02Inin00GroupC_DEFAULT_RTE_CALPRM_GROUP.GmStrtStopNormToMod1RateLim_Val" 0 DISPLAY_IDENTIFIER CalRegn02Inin00GroupC.CalibrationPorts.GmStrtStopNormToMod1RateLim.Val /end CHARACTERISTIC
/begin CHARACTERISTIC CalRegn02Inin00GroupC.GmStrtStopStopAndMod2RateLim.Val "MICROSAR RTE" VALUE 0x0 RTE_RL_FLOAT32_IEEE 0 NO_COMPU_METHOD -3.402823466e+38 3.402823466e+38 SYMBOL_LINK "Rte_CalprmRom_CalRegn02Inin00GroupC_DEFAULT_RTE_CALPRM_GROUP.GmStrtStopStopAndMod2RateLim_Val" 0 DISPLAY_IDENTIFIER CalRegn02Inin00GroupC.CalibrationPorts.GmStrtStopStopAndMod2RateLim.Val /end CHARACTERISTIC
/begin CHARACTERISTIC CalRegn02Inin00GroupC.GmStrtStopStopMod1HwTqTranThd.Val "MICROSAR RTE" VALUE 0x0 RTE_RL_FLOAT32_IEEE 0 NO_COMPU_METHOD -3.402823466e+38 3.402823466e+38 SYMBOL_LINK "Rte_CalprmRom_CalRegn02Inin00GroupC_DEFAULT_RTE_CALPRM_GROUP.GmStrtStopStopMod1HwTqTranThd_Val" 0 DISPLAY_IDENTIFIER CalRegn02Inin00GroupC.CalibrationPorts.GmStrtStopStopMod1HwTqTranThd.Val /end CHARACTERISTIC
/begin CHARACTERISTIC CalRegn02Inin00GroupC.GmStrtStopStopMod1HwVelTranThd.Val "MICROSAR RTE" VALUE 0x0 RTE_RL_FLOAT32_IEEE 0 NO_COMPU_METHOD -3.402823466e+38 3.402823466e+38 SYMBOL_LINK "Rte_CalprmRom_CalRegn02Inin00GroupC_DEFAULT_RTE_CALPRM_GROUP.GmStrtStopStopMod1HwVelTranThd_Val" 0 DISPLAY_IDENTIFIER CalRegn02Inin00GroupC.CalibrationPorts.GmStrtStopStopMod1HwVelTranThd.Val /end CHARACTERISTIC
/begin CHARACTERISTIC CalRegn02Inin00GroupC.GmStrtStopStopMod1Tmr.Val "MICROSAR RTE" VALUE 0x0 RTE_RL_FLOAT32_IEEE 0 NO_COMPU_METHOD -3.402823466e+38 3.402823466e+38 SYMBOL_LINK "Rte_CalprmRom_CalRegn02Inin00GroupC_DEFAULT_RTE_CALPRM_GROUP.GmStrtStopStopMod1Tmr_Val" 0 DISPLAY_IDENTIFIER CalRegn02Inin00GroupC.CalibrationPorts.GmStrtStopStopMod1Tmr.Val /end CHARACTERISTIC
/begin CHARACTERISTIC CalRegn02Inin00GroupC.GmStrtStopStopMod1VehSpdTranThd.Val "MICROSAR RTE" VALUE 0x0 RTE_RL_FLOAT32_IEEE 0 NO_COMPU_METHOD -3.402823466e+38 3.402823466e+38 SYMBOL_LINK "Rte_CalprmRom_CalRegn02Inin00GroupC_DEFAULT_RTE_CALPRM_GROUP.GmStrtStopStopMod1VehSpdTranThd_Val" 0 DISPLAY_IDENTIFIER CalRegn02Inin00GroupC.CalibrationPorts.GmStrtStopStopMod1VehSpdTranThd.Val /end CHARACTERISTIC
/begin CHARACTERISTIC CalRegn02Inin00GroupC.GmStrtStopStopMod2HwTqTranThd.Val "MICROSAR RTE" VALUE 0x0 RTE_RL_FLOAT32_IEEE 0 NO_COMPU_METHOD -3.402823466e+38 3.402823466e+38 SYMBOL_LINK "Rte_CalprmRom_CalRegn02Inin00GroupC_DEFAULT_RTE_CALPRM_GROUP.GmStrtStopStopMod2HwTqTranThd_Val" 0 DISPLAY_IDENTIFIER CalRegn02Inin00GroupC.CalibrationPorts.GmStrtStopStopMod2HwTqTranThd.Val /end CHARACTERISTIC
/begin CHARACTERISTIC CalRegn02Inin00GroupC.GmStrtStopStopMod2HwVelTranThd.Val "MICROSAR RTE" VALUE 0x0 RTE_RL_FLOAT32_IEEE 0 NO_COMPU_METHOD -3.402823466e+38 3.402823466e+38 SYMBOL_LINK "Rte_CalprmRom_CalRegn02Inin00GroupC_DEFAULT_RTE_CALPRM_GROUP.GmStrtStopStopMod2HwVelTranThd_Val" 0 DISPLAY_IDENTIFIER CalRegn02Inin00GroupC.CalibrationPorts.GmStrtStopStopMod2HwVelTranThd.Val /end CHARACTERISTIC
/begin CHARACTERISTIC CalRegn02Inin00GroupC.GmStrtStopStopMod2Tmr.Val "MICROSAR RTE" VALUE 0x0 RTE_RL_FLOAT32_IEEE 0 NO_COMPU_METHOD -3.402823466e+38 3.402823466e+38 SYMBOL_LINK "Rte_CalprmRom_CalRegn02Inin00GroupC_DEFAULT_RTE_CALPRM_GROUP.GmStrtStopStopMod2Tmr_Val" 0 DISPLAY_IDENTIFIER CalRegn02Inin00GroupC.CalibrationPorts.GmStrtStopStopMod2Tmr.Val /end CHARACTERISTIC
/begin CHARACTERISTIC CalRegn02Inin00GroupC.GmStrtStopStopMod2VehSpdTranThd.Val "MICROSAR RTE" VALUE 0x0 RTE_RL_FLOAT32_IEEE 0 NO_COMPU_METHOD -3.402823466e+38 3.402823466e+38 SYMBOL_LINK "Rte_CalprmRom_CalRegn02Inin00GroupC_DEFAULT_RTE_CALPRM_GROUP.GmStrtStopStopMod2VehSpdTranThd_Val" 0 DISPLAY_IDENTIFIER CalRegn02Inin00GroupC.CalibrationPorts.GmStrtStopStopMod2VehSpdTranThd.Val /end CHARACTERISTIC
/begin CHARACTERISTIC CalRegn02Inin00GroupC.GmStrtStopStopModSca.Val "MICROSAR RTE" VALUE 0x0 RTE_RL_FLOAT32_IEEE 0 NO_COMPU_METHOD -3.402823466e+38 3.402823466e+38 SYMBOL_LINK "Rte_CalprmRom_CalRegn02Inin00GroupC_DEFAULT_RTE_CALPRM_GROUP.GmStrtStopStopModSca_Val" 0 DISPLAY_IDENTIFIER CalRegn02Inin00GroupC.CalibrationPorts.GmStrtStopStopModSca.Val /end CHARACTERISTIC
/begin CHARACTERISTIC CalRegn02Inin00GroupC.GmTqArbnApaDiRateX.Ary1D "MICROSAR RTE" VAL_BLK 0x0 RTE_RL_UWORD 0 NO_COMPU_METHOD 0 65535 MATRIX_DIM 6 1 1 SYMBOL_LINK "Rte_CalprmRom_CalRegn02Inin00GroupC_DEFAULT_RTE_CALPRM_GROUP.GmTqArbnApaDiRateX_Ary1D" 0 DISPLAY_IDENTIFIER CalRegn02Inin00GroupC.CalibrationPorts.GmTqArbnApaDiRateX.Ary1D /end CHARACTERISTIC
/begin CHARACTERISTIC CalRegn02Inin00GroupC.GmTqArbnLkaSlewEna.Logl "MICROSAR RTE" VALUE 0x0 RTE_RL_BOOLEAN 0 RTE_CM_BOOLEAN 0 255 SYMBOL_LINK "Rte_CalprmRom_CalRegn02Inin00GroupC_DEFAULT_RTE_CALPRM_GROUP.GmTqArbnLkaSlewEna_Logl" 0 DISPLAY_IDENTIFIER CalRegn02Inin00GroupC.CalibrationPorts.GmTqArbnLkaSlewEna.Logl /end CHARACTERISTIC
/begin CHARACTERISTIC CalRegn02Inin00GroupC.HowDetnOffThd.Val "MICROSAR RTE" VALUE 0x0 RTE_RL_FLOAT32_IEEE 0 NO_COMPU_METHOD -3.402823466e+38 3.402823466e+38 SYMBOL_LINK "Rte_CalprmRom_CalRegn02Inin00GroupC_DEFAULT_RTE_CALPRM_GROUP.HowDetnOffThd_Val" 0 DISPLAY_IDENTIFIER CalRegn02Inin00GroupC.CalibrationPorts.HowDetnOffThd.Val /end CHARACTERISTIC
/begin CHARACTERISTIC CalRegn02Inin00GroupC.HowDetnOffTi.Val "MICROSAR RTE" VALUE 0x0 RTE_RL_FLOAT32_IEEE 0 NO_COMPU_METHOD -3.402823466e+38 3.402823466e+38 SYMBOL_LINK "Rte_CalprmRom_CalRegn02Inin00GroupC_DEFAULT_RTE_CALPRM_GROUP.HowDetnOffTi_Val" 0 DISPLAY_IDENTIFIER CalRegn02Inin00GroupC.CalibrationPorts.HowDetnOffTi.Val /end CHARACTERISTIC
/begin CHARACTERISTIC CalRegn02Rt00GroupC.GmOvrlStMgrHwAgTarLimr.Val "MICROSAR RTE" VALUE 0x0 RTE_RL_FLOAT32_IEEE 0 NO_COMPU_METHOD -3.402823466e+38 3.402823466e+38 SYMBOL_LINK "Rte_CalprmRom_CalRegn02Rt00GroupC_DEFAULT_RTE_CALPRM_GROUP.GmOvrlStMgrHwAgTarLimr_Val" 0 DISPLAY_IDENTIFIER CalRegn02Rt00GroupC.CalibrationPorts.GmOvrlStMgrHwAgTarLimr.Val /end CHARACTERISTIC
/begin CHARACTERISTIC CalRegn02Rt00GroupC.GmOvrlStMgrShiftLvrTiThd.Val "MICROSAR RTE" VALUE 0x0 RTE_RL_ULONG 0 NO_COMPU_METHOD 0 4294967295 SYMBOL_LINK "Rte_CalprmRom_CalRegn02Rt00GroupC_DEFAULT_RTE_CALPRM_GROUP.GmOvrlStMgrShiftLvrTiThd_Val" 0 DISPLAY_IDENTIFIER CalRegn02Rt00GroupC.CalibrationPorts.GmOvrlStMgrShiftLvrTiThd.Val /end CHARACTERISTIC
/begin CHARACTERISTIC CalRegn02Rt00GroupC.GmOvrlStMgrStandStillThd.Val "MICROSAR RTE" VALUE 0x0 RTE_RL_FLOAT32_IEEE 0 NO_COMPU_METHOD -3.402823466e+38 3.402823466e+38 SYMBOL_LINK "Rte_CalprmRom_CalRegn02Rt00GroupC_DEFAULT_RTE_CALPRM_GROUP.GmOvrlStMgrStandStillThd_Val" 0 DISPLAY_IDENTIFIER CalRegn02Rt00GroupC.CalibrationPorts.GmOvrlStMgrStandStillThd.Val /end CHARACTERISTIC
/begin CHARACTERISTIC CalRegn02Rt00GroupC.GmOvrlStMgrStandStillTiThd.Val "MICROSAR RTE" VALUE 0x0 RTE_RL_ULONG 0 NO_COMPU_METHOD 0 4294967295 SYMBOL_LINK "Rte_CalprmRom_CalRegn02Rt00GroupC_DEFAULT_RTE_CALPRM_GROUP.GmOvrlStMgrStandStillTiThd_Val" 0 DISPLAY_IDENTIFIER CalRegn02Rt00GroupC.CalibrationPorts.GmOvrlStMgrStandStillTiThd.Val /end CHARACTERISTIC
/begin CHARACTERISTIC CalRegn02Rt00GroupC.GmTqArbnApaDiRateY.Ary1D "MICROSAR RTE" VAL_BLK 0x0 RTE_RL_UWORD 0 NO_COMPU_METHOD 0 65535 MATRIX_DIM 6 1 1 SYMBOL_LINK "Rte_CalprmRom_CalRegn02Rt00GroupC_DEFAULT_RTE_CALPRM_GROUP.GmTqArbnApaDiRateY_Ary1D" 0 DISPLAY_IDENTIFIER CalRegn02Rt00GroupC.CalibrationPorts.GmTqArbnApaDiRateY.Ary1D /end CHARACTERISTIC
/begin CHARACTERISTIC CalRegn02Rt00GroupC.GmTqArbnApaEnaRate.Val "MICROSAR RTE" VALUE 0x0 RTE_RL_FLOAT32_IEEE 0 NO_COMPU_METHOD -3.402823466e+38 3.402823466e+38 SYMBOL_LINK "Rte_CalprmRom_CalRegn02Rt00GroupC_DEFAULT_RTE_CALPRM_GROUP.GmTqArbnApaEnaRate_Val" 0 DISPLAY_IDENTIFIER CalRegn02Rt00GroupC.CalibrationPorts.GmTqArbnApaEnaRate.Val /end CHARACTERISTIC
/begin CHARACTERISTIC CalRegn02Rt00GroupC.GmTqArbnApaSmotngHwTqLpFilFrq.Val "MICROSAR RTE" VALUE 0x0 RTE_RL_FLOAT32_IEEE 0 NO_COMPU_METHOD -3.402823466e+38 3.402823466e+38 SYMBOL_LINK "Rte_CalprmRom_CalRegn02Rt00GroupC_DEFAULT_RTE_CALPRM_GROUP.GmTqArbnApaSmotngHwTqLpFilFrq_Val" 0 DISPLAY_IDENTIFIER CalRegn02Rt00GroupC.CalibrationPorts.GmTqArbnApaSmotngHwTqLpFilFrq.Val /end CHARACTERISTIC
/begin CHARACTERISTIC CalRegn02Rt00GroupC.GmTqArbnApaSmotngX.Ary1D "MICROSAR RTE" VAL_BLK 0x0 RTE_RL_UWORD 0 NO_COMPU_METHOD 0 65535 MATRIX_DIM 10 1 1 SYMBOL_LINK "Rte_CalprmRom_CalRegn02Rt00GroupC_DEFAULT_RTE_CALPRM_GROUP.GmTqArbnApaSmotngX_Ary1D" 0 DISPLAY_IDENTIFIER CalRegn02Rt00GroupC.CalibrationPorts.GmTqArbnApaSmotngX.Ary1D /end CHARACTERISTIC
/begin CHARACTERISTIC CalRegn02Rt00GroupC.GmTqArbnApaSmotngY.Ary1D "MICROSAR RTE" VAL_BLK 0x0 RTE_RL_UWORD 0 NO_COMPU_METHOD 0 65535 MATRIX_DIM 10 1 1 SYMBOL_LINK "Rte_CalprmRom_CalRegn02Rt00GroupC_DEFAULT_RTE_CALPRM_GROUP.GmTqArbnApaSmotngY_Ary1D" 0 DISPLAY_IDENTIFIER CalRegn02Rt00GroupC.CalibrationPorts.GmTqArbnApaSmotngY.Ary1D /end CHARACTERISTIC
/begin CHARACTERISTIC CalRegn02Rt00GroupC.GmTqArbnLkaOutpOvrlX.Ary2D "MICROSAR RTE" VAL_BLK 0x0 RTE_RL_UWORD 0 NO_COMPU_METHOD 0 65535 MATRIX_DIM 20 12 1 SYMBOL_LINK "Rte_CalprmRom_CalRegn02Rt00GroupC_DEFAULT_RTE_CALPRM_GROUP.GmTqArbnLkaOutpOvrlX_Ary2D" 0 DISPLAY_IDENTIFIER CalRegn02Rt00GroupC.CalibrationPorts.GmTqArbnLkaOutpOvrlX.Ary2D /end CHARACTERISTIC
/begin CHARACTERISTIC CalRegn02Rt00GroupC.GmTqArbnLkaOutpOvrlY.Ary2D "MICROSAR RTE" VAL_BLK 0x0 RTE_RL_UWORD 0 NO_COMPU_METHOD 0 65535 MATRIX_DIM 20 12 1 SYMBOL_LINK "Rte_CalprmRom_CalRegn02Rt00GroupC_DEFAULT_RTE_CALPRM_GROUP.GmTqArbnLkaOutpOvrlY_Ary2D" 0 DISPLAY_IDENTIFIER CalRegn02Rt00GroupC.CalibrationPorts.GmTqArbnLkaOutpOvrlY.Ary2D /end CHARACTERISTIC
/begin CHARACTERISTIC CalRegn02Rt00GroupC.GmTqArbnLkaSlewX.Ary1D "MICROSAR RTE" VAL_BLK 0x0 RTE_RL_UWORD 0 NO_COMPU_METHOD 0 65535 MATRIX_DIM 6 1 1 SYMBOL_LINK "Rte_CalprmRom_CalRegn02Rt00GroupC_DEFAULT_RTE_CALPRM_GROUP.GmTqArbnLkaSlewX_Ary1D" 0 DISPLAY_IDENTIFIER CalRegn02Rt00GroupC.CalibrationPorts.GmTqArbnLkaSlewX.Ary1D /end CHARACTERISTIC
/begin CHARACTERISTIC CalRegn02Rt00GroupC.GmTqArbnLkaSlewY.Ary1D "MICROSAR RTE" VAL_BLK 0x0 RTE_RL_UWORD 0 NO_COMPU_METHOD 0 65535 MATRIX_DIM 6 1 1 SYMBOL_LINK "Rte_CalprmRom_CalRegn02Rt00GroupC_DEFAULT_RTE_CALPRM_GROUP.GmTqArbnLkaSlewY_Ary1D" 0 DISPLAY_IDENTIFIER CalRegn02Rt00GroupC.CalibrationPorts.GmTqArbnLkaSlewY.Ary1D /end CHARACTERISTIC
/begin CHARACTERISTIC CalRegn02Rt01GroupC.GmOvrlStMgrHwAgTarLimr.Val "MICROSAR RTE" VALUE 0x0 RTE_RL_FLOAT32_IEEE 0 NO_COMPU_METHOD -3.402823466e+38 3.402823466e+38 SYMBOL_LINK "Rte_CalprmRom_CalRegn02Rt01GroupC_DEFAULT_RTE_CALPRM_GROUP.GmOvrlStMgrHwAgTarLimr_Val" 0 DISPLAY_IDENTIFIER CalRegn02Rt01GroupC.CalibrationPorts.GmOvrlStMgrHwAgTarLimr.Val /end CHARACTERISTIC
/begin CHARACTERISTIC CalRegn02Rt01GroupC.GmOvrlStMgrShiftLvrTiThd.Val "MICROSAR RTE" VALUE 0x0 RTE_RL_ULONG 0 NO_COMPU_METHOD 0 4294967295 SYMBOL_LINK "Rte_CalprmRom_CalRegn02Rt01GroupC_DEFAULT_RTE_CALPRM_GROUP.GmOvrlStMgrShiftLvrTiThd_Val" 0 DISPLAY_IDENTIFIER CalRegn02Rt01GroupC.CalibrationPorts.GmOvrlStMgrShiftLvrTiThd.Val /end CHARACTERISTIC
/begin CHARACTERISTIC CalRegn02Rt01GroupC.GmOvrlStMgrStandStillThd.Val "MICROSAR RTE" VALUE 0x0 RTE_RL_FLOAT32_IEEE 0 NO_COMPU_METHOD -3.402823466e+38 3.402823466e+38 SYMBOL_LINK "Rte_CalprmRom_CalRegn02Rt01GroupC_DEFAULT_RTE_CALPRM_GROUP.GmOvrlStMgrStandStillThd_Val" 0 DISPLAY_IDENTIFIER CalRegn02Rt01GroupC.CalibrationPorts.GmOvrlStMgrStandStillThd.Val /end CHARACTERISTIC
/begin CHARACTERISTIC CalRegn02Rt01GroupC.GmOvrlStMgrStandStillTiThd.Val "MICROSAR RTE" VALUE 0x0 RTE_RL_ULONG 0 NO_COMPU_METHOD 0 4294967295 SYMBOL_LINK "Rte_CalprmRom_CalRegn02Rt01GroupC_DEFAULT_RTE_CALPRM_GROUP.GmOvrlStMgrStandStillTiThd_Val" 0 DISPLAY_IDENTIFIER CalRegn02Rt01GroupC.CalibrationPorts.GmOvrlStMgrStandStillTiThd.Val /end CHARACTERISTIC
/begin CHARACTERISTIC CalRegn02Rt01GroupC.GmTqArbnApaDiRateY.Ary1D "MICROSAR RTE" VAL_BLK 0x0 RTE_RL_UWORD 0 NO_COMPU_METHOD 0 65535 MATRIX_DIM 6 1 1 SYMBOL_LINK "Rte_CalprmRom_CalRegn02Rt01GroupC_DEFAULT_RTE_CALPRM_GROUP.GmTqArbnApaDiRateY_Ary1D" 0 DISPLAY_IDENTIFIER CalRegn02Rt01GroupC.CalibrationPorts.GmTqArbnApaDiRateY.Ary1D /end CHARACTERISTIC
/begin CHARACTERISTIC CalRegn02Rt01GroupC.GmTqArbnApaEnaRate.Val "MICROSAR RTE" VALUE 0x0 RTE_RL_FLOAT32_IEEE 0 NO_COMPU_METHOD -3.402823466e+38 3.402823466e+38 SYMBOL_LINK "Rte_CalprmRom_CalRegn02Rt01GroupC_DEFAULT_RTE_CALPRM_GROUP.GmTqArbnApaEnaRate_Val" 0 DISPLAY_IDENTIFIER CalRegn02Rt01GroupC.CalibrationPorts.GmTqArbnApaEnaRate.Val /end CHARACTERISTIC
/begin CHARACTERISTIC CalRegn02Rt01GroupC.GmTqArbnApaSmotngHwTqLpFilFrq.Val "MICROSAR RTE" VALUE 0x0 RTE_RL_FLOAT32_IEEE 0 NO_COMPU_METHOD -3.402823466e+38 3.402823466e+38 SYMBOL_LINK "Rte_CalprmRom_CalRegn02Rt01GroupC_DEFAULT_RTE_CALPRM_GROUP.GmTqArbnApaSmotngHwTqLpFilFrq_Val" 0 DISPLAY_IDENTIFIER CalRegn02Rt01GroupC.CalibrationPorts.GmTqArbnApaSmotngHwTqLpFilFrq.Val /end CHARACTERISTIC
/begin CHARACTERISTIC CalRegn02Rt01GroupC.GmTqArbnApaSmotngX.Ary1D "MICROSAR RTE" VAL_BLK 0x0 RTE_RL_UWORD 0 NO_COMPU_METHOD 0 65535 MATRIX_DIM 10 1 1 SYMBOL_LINK "Rte_CalprmRom_CalRegn02Rt01GroupC_DEFAULT_RTE_CALPRM_GROUP.GmTqArbnApaSmotngX_Ary1D" 0 DISPLAY_IDENTIFIER CalRegn02Rt01GroupC.CalibrationPorts.GmTqArbnApaSmotngX.Ary1D /end CHARACTERISTIC
/begin CHARACTERISTIC CalRegn02Rt01GroupC.GmTqArbnApaSmotngY.Ary1D "MICROSAR RTE" VAL_BLK 0x0 RTE_RL_UWORD 0 NO_COMPU_METHOD 0 65535 MATRIX_DIM 10 1 1 SYMBOL_LINK "Rte_CalprmRom_CalRegn02Rt01GroupC_DEFAULT_RTE_CALPRM_GROUP.GmTqArbnApaSmotngY_Ary1D" 0 DISPLAY_IDENTIFIER CalRegn02Rt01GroupC.CalibrationPorts.GmTqArbnApaSmotngY.Ary1D /end CHARACTERISTIC
/begin CHARACTERISTIC CalRegn02Rt01GroupC.GmTqArbnLkaOutpOvrlX.Ary2D "MICROSAR RTE" VAL_BLK 0x0 RTE_RL_UWORD 0 NO_COMPU_METHOD 0 65535 MATRIX_DIM 20 12 1 SYMBOL_LINK "Rte_CalprmRom_CalRegn02Rt01GroupC_DEFAULT_RTE_CALPRM_GROUP.GmTqArbnLkaOutpOvrlX_Ary2D" 0 DISPLAY_IDENTIFIER CalRegn02Rt01GroupC.CalibrationPorts.GmTqArbnLkaOutpOvrlX.Ary2D /end CHARACTERISTIC
/begin CHARACTERISTIC CalRegn02Rt01GroupC.GmTqArbnLkaOutpOvrlY.Ary2D "MICROSAR RTE" VAL_BLK 0x0 RTE_RL_UWORD 0 NO_COMPU_METHOD 0 65535 MATRIX_DIM 20 12 1 SYMBOL_LINK "Rte_CalprmRom_CalRegn02Rt01GroupC_DEFAULT_RTE_CALPRM_GROUP.GmTqArbnLkaOutpOvrlY_Ary2D" 0 DISPLAY_IDENTIFIER CalRegn02Rt01GroupC.CalibrationPorts.GmTqArbnLkaOutpOvrlY.Ary2D /end CHARACTERISTIC
/begin CHARACTERISTIC CalRegn02Rt01GroupC.GmTqArbnLkaSlewX.Ary1D "MICROSAR RTE" VAL_BLK 0x0 RTE_RL_UWORD 0 NO_COMPU_METHOD 0 65535 MATRIX_DIM 6 1 1 SYMBOL_LINK "Rte_CalprmRom_CalRegn02Rt01GroupC_DEFAULT_RTE_CALPRM_GROUP.GmTqArbnLkaSlewX_Ary1D" 0 DISPLAY_IDENTIFIER CalRegn02Rt01GroupC.CalibrationPorts.GmTqArbnLkaSlewX.Ary1D /end CHARACTERISTIC
/begin CHARACTERISTIC CalRegn02Rt01GroupC.GmTqArbnLkaSlewY.Ary1D "MICROSAR RTE" VAL_BLK 0x0 RTE_RL_UWORD 0 NO_COMPU_METHOD 0 65535 MATRIX_DIM 6 1 1 SYMBOL_LINK "Rte_CalprmRom_CalRegn02Rt01GroupC_DEFAULT_RTE_CALPRM_GROUP.GmTqArbnLkaSlewY_Ary1D" 0 DISPLAY_IDENTIFIER CalRegn02Rt01GroupC.CalibrationPorts.GmTqArbnLkaSlewY.Ary1D /end CHARACTERISTIC
/begin CHARACTERISTIC CalRegn02Rt02GroupC.GmOvrlStMgrHwAgTarLimr.Val "MICROSAR RTE" VALUE 0x0 RTE_RL_FLOAT32_IEEE 0 NO_COMPU_METHOD -3.402823466e+38 3.402823466e+38 SYMBOL_LINK "Rte_CalprmRom_CalRegn02Rt02GroupC_DEFAULT_RTE_CALPRM_GROUP.GmOvrlStMgrHwAgTarLimr_Val" 0 DISPLAY_IDENTIFIER CalRegn02Rt02GroupC.CalibrationPorts.GmOvrlStMgrHwAgTarLimr.Val /end CHARACTERISTIC
/begin CHARACTERISTIC CalRegn02Rt02GroupC.GmOvrlStMgrShiftLvrTiThd.Val "MICROSAR RTE" VALUE 0x0 RTE_RL_ULONG 0 NO_COMPU_METHOD 0 4294967295 SYMBOL_LINK "Rte_CalprmRom_CalRegn02Rt02GroupC_DEFAULT_RTE_CALPRM_GROUP.GmOvrlStMgrShiftLvrTiThd_Val" 0 DISPLAY_IDENTIFIER CalRegn02Rt02GroupC.CalibrationPorts.GmOvrlStMgrShiftLvrTiThd.Val /end CHARACTERISTIC
/begin CHARACTERISTIC CalRegn02Rt02GroupC.GmOvrlStMgrStandStillThd.Val "MICROSAR RTE" VALUE 0x0 RTE_RL_FLOAT32_IEEE 0 NO_COMPU_METHOD -3.402823466e+38 3.402823466e+38 SYMBOL_LINK "Rte_CalprmRom_CalRegn02Rt02GroupC_DEFAULT_RTE_CALPRM_GROUP.GmOvrlStMgrStandStillThd_Val" 0 DISPLAY_IDENTIFIER CalRegn02Rt02GroupC.CalibrationPorts.GmOvrlStMgrStandStillThd.Val /end CHARACTERISTIC
/begin CHARACTERISTIC CalRegn02Rt02GroupC.GmOvrlStMgrStandStillTiThd.Val "MICROSAR RTE" VALUE 0x0 RTE_RL_ULONG 0 NO_COMPU_METHOD 0 4294967295 SYMBOL_LINK "Rte_CalprmRom_CalRegn02Rt02GroupC_DEFAULT_RTE_CALPRM_GROUP.GmOvrlStMgrStandStillTiThd_Val" 0 DISPLAY_IDENTIFIER CalRegn02Rt02GroupC.CalibrationPorts.GmOvrlStMgrStandStillTiThd.Val /end CHARACTERISTIC
/begin CHARACTERISTIC CalRegn02Rt02GroupC.GmTqArbnApaDiRateY.Ary1D "MICROSAR RTE" VAL_BLK 0x0 RTE_RL_UWORD 0 NO_COMPU_METHOD 0 65535 MATRIX_DIM 6 1 1 SYMBOL_LINK "Rte_CalprmRom_CalRegn02Rt02GroupC_DEFAULT_RTE_CALPRM_GROUP.GmTqArbnApaDiRateY_Ary1D" 0 DISPLAY_IDENTIFIER CalRegn02Rt02GroupC.CalibrationPorts.GmTqArbnApaDiRateY.Ary1D /end CHARACTERISTIC
/begin CHARACTERISTIC CalRegn02Rt02GroupC.GmTqArbnApaEnaRate.Val "MICROSAR RTE" VALUE 0x0 RTE_RL_FLOAT32_IEEE 0 NO_COMPU_METHOD -3.402823466e+38 3.402823466e+38 SYMBOL_LINK "Rte_CalprmRom_CalRegn02Rt02GroupC_DEFAULT_RTE_CALPRM_GROUP.GmTqArbnApaEnaRate_Val" 0 DISPLAY_IDENTIFIER CalRegn02Rt02GroupC.CalibrationPorts.GmTqArbnApaEnaRate.Val /end CHARACTERISTIC
/begin CHARACTERISTIC CalRegn02Rt02GroupC.GmTqArbnApaSmotngHwTqLpFilFrq.Val "MICROSAR RTE" VALUE 0x0 RTE_RL_FLOAT32_IEEE 0 NO_COMPU_METHOD -3.402823466e+38 3.402823466e+38 SYMBOL_LINK "Rte_CalprmRom_CalRegn02Rt02GroupC_DEFAULT_RTE_CALPRM_GROUP.GmTqArbnApaSmotngHwTqLpFilFrq_Val" 0 DISPLAY_IDENTIFIER CalRegn02Rt02GroupC.CalibrationPorts.GmTqArbnApaSmotngHwTqLpFilFrq.Val /end CHARACTERISTIC
/begin CHARACTERISTIC CalRegn02Rt02GroupC.GmTqArbnApaSmotngX.Ary1D "MICROSAR RTE" VAL_BLK 0x0 RTE_RL_UWORD 0 NO_COMPU_METHOD 0 65535 MATRIX_DIM 10 1 1 SYMBOL_LINK "Rte_CalprmRom_CalRegn02Rt02GroupC_DEFAULT_RTE_CALPRM_GROUP.GmTqArbnApaSmotngX_Ary1D" 0 DISPLAY_IDENTIFIER CalRegn02Rt02GroupC.CalibrationPorts.GmTqArbnApaSmotngX.Ary1D /end CHARACTERISTIC
/begin CHARACTERISTIC CalRegn02Rt02GroupC.GmTqArbnApaSmotngY.Ary1D "MICROSAR RTE" VAL_BLK 0x0 RTE_RL_UWORD 0 NO_COMPU_METHOD 0 65535 MATRIX_DIM 10 1 1 SYMBOL_LINK "Rte_CalprmRom_CalRegn02Rt02GroupC_DEFAULT_RTE_CALPRM_GROUP.GmTqArbnApaSmotngY_Ary1D" 0 DISPLAY_IDENTIFIER CalRegn02Rt02GroupC.CalibrationPorts.GmTqArbnApaSmotngY.Ary1D /end CHARACTERISTIC
/begin CHARACTERISTIC CalRegn02Rt02GroupC.GmTqArbnLkaOutpOvrlX.Ary2D "MICROSAR RTE" VAL_BLK 0x0 RTE_RL_UWORD 0 NO_COMPU_METHOD 0 65535 MATRIX_DIM 20 12 1 SYMBOL_LINK "Rte_CalprmRom_CalRegn02Rt02GroupC_DEFAULT_RTE_CALPRM_GROUP.GmTqArbnLkaOutpOvrlX_Ary2D" 0 DISPLAY_IDENTIFIER CalRegn02Rt02GroupC.CalibrationPorts.GmTqArbnLkaOutpOvrlX.Ary2D /end CHARACTERISTIC
/begin CHARACTERISTIC CalRegn02Rt02GroupC.GmTqArbnLkaOutpOvrlY.Ary2D "MICROSAR RTE" VAL_BLK 0x0 RTE_RL_UWORD 0 NO_COMPU_METHOD 0 65535 MATRIX_DIM 20 12 1 SYMBOL_LINK "Rte_CalprmRom_CalRegn02Rt02GroupC_DEFAULT_RTE_CALPRM_GROUP.GmTqArbnLkaOutpOvrlY_Ary2D" 0 DISPLAY_IDENTIFIER CalRegn02Rt02GroupC.CalibrationPorts.GmTqArbnLkaOutpOvrlY.Ary2D /end CHARACTERISTIC
/begin CHARACTERISTIC CalRegn02Rt02GroupC.GmTqArbnLkaSlewX.Ary1D "MICROSAR RTE" VAL_BLK 0x0 RTE_RL_UWORD 0 NO_COMPU_METHOD 0 65535 MATRIX_DIM 6 1 1 SYMBOL_LINK "Rte_CalprmRom_CalRegn02Rt02GroupC_DEFAULT_RTE_CALPRM_GROUP.GmTqArbnLkaSlewX_Ary1D" 0 DISPLAY_IDENTIFIER CalRegn02Rt02GroupC.CalibrationPorts.GmTqArbnLkaSlewX.Ary1D /end CHARACTERISTIC
/begin CHARACTERISTIC CalRegn02Rt02GroupC.GmTqArbnLkaSlewY.Ary1D "MICROSAR RTE" VAL_BLK 0x0 RTE_RL_UWORD 0 NO_COMPU_METHOD 0 65535 MATRIX_DIM 6 1 1 SYMBOL_LINK "Rte_CalprmRom_CalRegn02Rt02GroupC_DEFAULT_RTE_CALPRM_GROUP.GmTqArbnLkaSlewY_Ary1D" 0 DISPLAY_IDENTIFIER CalRegn02Rt02GroupC.CalibrationPorts.GmTqArbnLkaSlewY.Ary1D /end CHARACTERISTIC
/begin CHARACTERISTIC CalRegn02Rt03GroupC.GmOvrlStMgrHwAgTarLimr.Val "MICROSAR RTE" VALUE 0x0 RTE_RL_FLOAT32_IEEE 0 NO_COMPU_METHOD -3.402823466e+38 3.402823466e+38 SYMBOL_LINK "Rte_CalprmRom_CalRegn02Rt03GroupC_DEFAULT_RTE_CALPRM_GROUP.GmOvrlStMgrHwAgTarLimr_Val" 0 DISPLAY_IDENTIFIER CalRegn02Rt03GroupC.CalibrationPorts.GmOvrlStMgrHwAgTarLimr.Val /end CHARACTERISTIC
/begin CHARACTERISTIC CalRegn02Rt03GroupC.GmOvrlStMgrShiftLvrTiThd.Val "MICROSAR RTE" VALUE 0x0 RTE_RL_ULONG 0 NO_COMPU_METHOD 0 4294967295 SYMBOL_LINK "Rte_CalprmRom_CalRegn02Rt03GroupC_DEFAULT_RTE_CALPRM_GROUP.GmOvrlStMgrShiftLvrTiThd_Val" 0 DISPLAY_IDENTIFIER CalRegn02Rt03GroupC.CalibrationPorts.GmOvrlStMgrShiftLvrTiThd.Val /end CHARACTERISTIC
/begin CHARACTERISTIC CalRegn02Rt03GroupC.GmOvrlStMgrStandStillThd.Val "MICROSAR RTE" VALUE 0x0 RTE_RL_FLOAT32_IEEE 0 NO_COMPU_METHOD -3.402823466e+38 3.402823466e+38 SYMBOL_LINK "Rte_CalprmRom_CalRegn02Rt03GroupC_DEFAULT_RTE_CALPRM_GROUP.GmOvrlStMgrStandStillThd_Val" 0 DISPLAY_IDENTIFIER CalRegn02Rt03GroupC.CalibrationPorts.GmOvrlStMgrStandStillThd.Val /end CHARACTERISTIC
/begin CHARACTERISTIC CalRegn02Rt03GroupC.GmOvrlStMgrStandStillTiThd.Val "MICROSAR RTE" VALUE 0x0 RTE_RL_ULONG 0 NO_COMPU_METHOD 0 4294967295 SYMBOL_LINK "Rte_CalprmRom_CalRegn02Rt03GroupC_DEFAULT_RTE_CALPRM_GROUP.GmOvrlStMgrStandStillTiThd_Val" 0 DISPLAY_IDENTIFIER CalRegn02Rt03GroupC.CalibrationPorts.GmOvrlStMgrStandStillTiThd.Val /end CHARACTERISTIC
/begin CHARACTERISTIC CalRegn02Rt03GroupC.GmTqArbnApaDiRateY.Ary1D "MICROSAR RTE" VAL_BLK 0x0 RTE_RL_UWORD 0 NO_COMPU_METHOD 0 65535 MATRIX_DIM 6 1 1 SYMBOL_LINK "Rte_CalprmRom_CalRegn02Rt03GroupC_DEFAULT_RTE_CALPRM_GROUP.GmTqArbnApaDiRateY_Ary1D" 0 DISPLAY_IDENTIFIER CalRegn02Rt03GroupC.CalibrationPorts.GmTqArbnApaDiRateY.Ary1D /end CHARACTERISTIC
/begin CHARACTERISTIC CalRegn02Rt03GroupC.GmTqArbnApaEnaRate.Val "MICROSAR RTE" VALUE 0x0 RTE_RL_FLOAT32_IEEE 0 NO_COMPU_METHOD -3.402823466e+38 3.402823466e+38 SYMBOL_LINK "Rte_CalprmRom_CalRegn02Rt03GroupC_DEFAULT_RTE_CALPRM_GROUP.GmTqArbnApaEnaRate_Val" 0 DISPLAY_IDENTIFIER CalRegn02Rt03GroupC.CalibrationPorts.GmTqArbnApaEnaRate.Val /end CHARACTERISTIC
/begin CHARACTERISTIC CalRegn02Rt03GroupC.GmTqArbnApaSmotngHwTqLpFilFrq.Val "MICROSAR RTE" VALUE 0x0 RTE_RL_FLOAT32_IEEE 0 NO_COMPU_METHOD -3.402823466e+38 3.402823466e+38 SYMBOL_LINK "Rte_CalprmRom_CalRegn02Rt03GroupC_DEFAULT_RTE_CALPRM_GROUP.GmTqArbnApaSmotngHwTqLpFilFrq_Val" 0 DISPLAY_IDENTIFIER CalRegn02Rt03GroupC.CalibrationPorts.GmTqArbnApaSmotngHwTqLpFilFrq.Val /end CHARACTERISTIC
/begin CHARACTERISTIC CalRegn02Rt03GroupC.GmTqArbnApaSmotngX.Ary1D "MICROSAR RTE" VAL_BLK 0x0 RTE_RL_UWORD 0 NO_COMPU_METHOD 0 65535 MATRIX_DIM 10 1 1 SYMBOL_LINK "Rte_CalprmRom_CalRegn02Rt03GroupC_DEFAULT_RTE_CALPRM_GROUP.GmTqArbnApaSmotngX_Ary1D" 0 DISPLAY_IDENTIFIER CalRegn02Rt03GroupC.CalibrationPorts.GmTqArbnApaSmotngX.Ary1D /end CHARACTERISTIC
/begin CHARACTERISTIC CalRegn02Rt03GroupC.GmTqArbnApaSmotngY.Ary1D "MICROSAR RTE" VAL_BLK 0x0 RTE_RL_UWORD 0 NO_COMPU_METHOD 0 65535 MATRIX_DIM 10 1 1 SYMBOL_LINK "Rte_CalprmRom_CalRegn02Rt03GroupC_DEFAULT_RTE_CALPRM_GROUP.GmTqArbnApaSmotngY_Ary1D" 0 DISPLAY_IDENTIFIER CalRegn02Rt03GroupC.CalibrationPorts.GmTqArbnApaSmotngY.Ary1D /end CHARACTERISTIC
/begin CHARACTERISTIC CalRegn02Rt03GroupC.GmTqArbnLkaOutpOvrlX.Ary2D "MICROSAR RTE" VAL_BLK 0x0 RTE_RL_UWORD 0 NO_COMPU_METHOD 0 65535 MATRIX_DIM 20 12 1 SYMBOL_LINK "Rte_CalprmRom_CalRegn02Rt03GroupC_DEFAULT_RTE_CALPRM_GROUP.GmTqArbnLkaOutpOvrlX_Ary2D" 0 DISPLAY_IDENTIFIER CalRegn02Rt03GroupC.CalibrationPorts.GmTqArbnLkaOutpOvrlX.Ary2D /end CHARACTERISTIC
/begin CHARACTERISTIC CalRegn02Rt03GroupC.GmTqArbnLkaOutpOvrlY.Ary2D "MICROSAR RTE" VAL_BLK 0x0 RTE_RL_UWORD 0 NO_COMPU_METHOD 0 65535 MATRIX_DIM 20 12 1 SYMBOL_LINK "Rte_CalprmRom_CalRegn02Rt03GroupC_DEFAULT_RTE_CALPRM_GROUP.GmTqArbnLkaOutpOvrlY_Ary2D" 0 DISPLAY_IDENTIFIER CalRegn02Rt03GroupC.CalibrationPorts.GmTqArbnLkaOutpOvrlY.Ary2D /end CHARACTERISTIC
/begin CHARACTERISTIC CalRegn02Rt03GroupC.GmTqArbnLkaSlewX.Ary1D "MICROSAR RTE" VAL_BLK 0x0 RTE_RL_UWORD 0 NO_COMPU_METHOD 0 65535 MATRIX_DIM 6 1 1 SYMBOL_LINK "Rte_CalprmRom_CalRegn02Rt03GroupC_DEFAULT_RTE_CALPRM_GROUP.GmTqArbnLkaSlewX_Ary1D" 0 DISPLAY_IDENTIFIER CalRegn02Rt03GroupC.CalibrationPorts.GmTqArbnLkaSlewX.Ary1D /end CHARACTERISTIC
/begin CHARACTERISTIC CalRegn02Rt03GroupC.GmTqArbnLkaSlewY.Ary1D "MICROSAR RTE" VAL_BLK 0x0 RTE_RL_UWORD 0 NO_COMPU_METHOD 0 65535 MATRIX_DIM 6 1 1 SYMBOL_LINK "Rte_CalprmRom_CalRegn02Rt03GroupC_DEFAULT_RTE_CALPRM_GROUP.GmTqArbnLkaSlewY_Ary1D" 0 DISPLAY_IDENTIFIER CalRegn02Rt03GroupC.CalibrationPorts.GmTqArbnLkaSlewY.Ary1D /end CHARACTERISTIC
/begin CHARACTERISTIC CalRegn02Rt04GroupC.GmOvrlStMgrHwAgTarLimr.Val "MICROSAR RTE" VALUE 0x0 RTE_RL_FLOAT32_IEEE 0 NO_COMPU_METHOD -3.402823466e+38 3.402823466e+38 SYMBOL_LINK "Rte_CalprmRom_CalRegn02Rt04GroupC_DEFAULT_RTE_CALPRM_GROUP.GmOvrlStMgrHwAgTarLimr_Val" 0 DISPLAY_IDENTIFIER CalRegn02Rt04GroupC.CalibrationPorts.GmOvrlStMgrHwAgTarLimr.Val /end CHARACTERISTIC
/begin CHARACTERISTIC CalRegn02Rt04GroupC.GmOvrlStMgrShiftLvrTiThd.Val "MICROSAR RTE" VALUE 0x0 RTE_RL_ULONG 0 NO_COMPU_METHOD 0 4294967295 SYMBOL_LINK "Rte_CalprmRom_CalRegn02Rt04GroupC_DEFAULT_RTE_CALPRM_GROUP.GmOvrlStMgrShiftLvrTiThd_Val" 0 DISPLAY_IDENTIFIER CalRegn02Rt04GroupC.CalibrationPorts.GmOvrlStMgrShiftLvrTiThd.Val /end CHARACTERISTIC
/begin CHARACTERISTIC CalRegn02Rt04GroupC.GmOvrlStMgrStandStillThd.Val "MICROSAR RTE" VALUE 0x0 RTE_RL_FLOAT32_IEEE 0 NO_COMPU_METHOD -3.402823466e+38 3.402823466e+38 SYMBOL_LINK "Rte_CalprmRom_CalRegn02Rt04GroupC_DEFAULT_RTE_CALPRM_GROUP.GmOvrlStMgrStandStillThd_Val" 0 DISPLAY_IDENTIFIER CalRegn02Rt04GroupC.CalibrationPorts.GmOvrlStMgrStandStillThd.Val /end CHARACTERISTIC
/begin CHARACTERISTIC CalRegn02Rt04GroupC.GmOvrlStMgrStandStillTiThd.Val "MICROSAR RTE" VALUE 0x0 RTE_RL_ULONG 0 NO_COMPU_METHOD 0 4294967295 SYMBOL_LINK "Rte_CalprmRom_CalRegn02Rt04GroupC_DEFAULT_RTE_CALPRM_GROUP.GmOvrlStMgrStandStillTiThd_Val" 0 DISPLAY_IDENTIFIER CalRegn02Rt04GroupC.CalibrationPorts.GmOvrlStMgrStandStillTiThd.Val /end CHARACTERISTIC
/begin CHARACTERISTIC CalRegn02Rt04GroupC.GmTqArbnApaDiRateY.Ary1D "MICROSAR RTE" VAL_BLK 0x0 RTE_RL_UWORD 0 NO_COMPU_METHOD 0 65535 MATRIX_DIM 6 1 1 SYMBOL_LINK "Rte_CalprmRom_CalRegn02Rt04GroupC_DEFAULT_RTE_CALPRM_GROUP.GmTqArbnApaDiRateY_Ary1D" 0 DISPLAY_IDENTIFIER CalRegn02Rt04GroupC.CalibrationPorts.GmTqArbnApaDiRateY.Ary1D /end CHARACTERISTIC
/begin CHARACTERISTIC CalRegn02Rt04GroupC.GmTqArbnApaEnaRate.Val "MICROSAR RTE" VALUE 0x0 RTE_RL_FLOAT32_IEEE 0 NO_COMPU_METHOD -3.402823466e+38 3.402823466e+38 SYMBOL_LINK "Rte_CalprmRom_CalRegn02Rt04GroupC_DEFAULT_RTE_CALPRM_GROUP.GmTqArbnApaEnaRate_Val" 0 DISPLAY_IDENTIFIER CalRegn02Rt04GroupC.CalibrationPorts.GmTqArbnApaEnaRate.Val /end CHARACTERISTIC
/begin CHARACTERISTIC CalRegn02Rt04GroupC.GmTqArbnApaSmotngHwTqLpFilFrq.Val "MICROSAR RTE" VALUE 0x0 RTE_RL_FLOAT32_IEEE 0 NO_COMPU_METHOD -3.402823466e+38 3.402823466e+38 SYMBOL_LINK "Rte_CalprmRom_CalRegn02Rt04GroupC_DEFAULT_RTE_CALPRM_GROUP.GmTqArbnApaSmotngHwTqLpFilFrq_Val" 0 DISPLAY_IDENTIFIER CalRegn02Rt04GroupC.CalibrationPorts.GmTqArbnApaSmotngHwTqLpFilFrq.Val /end CHARACTERISTIC
/begin CHARACTERISTIC CalRegn02Rt04GroupC.GmTqArbnApaSmotngX.Ary1D "MICROSAR RTE" VAL_BLK 0x0 RTE_RL_UWORD 0 NO_COMPU_METHOD 0 65535 MATRIX_DIM 10 1 1 SYMBOL_LINK "Rte_CalprmRom_CalRegn02Rt04GroupC_DEFAULT_RTE_CALPRM_GROUP.GmTqArbnApaSmotngX_Ary1D" 0 DISPLAY_IDENTIFIER CalRegn02Rt04GroupC.CalibrationPorts.GmTqArbnApaSmotngX.Ary1D /end CHARACTERISTIC
/begin CHARACTERISTIC CalRegn02Rt04GroupC.GmTqArbnApaSmotngY.Ary1D "MICROSAR RTE" VAL_BLK 0x0 RTE_RL_UWORD 0 NO_COMPU_METHOD 0 65535 MATRIX_DIM 10 1 1 SYMBOL_LINK "Rte_CalprmRom_CalRegn02Rt04GroupC_DEFAULT_RTE_CALPRM_GROUP.GmTqArbnApaSmotngY_Ary1D" 0 DISPLAY_IDENTIFIER CalRegn02Rt04GroupC.CalibrationPorts.GmTqArbnApaSmotngY.Ary1D /end CHARACTERISTIC
/begin CHARACTERISTIC CalRegn02Rt04GroupC.GmTqArbnLkaOutpOvrlX.Ary2D "MICROSAR RTE" VAL_BLK 0x0 RTE_RL_UWORD 0 NO_COMPU_METHOD 0 65535 MATRIX_DIM 20 12 1 SYMBOL_LINK "Rte_CalprmRom_CalRegn02Rt04GroupC_DEFAULT_RTE_CALPRM_GROUP.GmTqArbnLkaOutpOvrlX_Ary2D" 0 DISPLAY_IDENTIFIER CalRegn02Rt04GroupC.CalibrationPorts.GmTqArbnLkaOutpOvrlX.Ary2D /end CHARACTERISTIC
/begin CHARACTERISTIC CalRegn02Rt04GroupC.GmTqArbnLkaOutpOvrlY.Ary2D "MICROSAR RTE" VAL_BLK 0x0 RTE_RL_UWORD 0 NO_COMPU_METHOD 0 65535 MATRIX_DIM 20 12 1 SYMBOL_LINK "Rte_CalprmRom_CalRegn02Rt04GroupC_DEFAULT_RTE_CALPRM_GROUP.GmTqArbnLkaOutpOvrlY_Ary2D" 0 DISPLAY_IDENTIFIER CalRegn02Rt04GroupC.CalibrationPorts.GmTqArbnLkaOutpOvrlY.Ary2D /end CHARACTERISTIC
/begin CHARACTERISTIC CalRegn02Rt04GroupC.GmTqArbnLkaSlewX.Ary1D "MICROSAR RTE" VAL_BLK 0x0 RTE_RL_UWORD 0 NO_COMPU_METHOD 0 65535 MATRIX_DIM 6 1 1 SYMBOL_LINK "Rte_CalprmRom_CalRegn02Rt04GroupC_DEFAULT_RTE_CALPRM_GROUP.GmTqArbnLkaSlewX_Ary1D" 0 DISPLAY_IDENTIFIER CalRegn02Rt04GroupC.CalibrationPorts.GmTqArbnLkaSlewX.Ary1D /end CHARACTERISTIC
/begin CHARACTERISTIC CalRegn02Rt04GroupC.GmTqArbnLkaSlewY.Ary1D "MICROSAR RTE" VAL_BLK 0x0 RTE_RL_UWORD 0 NO_COMPU_METHOD 0 65535 MATRIX_DIM 6 1 1 SYMBOL_LINK "Rte_CalprmRom_CalRegn02Rt04GroupC_DEFAULT_RTE_CALPRM_GROUP.GmTqArbnLkaSlewY_Ary1D" 0 DISPLAY_IDENTIFIER CalRegn02Rt04GroupC.CalibrationPorts.GmTqArbnLkaSlewY.Ary1D /end CHARACTERISTIC
/begin CHARACTERISTIC CalRegn03Cmn.AssiHiFrqHpFilFrqY.Ary1D "MICROSAR RTE" VAL_BLK 0x0 RTE_RL_UWORD 0 NO_COMPU_METHOD 0 65535 MATRIX_DIM 12 1 1 SYMBOL_LINK "Rte_CalprmRom_CalRegn03Cmn_DEFAULT_RTE_CALPRM_GROUP.AssiHiFrqHpFilFrqY_Ary1D" 0 DISPLAY_IDENTIFIER CalRegn03Cmn.CalibrationPorts.AssiHiFrqHpFilFrqY.Ary1D /end CHARACTERISTIC
/begin CHARACTERISTIC CalRegn03Cmn.DampgQuadHwTqBacklsh.Val "MICROSAR RTE" VALUE 0x0 RTE_RL_FLOAT32_IEEE 0 NO_COMPU_METHOD 0.0 10.0 SYMBOL_LINK "Rte_CalprmRom_CalRegn03Cmn_DEFAULT_RTE_CALPRM_GROUP.DampgQuadHwTqBacklsh_Val" 0 DISPLAY_IDENTIFIER CalRegn03Cmn.CalibrationPorts.DampgQuadHwTqBacklsh.Val /end CHARACTERISTIC
/begin CHARACTERISTIC CalRegn03Cmn.DampgQuadMotVelBacklsh.Val "MICROSAR RTE" VALUE 0x0 RTE_RL_FLOAT32_IEEE 0 NO_COMPU_METHOD 0 128 SYMBOL_LINK "Rte_CalprmRom_CalRegn03Cmn_DEFAULT_RTE_CALPRM_GROUP.DampgQuadMotVelBacklsh_Val" 0 DISPLAY_IDENTIFIER CalRegn03Cmn.CalibrationPorts.DampgQuadMotVelBacklsh.Val /end CHARACTERISTIC
/begin CHARACTERISTIC CalRegn03Cmn.EotLrngHwAgOverTrvlEntr.Val "MICROSAR RTE" VALUE 0x0 RTE_RL_FLOAT32_IEEE 0 NO_COMPU_METHOD -3.402823466e+38 3.402823466e+38 SYMBOL_LINK "Rte_CalprmRom_CalRegn03Cmn_DEFAULT_RTE_CALPRM_GROUP.EotLrngHwAgOverTrvlEntr_Val" 0 DISPLAY_IDENTIFIER CalRegn03Cmn.CalibrationPorts.EotLrngHwAgOverTrvlEntr.Val /end CHARACTERISTIC
/begin CHARACTERISTIC CalRegn03Cmn.EotLrngHwAgOverTrvlExit.Val "MICROSAR RTE" VALUE 0x0 RTE_RL_FLOAT32_IEEE 0 NO_COMPU_METHOD -3.402823466e+38 3.402823466e+38 SYMBOL_LINK "Rte_CalprmRom_CalRegn03Cmn_DEFAULT_RTE_CALPRM_GROUP.EotLrngHwAgOverTrvlExit_Val" 0 DISPLAY_IDENTIFIER CalRegn03Cmn.CalibrationPorts.EotLrngHwAgOverTrvlExit.Val /end CHARACTERISTIC
/begin CHARACTERISTIC CalRegn03Cmn.EotProtnSoftEndStopAuthyThd.Val "MICROSAR RTE" VALUE 0x0 RTE_RL_FLOAT32_IEEE 0 NO_COMPU_METHOD -3.402823466e+38 3.402823466e+38 SYMBOL_LINK "Rte_CalprmRom_CalRegn03Cmn_DEFAULT_RTE_CALPRM_GROUP.EotProtnSoftEndStopAuthyThd_Val" 0 DISPLAY_IDENTIFIER CalRegn03Cmn.CalibrationPorts.EotProtnSoftEndStopAuthyThd.Val /end CHARACTERISTIC
/begin CHARACTERISTIC CalRegn03Cmn.HwAgTrakgServoDiRateX.Ary1D "MICROSAR RTE" VAL_BLK 0x0 RTE_RL_UWORD 0 NO_COMPU_METHOD 0 65535 MATRIX_DIM 6 1 1 SYMBOL_LINK "Rte_CalprmRom_CalRegn03Cmn_DEFAULT_RTE_CALPRM_GROUP.HwAgTrakgServoDiRateX_Ary1D" 0 DISPLAY_IDENTIFIER CalRegn03Cmn.CalibrationPorts.HwAgTrakgServoDiRateX.Ary1D /end CHARACTERISTIC
/begin CHARACTERISTIC CalRegn03Cmn.HwAgTrakgServoDiRateY.Ary1D "MICROSAR RTE" VAL_BLK 0x0 RTE_RL_UWORD 0 NO_COMPU_METHOD 0 65535 MATRIX_DIM 6 1 1 SYMBOL_LINK "Rte_CalprmRom_CalRegn03Cmn_DEFAULT_RTE_CALPRM_GROUP.HwAgTrakgServoDiRateY_Ary1D" 0 DISPLAY_IDENTIFIER CalRegn03Cmn.CalibrationPorts.HwAgTrakgServoDiRateY.Ary1D /end CHARACTERISTIC
/begin CHARACTERISTIC CalRegn03Cmn.HwAgTrakgServoEnaRate.Val "MICROSAR RTE" VALUE 0x0 RTE_RL_FLOAT32_IEEE 0 NO_COMPU_METHOD -3.402823466e+38 3.402823466e+38 SYMBOL_LINK "Rte_CalprmRom_CalRegn03Cmn_DEFAULT_RTE_CALPRM_GROUP.HwAgTrakgServoEnaRate_Val" 0 DISPLAY_IDENTIFIER CalRegn03Cmn.CalibrationPorts.HwAgTrakgServoEnaRate.Val /end CHARACTERISTIC
/begin CHARACTERISTIC CalRegn03Cmn.HwAgTrakgServoExecRate.Val "MICROSAR RTE" VALUE 0x0 RTE_RL_FLOAT32_IEEE 0 NO_COMPU_METHOD -3.402823466e+38 3.402823466e+38 SYMBOL_LINK "Rte_CalprmRom_CalRegn03Cmn_DEFAULT_RTE_CALPRM_GROUP.HwAgTrakgServoExecRate_Val" 0 DISPLAY_IDENTIFIER CalRegn03Cmn.CalibrationPorts.HwAgTrakgServoExecRate.Val /end CHARACTERISTIC
/begin CHARACTERISTIC CalRegn03Cmn.HwAgTrakgServoHwAgRateLim.Ary1D "MICROSAR RTE" VAL_BLK 0x0 RTE_RL_UWORD 0 NO_COMPU_METHOD 0 65535 MATRIX_DIM 3 1 1 SYMBOL_LINK "Rte_CalprmRom_CalRegn03Cmn_DEFAULT_RTE_CALPRM_GROUP.HwAgTrakgServoHwAgRateLim_Ary1D" 0 DISPLAY_IDENTIFIER CalRegn03Cmn.CalibrationPorts.HwAgTrakgServoHwAgRateLim.Ary1D /end CHARACTERISTIC
/begin CHARACTERISTIC CalRegn03Cmn.HwAgTrakgServoMaxCmdX.Ary1D "MICROSAR RTE" VAL_BLK 0x0 RTE_RL_UWORD 0 NO_COMPU_METHOD 0 65535 MATRIX_DIM 4 1 1 SYMBOL_LINK "Rte_CalprmRom_CalRegn03Cmn_DEFAULT_RTE_CALPRM_GROUP.HwAgTrakgServoMaxCmdX_Ary1D" 0 DISPLAY_IDENTIFIER CalRegn03Cmn.CalibrationPorts.HwAgTrakgServoMaxCmdX.Ary1D /end CHARACTERISTIC
/begin CHARACTERISTIC CalRegn03Cmn.HwAgTrakgServoMaxCmdY.Ary1D "MICROSAR RTE" VAL_BLK 0x0 RTE_RL_UWORD 0 NO_COMPU_METHOD 0 65535 MATRIX_DIM 4 1 1 SYMBOL_LINK "Rte_CalprmRom_CalRegn03Cmn_DEFAULT_RTE_CALPRM_GROUP.HwAgTrakgServoMaxCmdY_Ary1D" 0 DISPLAY_IDENTIFIER CalRegn03Cmn.CalibrationPorts.HwAgTrakgServoMaxCmdY.Ary1D /end CHARACTERISTIC
/begin CHARACTERISTIC CalRegn03Cmn.HwAgTrakgServoMaxRamp.Val "MICROSAR RTE" VALUE 0x0 RTE_RL_FLOAT32_IEEE 0 NO_COMPU_METHOD -3.402823466e+38 3.402823466e+38 SYMBOL_LINK "Rte_CalprmRom_CalRegn03Cmn_DEFAULT_RTE_CALPRM_GROUP.HwAgTrakgServoMaxRamp_Val" 0 DISPLAY_IDENTIFIER CalRegn03Cmn.CalibrationPorts.HwAgTrakgServoMaxRamp.Val /end CHARACTERISTIC
/begin CHARACTERISTIC CalRegn03Cmn.HwAgTrakgServoMinRamp.Val "MICROSAR RTE" VALUE 0x0 RTE_RL_FLOAT32_IEEE 0 NO_COMPU_METHOD -3.402823466e+38 3.402823466e+38 SYMBOL_LINK "Rte_CalprmRom_CalRegn03Cmn_DEFAULT_RTE_CALPRM_GROUP.HwAgTrakgServoMinRamp_Val" 0 DISPLAY_IDENTIFIER CalRegn03Cmn.CalibrationPorts.HwAgTrakgServoMinRamp.Val /end CHARACTERISTIC
/begin CHARACTERISTIC CalRegn03Cmn.HwAgTrakgServoPidLim.Val "MICROSAR RTE" VALUE 0x0 RTE_RL_FLOAT32_IEEE 0 NO_COMPU_METHOD -3.402823466e+38 3.402823466e+38 SYMBOL_LINK "Rte_CalprmRom_CalRegn03Cmn_DEFAULT_RTE_CALPRM_GROUP.HwAgTrakgServoPidLim_Val" 0 DISPLAY_IDENTIFIER CalRegn03Cmn.CalibrationPorts.HwAgTrakgServoPidLim.Val /end CHARACTERISTIC
/begin CHARACTERISTIC CalRegn03Cmn.HwAgTrakgServoRampCmpl.Val "MICROSAR RTE" VALUE 0x0 RTE_RL_FLOAT32_IEEE 0 NO_COMPU_METHOD -3.402823466e+38 3.402823466e+38 SYMBOL_LINK "Rte_CalprmRom_CalRegn03Cmn_DEFAULT_RTE_CALPRM_GROUP.HwAgTrakgServoRampCmpl_Val" 0 DISPLAY_IDENTIFIER CalRegn03Cmn.CalibrationPorts.HwAgTrakgServoRampCmpl.Val /end CHARACTERISTIC
/begin CHARACTERISTIC CalRegn03Cmn.HwAgTrakgServoVehSpdBasd.Ary1D "MICROSAR RTE" VAL_BLK 0x0 RTE_RL_UWORD 0 NO_COMPU_METHOD 0 65535 MATRIX_DIM 3 1 1 SYMBOL_LINK "Rte_CalprmRom_CalRegn03Cmn_DEFAULT_RTE_CALPRM_GROUP.HwAgTrakgServoVehSpdBasd_Ary1D" 0 DISPLAY_IDENTIFIER CalRegn03Cmn.CalibrationPorts.HwAgTrakgServoVehSpdBasd.Ary1D /end CHARACTERISTIC
/begin CHARACTERISTIC CalRegn03Cmn.NxtrCalIdsCal2DevlpAuthor.Ary1D "MICROSAR RTE" VAL_BLK 0x0 RTE_RL_UBYTE 0 NO_COMPU_METHOD 0 255 MATRIX_DIM 6 1 1 SYMBOL_LINK "Rte_CalprmRom_CalRegn03Cmn_DEFAULT_RTE_CALPRM_GROUP.NxtrCalIdsCal2DevlpAuthor_Ary1D" 0 DISPLAY_IDENTIFIER CalRegn03Cmn.CalibrationPorts.NxtrCalIdsCal2DevlpAuthor.Ary1D /end CHARACTERISTIC
/begin CHARACTERISTIC CalRegn03Cmn.NxtrCalIdsCal2DevlpDesc.Ary1D "MICROSAR RTE" VAL_BLK 0x0 RTE_RL_UBYTE 0 NO_COMPU_METHOD 0 255 MATRIX_DIM 48 1 1 SYMBOL_LINK "Rte_CalprmRom_CalRegn03Cmn_DEFAULT_RTE_CALPRM_GROUP.NxtrCalIdsCal2DevlpDesc_Ary1D" 0 DISPLAY_IDENTIFIER CalRegn03Cmn.CalibrationPorts.NxtrCalIdsCal2DevlpDesc.Ary1D /end CHARACTERISTIC
/begin CHARACTERISTIC CalRegn03Cmn.NxtrCalIdsCal2DevlpRelNr.Val "MICROSAR RTE" VALUE 0x0 RTE_RL_ULONG 0 NO_COMPU_METHOD 0 4294967295 SYMBOL_LINK "Rte_CalprmRom_CalRegn03Cmn_DEFAULT_RTE_CALPRM_GROUP.NxtrCalIdsCal2DevlpRelNr_Val" 0 DISPLAY_IDENTIFIER CalRegn03Cmn.CalibrationPorts.NxtrCalIdsCal2DevlpRelNr.Val /end CHARACTERISTIC
/begin CHARACTERISTIC CalRegn03Cmn.NxtrCalIdsCal2DevlpRelSt.Val "MICROSAR RTE" VALUE 0x0 RTE_RL_UBYTE 0 NO_COMPU_METHOD 0 255 SYMBOL_LINK "Rte_CalprmRom_CalRegn03Cmn_DEFAULT_RTE_CALPRM_GROUP.NxtrCalIdsCal2DevlpRelSt_Val" 0 DISPLAY_IDENTIFIER CalRegn03Cmn.CalibrationPorts.NxtrCalIdsCal2DevlpRelSt.Val /end CHARACTERISTIC
/begin CHARACTERISTIC CalRegn03Cmn.NxtrCalIdsCal2DevlpTiStamp.Val "MICROSAR RTE" VALUE 0x0 RTE_RL_ULONG 0 NO_COMPU_METHOD 0 4294967295 SYMBOL_LINK "Rte_CalprmRom_CalRegn03Cmn_DEFAULT_RTE_CALPRM_GROUP.NxtrCalIdsCal2DevlpTiStamp_Val" 0 DISPLAY_IDENTIFIER CalRegn03Cmn.CalibrationPorts.NxtrCalIdsCal2DevlpTiStamp.Val /end CHARACTERISTIC
/begin CHARACTERISTIC CalRegn03Cmn.NxtrCalIdsCal2DevlpVers.Val "MICROSAR RTE" VALUE 0x0 RTE_RL_UBYTE 0 NO_COMPU_METHOD 0 255 SYMBOL_LINK "Rte_CalprmRom_CalRegn03Cmn_DEFAULT_RTE_CALPRM_GROUP.NxtrCalIdsCal2DevlpVers_Val" 0 DISPLAY_IDENTIFIER CalRegn03Cmn.CalibrationPorts.NxtrCalIdsCal2DevlpVers.Val /end CHARACTERISTIC
/begin CHARACTERISTIC CalRegn03Cmn.TqLoaDrvrTqNom.Val "MICROSAR RTE" VALUE 0x0 RTE_RL_FLOAT32_IEEE 0 NO_COMPU_METHOD -3.402823466e+38 3.402823466e+38 SYMBOL_LINK "Rte_CalprmRom_CalRegn03Cmn_DEFAULT_RTE_CALPRM_GROUP.TqLoaDrvrTqNom_Val" 0 DISPLAY_IDENTIFIER CalRegn03Cmn.CalibrationPorts.TqLoaDrvrTqNom.Val /end CHARACTERISTIC
/begin CHARACTERISTIC CalRegn03Cmn.TqLoaMotTqCmdLim.Val "MICROSAR RTE" VALUE 0x0 RTE_RL_FLOAT32_IEEE 0 NO_COMPU_METHOD -3.402823466e+38 3.402823466e+38 SYMBOL_LINK "Rte_CalprmRom_CalRegn03Cmn_DEFAULT_RTE_CALPRM_GROUP.TqLoaMotTqCmdLim_Val" 0 DISPLAY_IDENTIFIER CalRegn03Cmn.CalibrationPorts.TqLoaMotTqCmdLim.Val /end CHARACTERISTIC
/begin CHARACTERISTIC CalRegn03Cmn.TqLoaMotVelAndTqBasdScaFacFallRate.Val "MICROSAR RTE" VALUE 0x0 RTE_RL_FLOAT32_IEEE 0 NO_COMPU_METHOD -3.402823466e+38 3.402823466e+38 SYMBOL_LINK "Rte_CalprmRom_CalRegn03Cmn_DEFAULT_RTE_CALPRM_GROUP.TqLoaMotVelAndTqBasdScaFacFallRate_Val" 0 DISPLAY_IDENTIFIER CalRegn03Cmn.CalibrationPorts.TqLoaMotVelAndTqBasdScaFacFallRate.Val /end CHARACTERISTIC
/begin CHARACTERISTIC CalRegn03Cmn.TqLoaMotVelAndTqBasdScaFacMax.Val "MICROSAR RTE" VALUE 0x0 RTE_RL_FLOAT32_IEEE 0 NO_COMPU_METHOD -3.402823466e+38 3.402823466e+38 SYMBOL_LINK "Rte_CalprmRom_CalRegn03Cmn_DEFAULT_RTE_CALPRM_GROUP.TqLoaMotVelAndTqBasdScaFacMax_Val" 0 DISPLAY_IDENTIFIER CalRegn03Cmn.CalibrationPorts.TqLoaMotVelAndTqBasdScaFacMax.Val /end CHARACTERISTIC
/begin CHARACTERISTIC CalRegn03Cmn.TqLoaMotVelAndTqBasdScaFacMin.Val "MICROSAR RTE" VALUE 0x0 RTE_RL_FLOAT32_IEEE 0 NO_COMPU_METHOD -3.402823466e+38 3.402823466e+38 SYMBOL_LINK "Rte_CalprmRom_CalRegn03Cmn_DEFAULT_RTE_CALPRM_GROUP.TqLoaMotVelAndTqBasdScaFacMin_Val" 0 DISPLAY_IDENTIFIER CalRegn03Cmn.CalibrationPorts.TqLoaMotVelAndTqBasdScaFacMin.Val /end CHARACTERISTIC
/begin CHARACTERISTIC CalRegn03Cmn.TqLoaMotVelAndTqBasdScaFacRiseRate.Val "MICROSAR RTE" VALUE 0x0 RTE_RL_FLOAT32_IEEE 0 NO_COMPU_METHOD -3.402823466e+38 3.402823466e+38 SYMBOL_LINK "Rte_CalprmRom_CalRegn03Cmn_DEFAULT_RTE_CALPRM_GROUP.TqLoaMotVelAndTqBasdScaFacRiseRate_Val" 0 DISPLAY_IDENTIFIER CalRegn03Cmn.CalibrationPorts.TqLoaMotVelAndTqBasdScaFacRiseRate.Val /end CHARACTERISTIC
/begin CHARACTERISTIC CalRegn03Cmn.TqLoaMotVelMgnThd.Val "MICROSAR RTE" VALUE 0x0 RTE_RL_FLOAT32_IEEE 0 NO_COMPU_METHOD -3.402823466e+38 3.402823466e+38 SYMBOL_LINK "Rte_CalprmRom_CalRegn03Cmn_DEFAULT_RTE_CALPRM_GROUP.TqLoaMotVelMgnThd_Val" 0 DISPLAY_IDENTIFIER CalRegn03Cmn.CalibrationPorts.TqLoaMotVelMgnThd.Val /end CHARACTERISTIC
/begin CHARACTERISTIC CalRegn03Cmn.TqLoaTqCmdLimY.Ary1D "MICROSAR RTE" VAL_BLK 0x0 RTE_RL_UWORD 0 NO_COMPU_METHOD 0 65535 MATRIX_DIM 8 1 1 SYMBOL_LINK "Rte_CalprmRom_CalRegn03Cmn_DEFAULT_RTE_CALPRM_GROUP.TqLoaTqCmdLimY_Ary1D" 0 DISPLAY_IDENTIFIER CalRegn03Cmn.CalibrationPorts.TqLoaTqCmdLimY.Ary1D /end CHARACTERISTIC
/begin CHARACTERISTIC CalRegn03Cmn.TqLoaTqCmdMgnThd.Val "MICROSAR RTE" VALUE 0x0 RTE_RL_FLOAT32_IEEE 0 NO_COMPU_METHOD -3.402823466e+38 3.402823466e+38 SYMBOL_LINK "Rte_CalprmRom_CalRegn03Cmn_DEFAULT_RTE_CALPRM_GROUP.TqLoaTqCmdMgnThd_Val" 0 DISPLAY_IDENTIFIER CalRegn03Cmn.CalibrationPorts.TqLoaTqCmdMgnThd.Val /end CHARACTERISTIC
/begin CHARACTERISTIC CalRegn03Cmn.TqLoaVehLatADifScaFacFallRate.Val "MICROSAR RTE" VALUE 0x0 RTE_RL_FLOAT32_IEEE 0 NO_COMPU_METHOD -3.402823466e+38 3.402823466e+38 SYMBOL_LINK "Rte_CalprmRom_CalRegn03Cmn_DEFAULT_RTE_CALPRM_GROUP.TqLoaVehLatADifScaFacFallRate_Val" 0 DISPLAY_IDENTIFIER CalRegn03Cmn.CalibrationPorts.TqLoaVehLatADifScaFacFallRate.Val /end CHARACTERISTIC
/begin CHARACTERISTIC CalRegn03Cmn.TqLoaVehLatADifScaFacRiseRate.Val "MICROSAR RTE" VALUE 0x0 RTE_RL_FLOAT32_IEEE 0 NO_COMPU_METHOD -3.402823466e+38 3.402823466e+38 SYMBOL_LINK "Rte_CalprmRom_CalRegn03Cmn_DEFAULT_RTE_CALPRM_GROUP.TqLoaVehLatADifScaFacRiseRate_Val" 0 DISPLAY_IDENTIFIER CalRegn03Cmn.CalibrationPorts.TqLoaVehLatADifScaFacRiseRate.Val /end CHARACTERISTIC
/begin CHARACTERISTIC CalRegn03Cmn.TqLoaVehLatADifScaFacX.Ary1D "MICROSAR RTE" VAL_BLK 0x0 RTE_RL_UWORD 0 NO_COMPU_METHOD 0 65535 MATRIX_DIM 4 1 1 SYMBOL_LINK "Rte_CalprmRom_CalRegn03Cmn_DEFAULT_RTE_CALPRM_GROUP.TqLoaVehLatADifScaFacX_Ary1D" 0 DISPLAY_IDENTIFIER CalRegn03Cmn.CalibrationPorts.TqLoaVehLatADifScaFacX.Ary1D /end CHARACTERISTIC
/begin CHARACTERISTIC CalRegn03Cmn.TqLoaVehLatADifScaFacY.Ary2D "MICROSAR RTE" VAL_BLK 0x0 RTE_RL_UWORD 0 NO_COMPU_METHOD 0 65535 MATRIX_DIM 4 8 1 SYMBOL_LINK "Rte_CalprmRom_CalRegn03Cmn_DEFAULT_RTE_CALPRM_GROUP.TqLoaVehLatADifScaFacY_Ary2D" 0 DISPLAY_IDENTIFIER CalRegn03Cmn.CalibrationPorts.TqLoaVehLatADifScaFacY.Ary2D /end CHARACTERISTIC
/begin CHARACTERISTIC CalRegn03Cmn.TqLoaVehLatAEstimnFilFrq.Val "MICROSAR RTE" VALUE 0x0 RTE_RL_FLOAT32_IEEE 0 NO_COMPU_METHOD -3.402823466e+38 3.402823466e+38 SYMBOL_LINK "Rte_CalprmRom_CalRegn03Cmn_DEFAULT_RTE_CALPRM_GROUP.TqLoaVehLatAEstimnFilFrq_Val" 0 DISPLAY_IDENTIFIER CalRegn03Cmn.CalibrationPorts.TqLoaVehLatAEstimnFilFrq.Val /end CHARACTERISTIC
/begin CHARACTERISTIC CalRegn03Cmn.TqLoaVehLatAGainY.Ary1D "MICROSAR RTE" VAL_BLK 0x0 RTE_RL_UWORD 0 NO_COMPU_METHOD 0 65535 MATRIX_DIM 8 1 1 SYMBOL_LINK "Rte_CalprmRom_CalRegn03Cmn_DEFAULT_RTE_CALPRM_GROUP.TqLoaVehLatAGainY_Ary1D" 0 DISPLAY_IDENTIFIER CalRegn03Cmn.CalibrationPorts.TqLoaVehLatAGainY.Ary1D /end CHARACTERISTIC
/begin CHARACTERISTIC CalRegn03Cmn.TqLoaVehSpdScaFacX.Ary1D "MICROSAR RTE" VAL_BLK 0x0 RTE_RL_UWORD 0 NO_COMPU_METHOD 0 65535 MATRIX_DIM 5 1 1 SYMBOL_LINK "Rte_CalprmRom_CalRegn03Cmn_DEFAULT_RTE_CALPRM_GROUP.TqLoaVehSpdScaFacX_Ary1D" 0 DISPLAY_IDENTIFIER CalRegn03Cmn.CalibrationPorts.TqLoaVehSpdScaFacX.Ary1D /end CHARACTERISTIC
/begin CHARACTERISTIC CalRegn03Cmn.TqLoaVehSpdScaFacY.Ary1D "MICROSAR RTE" VAL_BLK 0x0 RTE_RL_UWORD 0 NO_COMPU_METHOD 0 65535 MATRIX_DIM 5 1 1 SYMBOL_LINK "Rte_CalprmRom_CalRegn03Cmn_DEFAULT_RTE_CALPRM_GROUP.TqLoaVehSpdScaFacY_Ary1D" 0 DISPLAY_IDENTIFIER CalRegn03Cmn.CalibrationPorts.TqLoaVehSpdScaFacY.Ary1D /end CHARACTERISTIC
/begin CHARACTERISTIC CalRegn03Cmn.TqLoaVehSpdX.Ary1D "MICROSAR RTE" VAL_BLK 0x0 RTE_RL_UWORD 0 NO_COMPU_METHOD 0 65535 MATRIX_DIM 8 1 1 SYMBOL_LINK "Rte_CalprmRom_CalRegn03Cmn_DEFAULT_RTE_CALPRM_GROUP.TqLoaVehSpdX_Ary1D" 0 DISPLAY_IDENTIFIER CalRegn03Cmn.CalibrationPorts.TqLoaVehSpdX.Ary1D /end CHARACTERISTIC
/begin CHARACTERISTIC CalRegn03Cmn.TqLoaVehSteerRat.Val "MICROSAR RTE" VALUE 0x0 RTE_RL_FLOAT32_IEEE 0 NO_COMPU_METHOD -3.402823466e+38 3.402823466e+38 SYMBOL_LINK "Rte_CalprmRom_CalRegn03Cmn_DEFAULT_RTE_CALPRM_GROUP.TqLoaVehSteerRat_Val" 0 DISPLAY_IDENTIFIER CalRegn03Cmn.CalibrationPorts.TqLoaVehSteerRat.Val /end CHARACTERISTIC
/begin CHARACTERISTIC CalRegn03Cmn.TqLoaVehUnderSteerGrdt.Val "MICROSAR RTE" VALUE 0x0 RTE_RL_FLOAT32_IEEE 0 NO_COMPU_METHOD -3.402823466e+38 3.402823466e+38 SYMBOL_LINK "Rte_CalprmRom_CalRegn03Cmn_DEFAULT_RTE_CALPRM_GROUP.TqLoaVehUnderSteerGrdt_Val" 0 DISPLAY_IDENTIFIER CalRegn03Cmn.CalibrationPorts.TqLoaVehUnderSteerGrdt.Val /end CHARACTERISTIC
/begin CHARACTERISTIC CalRegn03Cmn.TqLoaVehWhlBas.Val "MICROSAR RTE" VALUE 0x0 RTE_RL_FLOAT32_IEEE 0 NO_COMPU_METHOD -3.402823466e+38 3.402823466e+38 SYMBOL_LINK "Rte_CalprmRom_CalRegn03Cmn_DEFAULT_RTE_CALPRM_GROUP.TqLoaVehWhlBas_Val" 0 DISPLAY_IDENTIFIER CalRegn03Cmn.CalibrationPorts.TqLoaVehWhlBas.Val /end CHARACTERISTIC
/begin CHARACTERISTIC CalRegn03Cmn.WhlImbRejctnCmdMgnLp1FilFrq.Val "MICROSAR RTE" VALUE 0x0 RTE_RL_FLOAT32_IEEE 0 NO_COMPU_METHOD -3.402823466e+38 3.402823466e+38 SYMBOL_LINK "Rte_CalprmRom_CalRegn03Cmn_DEFAULT_RTE_CALPRM_GROUP.WhlImbRejctnCmdMgnLp1FilFrq_Val" 0 DISPLAY_IDENTIFIER CalRegn03Cmn.CalibrationPorts.WhlImbRejctnCmdMgnLp1FilFrq.Val /end CHARACTERISTIC
/begin CHARACTERISTIC CalRegn03Cmn.WhlImbRejctnCmdMgnLp2FilFrq.Val "MICROSAR RTE" VALUE 0x0 RTE_RL_FLOAT32_IEEE 0 NO_COMPU_METHOD -3.402823466e+38 3.402823466e+38 SYMBOL_LINK "Rte_CalprmRom_CalRegn03Cmn_DEFAULT_RTE_CALPRM_GROUP.WhlImbRejctnCmdMgnLp2FilFrq_Val" 0 DISPLAY_IDENTIFIER CalRegn03Cmn.CalibrationPorts.WhlImbRejctnCmdMgnLp2FilFrq.Val /end CHARACTERISTIC
/begin CHARACTERISTIC CalRegn03Cmn.WhlImbRejctnDcTrendLpFil.Val "MICROSAR RTE" VALUE 0x0 RTE_RL_FLOAT32_IEEE 0 NO_COMPU_METHOD -3.402823466e+38 3.402823466e+38 SYMBOL_LINK "Rte_CalprmRom_CalRegn03Cmn_DEFAULT_RTE_CALPRM_GROUP.WhlImbRejctnDcTrendLpFil_Val" 0 DISPLAY_IDENTIFIER CalRegn03Cmn.CalibrationPorts.WhlImbRejctnDcTrendLpFil.Val /end CHARACTERISTIC
/begin CHARACTERISTIC CalRegn03CmnGroupA.AssiThermScaX.Ary1D "MICROSAR RTE" VAL_BLK 0x0 RTE_RL_UWORD 0 NO_COMPU_METHOD 0.0 200.0 MATRIX_DIM 2 1 1 SYMBOL_LINK "Rte_CalprmRom_CalRegn03CmnGroupA_DEFAULT_RTE_CALPRM_GROUP.AssiThermScaX_Ary1D" 0 DISPLAY_IDENTIFIER CalRegn03CmnGroupA.CalibrationPorts.AssiThermScaX.Ary1D /end CHARACTERISTIC
/begin CHARACTERISTIC CalRegn03CmnGroupA.AssiThermScaY.Ary1D "MICROSAR RTE" VAL_BLK 0x0 RTE_RL_UWORD 0 RTE_CM_Uls4 0 1 MATRIX_DIM 2 1 1 SYMBOL_LINK "Rte_CalprmRom_CalRegn03CmnGroupA_DEFAULT_RTE_CALPRM_GROUP.AssiThermScaY_Ary1D" 0 DISPLAY_IDENTIFIER CalRegn03CmnGroupA.CalibrationPorts.AssiThermScaY.Ary1D /end CHARACTERISTIC
/begin CHARACTERISTIC CalRegn03CmnGroupA.DampgHwTqX.Ary1D "MICROSAR RTE" VAL_BLK 0x0 RTE_RL_UWORD 0 RTE_CM_Tq6 0 10 MATRIX_DIM 2 1 1 SYMBOL_LINK "Rte_CalprmRom_CalRegn03CmnGroupA_DEFAULT_RTE_CALPRM_GROUP.DampgHwTqX_Ary1D" 0 DISPLAY_IDENTIFIER CalRegn03CmnGroupA.CalibrationPorts.DampgHwTqX.Ary1D /end CHARACTERISTIC
/begin CHARACTERISTIC CalRegn03CmnGroupA.DampgHwTqY.Ary1D "MICROSAR RTE" VAL_BLK 0x0 RTE_RL_UWORD 0 RTE_CM_Uls15 0 1 MATRIX_DIM 2 1 1 SYMBOL_LINK "Rte_CalprmRom_CalRegn03CmnGroupA_DEFAULT_RTE_CALPRM_GROUP.DampgHwTqY_Ary1D" 0 DISPLAY_IDENTIFIER CalRegn03CmnGroupA.CalibrationPorts.DampgHwTqY.Ary1D /end CHARACTERISTIC
/begin CHARACTERISTIC CalRegn03CmnGroupA.HysCmpEffLossY.Ary1D "MICROSAR RTE" VAL_BLK 0x0 RTE_RL_UWORD 0 NO_COMPU_METHOD 0 65535 MATRIX_DIM 12 1 1 SYMBOL_LINK "Rte_CalprmRom_CalRegn03CmnGroupA_DEFAULT_RTE_CALPRM_GROUP.HysCmpEffLossY_Ary1D" 0 DISPLAY_IDENTIFIER CalRegn03CmnGroupA.CalibrationPorts.HysCmpEffLossY.Ary1D /end CHARACTERISTIC
/begin CHARACTERISTIC CalRegn03CmnGroupA.HysCmpEffOffsY.Ary1D "MICROSAR RTE" VAL_BLK 0x0 RTE_RL_UWORD 0 NO_COMPU_METHOD 0 65535 MATRIX_DIM 12 1 1 SYMBOL_LINK "Rte_CalprmRom_CalRegn03CmnGroupA_DEFAULT_RTE_CALPRM_GROUP.HysCmpEffOffsY_Ary1D" 0 DISPLAY_IDENTIFIER CalRegn03CmnGroupA.CalibrationPorts.HysCmpEffOffsY.Ary1D /end CHARACTERISTIC
/begin CHARACTERISTIC CalRegn03CmnGroupA.HysCmpHwTqScaX.Ary2D "MICROSAR RTE" VAL_BLK 0x0 RTE_RL_UWORD 0 NO_COMPU_METHOD 0 65535 MATRIX_DIM 8 12 1 SYMBOL_LINK "Rte_CalprmRom_CalRegn03CmnGroupA_DEFAULT_RTE_CALPRM_GROUP.HysCmpHwTqScaX_Ary2D" 0 DISPLAY_IDENTIFIER CalRegn03CmnGroupA.CalibrationPorts.HysCmpHwTqScaX.Ary2D /end CHARACTERISTIC
/begin CHARACTERISTIC CalRegn03CmnGroupA.HysCmpHwTqScaY.Ary2D "MICROSAR RTE" VAL_BLK 0x0 RTE_RL_UWORD 0 NO_COMPU_METHOD 0 65535 MATRIX_DIM 8 12 1 SYMBOL_LINK "Rte_CalprmRom_CalRegn03CmnGroupA_DEFAULT_RTE_CALPRM_GROUP.HysCmpHwTqScaY_Ary2D" 0 DISPLAY_IDENTIFIER CalRegn03CmnGroupA.CalibrationPorts.HysCmpHwTqScaY.Ary2D /end CHARACTERISTIC
/begin CHARACTERISTIC CalRegn03CmnGroupA.HysCmpHysSatnY.Ary1D "MICROSAR RTE" VAL_BLK 0x0 RTE_RL_UWORD 0 NO_COMPU_METHOD 0 65535 MATRIX_DIM 12 1 1 SYMBOL_LINK "Rte_CalprmRom_CalRegn03CmnGroupA_DEFAULT_RTE_CALPRM_GROUP.HysCmpHysSatnY_Ary1D" 0 DISPLAY_IDENTIFIER CalRegn03CmnGroupA.CalibrationPorts.HysCmpHysSatnY.Ary1D /end CHARACTERISTIC
/begin CHARACTERISTIC CalRegn03CmnGroupA.HysCmpNegHysCmpScaX.Ary1D "MICROSAR RTE" VAL_BLK 0x0 RTE_RL_UWORD 0 NO_COMPU_METHOD 0 65535 MATRIX_DIM 5 1 1 SYMBOL_LINK "Rte_CalprmRom_CalRegn03CmnGroupA_DEFAULT_RTE_CALPRM_GROUP.HysCmpNegHysCmpScaX_Ary1D" 0 DISPLAY_IDENTIFIER CalRegn03CmnGroupA.CalibrationPorts.HysCmpNegHysCmpScaX.Ary1D /end CHARACTERISTIC
/begin CHARACTERISTIC CalRegn03CmnGroupA.HysCmpNegHysCmpScaY.Ary1D "MICROSAR RTE" VAL_BLK 0x0 RTE_RL_UWORD 0 NO_COMPU_METHOD 0 65535 MATRIX_DIM 5 1 1 SYMBOL_LINK "Rte_CalprmRom_CalRegn03CmnGroupA_DEFAULT_RTE_CALPRM_GROUP.HysCmpNegHysCmpScaY_Ary1D" 0 DISPLAY_IDENTIFIER CalRegn03CmnGroupA.CalibrationPorts.HysCmpNegHysCmpScaY.Ary1D /end CHARACTERISTIC
/begin CHARACTERISTIC CalRegn03CmnGroupA.HysCmpNegHysCmpX.Ary1D "MICROSAR RTE" VAL_BLK 0x0 RTE_RL_UWORD 0 NO_COMPU_METHOD 0 65535 MATRIX_DIM 8 1 1 SYMBOL_LINK "Rte_CalprmRom_CalRegn03CmnGroupA_DEFAULT_RTE_CALPRM_GROUP.HysCmpNegHysCmpX_Ary1D" 0 DISPLAY_IDENTIFIER CalRegn03CmnGroupA.CalibrationPorts.HysCmpNegHysCmpX.Ary1D /end CHARACTERISTIC
/begin CHARACTERISTIC CalRegn03CmnGroupA.HysCmpNegHysCmpY.Ary1D "MICROSAR RTE" VAL_BLK 0x0 RTE_RL_UWORD 0 NO_COMPU_METHOD 0 65535 MATRIX_DIM 8 1 1 SYMBOL_LINK "Rte_CalprmRom_CalRegn03CmnGroupA_DEFAULT_RTE_CALPRM_GROUP.HysCmpNegHysCmpY_Ary1D" 0 DISPLAY_IDENTIFIER CalRegn03CmnGroupA.CalibrationPorts.HysCmpNegHysCmpY.Ary1D /end CHARACTERISTIC
/begin CHARACTERISTIC CalRegn03CmnGroupA.HysCmpOutpLim.Val "MICROSAR RTE" VALUE 0x0 RTE_RL_FLOAT32_IEEE 0 NO_COMPU_METHOD -3.402823466e+38 3.402823466e+38 SYMBOL_LINK "Rte_CalprmRom_CalRegn03CmnGroupA_DEFAULT_RTE_CALPRM_GROUP.HysCmpOutpLim_Val" 0 DISPLAY_IDENTIFIER CalRegn03CmnGroupA.CalibrationPorts.HysCmpOutpLim.Val /end CHARACTERISTIC
/begin CHARACTERISTIC CalRegn03CmnGroupA.HysCmpRevGain.Val "MICROSAR RTE" VALUE 0x0 RTE_RL_FLOAT32_IEEE 0 NO_COMPU_METHOD -3.402823466e+38 3.402823466e+38 SYMBOL_LINK "Rte_CalprmRom_CalRegn03CmnGroupA_DEFAULT_RTE_CALPRM_GROUP.HysCmpRevGain_Val" 0 DISPLAY_IDENTIFIER CalRegn03CmnGroupA.CalibrationPorts.HysCmpRevGain.Val /end CHARACTERISTIC
/begin CHARACTERISTIC CalRegn03CmnGroupA.HysCmpRiseX.Ary1D "MICROSAR RTE" VAL_BLK 0x0 RTE_RL_UWORD 0 NO_COMPU_METHOD 0 65535 MATRIX_DIM 6 1 1 SYMBOL_LINK "Rte_CalprmRom_CalRegn03CmnGroupA_DEFAULT_RTE_CALPRM_GROUP.HysCmpRiseX_Ary1D" 0 DISPLAY_IDENTIFIER CalRegn03CmnGroupA.CalibrationPorts.HysCmpRiseX.Ary1D /end CHARACTERISTIC
/begin CHARACTERISTIC CalRegn03CmnGroupA.HysCmpRiseY.Ary1D "MICROSAR RTE" VAL_BLK 0x0 RTE_RL_UWORD 0 NO_COMPU_METHOD 0 65535 MATRIX_DIM 6 1 1 SYMBOL_LINK "Rte_CalprmRom_CalRegn03CmnGroupA_DEFAULT_RTE_CALPRM_GROUP.HysCmpRiseY_Ary1D" 0 DISPLAY_IDENTIFIER CalRegn03CmnGroupA.CalibrationPorts.HysCmpRiseY.Ary1D /end CHARACTERISTIC
/begin CHARACTERISTIC CalRegn03CmnGroupA.RtnVehSpdSeln.Ary1D "MICROSAR RTE" VAL_BLK 0x0 RTE_RL_UWORD 0 RTE_CM_Spd2 0 511 MATRIX_DIM 9 1 1 SYMBOL_LINK "Rte_CalprmRom_CalRegn03CmnGroupA_DEFAULT_RTE_CALPRM_GROUP.RtnVehSpdSeln_Ary1D" 0 DISPLAY_IDENTIFIER CalRegn03CmnGroupA.CalibrationPorts.RtnVehSpdSeln.Ary1D /end CHARACTERISTIC
/begin CHARACTERISTIC CalRegn03CmnGroupB.EotProtnActvRegnBypMaxThd.Val "MICROSAR RTE" VALUE 0x0 RTE_RL_FLOAT32_IEEE 0 NO_COMPU_METHOD -3.402823466e+38 3.402823466e+38 SYMBOL_LINK "Rte_CalprmRom_CalRegn03CmnGroupB_DEFAULT_RTE_CALPRM_GROUP.EotProtnActvRegnBypMaxThd_Val" 0 DISPLAY_IDENTIFIER CalRegn03CmnGroupB.CalibrationPorts.EotProtnActvRegnBypMaxThd.Val /end CHARACTERISTIC
/begin CHARACTERISTIC CalRegn03CmnGroupB.EotProtnDeltaTqThd.Val "MICROSAR RTE" VALUE 0x0 RTE_RL_FLOAT32_IEEE 0 NO_COMPU_METHOD -3.402823466e+38 3.402823466e+38 SYMBOL_LINK "Rte_CalprmRom_CalRegn03CmnGroupB_DEFAULT_RTE_CALPRM_GROUP.EotProtnDeltaTqThd_Val" 0 DISPLAY_IDENTIFIER CalRegn03CmnGroupB.CalibrationPorts.EotProtnDeltaTqThd.Val /end CHARACTERISTIC
/begin CHARACTERISTIC CalRegn03CmnGroupB.EotProtnMotSpdIncptY.Ary1D "MICROSAR RTE" VAL_BLK 0x0 RTE_RL_UWORD 0 NO_COMPU_METHOD 0 65535 MATRIX_DIM 2 1 1 SYMBOL_LINK "Rte_CalprmRom_CalRegn03CmnGroupB_DEFAULT_RTE_CALPRM_GROUP.EotProtnMotSpdIncptY_Ary1D" 0 DISPLAY_IDENTIFIER CalRegn03CmnGroupB.CalibrationPorts.EotProtnMotSpdIncptY.Ary1D /end CHARACTERISTIC
/begin CHARACTERISTIC CalRegn03CmnGroupB.InertiaCmpVelDampgWhlImbRejctnBlndX.Ary1D "MICROSAR RTE" VAL_BLK 0x0 RTE_RL_UWORD 0 NO_COMPU_METHOD 0 65535 MATRIX_DIM 5 1 1 SYMBOL_LINK "Rte_CalprmRom_CalRegn03CmnGroupB_DEFAULT_RTE_CALPRM_GROUP.InertiaCmpVelDampgWhlImbRejctnBlndX_Ary1D" 0 DISPLAY_IDENTIFIER CalRegn03CmnGroupB.CalibrationPorts.InertiaCmpVelDampgWhlImbRejctnBlndX.Ary1D /end CHARACTERISTIC
/begin CHARACTERISTIC CalRegn03CmnGroupB.InertiaCmpVelDampgWhlImbRejctnBlndY.Ary1D "MICROSAR RTE" VAL_BLK 0x0 RTE_RL_UWORD 0 NO_COMPU_METHOD 0 65535 MATRIX_DIM 5 1 1 SYMBOL_LINK "Rte_CalprmRom_CalRegn03CmnGroupB_DEFAULT_RTE_CALPRM_GROUP.InertiaCmpVelDampgWhlImbRejctnBlndY_Ary1D" 0 DISPLAY_IDENTIFIER CalRegn03CmnGroupB.CalibrationPorts.InertiaCmpVelDampgWhlImbRejctnBlndY.Ary1D /end CHARACTERISTIC
/begin CHARACTERISTIC CalRegn03CmnGroupB.PullCmpActvCmpLrnTiDecShoTerm.Val "MICROSAR RTE" VALUE 0x0 RTE_RL_FLOAT32_IEEE 0 NO_COMPU_METHOD -3.402823466e+38 3.402823466e+38 SYMBOL_LINK "Rte_CalprmRom_CalRegn03CmnGroupB_DEFAULT_RTE_CALPRM_GROUP.PullCmpActvCmpLrnTiDecShoTerm_Val" 0 DISPLAY_IDENTIFIER CalRegn03CmnGroupB.CalibrationPorts.PullCmpActvCmpLrnTiDecShoTerm.Val /end CHARACTERISTIC
/begin CHARACTERISTIC CalRegn03CmnGroupB.PullCmpActvCmpLrnTiIncShoTerm.Val "MICROSAR RTE" VALUE 0x0 RTE_RL_FLOAT32_IEEE 0 NO_COMPU_METHOD -3.402823466e+38 3.402823466e+38 SYMBOL_LINK "Rte_CalprmRom_CalRegn03CmnGroupB_DEFAULT_RTE_CALPRM_GROUP.PullCmpActvCmpLrnTiIncShoTerm_Val" 0 DISPLAY_IDENTIFIER CalRegn03CmnGroupB.CalibrationPorts.PullCmpActvCmpLrnTiIncShoTerm.Val /end CHARACTERISTIC
/begin CHARACTERISTIC CalRegn03CmnGroupB.PullCmpActvCmpLrnTiLongTerm.Val "MICROSAR RTE" VALUE 0x0 RTE_RL_FLOAT32_IEEE 0 NO_COMPU_METHOD -3.402823466e+38 3.402823466e+38 SYMBOL_LINK "Rte_CalprmRom_CalRegn03CmnGroupB_DEFAULT_RTE_CALPRM_GROUP.PullCmpActvCmpLrnTiLongTerm_Val" 0 DISPLAY_IDENTIFIER CalRegn03CmnGroupB.CalibrationPorts.PullCmpActvCmpLrnTiLongTerm.Val /end CHARACTERISTIC
/begin CHARACTERISTIC CalRegn03CmnGroupB.PullCmpActvCmpShoTermRstHwAgThd.Val "MICROSAR RTE" VALUE 0x0 RTE_RL_FLOAT32_IEEE 0 NO_COMPU_METHOD -3.402823466e+38 3.402823466e+38 SYMBOL_LINK "Rte_CalprmRom_CalRegn03CmnGroupB_DEFAULT_RTE_CALPRM_GROUP.PullCmpActvCmpShoTermRstHwAgThd_Val" 0 DISPLAY_IDENTIFIER CalRegn03CmnGroupB.CalibrationPorts.PullCmpActvCmpShoTermRstHwAgThd.Val /end CHARACTERISTIC
/begin CHARACTERISTIC CalRegn03CmnGroupB.PullCmpActvCmpShoTermRstHwTqThd.Val "MICROSAR RTE" VALUE 0x0 RTE_RL_FLOAT32_IEEE 0 NO_COMPU_METHOD -3.402823466e+38 3.402823466e+38 SYMBOL_LINK "Rte_CalprmRom_CalRegn03CmnGroupB_DEFAULT_RTE_CALPRM_GROUP.PullCmpActvCmpShoTermRstHwTqThd_Val" 0 DISPLAY_IDENTIFIER CalRegn03CmnGroupB.CalibrationPorts.PullCmpActvCmpShoTermRstHwTqThd.Val /end CHARACTERISTIC
/begin CHARACTERISTIC CalRegn03CmnGroupB.PullCmpActvCmpShoTermRstLatAThd.Val "MICROSAR RTE" VALUE 0x0 RTE_RL_FLOAT32_IEEE 0 NO_COMPU_METHOD -3.402823466e+38 3.402823466e+38 SYMBOL_LINK "Rte_CalprmRom_CalRegn03CmnGroupB_DEFAULT_RTE_CALPRM_GROUP.PullCmpActvCmpShoTermRstLatAThd_Val" 0 DISPLAY_IDENTIFIER CalRegn03CmnGroupB.CalibrationPorts.PullCmpActvCmpShoTermRstLatAThd.Val /end CHARACTERISTIC
/begin CHARACTERISTIC CalRegn03CmnGroupB.PullCmpActvCmpShoTermRstYawRateThd.Val "MICROSAR RTE" VALUE 0x0 RTE_RL_FLOAT32_IEEE 0 NO_COMPU_METHOD -3.402823466e+38 3.402823466e+38 SYMBOL_LINK "Rte_CalprmRom_CalRegn03CmnGroupB_DEFAULT_RTE_CALPRM_GROUP.PullCmpActvCmpShoTermRstYawRateThd_Val" 0 DISPLAY_IDENTIFIER CalRegn03CmnGroupB.CalibrationPorts.PullCmpActvCmpShoTermRstYawRateThd.Val /end CHARACTERISTIC
/begin CHARACTERISTIC CalRegn03CmnGroupB.PullCmpActvHwTqFilFrqLongTerm.Val "MICROSAR RTE" VALUE 0x0 RTE_RL_FLOAT32_IEEE 0 NO_COMPU_METHOD -3.402823466e+38 3.402823466e+38 SYMBOL_LINK "Rte_CalprmRom_CalRegn03CmnGroupB_DEFAULT_RTE_CALPRM_GROUP.PullCmpActvHwTqFilFrqLongTerm_Val" 0 DISPLAY_IDENTIFIER CalRegn03CmnGroupB.CalibrationPorts.PullCmpActvHwTqFilFrqLongTerm.Val /end CHARACTERISTIC
/begin CHARACTERISTIC CalRegn03CmnGroupB.PullCmpActvHwTqFilFrqLrngEna.Val "MICROSAR RTE" VALUE 0x0 RTE_RL_FLOAT32_IEEE 0 NO_COMPU_METHOD -3.402823466e+38 3.402823466e+38 SYMBOL_LINK "Rte_CalprmRom_CalRegn03CmnGroupB_DEFAULT_RTE_CALPRM_GROUP.PullCmpActvHwTqFilFrqLrngEna_Val" 0 DISPLAY_IDENTIFIER CalRegn03CmnGroupB.CalibrationPorts.PullCmpActvHwTqFilFrqLrngEna.Val /end CHARACTERISTIC
/begin CHARACTERISTIC CalRegn03CmnGroupB.PullCmpActvHwTqFilFrqShoTerm.Val "MICROSAR RTE" VALUE 0x0 RTE_RL_FLOAT32_IEEE 0 NO_COMPU_METHOD -3.402823466e+38 3.402823466e+38 SYMBOL_LINK "Rte_CalprmRom_CalRegn03CmnGroupB_DEFAULT_RTE_CALPRM_GROUP.PullCmpActvHwTqFilFrqShoTerm_Val" 0 DISPLAY_IDENTIFIER CalRegn03CmnGroupB.CalibrationPorts.PullCmpActvHwTqFilFrqShoTerm.Val /end CHARACTERISTIC
/begin CHARACTERISTIC CalRegn03CmnGroupB.PullCmpActvLongTermLim.Val "MICROSAR RTE" VALUE 0x0 RTE_RL_FLOAT32_IEEE 0 NO_COMPU_METHOD -3.402823466e+38 3.402823466e+38 SYMBOL_LINK "Rte_CalprmRom_CalRegn03CmnGroupB_DEFAULT_RTE_CALPRM_GROUP.PullCmpActvLongTermLim_Val" 0 DISPLAY_IDENTIFIER CalRegn03CmnGroupB.CalibrationPorts.PullCmpActvLongTermLim.Val /end CHARACTERISTIC
/begin CHARACTERISTIC CalRegn03CmnGroupB.PullCmpActvLrngEnaAgConfMinMgn.Val "MICROSAR RTE" VALUE 0x0 RTE_RL_FLOAT32_IEEE 0 NO_COMPU_METHOD -3.402823466e+38 3.402823466e+38 SYMBOL_LINK "Rte_CalprmRom_CalRegn03CmnGroupB_DEFAULT_RTE_CALPRM_GROUP.PullCmpActvLrngEnaAgConfMinMgn_Val" 0 DISPLAY_IDENTIFIER CalRegn03CmnGroupB.CalibrationPorts.PullCmpActvLrngEnaAgConfMinMgn.Val /end CHARACTERISTIC
/begin CHARACTERISTIC CalRegn03CmnGroupB.PullCmpActvLrngEnaHwAgMaxMgn.Val "MICROSAR RTE" VALUE 0x0 RTE_RL_FLOAT32_IEEE 0 NO_COMPU_METHOD -3.402823466e+38 3.402823466e+38 SYMBOL_LINK "Rte_CalprmRom_CalRegn03CmnGroupB_DEFAULT_RTE_CALPRM_GROUP.PullCmpActvLrngEnaHwAgMaxMgn_Val" 0 DISPLAY_IDENTIFIER CalRegn03CmnGroupB.CalibrationPorts.PullCmpActvLrngEnaHwAgMaxMgn.Val /end CHARACTERISTIC
/begin CHARACTERISTIC CalRegn03CmnGroupB.PullCmpActvLrngEnaHwTqMaxMgn.Val "MICROSAR RTE" VALUE 0x0 RTE_RL_FLOAT32_IEEE 0 NO_COMPU_METHOD -3.402823466e+38 3.402823466e+38 SYMBOL_LINK "Rte_CalprmRom_CalRegn03CmnGroupB_DEFAULT_RTE_CALPRM_GROUP.PullCmpActvLrngEnaHwTqMaxMgn_Val" 0 DISPLAY_IDENTIFIER CalRegn03CmnGroupB.CalibrationPorts.PullCmpActvLrngEnaHwTqMaxMgn.Val /end CHARACTERISTIC
/begin GROUP CalRegn02CmnGroupC.CalibrationPorts "MICROSAR RTE"
 /begin SUB_GROUP CalRegn02CmnGroupC.GmOvrlStMgrApaHaptcEna.Logl CalRegn02CmnGroupC.GmOvrlStMgrApaHwTqThd.Val CalRegn02CmnGroupC.GmOvrlStMgrApaVehSpdHiLim.Val CalRegn02CmnGroupC.GmOvrlStMgrEscVehSpdHiLim.Val CalRegn02CmnGroupC.GmOvrlStMgrHaptcAmp.Val CalRegn02CmnGroupC.GmOvrlStMgrHaptcDurn.Val CalRegn02CmnGroupC.GmOvrlStMgrLkaVehSpdHiLim.Val CalRegn02CmnGroupC.GmOvrlStMgrLkaVehSpdLoLim.Val CalRegn02CmnGroupC.HowDetnHiFrqGainY.Ary1D CalRegn02CmnGroupC.HowDetnHiFrqRateX.Ary2D CalRegn02CmnGroupC.HowDetnHiFrqRateY.Ary2D CalRegn02CmnGroupC.HowDetnLoFrqRateX.Ary2D CalRegn02CmnGroupC.HowDetnLoFrqRateY.Ary2D CalRegn02CmnGroupC.HowDetnMinVehSpd.Val CalRegn02CmnGroupC.HowDetnPercOfPrevHowEstim.Val CalRegn02CmnGroupC.HowDetnSlewRate.Val CalRegn02CmnGroupC.HowDetnStThdX.Ary1D CalRegn02CmnGroupC.HowDetnTqHpFilFrq.Val CalRegn02CmnGroupC.HowDetnVehSpd.Ary1D CalRegn02CmnGroupC.SnsrOffsLrngFctEna.Logl CalRegn02CmnGroupC.SnsrOffsLrngHwAgLrngDrvgDstThd.Val CalRegn02CmnGroupC.SnsrOffsLrngHwAgLrngEna.Logl CalRegn02CmnGroupC.SnsrOffsLrngHwAgLrngHwVelThd.Val CalRegn02CmnGroupC.SnsrOffsLrngHwAgLrngSysTqThd.Val CalRegn02CmnGroupC.SnsrOffsLrngHwAgLrngSysTqThdMed.Val CalRegn02CmnGroupC.SnsrOffsLrngHwAgLrngSysTqThdTrustd.Val CalRegn02CmnGroupC.SnsrOffsLrngHwAgLrngSysTqThdWide.Val CalRegn02CmnGroupC.SnsrOffsLrngHwAgLrngVehSpdThd.Val CalRegn02CmnGroupC.SnsrOffsLrngHwAgLrngYawOffsDbnd.Val CalRegn02CmnGroupC.SnsrOffsLrngHwAgLrngYawRateThd.Val CalRegn02CmnGroupC.SnsrOffsLrngHwAgOffsLim.Val CalRegn02CmnGroupC.SnsrOffsLrngHwTqLrngEna.Logl CalRegn02CmnGroupC.SnsrOffsLrngHwTqLrngEnaTiThd.Val CalRegn02CmnGroupC.SnsrOffsLrngHwTqLrngHwAgDbnd.Val CalRegn02CmnGroupC.SnsrOffsLrngHwTqLrngHwAgThd.Val CalRegn02CmnGroupC.SnsrOffsLrngHwTqLrngHwTqThd.Val CalRegn02CmnGroupC.SnsrOffsLrngHwTqLrngHwVelThd.Val CalRegn02CmnGroupC.SnsrOffsLrngHwTqLrngMeasTiScar.Val CalRegn02CmnGroupC.SnsrOffsLrngHwTqLrngVehSpdThd.Val CalRegn02CmnGroupC.SnsrOffsLrngHwTqOffsLim.Val CalRegn02CmnGroupC.SnsrOffsLrngTqInpDetnPwrEstimnThd.Val CalRegn02CmnGroupC.SnsrOffsLrngTqInpDetnSinGenrAmp.Val CalRegn02CmnGroupC.SnsrOffsLrngTqInpDetnSinGenrFrq.Val CalRegn02CmnGroupC.SnsrOffsLrngTqInpDetnStg1FilGain.Val CalRegn02CmnGroupC.SnsrOffsLrngTqInpDetnStg1WinSize.Val CalRegn02CmnGroupC.SnsrOffsLrngTqInpDetnStg2FilGainCen.Val CalRegn02CmnGroupC.SnsrOffsLrngTqInpDetnStg2FilGainDwn.Val CalRegn02CmnGroupC.SnsrOffsLrngTqInpDetnStg2FilGainUp.Val CalRegn02CmnGroupC.SnsrOffsLrngTqInpDetnStg2WinSize.Val CalRegn02CmnGroupC.SnsrOffsLrngYawLrngEna.Logl CalRegn02CmnGroupC.SnsrOffsLrngYawLrngHwAgThd.Val CalRegn02CmnGroupC.SnsrOffsLrngYawLrngYawAThd.Val CalRegn02CmnGroupC.SnsrOffsLrngYawOffsFrshTiThd.Val CalRegn02CmnGroupC.SnsrOffsLrngYawRateOffsLim.Val /end SUB_GROUP
 /begin FUNCTION_LIST /end FUNCTION_LIST
 /begin REF_CHARACTERISTIC /end REF_CHARACTERISTIC
 /begin REF_MEASUREMENT /end REF_MEASUREMENT
/end GROUP
/begin GROUP CalRegn02CmnGroupC.GmOvrlStMgrApaHaptcEna.Logl "MICROSAR RTE" /begin SUB_GROUP /end SUB_GROUP /begin FUNCTION_LIST /end FUNCTION_LIST /begin REF_CHARACTERISTIC CalRegn02CmnGroupC.GmOvrlStMgrApaHaptcEna.Logl /end REF_CHARACTERISTIC /begin REF_MEASUREMENT /end REF_MEASUREMENT /end GROUP
/begin GROUP CalRegn02CmnGroupC.GmOvrlStMgrApaHwTqThd.Val "MICROSAR RTE" /begin SUB_GROUP /end SUB_GROUP /begin FUNCTION_LIST /end FUNCTION_LIST /begin REF_CHARACTERISTIC CalRegn02CmnGroupC.GmOvrlStMgrApaHwTqThd.Val /end REF_CHARACTERISTIC /begin REF_MEASUREMENT /end REF_MEASUREMENT /end GROUP
/begin GROUP CalRegn02CmnGroupC.GmOvrlStMgrApaVehSpdHiLim.Val "MICROSAR RTE" /begin SUB_GROUP /end SUB_GROUP /begin FUNCTION_LIST /end FUNCTION_LIST /begin REF_CHARACTERISTIC CalRegn02CmnGroupC.GmOvrlStMgrApaVehSpdHiLim.Val /end REF_CHARACTERISTIC /begin REF_MEASUREMENT /end REF_MEASUREMENT /end GROUP
/begin GROUP CalRegn02CmnGroupC.GmOvrlStMgrEscVehSpdHiLim.Val "MICROSAR RTE" /begin SUB_GROUP /end SUB_GROUP /begin FUNCTION_LIST /end FUNCTION_LIST /begin REF_CHARACTERISTIC CalRegn02CmnGroupC.GmOvrlStMgrEscVehSpdHiLim.Val /end REF_CHARACTERISTIC /begin REF_MEASUREMENT /end REF_MEASUREMENT /end GROUP
/begin GROUP CalRegn02CmnGroupC.GmOvrlStMgrHaptcAmp.Val "MICROSAR RTE" /begin SUB_GROUP /end SUB_GROUP /begin FUNCTION_LIST /end FUNCTION_LIST /begin REF_CHARACTERISTIC CalRegn02CmnGroupC.GmOvrlStMgrHaptcAmp.Val /end REF_CHARACTERISTIC /begin REF_MEASUREMENT /end REF_MEASUREMENT /end GROUP
/begin GROUP CalRegn02CmnGroupC.GmOvrlStMgrHaptcDurn.Val "MICROSAR RTE" /begin SUB_GROUP /end SUB_GROUP /begin FUNCTION_LIST /end FUNCTION_LIST /begin REF_CHARACTERISTIC CalRegn02CmnGroupC.GmOvrlStMgrHaptcDurn.Val /end REF_CHARACTERISTIC /begin REF_MEASUREMENT /end REF_MEASUREMENT /end GROUP
/begin GROUP CalRegn02CmnGroupC.GmOvrlStMgrLkaVehSpdHiLim.Val "MICROSAR RTE" /begin SUB_GROUP /end SUB_GROUP /begin FUNCTION_LIST /end FUNCTION_LIST /begin REF_CHARACTERISTIC CalRegn02CmnGroupC.GmOvrlStMgrLkaVehSpdHiLim.Val /end REF_CHARACTERISTIC /begin REF_MEASUREMENT /end REF_MEASUREMENT /end GROUP
/begin GROUP CalRegn02CmnGroupC.GmOvrlStMgrLkaVehSpdLoLim.Val "MICROSAR RTE" /begin SUB_GROUP /end SUB_GROUP /begin FUNCTION_LIST /end FUNCTION_LIST /begin REF_CHARACTERISTIC CalRegn02CmnGroupC.GmOvrlStMgrLkaVehSpdLoLim.Val /end REF_CHARACTERISTIC /begin REF_MEASUREMENT /end REF_MEASUREMENT /end GROUP
/begin GROUP CalRegn02CmnGroupC.HowDetnHiFrqGainY.Ary1D "MICROSAR RTE" /begin SUB_GROUP /end SUB_GROUP /begin FUNCTION_LIST /end FUNCTION_LIST /begin REF_CHARACTERISTIC CalRegn02CmnGroupC.HowDetnHiFrqGainY.Ary1D /end REF_CHARACTERISTIC /begin REF_MEASUREMENT /end REF_MEASUREMENT /end GROUP
/begin GROUP CalRegn02CmnGroupC.HowDetnHiFrqRateX.Ary2D "MICROSAR RTE" /begin SUB_GROUP /end SUB_GROUP /begin FUNCTION_LIST /end FUNCTION_LIST /begin REF_CHARACTERISTIC CalRegn02CmnGroupC.HowDetnHiFrqRateX.Ary2D /end REF_CHARACTERISTIC /begin REF_MEASUREMENT /end REF_MEASUREMENT /end GROUP
/begin GROUP CalRegn02CmnGroupC.HowDetnHiFrqRateY.Ary2D "MICROSAR RTE" /begin SUB_GROUP /end SUB_GROUP /begin FUNCTION_LIST /end FUNCTION_LIST /begin REF_CHARACTERISTIC CalRegn02CmnGroupC.HowDetnHiFrqRateY.Ary2D /end REF_CHARACTERISTIC /begin REF_MEASUREMENT /end REF_MEASUREMENT /end GROUP
/begin GROUP CalRegn02CmnGroupC.HowDetnLoFrqRateX.Ary2D "MICROSAR RTE" /begin SUB_GROUP /end SUB_GROUP /begin FUNCTION_LIST /end FUNCTION_LIST /begin REF_CHARACTERISTIC CalRegn02CmnGroupC.HowDetnLoFrqRateX.Ary2D /end REF_CHARACTERISTIC /begin REF_MEASUREMENT /end REF_MEASUREMENT /end GROUP
/begin GROUP CalRegn02CmnGroupC.HowDetnLoFrqRateY.Ary2D "MICROSAR RTE" /begin SUB_GROUP /end SUB_GROUP /begin FUNCTION_LIST /end FUNCTION_LIST /begin REF_CHARACTERISTIC CalRegn02CmnGroupC.HowDetnLoFrqRateY.Ary2D /end REF_CHARACTERISTIC /begin REF_MEASUREMENT /end REF_MEASUREMENT /end GROUP
/begin GROUP CalRegn02CmnGroupC.HowDetnMinVehSpd.Val "MICROSAR RTE" /begin SUB_GROUP /end SUB_GROUP /begin FUNCTION_LIST /end FUNCTION_LIST /begin REF_CHARACTERISTIC CalRegn02CmnGroupC.HowDetnMinVehSpd.Val /end REF_CHARACTERISTIC /begin REF_MEASUREMENT /end REF_MEASUREMENT /end GROUP
/begin GROUP CalRegn02CmnGroupC.HowDetnPercOfPrevHowEstim.Val "MICROSAR RTE" /begin SUB_GROUP /end SUB_GROUP /begin FUNCTION_LIST /end FUNCTION_LIST /begin REF_CHARACTERISTIC CalRegn02CmnGroupC.HowDetnPercOfPrevHowEstim.Val /end REF_CHARACTERISTIC /begin REF_MEASUREMENT /end REF_MEASUREMENT /end GROUP
/begin GROUP CalRegn02CmnGroupC.HowDetnSlewRate.Val "MICROSAR RTE" /begin SUB_GROUP /end SUB_GROUP /begin FUNCTION_LIST /end FUNCTION_LIST /begin REF_CHARACTERISTIC CalRegn02CmnGroupC.HowDetnSlewRate.Val /end REF_CHARACTERISTIC /begin REF_MEASUREMENT /end REF_MEASUREMENT /end GROUP
/begin GROUP CalRegn02CmnGroupC.HowDetnStThdX.Ary1D "MICROSAR RTE" /begin SUB_GROUP /end SUB_GROUP /begin FUNCTION_LIST /end FUNCTION_LIST /begin REF_CHARACTERISTIC CalRegn02CmnGroupC.HowDetnStThdX.Ary1D /end REF_CHARACTERISTIC /begin REF_MEASUREMENT /end REF_MEASUREMENT /end GROUP
/begin GROUP CalRegn02CmnGroupC.HowDetnTqHpFilFrq.Val "MICROSAR RTE" /begin SUB_GROUP /end SUB_GROUP /begin FUNCTION_LIST /end FUNCTION_LIST /begin REF_CHARACTERISTIC CalRegn02CmnGroupC.HowDetnTqHpFilFrq.Val /end REF_CHARACTERISTIC /begin REF_MEASUREMENT /end REF_MEASUREMENT /end GROUP
/begin GROUP CalRegn02CmnGroupC.HowDetnVehSpd.Ary1D "MICROSAR RTE" /begin SUB_GROUP /end SUB_GROUP /begin FUNCTION_LIST /end FUNCTION_LIST /begin REF_CHARACTERISTIC CalRegn02CmnGroupC.HowDetnVehSpd.Ary1D /end REF_CHARACTERISTIC /begin REF_MEASUREMENT /end REF_MEASUREMENT /end GROUP
/begin GROUP CalRegn02CmnGroupC.SnsrOffsLrngFctEna.Logl "MICROSAR RTE" /begin SUB_GROUP /end SUB_GROUP /begin FUNCTION_LIST /end FUNCTION_LIST /begin REF_CHARACTERISTIC CalRegn02CmnGroupC.SnsrOffsLrngFctEna.Logl /end REF_CHARACTERISTIC /begin REF_MEASUREMENT /end REF_MEASUREMENT /end GROUP
/begin GROUP CalRegn02CmnGroupC.SnsrOffsLrngHwAgLrngDrvgDstThd.Val "MICROSAR RTE" /begin SUB_GROUP /end SUB_GROUP /begin FUNCTION_LIST /end FUNCTION_LIST /begin REF_CHARACTERISTIC CalRegn02CmnGroupC.SnsrOffsLrngHwAgLrngDrvgDstThd.Val /end REF_CHARACTERISTIC /begin REF_MEASUREMENT /end REF_MEASUREMENT /end GROUP
/begin GROUP CalRegn02CmnGroupC.SnsrOffsLrngHwAgLrngEna.Logl "MICROSAR RTE" /begin SUB_GROUP /end SUB_GROUP /begin FUNCTION_LIST /end FUNCTION_LIST /begin REF_CHARACTERISTIC CalRegn02CmnGroupC.SnsrOffsLrngHwAgLrngEna.Logl /end REF_CHARACTERISTIC /begin REF_MEASUREMENT /end REF_MEASUREMENT /end GROUP
/begin GROUP CalRegn02CmnGroupC.SnsrOffsLrngHwAgLrngHwVelThd.Val "MICROSAR RTE" /begin SUB_GROUP /end SUB_GROUP /begin FUNCTION_LIST /end FUNCTION_LIST /begin REF_CHARACTERISTIC CalRegn02CmnGroupC.SnsrOffsLrngHwAgLrngHwVelThd.Val /end REF_CHARACTERISTIC /begin REF_MEASUREMENT /end REF_MEASUREMENT /end GROUP
/begin GROUP CalRegn02CmnGroupC.SnsrOffsLrngHwAgLrngSysTqThd.Val "MICROSAR RTE" /begin SUB_GROUP /end SUB_GROUP /begin FUNCTION_LIST /end FUNCTION_LIST /begin REF_CHARACTERISTIC CalRegn02CmnGroupC.SnsrOffsLrngHwAgLrngSysTqThd.Val /end REF_CHARACTERISTIC /begin REF_MEASUREMENT /end REF_MEASUREMENT /end GROUP
/begin GROUP CalRegn02CmnGroupC.SnsrOffsLrngHwAgLrngSysTqThdMed.Val "MICROSAR RTE" /begin SUB_GROUP /end SUB_GROUP /begin FUNCTION_LIST /end FUNCTION_LIST /begin REF_CHARACTERISTIC CalRegn02CmnGroupC.SnsrOffsLrngHwAgLrngSysTqThdMed.Val /end REF_CHARACTERISTIC /begin REF_MEASUREMENT /end REF_MEASUREMENT /end GROUP
/begin GROUP CalRegn02CmnGroupC.SnsrOffsLrngHwAgLrngSysTqThdTrustd.Val "MICROSAR RTE" /begin SUB_GROUP /end SUB_GROUP /begin FUNCTION_LIST /end FUNCTION_LIST /begin REF_CHARACTERISTIC CalRegn02CmnGroupC.SnsrOffsLrngHwAgLrngSysTqThdTrustd.Val /end REF_CHARACTERISTIC /begin REF_MEASUREMENT /end REF_MEASUREMENT /end GROUP
/begin GROUP CalRegn02CmnGroupC.SnsrOffsLrngHwAgLrngSysTqThdWide.Val "MICROSAR RTE" /begin SUB_GROUP /end SUB_GROUP /begin FUNCTION_LIST /end FUNCTION_LIST /begin REF_CHARACTERISTIC CalRegn02CmnGroupC.SnsrOffsLrngHwAgLrngSysTqThdWide.Val /end REF_CHARACTERISTIC /begin REF_MEASUREMENT /end REF_MEASUREMENT /end GROUP
/begin GROUP CalRegn02CmnGroupC.SnsrOffsLrngHwAgLrngVehSpdThd.Val "MICROSAR RTE" /begin SUB_GROUP /end SUB_GROUP /begin FUNCTION_LIST /end FUNCTION_LIST /begin REF_CHARACTERISTIC CalRegn02CmnGroupC.SnsrOffsLrngHwAgLrngVehSpdThd.Val /end REF_CHARACTERISTIC /begin REF_MEASUREMENT /end REF_MEASUREMENT /end GROUP
/begin GROUP CalRegn02CmnGroupC.SnsrOffsLrngHwAgLrngYawOffsDbnd.Val "MICROSAR RTE" /begin SUB_GROUP /end SUB_GROUP /begin FUNCTION_LIST /end FUNCTION_LIST /begin REF_CHARACTERISTIC CalRegn02CmnGroupC.SnsrOffsLrngHwAgLrngYawOffsDbnd.Val /end REF_CHARACTERISTIC /begin REF_MEASUREMENT /end REF_MEASUREMENT /end GROUP
/begin GROUP CalRegn02CmnGroupC.SnsrOffsLrngHwAgLrngYawRateThd.Val "MICROSAR RTE" /begin SUB_GROUP /end SUB_GROUP /begin FUNCTION_LIST /end FUNCTION_LIST /begin REF_CHARACTERISTIC CalRegn02CmnGroupC.SnsrOffsLrngHwAgLrngYawRateThd.Val /end REF_CHARACTERISTIC /begin REF_MEASUREMENT /end REF_MEASUREMENT /end GROUP
/begin GROUP CalRegn02CmnGroupC.SnsrOffsLrngHwAgOffsLim.Val "MICROSAR RTE" /begin SUB_GROUP /end SUB_GROUP /begin FUNCTION_LIST /end FUNCTION_LIST /begin REF_CHARACTERISTIC CalRegn02CmnGroupC.SnsrOffsLrngHwAgOffsLim.Val /end REF_CHARACTERISTIC /begin REF_MEASUREMENT /end REF_MEASUREMENT /end GROUP
/begin GROUP CalRegn02CmnGroupC.SnsrOffsLrngHwTqLrngEna.Logl "MICROSAR RTE" /begin SUB_GROUP /end SUB_GROUP /begin FUNCTION_LIST /end FUNCTION_LIST /begin REF_CHARACTERISTIC CalRegn02CmnGroupC.SnsrOffsLrngHwTqLrngEna.Logl /end REF_CHARACTERISTIC /begin REF_MEASUREMENT /end REF_MEASUREMENT /end GROUP
/begin GROUP CalRegn02CmnGroupC.SnsrOffsLrngHwTqLrngEnaTiThd.Val "MICROSAR RTE" /begin SUB_GROUP /end SUB_GROUP /begin FUNCTION_LIST /end FUNCTION_LIST /begin REF_CHARACTERISTIC CalRegn02CmnGroupC.SnsrOffsLrngHwTqLrngEnaTiThd.Val /end REF_CHARACTERISTIC /begin REF_MEASUREMENT /end REF_MEASUREMENT /end GROUP
/begin GROUP CalRegn02CmnGroupC.SnsrOffsLrngHwTqLrngHwAgDbnd.Val "MICROSAR RTE" /begin SUB_GROUP /end SUB_GROUP /begin FUNCTION_LIST /end FUNCTION_LIST /begin REF_CHARACTERISTIC CalRegn02CmnGroupC.SnsrOffsLrngHwTqLrngHwAgDbnd.Val /end REF_CHARACTERISTIC /begin REF_MEASUREMENT /end REF_MEASUREMENT /end GROUP
/begin GROUP CalRegn02CmnGroupC.SnsrOffsLrngHwTqLrngHwAgThd.Val "MICROSAR RTE" /begin SUB_GROUP /end SUB_GROUP /begin FUNCTION_LIST /end FUNCTION_LIST /begin REF_CHARACTERISTIC CalRegn02CmnGroupC.SnsrOffsLrngHwTqLrngHwAgThd.Val /end REF_CHARACTERISTIC /begin REF_MEASUREMENT /end REF_MEASUREMENT /end GROUP
/begin GROUP CalRegn02CmnGroupC.SnsrOffsLrngHwTqLrngHwTqThd.Val "MICROSAR RTE" /begin SUB_GROUP /end SUB_GROUP /begin FUNCTION_LIST /end FUNCTION_LIST /begin REF_CHARACTERISTIC CalRegn02CmnGroupC.SnsrOffsLrngHwTqLrngHwTqThd.Val /end REF_CHARACTERISTIC /begin REF_MEASUREMENT /end REF_MEASUREMENT /end GROUP
/begin GROUP CalRegn02CmnGroupC.SnsrOffsLrngHwTqLrngHwVelThd.Val "MICROSAR RTE" /begin SUB_GROUP /end SUB_GROUP /begin FUNCTION_LIST /end FUNCTION_LIST /begin REF_CHARACTERISTIC CalRegn02CmnGroupC.SnsrOffsLrngHwTqLrngHwVelThd.Val /end REF_CHARACTERISTIC /begin REF_MEASUREMENT /end REF_MEASUREMENT /end GROUP
/begin GROUP CalRegn02CmnGroupC.SnsrOffsLrngHwTqLrngMeasTiScar.Val "MICROSAR RTE" /begin SUB_GROUP /end SUB_GROUP /begin FUNCTION_LIST /end FUNCTION_LIST /begin REF_CHARACTERISTIC CalRegn02CmnGroupC.SnsrOffsLrngHwTqLrngMeasTiScar.Val /end REF_CHARACTERISTIC /begin REF_MEASUREMENT /end REF_MEASUREMENT /end GROUP
/begin GROUP CalRegn02CmnGroupC.SnsrOffsLrngHwTqLrngVehSpdThd.Val "MICROSAR RTE" /begin SUB_GROUP /end SUB_GROUP /begin FUNCTION_LIST /end FUNCTION_LIST /begin REF_CHARACTERISTIC CalRegn02CmnGroupC.SnsrOffsLrngHwTqLrngVehSpdThd.Val /end REF_CHARACTERISTIC /begin REF_MEASUREMENT /end REF_MEASUREMENT /end GROUP
/begin GROUP CalRegn02CmnGroupC.SnsrOffsLrngHwTqOffsLim.Val "MICROSAR RTE" /begin SUB_GROUP /end SUB_GROUP /begin FUNCTION_LIST /end FUNCTION_LIST /begin REF_CHARACTERISTIC CalRegn02CmnGroupC.SnsrOffsLrngHwTqOffsLim.Val /end REF_CHARACTERISTIC /begin REF_MEASUREMENT /end REF_MEASUREMENT /end GROUP
/begin GROUP CalRegn02CmnGroupC.SnsrOffsLrngTqInpDetnPwrEstimnThd.Val "MICROSAR RTE" /begin SUB_GROUP /end SUB_GROUP /begin FUNCTION_LIST /end FUNCTION_LIST /begin REF_CHARACTERISTIC CalRegn02CmnGroupC.SnsrOffsLrngTqInpDetnPwrEstimnThd.Val /end REF_CHARACTERISTIC /begin REF_MEASUREMENT /end REF_MEASUREMENT /end GROUP
/begin GROUP CalRegn02CmnGroupC.SnsrOffsLrngTqInpDetnSinGenrAmp.Val "MICROSAR RTE" /begin SUB_GROUP /end SUB_GROUP /begin FUNCTION_LIST /end FUNCTION_LIST /begin REF_CHARACTERISTIC CalRegn02CmnGroupC.SnsrOffsLrngTqInpDetnSinGenrAmp.Val /end REF_CHARACTERISTIC /begin REF_MEASUREMENT /end REF_MEASUREMENT /end GROUP
/begin GROUP CalRegn02CmnGroupC.SnsrOffsLrngTqInpDetnSinGenrFrq.Val "MICROSAR RTE" /begin SUB_GROUP /end SUB_GROUP /begin FUNCTION_LIST /end FUNCTION_LIST /begin REF_CHARACTERISTIC CalRegn02CmnGroupC.SnsrOffsLrngTqInpDetnSinGenrFrq.Val /end REF_CHARACTERISTIC /begin REF_MEASUREMENT /end REF_MEASUREMENT /end GROUP
/begin GROUP CalRegn02CmnGroupC.SnsrOffsLrngTqInpDetnStg1FilGain.Val "MICROSAR RTE" /begin SUB_GROUP /end SUB_GROUP /begin FUNCTION_LIST /end FUNCTION_LIST /begin REF_CHARACTERISTIC CalRegn02CmnGroupC.SnsrOffsLrngTqInpDetnStg1FilGain.Val /end REF_CHARACTERISTIC /begin REF_MEASUREMENT /end REF_MEASUREMENT /end GROUP
/begin GROUP CalRegn02CmnGroupC.SnsrOffsLrngTqInpDetnStg1WinSize.Val "MICROSAR RTE" /begin SUB_GROUP /end SUB_GROUP /begin FUNCTION_LIST /end FUNCTION_LIST /begin REF_CHARACTERISTIC CalRegn02CmnGroupC.SnsrOffsLrngTqInpDetnStg1WinSize.Val /end REF_CHARACTERISTIC /begin REF_MEASUREMENT /end REF_MEASUREMENT /end GROUP
/begin GROUP CalRegn02CmnGroupC.SnsrOffsLrngTqInpDetnStg2FilGainCen.Val "MICROSAR RTE" /begin SUB_GROUP /end SUB_GROUP /begin FUNCTION_LIST /end FUNCTION_LIST /begin REF_CHARACTERISTIC CalRegn02CmnGroupC.SnsrOffsLrngTqInpDetnStg2FilGainCen.Val /end REF_CHARACTERISTIC /begin REF_MEASUREMENT /end REF_MEASUREMENT /end GROUP
/begin GROUP CalRegn02CmnGroupC.SnsrOffsLrngTqInpDetnStg2FilGainDwn.Val "MICROSAR RTE" /begin SUB_GROUP /end SUB_GROUP /begin FUNCTION_LIST /end FUNCTION_LIST /begin REF_CHARACTERISTIC CalRegn02CmnGroupC.SnsrOffsLrngTqInpDetnStg2FilGainDwn.Val /end REF_CHARACTERISTIC /begin REF_MEASUREMENT /end REF_MEASUREMENT /end GROUP
/begin GROUP CalRegn02CmnGroupC.SnsrOffsLrngTqInpDetnStg2FilGainUp.Val "MICROSAR RTE" /begin SUB_GROUP /end SUB_GROUP /begin FUNCTION_LIST /end FUNCTION_LIST /begin REF_CHARACTERISTIC CalRegn02CmnGroupC.SnsrOffsLrngTqInpDetnStg2FilGainUp.Val /end REF_CHARACTERISTIC /begin REF_MEASUREMENT /end REF_MEASUREMENT /end GROUP
/begin GROUP CalRegn02CmnGroupC.SnsrOffsLrngTqInpDetnStg2WinSize.Val "MICROSAR RTE" /begin SUB_GROUP /end SUB_GROUP /begin FUNCTION_LIST /end FUNCTION_LIST /begin REF_CHARACTERISTIC CalRegn02CmnGroupC.SnsrOffsLrngTqInpDetnStg2WinSize.Val /end REF_CHARACTERISTIC /begin REF_MEASUREMENT /end REF_MEASUREMENT /end GROUP
/begin GROUP CalRegn02CmnGroupC.SnsrOffsLrngYawLrngEna.Logl "MICROSAR RTE" /begin SUB_GROUP /end SUB_GROUP /begin FUNCTION_LIST /end FUNCTION_LIST /begin REF_CHARACTERISTIC CalRegn02CmnGroupC.SnsrOffsLrngYawLrngEna.Logl /end REF_CHARACTERISTIC /begin REF_MEASUREMENT /end REF_MEASUREMENT /end GROUP
/begin GROUP CalRegn02CmnGroupC.SnsrOffsLrngYawLrngHwAgThd.Val "MICROSAR RTE" /begin SUB_GROUP /end SUB_GROUP /begin FUNCTION_LIST /end FUNCTION_LIST /begin REF_CHARACTERISTIC CalRegn02CmnGroupC.SnsrOffsLrngYawLrngHwAgThd.Val /end REF_CHARACTERISTIC /begin REF_MEASUREMENT /end REF_MEASUREMENT /end GROUP
/begin GROUP CalRegn02CmnGroupC.SnsrOffsLrngYawLrngYawAThd.Val "MICROSAR RTE" /begin SUB_GROUP /end SUB_GROUP /begin FUNCTION_LIST /end FUNCTION_LIST /begin REF_CHARACTERISTIC CalRegn02CmnGroupC.SnsrOffsLrngYawLrngYawAThd.Val /end REF_CHARACTERISTIC /begin REF_MEASUREMENT /end REF_MEASUREMENT /end GROUP
/begin GROUP CalRegn02CmnGroupC.SnsrOffsLrngYawOffsFrshTiThd.Val "MICROSAR RTE" /begin SUB_GROUP /end SUB_GROUP /begin FUNCTION_LIST /end FUNCTION_LIST /begin REF_CHARACTERISTIC CalRegn02CmnGroupC.SnsrOffsLrngYawOffsFrshTiThd.Val /end REF_CHARACTERISTIC /begin REF_MEASUREMENT /end REF_MEASUREMENT /end GROUP
/begin GROUP CalRegn02CmnGroupC.SnsrOffsLrngYawRateOffsLim.Val "MICROSAR RTE" /begin SUB_GROUP /end SUB_GROUP /begin FUNCTION_LIST /end FUNCTION_LIST /begin REF_CHARACTERISTIC CalRegn02CmnGroupC.SnsrOffsLrngYawRateOffsLim.Val /end REF_CHARACTERISTIC /begin REF_MEASUREMENT /end REF_MEASUREMENT /end GROUP
/begin GROUP CalRegn02Inin00 "MICROSAR RTE" /begin SUB_GROUP CalRegn02Inin00.CalibrationPorts /end SUB_GROUP /begin FUNCTION_LIST /end FUNCTION_LIST /begin REF_CHARACTERISTIC /end REF_CHARACTERISTIC /begin REF_MEASUREMENT /end REF_MEASUREMENT /end GROUP
/begin GROUP CalRegn02Inin00.CalibrationPorts "MICROSAR RTE"
 /begin SUB_GROUP CalRegn02Inin00.GmOvrlStMgrApaHwTqFilFrq.Val CalRegn02Inin00.GmOvrlStMgrHwTqFilFrq.Val CalRegn02Inin00.GmOvrlStMgrLkaHwTqFilFrq.Val CalRegn02Inin00.GmOvrlStMgrLkaHwTqTiThd2.Val CalRegn02Inin00.GmStrtStopEna.Logl CalRegn02Inin00.GmTqArbnApaAssiScaEna.Logl CalRegn02Inin00.GmTqArbnApaDampgScaEna.Logl CalRegn02Inin00.GmTqArbnApaRtnScaEna.Logl CalRegn02Inin00.GmTqArbnEscMaxTq.Val CalRegn02Inin00.GmTqArbnLkaOutpOvrlUpprLim.Val CalRegn02Inin00.HowDetnEstimLpFilFrq.Val CalRegn02Inin00.HowDetnStLpFilFrq.Val CalRegn02Inin00.HowDetnTqFinalLpFilFrq.Val CalRegn02Inin00.HowDetnTqInitLpFilFrq.Val CalRegn02Inin00.SnsrOffsLrngHwVelFilFrq.Val CalRegn02Inin00.SnsrOffsLrngTqAndAgFilFrq.Val CalRegn02Inin00.SnsrOffsLrngTqInpDetnHwTqFilFrq.Val CalRegn02Inin00.SnsrOffsLrngYawACdngFilFrq.Val CalRegn02Inin00.SnsrOffsLrngYawRateCdngFilFrq.Val /end SUB_GROUP
 /begin FUNCTION_LIST /end FUNCTION_LIST
 /begin REF_CHARACTERISTIC /end REF_CHARACTERISTIC
 /begin REF_MEASUREMENT /end REF_MEASUREMENT
/end GROUP
/begin GROUP CalRegn02Inin00.GmOvrlStMgrApaHwTqFilFrq.Val "MICROSAR RTE" /begin SUB_GROUP /end SUB_GROUP /begin FUNCTION_LIST /end FUNCTION_LIST /begin REF_CHARACTERISTIC CalRegn02Inin00.GmOvrlStMgrApaHwTqFilFrq.Val /end REF_CHARACTERISTIC /begin REF_MEASUREMENT /end REF_MEASUREMENT /end GROUP
/begin GROUP CalRegn02Inin00.GmOvrlStMgrHwTqFilFrq.Val "MICROSAR RTE" /begin SUB_GROUP /end SUB_GROUP /begin FUNCTION_LIST /end FUNCTION_LIST /begin REF_CHARACTERISTIC CalRegn02Inin00.GmOvrlStMgrHwTqFilFrq.Val /end REF_CHARACTERISTIC /begin REF_MEASUREMENT /end REF_MEASUREMENT /end GROUP
/begin GROUP CalRegn02Inin00.GmOvrlStMgrLkaHwTqFilFrq.Val "MICROSAR RTE" /begin SUB_GROUP /end SUB_GROUP /begin FUNCTION_LIST /end FUNCTION_LIST /begin REF_CHARACTERISTIC CalRegn02Inin00.GmOvrlStMgrLkaHwTqFilFrq.Val /end REF_CHARACTERISTIC /begin REF_MEASUREMENT /end REF_MEASUREMENT /end GROUP
/begin GROUP CalRegn02Inin00.GmOvrlStMgrLkaHwTqTiThd2.Val "MICROSAR RTE" /begin SUB_GROUP /end SUB_GROUP /begin FUNCTION_LIST /end FUNCTION_LIST /begin REF_CHARACTERISTIC CalRegn02Inin00.GmOvrlStMgrLkaHwTqTiThd2.Val /end REF_CHARACTERISTIC /begin REF_MEASUREMENT /end REF_MEASUREMENT /end GROUP
/begin GROUP CalRegn02Inin00.GmStrtStopEna.Logl "MICROSAR RTE" /begin SUB_GROUP /end SUB_GROUP /begin FUNCTION_LIST /end FUNCTION_LIST /begin REF_CHARACTERISTIC CalRegn02Inin00.GmStrtStopEna.Logl /end REF_CHARACTERISTIC /begin REF_MEASUREMENT /end REF_MEASUREMENT /end GROUP
/begin GROUP CalRegn02Inin00.GmTqArbnApaAssiScaEna.Logl "MICROSAR RTE" /begin SUB_GROUP /end SUB_GROUP /begin FUNCTION_LIST /end FUNCTION_LIST /begin REF_CHARACTERISTIC CalRegn02Inin00.GmTqArbnApaAssiScaEna.Logl /end REF_CHARACTERISTIC /begin REF_MEASUREMENT /end REF_MEASUREMENT /end GROUP
/begin GROUP CalRegn02Inin00.GmTqArbnApaDampgScaEna.Logl "MICROSAR RTE" /begin SUB_GROUP /end SUB_GROUP /begin FUNCTION_LIST /end FUNCTION_LIST /begin REF_CHARACTERISTIC CalRegn02Inin00.GmTqArbnApaDampgScaEna.Logl /end REF_CHARACTERISTIC /begin REF_MEASUREMENT /end REF_MEASUREMENT /end GROUP
/begin GROUP CalRegn02Inin00.GmTqArbnApaRtnScaEna.Logl "MICROSAR RTE" /begin SUB_GROUP /end SUB_GROUP /begin FUNCTION_LIST /end FUNCTION_LIST /begin REF_CHARACTERISTIC CalRegn02Inin00.GmTqArbnApaRtnScaEna.Logl /end REF_CHARACTERISTIC /begin REF_MEASUREMENT /end REF_MEASUREMENT /end GROUP
/begin GROUP CalRegn02Inin00.GmTqArbnEscMaxTq.Val "MICROSAR RTE" /begin SUB_GROUP /end SUB_GROUP /begin FUNCTION_LIST /end FUNCTION_LIST /begin REF_CHARACTERISTIC CalRegn02Inin00.GmTqArbnEscMaxTq.Val /end REF_CHARACTERISTIC /begin REF_MEASUREMENT /end REF_MEASUREMENT /end GROUP
/begin GROUP CalRegn02Inin00.GmTqArbnLkaOutpOvrlUpprLim.Val "MICROSAR RTE" /begin SUB_GROUP /end SUB_GROUP /begin FUNCTION_LIST /end FUNCTION_LIST /begin REF_CHARACTERISTIC CalRegn02Inin00.GmTqArbnLkaOutpOvrlUpprLim.Val /end REF_CHARACTERISTIC /begin REF_MEASUREMENT /end REF_MEASUREMENT /end GROUP
/begin GROUP CalRegn02Inin00.HowDetnEstimLpFilFrq.Val "MICROSAR RTE" /begin SUB_GROUP /end SUB_GROUP /begin FUNCTION_LIST /end FUNCTION_LIST /begin REF_CHARACTERISTIC CalRegn02Inin00.HowDetnEstimLpFilFrq.Val /end REF_CHARACTERISTIC /begin REF_MEASUREMENT /end REF_MEASUREMENT /end GROUP
/begin GROUP CalRegn02Inin00.HowDetnStLpFilFrq.Val "MICROSAR RTE" /begin SUB_GROUP /end SUB_GROUP /begin FUNCTION_LIST /end FUNCTION_LIST /begin REF_CHARACTERISTIC CalRegn02Inin00.HowDetnStLpFilFrq.Val /end REF_CHARACTERISTIC /begin REF_MEASUREMENT /end REF_MEASUREMENT /end GROUP
/begin GROUP CalRegn02Inin00.HowDetnTqFinalLpFilFrq.Val "MICROSAR RTE" /begin SUB_GROUP /end SUB_GROUP /begin FUNCTION_LIST /end FUNCTION_LIST /begin REF_CHARACTERISTIC CalRegn02Inin00.HowDetnTqFinalLpFilFrq.Val /end REF_CHARACTERISTIC /begin REF_MEASUREMENT /end REF_MEASUREMENT /end GROUP
/begin GROUP CalRegn02Inin00.HowDetnTqInitLpFilFrq.Val "MICROSAR RTE" /begin SUB_GROUP /end SUB_GROUP /begin FUNCTION_LIST /end FUNCTION_LIST /begin REF_CHARACTERISTIC CalRegn02Inin00.HowDetnTqInitLpFilFrq.Val /end REF_CHARACTERISTIC /begin REF_MEASUREMENT /end REF_MEASUREMENT /end GROUP
/begin GROUP CalRegn02Inin00.SnsrOffsLrngHwVelFilFrq.Val "MICROSAR RTE" /begin SUB_GROUP /end SUB_GROUP /begin FUNCTION_LIST /end FUNCTION_LIST /begin REF_CHARACTERISTIC CalRegn02Inin00.SnsrOffsLrngHwVelFilFrq.Val /end REF_CHARACTERISTIC /begin REF_MEASUREMENT /end REF_MEASUREMENT /end GROUP
/begin GROUP CalRegn02Inin00.SnsrOffsLrngTqAndAgFilFrq.Val "MICROSAR RTE" /begin SUB_GROUP /end SUB_GROUP /begin FUNCTION_LIST /end FUNCTION_LIST /begin REF_CHARACTERISTIC CalRegn02Inin00.SnsrOffsLrngTqAndAgFilFrq.Val /end REF_CHARACTERISTIC /begin REF_MEASUREMENT /end REF_MEASUREMENT /end GROUP
/begin GROUP CalRegn02Inin00.SnsrOffsLrngTqInpDetnHwTqFilFrq.Val "MICROSAR RTE" /begin SUB_GROUP /end SUB_GROUP /begin FUNCTION_LIST /end FUNCTION_LIST /begin REF_CHARACTERISTIC CalRegn02Inin00.SnsrOffsLrngTqInpDetnHwTqFilFrq.Val /end REF_CHARACTERISTIC /begin REF_MEASUREMENT /end REF_MEASUREMENT /end GROUP
/begin GROUP CalRegn02Inin00.SnsrOffsLrngYawACdngFilFrq.Val "MICROSAR RTE" /begin SUB_GROUP /end SUB_GROUP /begin FUNCTION_LIST /end FUNCTION_LIST /begin REF_CHARACTERISTIC CalRegn02Inin00.SnsrOffsLrngYawACdngFilFrq.Val /end REF_CHARACTERISTIC /begin REF_MEASUREMENT /end REF_MEASUREMENT /end GROUP
/begin GROUP CalRegn02Inin00.SnsrOffsLrngYawRateCdngFilFrq.Val "MICROSAR RTE" /begin SUB_GROUP /end SUB_GROUP /begin FUNCTION_LIST /end FUNCTION_LIST /begin REF_CHARACTERISTIC CalRegn02Inin00.SnsrOffsLrngYawRateCdngFilFrq.Val /end REF_CHARACTERISTIC /begin REF_MEASUREMENT /end REF_MEASUREMENT /end GROUP
/begin GROUP CalRegn02Inin00GroupA "MICROSAR RTE" /begin SUB_GROUP CalRegn02Inin00GroupA.CalibrationPorts /end SUB_GROUP /begin FUNCTION_LIST /end FUNCTION_LIST /begin REF_CHARACTERISTIC /end REF_CHARACTERISTIC /begin REF_MEASUREMENT /end REF_MEASUREMENT /end GROUP
/begin GROUP CalRegn02Inin00GroupA.CalibrationPorts "MICROSAR RTE" /begin SUB_GROUP CalRegn02Inin00GroupA.GmOvrlStMgrLkaHwTqTiThd1.Val /end SUB_GROUP /begin FUNCTION_LIST /end FUNCTION_LIST /begin REF_CHARACTERISTIC /end REF_CHARACTERISTIC /begin REF_MEASUREMENT /end REF_MEASUREMENT /end GROUP
/begin GROUP CalRegn02Inin00GroupA.GmOvrlStMgrLkaHwTqTiThd1.Val "MICROSAR RTE" /begin SUB_GROUP /end SUB_GROUP /begin FUNCTION_LIST /end FUNCTION_LIST /begin REF_CHARACTERISTIC CalRegn02Inin00GroupA.GmOvrlStMgrLkaHwTqTiThd1.Val /end REF_CHARACTERISTIC /begin REF_MEASUREMENT /end REF_MEASUREMENT /end GROUP
/begin GROUP CalRegn02Inin00GroupC "MICROSAR RTE" /begin SUB_GROUP CalRegn02Inin00GroupC.CalibrationPorts /end SUB_GROUP /begin FUNCTION_LIST /end FUNCTION_LIST /begin REF_CHARACTERISTIC /end REF_CHARACTERISTIC /begin REF_MEASUREMENT /end REF_MEASUREMENT /end GROUP
/begin GROUP CalRegn02Inin00GroupC.CalibrationPorts "MICROSAR RTE"
 /begin SUB_GROUP CalRegn02Inin00GroupC.GmOvrlStMgrApaHwTqTiThd.Val CalRegn02Inin00GroupC.GmOvrlStMgrHaptcFrq.Val CalRegn02Inin00GroupC.GmOvrlStMgrHaptcReactnTi.Val CalRegn02Inin00GroupC.GmOvrlStMgrHaptcReqTiThd.Val CalRegn02Inin00GroupC.GmStrtStopFltRateLim.Val CalRegn02Inin00GroupC.GmStrtStopMod1EngTranThd.Val CalRegn02Inin00GroupC.GmStrtStopMod1Sca.Val CalRegn02Inin00GroupC.GmStrtStopMod1ToStopRateLim.Val CalRegn02Inin00GroupC.GmStrtStopMod1VehSpdTranThd.Val CalRegn02Inin00GroupC.GmStrtStopMod2Sca.Val CalRegn02Inin00GroupC.GmStrtStopNormModEngTranThd.Val CalRegn02Inin00GroupC.GmStrtStopNormModVehSpdTranThd.Val CalRegn02Inin00GroupC.GmStrtStopNormRateLim.Val CalRegn02Inin00GroupC.GmStrtStopNormToMod1RateLim.Val CalRegn02Inin00GroupC.GmStrtStopStopAndMod2RateLim.Val CalRegn02Inin00GroupC.GmStrtStopStopMod1HwTqTranThd.Val CalRegn02Inin00GroupC.GmStrtStopStopMod1HwVelTranThd.Val CalRegn02Inin00GroupC.GmStrtStopStopMod1Tmr.Val CalRegn02Inin00GroupC.GmStrtStopStopMod1VehSpdTranThd.Val CalRegn02Inin00GroupC.GmStrtStopStopMod2HwTqTranThd.Val CalRegn02Inin00GroupC.GmStrtStopStopMod2HwVelTranThd.Val CalRegn02Inin00GroupC.GmStrtStopStopMod2Tmr.Val CalRegn02Inin00GroupC.GmStrtStopStopMod2VehSpdTranThd.Val CalRegn02Inin00GroupC.GmStrtStopStopModSca.Val CalRegn02Inin00GroupC.GmTqArbnApaDiRateX.Ary1D CalRegn02Inin00GroupC.GmTqArbnLkaSlewEna.Logl CalRegn02Inin00GroupC.HowDetnOffThd.Val CalRegn02Inin00GroupC.HowDetnOffTi.Val /end SUB_GROUP
 /begin FUNCTION_LIST /end FUNCTION_LIST
 /begin REF_CHARACTERISTIC /end REF_CHARACTERISTIC
 /begin REF_MEASUREMENT /end REF_MEASUREMENT
/end GROUP
/begin GROUP CalRegn02Inin00GroupC.GmOvrlStMgrApaHwTqTiThd.Val "MICROSAR RTE" /begin SUB_GROUP /end SUB_GROUP /begin FUNCTION_LIST /end FUNCTION_LIST /begin REF_CHARACTERISTIC CalRegn02Inin00GroupC.GmOvrlStMgrApaHwTqTiThd.Val /end REF_CHARACTERISTIC /begin REF_MEASUREMENT /end REF_MEASUREMENT /end GROUP
/begin GROUP CalRegn02Inin00GroupC.GmOvrlStMgrHaptcFrq.Val "MICROSAR RTE" /begin SUB_GROUP /end SUB_GROUP /begin FUNCTION_LIST /end FUNCTION_LIST /begin REF_CHARACTERISTIC CalRegn02Inin00GroupC.GmOvrlStMgrHaptcFrq.Val /end REF_CHARACTERISTIC /begin REF_MEASUREMENT /end REF_MEASUREMENT /end GROUP
/begin GROUP CalRegn02Inin00GroupC.GmOvrlStMgrHaptcReactnTi.Val "MICROSAR RTE" /begin SUB_GROUP /end SUB_GROUP /begin FUNCTION_LIST /end FUNCTION_LIST /begin REF_CHARACTERISTIC CalRegn02Inin00GroupC.GmOvrlStMgrHaptcReactnTi.Val /end REF_CHARACTERISTIC /begin REF_MEASUREMENT /end REF_MEASUREMENT /end GROUP
/begin GROUP CalRegn02Inin00GroupC.GmOvrlStMgrHaptcReqTiThd.Val "MICROSAR RTE" /begin SUB_GROUP /end SUB_GROUP /begin FUNCTION_LIST /end FUNCTION_LIST /begin REF_CHARACTERISTIC CalRegn02Inin00GroupC.GmOvrlStMgrHaptcReqTiThd.Val /end REF_CHARACTERISTIC /begin REF_MEASUREMENT /end REF_MEASUREMENT /end GROUP
/begin GROUP CalRegn02Inin00GroupC.GmStrtStopFltRateLim.Val "MICROSAR RTE" /begin SUB_GROUP /end SUB_GROUP /begin FUNCTION_LIST /end FUNCTION_LIST /begin REF_CHARACTERISTIC CalRegn02Inin00GroupC.GmStrtStopFltRateLim.Val /end REF_CHARACTERISTIC /begin REF_MEASUREMENT /end REF_MEASUREMENT /end GROUP
/begin GROUP CalRegn02Inin00GroupC.GmStrtStopMod1EngTranThd.Val "MICROSAR RTE" /begin SUB_GROUP /end SUB_GROUP /begin FUNCTION_LIST /end FUNCTION_LIST /begin REF_CHARACTERISTIC CalRegn02Inin00GroupC.GmStrtStopMod1EngTranThd.Val /end REF_CHARACTERISTIC /begin REF_MEASUREMENT /end REF_MEASUREMENT /end GROUP
/begin GROUP CalRegn02Inin00GroupC.GmStrtStopMod1Sca.Val "MICROSAR RTE" /begin SUB_GROUP /end SUB_GROUP /begin FUNCTION_LIST /end FUNCTION_LIST /begin REF_CHARACTERISTIC CalRegn02Inin00GroupC.GmStrtStopMod1Sca.Val /end REF_CHARACTERISTIC /begin REF_MEASUREMENT /end REF_MEASUREMENT /end GROUP
/begin GROUP CalRegn02Inin00GroupC.GmStrtStopMod1ToStopRateLim.Val "MICROSAR RTE" /begin SUB_GROUP /end SUB_GROUP /begin FUNCTION_LIST /end FUNCTION_LIST /begin REF_CHARACTERISTIC CalRegn02Inin00GroupC.GmStrtStopMod1ToStopRateLim.Val /end REF_CHARACTERISTIC /begin REF_MEASUREMENT /end REF_MEASUREMENT /end GROUP
/begin GROUP CalRegn02Inin00GroupC.GmStrtStopMod1VehSpdTranThd.Val "MICROSAR RTE" /begin SUB_GROUP /end SUB_GROUP /begin FUNCTION_LIST /end FUNCTION_LIST /begin REF_CHARACTERISTIC CalRegn02Inin00GroupC.GmStrtStopMod1VehSpdTranThd.Val /end REF_CHARACTERISTIC /begin REF_MEASUREMENT /end REF_MEASUREMENT /end GROUP
/begin GROUP CalRegn02Inin00GroupC.GmStrtStopMod2Sca.Val "MICROSAR RTE" /begin SUB_GROUP /end SUB_GROUP /begin FUNCTION_LIST /end FUNCTION_LIST /begin REF_CHARACTERISTIC CalRegn02Inin00GroupC.GmStrtStopMod2Sca.Val /end REF_CHARACTERISTIC /begin REF_MEASUREMENT /end REF_MEASUREMENT /end GROUP
/begin GROUP CalRegn02Inin00GroupC.GmStrtStopNormModEngTranThd.Val "MICROSAR RTE" /begin SUB_GROUP /end SUB_GROUP /begin FUNCTION_LIST /end FUNCTION_LIST /begin REF_CHARACTERISTIC CalRegn02Inin00GroupC.GmStrtStopNormModEngTranThd.Val /end REF_CHARACTERISTIC /begin REF_MEASUREMENT /end REF_MEASUREMENT /end GROUP
/begin GROUP CalRegn02Inin00GroupC.GmStrtStopNormModVehSpdTranThd.Val "MICROSAR RTE" /begin SUB_GROUP /end SUB_GROUP /begin FUNCTION_LIST /end FUNCTION_LIST /begin REF_CHARACTERISTIC CalRegn02Inin00GroupC.GmStrtStopNormModVehSpdTranThd.Val /end REF_CHARACTERISTIC /begin REF_MEASUREMENT /end REF_MEASUREMENT /end GROUP
/begin GROUP CalRegn02Inin00GroupC.GmStrtStopNormRateLim.Val "MICROSAR RTE" /begin SUB_GROUP /end SUB_GROUP /begin FUNCTION_LIST /end FUNCTION_LIST /begin REF_CHARACTERISTIC CalRegn02Inin00GroupC.GmStrtStopNormRateLim.Val /end REF_CHARACTERISTIC /begin REF_MEASUREMENT /end REF_MEASUREMENT /end GROUP
/begin GROUP CalRegn02Inin00GroupC.GmStrtStopNormToMod1RateLim.Val "MICROSAR RTE" /begin SUB_GROUP /end SUB_GROUP /begin FUNCTION_LIST /end FUNCTION_LIST /begin REF_CHARACTERISTIC CalRegn02Inin00GroupC.GmStrtStopNormToMod1RateLim.Val /end REF_CHARACTERISTIC /begin REF_MEASUREMENT /end REF_MEASUREMENT /end GROUP
/begin GROUP CalRegn02Inin00GroupC.GmStrtStopStopAndMod2RateLim.Val "MICROSAR RTE" /begin SUB_GROUP /end SUB_GROUP /begin FUNCTION_LIST /end FUNCTION_LIST /begin REF_CHARACTERISTIC CalRegn02Inin00GroupC.GmStrtStopStopAndMod2RateLim.Val /end REF_CHARACTERISTIC /begin REF_MEASUREMENT /end REF_MEASUREMENT /end GROUP
/begin GROUP CalRegn02Inin00GroupC.GmStrtStopStopMod1HwTqTranThd.Val "MICROSAR RTE" /begin SUB_GROUP /end SUB_GROUP /begin FUNCTION_LIST /end FUNCTION_LIST /begin REF_CHARACTERISTIC CalRegn02Inin00GroupC.GmStrtStopStopMod1HwTqTranThd.Val /end REF_CHARACTERISTIC /begin REF_MEASUREMENT /end REF_MEASUREMENT /end GROUP
/begin GROUP CalRegn02Inin00GroupC.GmStrtStopStopMod1HwVelTranThd.Val "MICROSAR RTE" /begin SUB_GROUP /end SUB_GROUP /begin FUNCTION_LIST /end FUNCTION_LIST /begin REF_CHARACTERISTIC CalRegn02Inin00GroupC.GmStrtStopStopMod1HwVelTranThd.Val /end REF_CHARACTERISTIC /begin REF_MEASUREMENT /end REF_MEASUREMENT /end GROUP
/begin GROUP CalRegn02Inin00GroupC.GmStrtStopStopMod1Tmr.Val "MICROSAR RTE" /begin SUB_GROUP /end SUB_GROUP /begin FUNCTION_LIST /end FUNCTION_LIST /begin REF_CHARACTERISTIC CalRegn02Inin00GroupC.GmStrtStopStopMod1Tmr.Val /end REF_CHARACTERISTIC /begin REF_MEASUREMENT /end REF_MEASUREMENT /end GROUP
/begin GROUP CalRegn02Inin00GroupC.GmStrtStopStopMod1VehSpdTranThd.Val "MICROSAR RTE" /begin SUB_GROUP /end SUB_GROUP /begin FUNCTION_LIST /end FUNCTION_LIST /begin REF_CHARACTERISTIC CalRegn02Inin00GroupC.GmStrtStopStopMod1VehSpdTranThd.Val /end REF_CHARACTERISTIC /begin REF_MEASUREMENT /end REF_MEASUREMENT /end GROUP
/begin GROUP CalRegn02Inin00GroupC.GmStrtStopStopMod2HwTqTranThd.Val "MICROSAR RTE" /begin SUB_GROUP /end SUB_GROUP /begin FUNCTION_LIST /end FUNCTION_LIST /begin REF_CHARACTERISTIC CalRegn02Inin00GroupC.GmStrtStopStopMod2HwTqTranThd.Val /end REF_CHARACTERISTIC /begin REF_MEASUREMENT /end REF_MEASUREMENT /end GROUP
/begin GROUP CalRegn02Inin00GroupC.GmStrtStopStopMod2HwVelTranThd.Val "MICROSAR RTE" /begin SUB_GROUP /end SUB_GROUP /begin FUNCTION_LIST /end FUNCTION_LIST /begin REF_CHARACTERISTIC CalRegn02Inin00GroupC.GmStrtStopStopMod2HwVelTranThd.Val /end REF_CHARACTERISTIC /begin REF_MEASUREMENT /end REF_MEASUREMENT /end GROUP
/begin GROUP CalRegn02Inin00GroupC.GmStrtStopStopMod2Tmr.Val "MICROSAR RTE" /begin SUB_GROUP /end SUB_GROUP /begin FUNCTION_LIST /end FUNCTION_LIST /begin REF_CHARACTERISTIC CalRegn02Inin00GroupC.GmStrtStopStopMod2Tmr.Val /end REF_CHARACTERISTIC /begin REF_MEASUREMENT /end REF_MEASUREMENT /end GROUP
/begin GROUP CalRegn02Inin00GroupC.GmStrtStopStopMod2VehSpdTranThd.Val "MICROSAR RTE" /begin SUB_GROUP /end SUB_GROUP /begin FUNCTION_LIST /end FUNCTION_LIST /begin REF_CHARACTERISTIC CalRegn02Inin00GroupC.GmStrtStopStopMod2VehSpdTranThd.Val /end REF_CHARACTERISTIC /begin REF_MEASUREMENT /end REF_MEASUREMENT /end GROUP
/begin GROUP CalRegn02Inin00GroupC.GmStrtStopStopModSca.Val "MICROSAR RTE" /begin SUB_GROUP /end SUB_GROUP /begin FUNCTION_LIST /end FUNCTION_LIST /begin REF_CHARACTERISTIC CalRegn02Inin00GroupC.GmStrtStopStopModSca.Val /end REF_CHARACTERISTIC /begin REF_MEASUREMENT /end REF_MEASUREMENT /end GROUP
/begin GROUP CalRegn02Inin00GroupC.GmTqArbnApaDiRateX.Ary1D "MICROSAR RTE" /begin SUB_GROUP /end SUB_GROUP /begin FUNCTION_LIST /end FUNCTION_LIST /begin REF_CHARACTERISTIC CalRegn02Inin00GroupC.GmTqArbnApaDiRateX.Ary1D /end REF_CHARACTERISTIC /begin REF_MEASUREMENT /end REF_MEASUREMENT /end GROUP
/begin GROUP CalRegn02Inin00GroupC.GmTqArbnLkaSlewEna.Logl "MICROSAR RTE" /begin SUB_GROUP /end SUB_GROUP /begin FUNCTION_LIST /end FUNCTION_LIST /begin REF_CHARACTERISTIC CalRegn02Inin00GroupC.GmTqArbnLkaSlewEna.Logl /end REF_CHARACTERISTIC /begin REF_MEASUREMENT /end REF_MEASUREMENT /end GROUP
/begin GROUP CalRegn02Inin00GroupC.HowDetnOffThd.Val "MICROSAR RTE" /begin SUB_GROUP /end SUB_GROUP /begin FUNCTION_LIST /end FUNCTION_LIST /begin REF_CHARACTERISTIC CalRegn02Inin00GroupC.HowDetnOffThd.Val /end REF_CHARACTERISTIC /begin REF_MEASUREMENT /end REF_MEASUREMENT /end GROUP
/begin GROUP CalRegn02Inin00GroupC.HowDetnOffTi.Val "MICROSAR RTE" /begin SUB_GROUP /end SUB_GROUP /begin FUNCTION_LIST /end FUNCTION_LIST /begin REF_CHARACTERISTIC CalRegn02Inin00GroupC.HowDetnOffTi.Val /end REF_CHARACTERISTIC /begin REF_MEASUREMENT /end REF_MEASUREMENT /end GROUP
/begin GROUP CalRegn02Rt00GroupC "MICROSAR RTE" /begin SUB_GROUP CalRegn02Rt00GroupC.CalibrationPorts /end SUB_GROUP /begin FUNCTION_LIST /end FUNCTION_LIST /begin REF_CHARACTERISTIC /end REF_CHARACTERISTIC /begin REF_MEASUREMENT /end REF_MEASUREMENT /end GROUP
/begin GROUP CalRegn02Rt00GroupC.CalibrationPorts "MICROSAR RTE"
 /begin SUB_GROUP CalRegn02Rt00GroupC.GmOvrlStMgrHwAgTarLimr.Val CalRegn02Rt00GroupC.GmOvrlStMgrShiftLvrTiThd.Val CalRegn02Rt00GroupC.GmOvrlStMgrStandStillThd.Val CalRegn02Rt00GroupC.GmOvrlStMgrStandStillTiThd.Val CalRegn02Rt00GroupC.GmTqArbnApaDiRateY.Ary1D CalRegn02Rt00GroupC.GmTqArbnApaEnaRate.Val CalRegn02Rt00GroupC.GmTqArbnApaSmotngHwTqLpFilFrq.Val CalRegn02Rt00GroupC.GmTqArbnApaSmotngX.Ary1D CalRegn02Rt00GroupC.GmTqArbnApaSmotngY.Ary1D CalRegn02Rt00GroupC.GmTqArbnLkaOutpOvrlX.Ary2D CalRegn02Rt00GroupC.GmTqArbnLkaOutpOvrlY.Ary2D CalRegn02Rt00GroupC.GmTqArbnLkaSlewX.Ary1D CalRegn02Rt00GroupC.GmTqArbnLkaSlewY.Ary1D /end SUB_GROUP
 /begin FUNCTION_LIST /end FUNCTION_LIST
 /begin REF_CHARACTERISTIC /end REF_CHARACTERISTIC
 /begin REF_MEASUREMENT /end REF_MEASUREMENT
/end GROUP
/begin GROUP CalRegn02Rt00GroupC.GmOvrlStMgrHwAgTarLimr.Val "MICROSAR RTE" /begin SUB_GROUP /end SUB_GROUP /begin FUNCTION_LIST /end FUNCTION_LIST /begin REF_CHARACTERISTIC CalRegn02Rt00GroupC.GmOvrlStMgrHwAgTarLimr.Val /end REF_CHARACTERISTIC /begin REF_MEASUREMENT /end REF_MEASUREMENT /end GROUP
/begin GROUP CalRegn02Rt00GroupC.GmOvrlStMgrShiftLvrTiThd.Val "MICROSAR RTE" /begin SUB_GROUP /end SUB_GROUP /begin FUNCTION_LIST /end FUNCTION_LIST /begin REF_CHARACTERISTIC CalRegn02Rt00GroupC.GmOvrlStMgrShiftLvrTiThd.Val /end REF_CHARACTERISTIC /begin REF_MEASUREMENT /end REF_MEASUREMENT /end GROUP
/begin GROUP CalRegn02Rt00GroupC.GmOvrlStMgrStandStillThd.Val "MICROSAR RTE" /begin SUB_GROUP /end SUB_GROUP /begin FUNCTION_LIST /end FUNCTION_LIST /begin REF_CHARACTERISTIC CalRegn02Rt00GroupC.GmOvrlStMgrStandStillThd.Val /end REF_CHARACTERISTIC /begin REF_MEASUREMENT /end REF_MEASUREMENT /end GROUP
/begin GROUP CalRegn02Rt00GroupC.GmOvrlStMgrStandStillTiThd.Val "MICROSAR RTE" /begin SUB_GROUP /end SUB_GROUP /begin FUNCTION_LIST /end FUNCTION_LIST /begin REF_CHARACTERISTIC CalRegn02Rt00GroupC.GmOvrlStMgrStandStillTiThd.Val /end REF_CHARACTERISTIC /begin REF_MEASUREMENT /end REF_MEASUREMENT /end GROUP
/begin GROUP CalRegn02Rt00GroupC.GmTqArbnApaDiRateY.Ary1D "MICROSAR RTE" /begin SUB_GROUP /end SUB_GROUP /begin FUNCTION_LIST /end FUNCTION_LIST /begin REF_CHARACTERISTIC CalRegn02Rt00GroupC.GmTqArbnApaDiRateY.Ary1D /end REF_CHARACTERISTIC /begin REF_MEASUREMENT /end REF_MEASUREMENT /end GROUP
/begin GROUP CalRegn02Rt00GroupC.GmTqArbnApaEnaRate.Val "MICROSAR RTE" /begin SUB_GROUP /end SUB_GROUP /begin FUNCTION_LIST /end FUNCTION_LIST /begin REF_CHARACTERISTIC CalRegn02Rt00GroupC.GmTqArbnApaEnaRate.Val /end REF_CHARACTERISTIC /begin REF_MEASUREMENT /end REF_MEASUREMENT /end GROUP
/begin GROUP CalRegn02Rt00GroupC.GmTqArbnApaSmotngHwTqLpFilFrq.Val "MICROSAR RTE" /begin SUB_GROUP /end SUB_GROUP /begin FUNCTION_LIST /end FUNCTION_LIST /begin REF_CHARACTERISTIC CalRegn02Rt00GroupC.GmTqArbnApaSmotngHwTqLpFilFrq.Val /end REF_CHARACTERISTIC /begin REF_MEASUREMENT /end REF_MEASUREMENT /end GROUP
/begin GROUP CalRegn02Rt00GroupC.GmTqArbnApaSmotngX.Ary1D "MICROSAR RTE" /begin SUB_GROUP /end SUB_GROUP /begin FUNCTION_LIST /end FUNCTION_LIST /begin REF_CHARACTERISTIC CalRegn02Rt00GroupC.GmTqArbnApaSmotngX.Ary1D /end REF_CHARACTERISTIC /begin REF_MEASUREMENT /end REF_MEASUREMENT /end GROUP
/begin GROUP CalRegn02Rt00GroupC.GmTqArbnApaSmotngY.Ary1D "MICROSAR RTE" /begin SUB_GROUP /end SUB_GROUP /begin FUNCTION_LIST /end FUNCTION_LIST /begin REF_CHARACTERISTIC CalRegn02Rt00GroupC.GmTqArbnApaSmotngY.Ary1D /end REF_CHARACTERISTIC /begin REF_MEASUREMENT /end REF_MEASUREMENT /end GROUP
/begin GROUP CalRegn02Rt00GroupC.GmTqArbnLkaOutpOvrlX.Ary2D "MICROSAR RTE" /begin SUB_GROUP /end SUB_GROUP /begin FUNCTION_LIST /end FUNCTION_LIST /begin REF_CHARACTERISTIC CalRegn02Rt00GroupC.GmTqArbnLkaOutpOvrlX.Ary2D /end REF_CHARACTERISTIC /begin REF_MEASUREMENT /end REF_MEASUREMENT /end GROUP
/begin GROUP CalRegn02Rt00GroupC.GmTqArbnLkaOutpOvrlY.Ary2D "MICROSAR RTE" /begin SUB_GROUP /end SUB_GROUP /begin FUNCTION_LIST /end FUNCTION_LIST /begin REF_CHARACTERISTIC CalRegn02Rt00GroupC.GmTqArbnLkaOutpOvrlY.Ary2D /end REF_CHARACTERISTIC /begin REF_MEASUREMENT /end REF_MEASUREMENT /end GROUP
/begin GROUP CalRegn02Rt00GroupC.GmTqArbnLkaSlewX.Ary1D "MICROSAR RTE" /begin SUB_GROUP /end SUB_GROUP /begin FUNCTION_LIST /end FUNCTION_LIST /begin REF_CHARACTERISTIC CalRegn02Rt00GroupC.GmTqArbnLkaSlewX.Ary1D /end REF_CHARACTERISTIC /begin REF_MEASUREMENT /end REF_MEASUREMENT /end GROUP
/begin GROUP CalRegn02Rt00GroupC.GmTqArbnLkaSlewY.Ary1D "MICROSAR RTE" /begin SUB_GROUP /end SUB_GROUP /begin FUNCTION_LIST /end FUNCTION_LIST /begin REF_CHARACTERISTIC CalRegn02Rt00GroupC.GmTqArbnLkaSlewY.Ary1D /end REF_CHARACTERISTIC /begin REF_MEASUREMENT /end REF_MEASUREMENT /end GROUP
/begin GROUP CalRegn02Rt01GroupC "MICROSAR RTE" /begin SUB_GROUP CalRegn02Rt01GroupC.CalibrationPorts /end SUB_GROUP /begin FUNCTION_LIST /end FUNCTION_LIST /begin REF_CHARACTERISTIC /end REF_CHARACTERISTIC /begin REF_MEASUREMENT /end REF_MEASUREMENT /end GROUP
/begin GROUP CalRegn02Rt01GroupC.CalibrationPorts "MICROSAR RTE"
 /begin SUB_GROUP CalRegn02Rt01GroupC.GmOvrlStMgrHwAgTarLimr.Val CalRegn02Rt01GroupC.GmOvrlStMgrShiftLvrTiThd.Val CalRegn02Rt01GroupC.GmOvrlStMgrStandStillThd.Val CalRegn02Rt01GroupC.GmOvrlStMgrStandStillTiThd.Val CalRegn02Rt01GroupC.GmTqArbnApaDiRateY.Ary1D CalRegn02Rt01GroupC.GmTqArbnApaEnaRate.Val CalRegn02Rt01GroupC.GmTqArbnApaSmotngHwTqLpFilFrq.Val CalRegn02Rt01GroupC.GmTqArbnApaSmotngX.Ary1D CalRegn02Rt01GroupC.GmTqArbnApaSmotngY.Ary1D CalRegn02Rt01GroupC.GmTqArbnLkaOutpOvrlX.Ary2D CalRegn02Rt01GroupC.GmTqArbnLkaOutpOvrlY.Ary2D CalRegn02Rt01GroupC.GmTqArbnLkaSlewX.Ary1D CalRegn02Rt01GroupC.GmTqArbnLkaSlewY.Ary1D /end SUB_GROUP
 /begin FUNCTION_LIST /end FUNCTION_LIST
 /begin REF_CHARACTERISTIC /end REF_CHARACTERISTIC
 /begin REF_MEASUREMENT /end REF_MEASUREMENT
/end GROUP
/begin GROUP CalRegn02Rt01GroupC.GmOvrlStMgrHwAgTarLimr.Val "MICROSAR RTE" /begin SUB_GROUP /end SUB_GROUP /begin FUNCTION_LIST /end FUNCTION_LIST /begin REF_CHARACTERISTIC CalRegn02Rt01GroupC.GmOvrlStMgrHwAgTarLimr.Val /end REF_CHARACTERISTIC /begin REF_MEASUREMENT /end REF_MEASUREMENT /end GROUP
/begin GROUP CalRegn02Rt01GroupC.GmOvrlStMgrShiftLvrTiThd.Val "MICROSAR RTE" /begin SUB_GROUP /end SUB_GROUP /begin FUNCTION_LIST /end FUNCTION_LIST /begin REF_CHARACTERISTIC CalRegn02Rt01GroupC.GmOvrlStMgrShiftLvrTiThd.Val /end REF_CHARACTERISTIC /begin REF_MEASUREMENT /end REF_MEASUREMENT /end GROUP
/begin GROUP CalRegn02Rt01GroupC.GmOvrlStMgrStandStillThd.Val "MICROSAR RTE" /begin SUB_GROUP /end SUB_GROUP /begin FUNCTION_LIST /end FUNCTION_LIST /begin REF_CHARACTERISTIC CalRegn02Rt01GroupC.GmOvrlStMgrStandStillThd.Val /end REF_CHARACTERISTIC /begin REF_MEASUREMENT /end REF_MEASUREMENT /end GROUP
/begin GROUP CalRegn02Rt01GroupC.GmOvrlStMgrStandStillTiThd.Val "MICROSAR RTE" /begin SUB_GROUP /end SUB_GROUP /begin FUNCTION_LIST /end FUNCTION_LIST /begin REF_CHARACTERISTIC CalRegn02Rt01GroupC.GmOvrlStMgrStandStillTiThd.Val /end REF_CHARACTERISTIC /begin REF_MEASUREMENT /end REF_MEASUREMENT /end GROUP
/begin GROUP CalRegn02Rt01GroupC.GmTqArbnApaDiRateY.Ary1D "MICROSAR RTE" /begin SUB_GROUP /end SUB_GROUP /begin FUNCTION_LIST /end FUNCTION_LIST /begin REF_CHARACTERISTIC CalRegn02Rt01GroupC.GmTqArbnApaDiRateY.Ary1D /end REF_CHARACTERISTIC /begin REF_MEASUREMENT /end REF_MEASUREMENT /end GROUP
/begin GROUP CalRegn02Rt01GroupC.GmTqArbnApaEnaRate.Val "MICROSAR RTE" /begin SUB_GROUP /end SUB_GROUP /begin FUNCTION_LIST /end FUNCTION_LIST /begin REF_CHARACTERISTIC CalRegn02Rt01GroupC.GmTqArbnApaEnaRate.Val /end REF_CHARACTERISTIC /begin REF_MEASUREMENT /end REF_MEASUREMENT /end GROUP
/begin GROUP CalRegn02Rt01GroupC.GmTqArbnApaSmotngHwTqLpFilFrq.Val "MICROSAR RTE" /begin SUB_GROUP /end SUB_GROUP /begin FUNCTION_LIST /end FUNCTION_LIST /begin REF_CHARACTERISTIC CalRegn02Rt01GroupC.GmTqArbnApaSmotngHwTqLpFilFrq.Val /end REF_CHARACTERISTIC /begin REF_MEASUREMENT /end REF_MEASUREMENT /end GROUP
/begin GROUP CalRegn02Rt01GroupC.GmTqArbnApaSmotngX.Ary1D "MICROSAR RTE" /begin SUB_GROUP /end SUB_GROUP /begin FUNCTION_LIST /end FUNCTION_LIST /begin REF_CHARACTERISTIC CalRegn02Rt01GroupC.GmTqArbnApaSmotngX.Ary1D /end REF_CHARACTERISTIC /begin REF_MEASUREMENT /end REF_MEASUREMENT /end GROUP
/begin GROUP CalRegn02Rt01GroupC.GmTqArbnApaSmotngY.Ary1D "MICROSAR RTE" /begin SUB_GROUP /end SUB_GROUP /begin FUNCTION_LIST /end FUNCTION_LIST /begin REF_CHARACTERISTIC CalRegn02Rt01GroupC.GmTqArbnApaSmotngY.Ary1D /end REF_CHARACTERISTIC /begin REF_MEASUREMENT /end REF_MEASUREMENT /end GROUP
/begin GROUP CalRegn02Rt01GroupC.GmTqArbnLkaOutpOvrlX.Ary2D "MICROSAR RTE" /begin SUB_GROUP /end SUB_GROUP /begin FUNCTION_LIST /end FUNCTION_LIST /begin REF_CHARACTERISTIC CalRegn02Rt01GroupC.GmTqArbnLkaOutpOvrlX.Ary2D /end REF_CHARACTERISTIC /begin REF_MEASUREMENT /end REF_MEASUREMENT /end GROUP
/begin GROUP CalRegn02Rt01GroupC.GmTqArbnLkaOutpOvrlY.Ary2D "MICROSAR RTE" /begin SUB_GROUP /end SUB_GROUP /begin FUNCTION_LIST /end FUNCTION_LIST /begin REF_CHARACTERISTIC CalRegn02Rt01GroupC.GmTqArbnLkaOutpOvrlY.Ary2D /end REF_CHARACTERISTIC /begin REF_MEASUREMENT /end REF_MEASUREMENT /end GROUP
/begin GROUP CalRegn02Rt01GroupC.GmTqArbnLkaSlewX.Ary1D "MICROSAR RTE" /begin SUB_GROUP /end SUB_GROUP /begin FUNCTION_LIST /end FUNCTION_LIST /begin REF_CHARACTERISTIC CalRegn02Rt01GroupC.GmTqArbnLkaSlewX.Ary1D /end REF_CHARACTERISTIC /begin REF_MEASUREMENT /end REF_MEASUREMENT /end GROUP
/begin GROUP CalRegn02Rt01GroupC.GmTqArbnLkaSlewY.Ary1D "MICROSAR RTE" /begin SUB_GROUP /end SUB_GROUP /begin FUNCTION_LIST /end FUNCTION_LIST /begin REF_CHARACTERISTIC CalRegn02Rt01GroupC.GmTqArbnLkaSlewY.Ary1D /end REF_CHARACTERISTIC /begin REF_MEASUREMENT /end REF_MEASUREMENT /end GROUP
/begin GROUP CalRegn02Rt02GroupC "MICROSAR RTE" /begin SUB_GROUP CalRegn02Rt02GroupC.CalibrationPorts /end SUB_GROUP /begin FUNCTION_LIST /end FUNCTION_LIST /begin REF_CHARACTERISTIC /end REF_CHARACTERISTIC /begin REF_MEASUREMENT /end REF_MEASUREMENT /end GROUP
/begin GROUP CalRegn02Rt02GroupC.CalibrationPorts "MICROSAR RTE"
 /begin SUB_GROUP CalRegn02Rt02GroupC.GmOvrlStMgrHwAgTarLimr.Val CalRegn02Rt02GroupC.GmOvrlStMgrShiftLvrTiThd.Val CalRegn02Rt02GroupC.GmOvrlStMgrStandStillThd.Val CalRegn02Rt02GroupC.GmOvrlStMgrStandStillTiThd.Val CalRegn02Rt02GroupC.GmTqArbnApaDiRateY.Ary1D CalRegn02Rt02GroupC.GmTqArbnApaEnaRate.Val CalRegn02Rt02GroupC.GmTqArbnApaSmotngHwTqLpFilFrq.Val CalRegn02Rt02GroupC.GmTqArbnApaSmotngX.Ary1D CalRegn02Rt02GroupC.GmTqArbnApaSmotngY.Ary1D CalRegn02Rt02GroupC.GmTqArbnLkaOutpOvrlX.Ary2D CalRegn02Rt02GroupC.GmTqArbnLkaOutpOvrlY.Ary2D CalRegn02Rt02GroupC.GmTqArbnLkaSlewX.Ary1D CalRegn02Rt02GroupC.GmTqArbnLkaSlewY.Ary1D /end SUB_GROUP
 /begin FUNCTION_LIST /end FUNCTION_LIST
 /begin REF_CHARACTERISTIC /end REF_CHARACTERISTIC
 /begin REF_MEASUREMENT /end REF_MEASUREMENT
/end GROUP
/begin GROUP CalRegn02Rt02GroupC.GmOvrlStMgrHwAgTarLimr.Val "MICROSAR RTE" /begin SUB_GROUP /end SUB_GROUP /begin FUNCTION_LIST /end FUNCTION_LIST /begin REF_CHARACTERISTIC CalRegn02Rt02GroupC.GmOvrlStMgrHwAgTarLimr.Val /end REF_CHARACTERISTIC /begin REF_MEASUREMENT /end REF_MEASUREMENT /end GROUP
/begin GROUP CalRegn02Rt02GroupC.GmOvrlStMgrShiftLvrTiThd.Val "MICROSAR RTE" /begin SUB_GROUP /end SUB_GROUP /begin FUNCTION_LIST /end FUNCTION_LIST /begin REF_CHARACTERISTIC CalRegn02Rt02GroupC.GmOvrlStMgrShiftLvrTiThd.Val /end REF_CHARACTERISTIC /begin REF_MEASUREMENT /end REF_MEASUREMENT /end GROUP
/begin GROUP CalRegn02Rt02GroupC.GmOvrlStMgrStandStillThd.Val "MICROSAR RTE" /begin SUB_GROUP /end SUB_GROUP /begin FUNCTION_LIST /end FUNCTION_LIST /begin REF_CHARACTERISTIC CalRegn02Rt02GroupC.GmOvrlStMgrStandStillThd.Val /end REF_CHARACTERISTIC /begin REF_MEASUREMENT /end REF_MEASUREMENT /end GROUP
/begin GROUP CalRegn02Rt02GroupC.GmOvrlStMgrStandStillTiThd.Val "MICROSAR RTE" /begin SUB_GROUP /end SUB_GROUP /begin FUNCTION_LIST /end FUNCTION_LIST /begin REF_CHARACTERISTIC CalRegn02Rt02GroupC.GmOvrlStMgrStandStillTiThd.Val /end REF_CHARACTERISTIC /begin REF_MEASUREMENT /end REF_MEASUREMENT /end GROUP
/begin GROUP CalRegn02Rt02GroupC.GmTqArbnApaDiRateY.Ary1D "MICROSAR RTE" /begin SUB_GROUP /end SUB_GROUP /begin FUNCTION_LIST /end FUNCTION_LIST /begin REF_CHARACTERISTIC CalRegn02Rt02GroupC.GmTqArbnApaDiRateY.Ary1D /end REF_CHARACTERISTIC /begin REF_MEASUREMENT /end REF_MEASUREMENT /end GROUP
/begin GROUP CalRegn02Rt02GroupC.GmTqArbnApaEnaRate.Val "MICROSAR RTE" /begin SUB_GROUP /end SUB_GROUP /begin FUNCTION_LIST /end FUNCTION_LIST /begin REF_CHARACTERISTIC CalRegn02Rt02GroupC.GmTqArbnApaEnaRate.Val /end REF_CHARACTERISTIC /begin REF_MEASUREMENT /end REF_MEASUREMENT /end GROUP
/begin GROUP CalRegn02Rt02GroupC.GmTqArbnApaSmotngHwTqLpFilFrq.Val "MICROSAR RTE" /begin SUB_GROUP /end SUB_GROUP /begin FUNCTION_LIST /end FUNCTION_LIST /begin REF_CHARACTERISTIC CalRegn02Rt02GroupC.GmTqArbnApaSmotngHwTqLpFilFrq.Val /end REF_CHARACTERISTIC /begin REF_MEASUREMENT /end REF_MEASUREMENT /end GROUP
/begin GROUP CalRegn02Rt02GroupC.GmTqArbnApaSmotngX.Ary1D "MICROSAR RTE" /begin SUB_GROUP /end SUB_GROUP /begin FUNCTION_LIST /end FUNCTION_LIST /begin REF_CHARACTERISTIC CalRegn02Rt02GroupC.GmTqArbnApaSmotngX.Ary1D /end REF_CHARACTERISTIC /begin REF_MEASUREMENT /end REF_MEASUREMENT /end GROUP
/begin GROUP CalRegn02Rt02GroupC.GmTqArbnApaSmotngY.Ary1D "MICROSAR RTE" /begin SUB_GROUP /end SUB_GROUP /begin FUNCTION_LIST /end FUNCTION_LIST /begin REF_CHARACTERISTIC CalRegn02Rt02GroupC.GmTqArbnApaSmotngY.Ary1D /end REF_CHARACTERISTIC /begin REF_MEASUREMENT /end REF_MEASUREMENT /end GROUP
/begin GROUP CalRegn02Rt02GroupC.GmTqArbnLkaOutpOvrlX.Ary2D "MICROSAR RTE" /begin SUB_GROUP /end SUB_GROUP /begin FUNCTION_LIST /end FUNCTION_LIST /begin REF_CHARACTERISTIC CalRegn02Rt02GroupC.GmTqArbnLkaOutpOvrlX.Ary2D /end REF_CHARACTERISTIC /begin REF_MEASUREMENT /end REF_MEASUREMENT /end GROUP
/begin GROUP CalRegn02Rt02GroupC.GmTqArbnLkaOutpOvrlY.Ary2D "MICROSAR RTE" /begin SUB_GROUP /end SUB_GROUP /begin FUNCTION_LIST /end FUNCTION_LIST /begin REF_CHARACTERISTIC CalRegn02Rt02GroupC.GmTqArbnLkaOutpOvrlY.Ary2D /end REF_CHARACTERISTIC /begin REF_MEASUREMENT /end REF_MEASUREMENT /end GROUP
/begin GROUP CalRegn02Rt02GroupC.GmTqArbnLkaSlewX.Ary1D "MICROSAR RTE" /begin SUB_GROUP /end SUB_GROUP /begin FUNCTION_LIST /end FUNCTION_LIST /begin REF_CHARACTERISTIC CalRegn02Rt02GroupC.GmTqArbnLkaSlewX.Ary1D /end REF_CHARACTERISTIC /begin REF_MEASUREMENT /end REF_MEASUREMENT /end GROUP
/begin GROUP CalRegn02Rt02GroupC.GmTqArbnLkaSlewY.Ary1D "MICROSAR RTE" /begin SUB_GROUP /end SUB_GROUP /begin FUNCTION_LIST /end FUNCTION_LIST /begin REF_CHARACTERISTIC CalRegn02Rt02GroupC.GmTqArbnLkaSlewY.Ary1D /end REF_CHARACTERISTIC /begin REF_MEASUREMENT /end REF_MEASUREMENT /end GROUP
/begin GROUP CalRegn02Rt03GroupC "MICROSAR RTE" /begin SUB_GROUP CalRegn02Rt03GroupC.CalibrationPorts /end SUB_GROUP /begin FUNCTION_LIST /end FUNCTION_LIST /begin REF_CHARACTERISTIC /end REF_CHARACTERISTIC /begin REF_MEASUREMENT /end REF_MEASUREMENT /end GROUP
/begin GROUP CalRegn02Rt03GroupC.CalibrationPorts "MICROSAR RTE"
 /begin SUB_GROUP CalRegn02Rt03GroupC.GmOvrlStMgrHwAgTarLimr.Val CalRegn02Rt03GroupC.GmOvrlStMgrShiftLvrTiThd.Val CalRegn02Rt03GroupC.GmOvrlStMgrStandStillThd.Val CalRegn02Rt03GroupC.GmOvrlStMgrStandStillTiThd.Val CalRegn02Rt03GroupC.GmTqArbnApaDiRateY.Ary1D CalRegn02Rt03GroupC.GmTqArbnApaEnaRate.Val CalRegn02Rt03GroupC.GmTqArbnApaSmotngHwTqLpFilFrq.Val CalRegn02Rt03GroupC.GmTqArbnApaSmotngX.Ary1D CalRegn02Rt03GroupC.GmTqArbnApaSmotngY.Ary1D CalRegn02Rt03GroupC.GmTqArbnLkaOutpOvrlX.Ary2D CalRegn02Rt03GroupC.GmTqArbnLkaOutpOvrlY.Ary2D CalRegn02Rt03GroupC.GmTqArbnLkaSlewX.Ary1D CalRegn02Rt03GroupC.GmTqArbnLkaSlewY.Ary1D /end SUB_GROUP
 /begin FUNCTION_LIST /end FUNCTION_LIST
 /begin REF_CHARACTERISTIC /end REF_CHARACTERISTIC
 /begin REF_MEASUREMENT /end REF_MEASUREMENT
/end GROUP
/begin GROUP CalRegn02Rt03GroupC.GmOvrlStMgrHwAgTarLimr.Val "MICROSAR RTE" /begin SUB_GROUP /end SUB_GROUP /begin FUNCTION_LIST /end FUNCTION_LIST /begin REF_CHARACTERISTIC CalRegn02Rt03GroupC.GmOvrlStMgrHwAgTarLimr.Val /end REF_CHARACTERISTIC /begin REF_MEASUREMENT /end REF_MEASUREMENT /end GROUP
/begin GROUP CalRegn02Rt03GroupC.GmOvrlStMgrShiftLvrTiThd.Val "MICROSAR RTE" /begin SUB_GROUP /end SUB_GROUP /begin FUNCTION_LIST /end FUNCTION_LIST /begin REF_CHARACTERISTIC CalRegn02Rt03GroupC.GmOvrlStMgrShiftLvrTiThd.Val /end REF_CHARACTERISTIC /begin REF_MEASUREMENT /end REF_MEASUREMENT /end GROUP
/begin GROUP CalRegn02Rt03GroupC.GmOvrlStMgrStandStillThd.Val "MICROSAR RTE" /begin SUB_GROUP /end SUB_GROUP /begin FUNCTION_LIST /end FUNCTION_LIST /begin REF_CHARACTERISTIC CalRegn02Rt03GroupC.GmOvrlStMgrStandStillThd.Val /end REF_CHARACTERISTIC /begin REF_MEASUREMENT /end REF_MEASUREMENT /end GROUP
/begin GROUP CalRegn02Rt03GroupC.GmOvrlStMgrStandStillTiThd.Val "MICROSAR RTE" /begin SUB_GROUP /end SUB_GROUP /begin FUNCTION_LIST /end FUNCTION_LIST /begin REF_CHARACTERISTIC CalRegn02Rt03GroupC.GmOvrlStMgrStandStillTiThd.Val /end REF_CHARACTERISTIC /begin REF_MEASUREMENT /end REF_MEASUREMENT /end GROUP
/begin GROUP CalRegn02Rt03GroupC.GmTqArbnApaDiRateY.Ary1D "MICROSAR RTE" /begin SUB_GROUP /end SUB_GROUP /begin FUNCTION_LIST /end FUNCTION_LIST /begin REF_CHARACTERISTIC CalRegn02Rt03GroupC.GmTqArbnApaDiRateY.Ary1D /end REF_CHARACTERISTIC /begin REF_MEASUREMENT /end REF_MEASUREMENT /end GROUP
/begin GROUP CalRegn02Rt03GroupC.GmTqArbnApaEnaRate.Val "MICROSAR RTE" /begin SUB_GROUP /end SUB_GROUP /begin FUNCTION_LIST /end FUNCTION_LIST /begin REF_CHARACTERISTIC CalRegn02Rt03GroupC.GmTqArbnApaEnaRate.Val /end REF_CHARACTERISTIC /begin REF_MEASUREMENT /end REF_MEASUREMENT /end GROUP
/begin GROUP CalRegn02Rt03GroupC.GmTqArbnApaSmotngHwTqLpFilFrq.Val "MICROSAR RTE" /begin SUB_GROUP /end SUB_GROUP /begin FUNCTION_LIST /end FUNCTION_LIST /begin REF_CHARACTERISTIC CalRegn02Rt03GroupC.GmTqArbnApaSmotngHwTqLpFilFrq.Val /end REF_CHARACTERISTIC /begin REF_MEASUREMENT /end REF_MEASUREMENT /end GROUP
/begin GROUP CalRegn02Rt03GroupC.GmTqArbnApaSmotngX.Ary1D "MICROSAR RTE" /begin SUB_GROUP /end SUB_GROUP /begin FUNCTION_LIST /end FUNCTION_LIST /begin REF_CHARACTERISTIC CalRegn02Rt03GroupC.GmTqArbnApaSmotngX.Ary1D /end REF_CHARACTERISTIC /begin REF_MEASUREMENT /end REF_MEASUREMENT /end GROUP
/begin GROUP CalRegn02Rt03GroupC.GmTqArbnApaSmotngY.Ary1D "MICROSAR RTE" /begin SUB_GROUP /end SUB_GROUP /begin FUNCTION_LIST /end FUNCTION_LIST /begin REF_CHARACTERISTIC CalRegn02Rt03GroupC.GmTqArbnApaSmotngY.Ary1D /end REF_CHARACTERISTIC /begin REF_MEASUREMENT /end REF_MEASUREMENT /end GROUP
/begin GROUP CalRegn02Rt03GroupC.GmTqArbnLkaOutpOvrlX.Ary2D "MICROSAR RTE" /begin SUB_GROUP /end SUB_GROUP /begin FUNCTION_LIST /end FUNCTION_LIST /begin REF_CHARACTERISTIC CalRegn02Rt03GroupC.GmTqArbnLkaOutpOvrlX.Ary2D /end REF_CHARACTERISTIC /begin REF_MEASUREMENT /end REF_MEASUREMENT /end GROUP
/begin GROUP CalRegn02Rt03GroupC.GmTqArbnLkaOutpOvrlY.Ary2D "MICROSAR RTE" /begin SUB_GROUP /end SUB_GROUP /begin FUNCTION_LIST /end FUNCTION_LIST /begin REF_CHARACTERISTIC CalRegn02Rt03GroupC.GmTqArbnLkaOutpOvrlY.Ary2D /end REF_CHARACTERISTIC /begin REF_MEASUREMENT /end REF_MEASUREMENT /end GROUP
/begin GROUP CalRegn02Rt03GroupC.GmTqArbnLkaSlewX.Ary1D "MICROSAR RTE" /begin SUB_GROUP /end SUB_GROUP /begin FUNCTION_LIST /end FUNCTION_LIST /begin REF_CHARACTERISTIC CalRegn02Rt03GroupC.GmTqArbnLkaSlewX.Ary1D /end REF_CHARACTERISTIC /begin REF_MEASUREMENT /end REF_MEASUREMENT /end GROUP
/begin GROUP CalRegn02Rt03GroupC.GmTqArbnLkaSlewY.Ary1D "MICROSAR RTE" /begin SUB_GROUP /end SUB_GROUP /begin FUNCTION_LIST /end FUNCTION_LIST /begin REF_CHARACTERISTIC CalRegn02Rt03GroupC.GmTqArbnLkaSlewY.Ary1D /end REF_CHARACTERISTIC /begin REF_MEASUREMENT /end REF_MEASUREMENT /end GROUP
/begin GROUP CalRegn02Rt04GroupC "MICROSAR RTE" /begin SUB_GROUP CalRegn02Rt04GroupC.CalibrationPorts /end SUB_GROUP /begin FUNCTION_LIST /end FUNCTION_LIST /begin REF_CHARACTERISTIC /end REF_CHARACTERISTIC /begin REF_MEASUREMENT /end REF_MEASUREMENT /end GROUP
/begin GROUP CalRegn02Rt04GroupC.CalibrationPorts "MICROSAR RTE"
 /begin SUB_GROUP CalRegn02Rt04GroupC.GmOvrlStMgrHwAgTarLimr.Val CalRegn02Rt04GroupC.GmOvrlStMgrShiftLvrTiThd.Val CalRegn02Rt04GroupC.GmOvrlStMgrStandStillThd.Val CalRegn02Rt04GroupC.GmOvrlStMgrStandStillTiThd.Val CalRegn02Rt04GroupC.GmTqArbnApaDiRateY.Ary1D CalRegn02Rt04GroupC.GmTqArbnApaEnaRate.Val CalRegn02Rt04GroupC.GmTqArbnApaSmotngHwTqLpFilFrq.Val CalRegn02Rt04GroupC.GmTqArbnApaSmotngX.Ary1D CalRegn02Rt04GroupC.GmTqArbnApaSmotngY.Ary1D CalRegn02Rt04GroupC.GmTqArbnLkaOutpOvrlX.Ary2D CalRegn02Rt04GroupC.GmTqArbnLkaOutpOvrlY.Ary2D CalRegn02Rt04GroupC.GmTqArbnLkaSlewX.Ary1D CalRegn02Rt04GroupC.GmTqArbnLkaSlewY.Ary1D /end SUB_GROUP
 /begin FUNCTION_LIST /end FUNCTION_LIST
 /begin REF_CHARACTERISTIC /end REF_CHARACTERISTIC
 /begin REF_MEASUREMENT /end REF_MEASUREMENT
/end GROUP
/begin GROUP CalRegn02Rt04GroupC.GmOvrlStMgrHwAgTarLimr.Val "MICROSAR RTE" /begin SUB_GROUP /end SUB_GROUP /begin FUNCTION_LIST /end FUNCTION_LIST /begin REF_CHARACTERISTIC CalRegn02Rt04GroupC.GmOvrlStMgrHwAgTarLimr.Val /end REF_CHARACTERISTIC /begin REF_MEASUREMENT /end REF_MEASUREMENT /end GROUP
/begin GROUP CalRegn02Rt04GroupC.GmOvrlStMgrShiftLvrTiThd.Val "MICROSAR RTE" /begin SUB_GROUP /end SUB_GROUP /begin FUNCTION_LIST /end FUNCTION_LIST /begin REF_CHARACTERISTIC CalRegn02Rt04GroupC.GmOvrlStMgrShiftLvrTiThd.Val /end REF_CHARACTERISTIC /begin REF_MEASUREMENT /end REF_MEASUREMENT /end GROUP
/begin GROUP CalRegn02Rt04GroupC.GmOvrlStMgrStandStillThd.Val "MICROSAR RTE" /begin SUB_GROUP /end SUB_GROUP /begin FUNCTION_LIST /end FUNCTION_LIST /begin REF_CHARACTERISTIC CalRegn02Rt04GroupC.GmOvrlStMgrStandStillThd.Val /end REF_CHARACTERISTIC /begin REF_MEASUREMENT /end REF_MEASUREMENT /end GROUP
/begin GROUP CalRegn02Rt04GroupC.GmOvrlStMgrStandStillTiThd.Val "MICROSAR RTE" /begin SUB_GROUP /end SUB_GROUP /begin FUNCTION_LIST /end FUNCTION_LIST /begin REF_CHARACTERISTIC CalRegn02Rt04GroupC.GmOvrlStMgrStandStillTiThd.Val /end REF_CHARACTERISTIC /begin REF_MEASUREMENT /end REF_MEASUREMENT /end GROUP
/begin GROUP CalRegn02Rt04GroupC.GmTqArbnApaDiRateY.Ary1D "MICROSAR RTE" /begin SUB_GROUP /end SUB_GROUP /begin FUNCTION_LIST /end FUNCTION_LIST /begin REF_CHARACTERISTIC CalRegn02Rt04GroupC.GmTqArbnApaDiRateY.Ary1D /end REF_CHARACTERISTIC /begin REF_MEASUREMENT /end REF_MEASUREMENT /end GROUP
/begin GROUP CalRegn02Rt04GroupC.GmTqArbnApaEnaRate.Val "MICROSAR RTE" /begin SUB_GROUP /end SUB_GROUP /begin FUNCTION_LIST /end FUNCTION_LIST /begin REF_CHARACTERISTIC CalRegn02Rt04GroupC.GmTqArbnApaEnaRate.Val /end REF_CHARACTERISTIC /begin REF_MEASUREMENT /end REF_MEASUREMENT /end GROUP
/begin GROUP CalRegn02Rt04GroupC.GmTqArbnApaSmotngHwTqLpFilFrq.Val "MICROSAR RTE" /begin SUB_GROUP /end SUB_GROUP /begin FUNCTION_LIST /end FUNCTION_LIST /begin REF_CHARACTERISTIC CalRegn02Rt04GroupC.GmTqArbnApaSmotngHwTqLpFilFrq.Val /end REF_CHARACTERISTIC /begin REF_MEASUREMENT /end REF_MEASUREMENT /end GROUP
/begin GROUP CalRegn02Rt04GroupC.GmTqArbnApaSmotngX.Ary1D "MICROSAR RTE" /begin SUB_GROUP /end SUB_GROUP /begin FUNCTION_LIST /end FUNCTION_LIST /begin REF_CHARACTERISTIC CalRegn02Rt04GroupC.GmTqArbnApaSmotngX.Ary1D /end REF_CHARACTERISTIC /begin REF_MEASUREMENT /end REF_MEASUREMENT /end GROUP
/begin GROUP CalRegn02Rt04GroupC.GmTqArbnApaSmotngY.Ary1D "MICROSAR RTE" /begin SUB_GROUP /end SUB_GROUP /begin FUNCTION_LIST /end FUNCTION_LIST /begin REF_CHARACTERISTIC CalRegn02Rt04GroupC.GmTqArbnApaSmotngY.Ary1D /end REF_CHARACTERISTIC /begin REF_MEASUREMENT /end REF_MEASUREMENT /end GROUP
/begin GROUP CalRegn02Rt04GroupC.GmTqArbnLkaOutpOvrlX.Ary2D "MICROSAR RTE" /begin SUB_GROUP /end SUB_GROUP /begin FUNCTION_LIST /end FUNCTION_LIST /begin REF_CHARACTERISTIC CalRegn02Rt04GroupC.GmTqArbnLkaOutpOvrlX.Ary2D /end REF_CHARACTERISTIC /begin REF_MEASUREMENT /end REF_MEASUREMENT /end GROUP
/begin GROUP CalRegn02Rt04GroupC.GmTqArbnLkaOutpOvrlY.Ary2D "MICROSAR RTE" /begin SUB_GROUP /end SUB_GROUP /begin FUNCTION_LIST /end FUNCTION_LIST /begin REF_CHARACTERISTIC CalRegn02Rt04GroupC.GmTqArbnLkaOutpOvrlY.Ary2D /end REF_CHARACTERISTIC /begin REF_MEASUREMENT /end REF_MEASUREMENT /end GROUP
/begin GROUP CalRegn02Rt04GroupC.GmTqArbnLkaSlewX.Ary1D "MICROSAR RTE" /begin SUB_GROUP /end SUB_GROUP /begin FUNCTION_LIST /end FUNCTION_LIST /begin REF_CHARACTERISTIC CalRegn02Rt04GroupC.GmTqArbnLkaSlewX.Ary1D /end REF_CHARACTERISTIC /begin REF_MEASUREMENT /end REF_MEASUREMENT /end GROUP
/begin GROUP CalRegn02Rt04GroupC.GmTqArbnLkaSlewY.Ary1D "MICROSAR RTE" /begin SUB_GROUP /end SUB_GROUP /begin FUNCTION_LIST /end FUNCTION_LIST /begin REF_CHARACTERISTIC CalRegn02Rt04GroupC.GmTqArbnLkaSlewY.Ary1D /end REF_CHARACTERISTIC /begin REF_MEASUREMENT /end REF_MEASUREMENT /end GROUP
/begin GROUP CalRegn03Cmn "MICROSAR RTE" /begin SUB_GROUP CalRegn03Cmn.CalibrationPorts /end SUB_GROUP /begin FUNCTION_LIST /end FUNCTION_LIST /begin REF_CHARACTERISTIC /end REF_CHARACTERISTIC /begin REF_MEASUREMENT /end REF_MEASUREMENT /end GROUP
/begin GROUP CalRegn03Cmn.AssiHiFrqHpFilFrqY.Ary1D "MICROSAR RTE" /begin SUB_GROUP /end SUB_GROUP /begin FUNCTION_LIST /end FUNCTION_LIST /begin REF_CHARACTERISTIC CalRegn03Cmn.AssiHiFrqHpFilFrqY.Ary1D /end REF_CHARACTERISTIC /begin REF_MEASUREMENT /end REF_MEASUREMENT /end GROUP
/begin GROUP CalRegn03Cmn.CalibrationPorts "MICROSAR RTE"
 /begin SUB_GROUP CalRegn03Cmn.AssiHiFrqHpFilFrqY.Ary1D CalRegn03Cmn.DampgQuadHwTqBacklsh.Val CalRegn03Cmn.DampgQuadMotVelBacklsh.Val CalRegn03Cmn.EotLrngHwAgOverTrvlEntr.Val CalRegn03Cmn.EotLrngHwAgOverTrvlExit.Val CalRegn03Cmn.EotProtnSoftEndStopAuthyThd.Val CalRegn03Cmn.HwAgTrakgServoDiRateX.Ary1D CalRegn03Cmn.HwAgTrakgServoDiRateY.Ary1D CalRegn03Cmn.HwAgTrakgServoEnaRate.Val CalRegn03Cmn.HwAgTrakgServoExecRate.Val CalRegn03Cmn.HwAgTrakgServoHwAgRateLim.Ary1D CalRegn03Cmn.HwAgTrakgServoMaxCmdX.Ary1D CalRegn03Cmn.HwAgTrakgServoMaxCmdY.Ary1D CalRegn03Cmn.HwAgTrakgServoMaxRamp.Val CalRegn03Cmn.HwAgTrakgServoMinRamp.Val CalRegn03Cmn.HwAgTrakgServoPidLim.Val CalRegn03Cmn.HwAgTrakgServoRampCmpl.Val CalRegn03Cmn.HwAgTrakgServoVehSpdBasd.Ary1D CalRegn03Cmn.NxtrCalIdsCal2DevlpAuthor.Ary1D CalRegn03Cmn.NxtrCalIdsCal2DevlpDesc.Ary1D CalRegn03Cmn.NxtrCalIdsCal2DevlpRelNr.Val CalRegn03Cmn.NxtrCalIdsCal2DevlpRelSt.Val CalRegn03Cmn.NxtrCalIdsCal2DevlpTiStamp.Val CalRegn03Cmn.NxtrCalIdsCal2DevlpVers.Val CalRegn03Cmn.TqLoaDrvrTqNom.Val CalRegn03Cmn.TqLoaMotTqCmdLim.Val CalRegn03Cmn.TqLoaMotVelAndTqBasdScaFacFallRate.Val CalRegn03Cmn.TqLoaMotVelAndTqBasdScaFacMax.Val CalRegn03Cmn.TqLoaMotVelAndTqBasdScaFacMin.Val CalRegn03Cmn.TqLoaMotVelAndTqBasdScaFacRiseRate.Val CalRegn03Cmn.TqLoaMotVelMgnThd.Val CalRegn03Cmn.TqLoaTqCmdLimY.Ary1D CalRegn03Cmn.TqLoaTqCmdMgnThd.Val CalRegn03Cmn.TqLoaVehLatADifScaFacFallRate.Val CalRegn03Cmn.TqLoaVehLatADifScaFacRiseRate.Val CalRegn03Cmn.TqLoaVehLatADifScaFacX.Ary1D CalRegn03Cmn.TqLoaVehLatADifScaFacY.Ary2D CalRegn03Cmn.TqLoaVehLatAEstimnFilFrq.Val CalRegn03Cmn.TqLoaVehLatAGainY.Ary1D CalRegn03Cmn.TqLoaVehSpdScaFacX.Ary1D CalRegn03Cmn.TqLoaVehSpdScaFacY.Ary1D CalRegn03Cmn.TqLoaVehSpdX.Ary1D CalRegn03Cmn.TqLoaVehSteerRat.Val CalRegn03Cmn.TqLoaVehUnderSteerGrdt.Val CalRegn03Cmn.TqLoaVehWhlBas.Val CalRegn03Cmn.WhlImbRejctnCmdMgnLp1FilFrq.Val CalRegn03Cmn.WhlImbRejctnCmdMgnLp2FilFrq.Val CalRegn03Cmn.WhlImbRejctnDcTrendLpFil.Val /end SUB_GROUP
 /begin FUNCTION_LIST /end FUNCTION_LIST
 /begin REF_CHARACTERISTIC /end REF_CHARACTERISTIC
 /begin REF_MEASUREMENT /end REF_MEASUREMENT
/end GROUP
/begin GROUP CalRegn03Cmn.DampgQuadHwTqBacklsh.Val "MICROSAR RTE" /begin SUB_GROUP /end SUB_GROUP /begin FUNCTION_LIST /end FUNCTION_LIST /begin REF_CHARACTERISTIC CalRegn03Cmn.DampgQuadHwTqBacklsh.Val /end REF_CHARACTERISTIC /begin REF_MEASUREMENT /end REF_MEASUREMENT /end GROUP
/begin GROUP CalRegn03Cmn.DampgQuadMotVelBacklsh.Val "MICROSAR RTE" /begin SUB_GROUP /end SUB_GROUP /begin FUNCTION_LIST /end FUNCTION_LIST /begin REF_CHARACTERISTIC CalRegn03Cmn.DampgQuadMotVelBacklsh.Val /end REF_CHARACTERISTIC /begin REF_MEASUREMENT /end REF_MEASUREMENT /end GROUP
/begin GROUP CalRegn03Cmn.EotLrngHwAgOverTrvlEntr.Val "MICROSAR RTE" /begin SUB_GROUP /end SUB_GROUP /begin FUNCTION_LIST /end FUNCTION_LIST /begin REF_CHARACTERISTIC CalRegn03Cmn.EotLrngHwAgOverTrvlEntr.Val /end REF_CHARACTERISTIC /begin REF_MEASUREMENT /end REF_MEASUREMENT /end GROUP
/begin GROUP CalRegn03Cmn.EotLrngHwAgOverTrvlExit.Val "MICROSAR RTE" /begin SUB_GROUP /end SUB_GROUP /begin FUNCTION_LIST /end FUNCTION_LIST /begin REF_CHARACTERISTIC CalRegn03Cmn.EotLrngHwAgOverTrvlExit.Val /end REF_CHARACTERISTIC /begin REF_MEASUREMENT /end REF_MEASUREMENT /end GROUP
/begin GROUP CalRegn03Cmn.EotProtnSoftEndStopAuthyThd.Val "MICROSAR RTE" /begin SUB_GROUP /end SUB_GROUP /begin FUNCTION_LIST /end FUNCTION_LIST /begin REF_CHARACTERISTIC CalRegn03Cmn.EotProtnSoftEndStopAuthyThd.Val /end REF_CHARACTERISTIC /begin REF_MEASUREMENT /end REF_MEASUREMENT /end GROUP
/begin GROUP CalRegn03Cmn.HwAgTrakgServoDiRateX.Ary1D "MICROSAR RTE" /begin SUB_GROUP /end SUB_GROUP /begin FUNCTION_LIST /end FUNCTION_LIST /begin REF_CHARACTERISTIC CalRegn03Cmn.HwAgTrakgServoDiRateX.Ary1D /end REF_CHARACTERISTIC /begin REF_MEASUREMENT /end REF_MEASUREMENT /end GROUP
/begin GROUP CalRegn03Cmn.HwAgTrakgServoDiRateY.Ary1D "MICROSAR RTE" /begin SUB_GROUP /end SUB_GROUP /begin FUNCTION_LIST /end FUNCTION_LIST /begin REF_CHARACTERISTIC CalRegn03Cmn.HwAgTrakgServoDiRateY.Ary1D /end REF_CHARACTERISTIC /begin REF_MEASUREMENT /end REF_MEASUREMENT /end GROUP
/begin GROUP CalRegn03Cmn.HwAgTrakgServoEnaRate.Val "MICROSAR RTE" /begin SUB_GROUP /end SUB_GROUP /begin FUNCTION_LIST /end FUNCTION_LIST /begin REF_CHARACTERISTIC CalRegn03Cmn.HwAgTrakgServoEnaRate.Val /end REF_CHARACTERISTIC /begin REF_MEASUREMENT /end REF_MEASUREMENT /end GROUP
/begin GROUP CalRegn03Cmn.HwAgTrakgServoExecRate.Val "MICROSAR RTE" /begin SUB_GROUP /end SUB_GROUP /begin FUNCTION_LIST /end FUNCTION_LIST /begin REF_CHARACTERISTIC CalRegn03Cmn.HwAgTrakgServoExecRate.Val /end REF_CHARACTERISTIC /begin REF_MEASUREMENT /end REF_MEASUREMENT /end GROUP
/begin GROUP CalRegn03Cmn.HwAgTrakgServoHwAgRateLim.Ary1D "MICROSAR RTE" /begin SUB_GROUP /end SUB_GROUP /begin FUNCTION_LIST /end FUNCTION_LIST /begin REF_CHARACTERISTIC CalRegn03Cmn.HwAgTrakgServoHwAgRateLim.Ary1D /end REF_CHARACTERISTIC /begin REF_MEASUREMENT /end REF_MEASUREMENT /end GROUP
/begin GROUP CalRegn03Cmn.HwAgTrakgServoMaxCmdX.Ary1D "MICROSAR RTE" /begin SUB_GROUP /end SUB_GROUP /begin FUNCTION_LIST /end FUNCTION_LIST /begin REF_CHARACTERISTIC CalRegn03Cmn.HwAgTrakgServoMaxCmdX.Ary1D /end REF_CHARACTERISTIC /begin REF_MEASUREMENT /end REF_MEASUREMENT /end GROUP
/begin GROUP CalRegn03Cmn.HwAgTrakgServoMaxCmdY.Ary1D "MICROSAR RTE" /begin SUB_GROUP /end SUB_GROUP /begin FUNCTION_LIST /end FUNCTION_LIST /begin REF_CHARACTERISTIC CalRegn03Cmn.HwAgTrakgServoMaxCmdY.Ary1D /end REF_CHARACTERISTIC /begin REF_MEASUREMENT /end REF_MEASUREMENT /end GROUP
/begin GROUP CalRegn03Cmn.HwAgTrakgServoMaxRamp.Val "MICROSAR RTE" /begin SUB_GROUP /end SUB_GROUP /begin FUNCTION_LIST /end FUNCTION_LIST /begin REF_CHARACTERISTIC CalRegn03Cmn.HwAgTrakgServoMaxRamp.Val /end REF_CHARACTERISTIC /begin REF_MEASUREMENT /end REF_MEASUREMENT /end GROUP
/begin GROUP CalRegn03Cmn.HwAgTrakgServoMinRamp.Val "MICROSAR RTE" /begin SUB_GROUP /end SUB_GROUP /begin FUNCTION_LIST /end FUNCTION_LIST /begin REF_CHARACTERISTIC CalRegn03Cmn.HwAgTrakgServoMinRamp.Val /end REF_CHARACTERISTIC /begin REF_MEASUREMENT /end REF_MEASUREMENT /end GROUP
/begin GROUP CalRegn03Cmn.HwAgTrakgServoPidLim.Val "MICROSAR RTE" /begin SUB_GROUP /end SUB_GROUP /begin FUNCTION_LIST /end FUNCTION_LIST /begin REF_CHARACTERISTIC CalRegn03Cmn.HwAgTrakgServoPidLim.Val /end REF_CHARACTERISTIC /begin REF_MEASUREMENT /end REF_MEASUREMENT /end GROUP
/begin GROUP CalRegn03Cmn.HwAgTrakgServoRampCmpl.Val "MICROSAR RTE" /begin SUB_GROUP /end SUB_GROUP /begin FUNCTION_LIST /end FUNCTION_LIST /begin REF_CHARACTERISTIC CalRegn03Cmn.HwAgTrakgServoRampCmpl.Val /end REF_CHARACTERISTIC /begin REF_MEASUREMENT /end REF_MEASUREMENT /end GROUP
/begin GROUP CalRegn03Cmn.HwAgTrakgServoVehSpdBasd.Ary1D "MICROSAR RTE" /begin SUB_GROUP /end SUB_GROUP /begin FUNCTION_LIST /end FUNCTION_LIST /begin REF_CHARACTERISTIC CalRegn03Cmn.HwAgTrakgServoVehSpdBasd.Ary1D /end REF_CHARACTERISTIC /begin REF_MEASUREMENT /end REF_MEASUREMENT /end GROUP
/begin GROUP CalRegn03Cmn.NxtrCalIdsCal2DevlpAuthor.Ary1D "MICROSAR RTE" /begin SUB_GROUP /end SUB_GROUP /begin FUNCTION_LIST /end FUNCTION_LIST /begin REF_CHARACTERISTIC CalRegn03Cmn.NxtrCalIdsCal2DevlpAuthor.Ary1D /end REF_CHARACTERISTIC /begin REF_MEASUREMENT /end REF_MEASUREMENT /end GROUP
/begin GROUP CalRegn03Cmn.NxtrCalIdsCal2DevlpDesc.Ary1D "MICROSAR RTE" /begin SUB_GROUP /end SUB_GROUP /begin FUNCTION_LIST /end FUNCTION_LIST /begin REF_CHARACTERISTIC CalRegn03Cmn.NxtrCalIdsCal2DevlpDesc.Ary1D /end REF_CHARACTERISTIC /begin REF_MEASUREMENT /end REF_MEASUREMENT /end GROUP
/begin GROUP CalRegn03Cmn.NxtrCalIdsCal2DevlpRelNr.Val "MICROSAR RTE" /begin SUB_GROUP /end SUB_GROUP /begin FUNCTION_LIST /end FUNCTION_LIST /begin REF_CHARACTERISTIC CalRegn03Cmn.NxtrCalIdsCal2DevlpRelNr.Val /end REF_CHARACTERISTIC /begin REF_MEASUREMENT /end REF_MEASUREMENT /end GROUP
/begin GROUP CalRegn03Cmn.NxtrCalIdsCal2DevlpRelSt.Val "MICROSAR RTE" /begin SUB_GROUP /end SUB_GROUP /begin FUNCTION_LIST /end FUNCTION_LIST /begin REF_CHARACTERISTIC CalRegn03Cmn.NxtrCalIdsCal2DevlpRelSt.Val /end REF_CHARACTERISTIC /begin REF_MEASUREMENT /end REF_MEASUREMENT /end GROUP
/begin GROUP CalRegn03Cmn.NxtrCalIdsCal2DevlpTiStamp.Val "MICROSAR RTE" /begin SUB_GROUP /end SUB_GROUP /begin FUNCTION_LIST /end FUNCTION_LIST /begin REF_CHARACTERISTIC CalRegn03Cmn.NxtrCalIdsCal2DevlpTiStamp.Val /end REF_CHARACTERISTIC /begin REF_MEASUREMENT /end REF_MEASUREMENT /end GROUP
/begin GROUP CalRegn03Cmn.NxtrCalIdsCal2DevlpVers.Val "MICROSAR RTE" /begin SUB_GROUP /end SUB_GROUP /begin FUNCTION_LIST /end FUNCTION_LIST /begin REF_CHARACTERISTIC CalRegn03Cmn.NxtrCalIdsCal2DevlpVers.Val /end REF_CHARACTERISTIC /begin REF_MEASUREMENT /end REF_MEASUREMENT /end GROUP
/begin GROUP CalRegn03Cmn.TqLoaDrvrTqNom.Val "MICROSAR RTE" /begin SUB_GROUP /end SUB_GROUP /begin FUNCTION_LIST /end FUNCTION_LIST /begin REF_CHARACTERISTIC CalRegn03Cmn.TqLoaDrvrTqNom.Val /end REF_CHARACTERISTIC /begin REF_MEASUREMENT /end REF_MEASUREMENT /end GROUP
/begin GROUP CalRegn03Cmn.TqLoaMotTqCmdLim.Val "MICROSAR RTE" /begin SUB_GROUP /end SUB_GROUP /begin FUNCTION_LIST /end FUNCTION_LIST /begin REF_CHARACTERISTIC CalRegn03Cmn.TqLoaMotTqCmdLim.Val /end REF_CHARACTERISTIC /begin REF_MEASUREMENT /end REF_MEASUREMENT /end GROUP
/begin GROUP CalRegn03Cmn.TqLoaMotVelAndTqBasdScaFacFallRate.Val "MICROSAR RTE" /begin SUB_GROUP /end SUB_GROUP /begin FUNCTION_LIST /end FUNCTION_LIST /begin REF_CHARACTERISTIC CalRegn03Cmn.TqLoaMotVelAndTqBasdScaFacFallRate.Val /end REF_CHARACTERISTIC /begin REF_MEASUREMENT /end REF_MEASUREMENT /end GROUP
/begin GROUP CalRegn03Cmn.TqLoaMotVelAndTqBasdScaFacMax.Val "MICROSAR RTE" /begin SUB_GROUP /end SUB_GROUP /begin FUNCTION_LIST /end FUNCTION_LIST /begin REF_CHARACTERISTIC CalRegn03Cmn.TqLoaMotVelAndTqBasdScaFacMax.Val /end REF_CHARACTERISTIC /begin REF_MEASUREMENT /end REF_MEASUREMENT /end GROUP
/begin GROUP CalRegn03Cmn.TqLoaMotVelAndTqBasdScaFacMin.Val "MICROSAR RTE" /begin SUB_GROUP /end SUB_GROUP /begin FUNCTION_LIST /end FUNCTION_LIST /begin REF_CHARACTERISTIC CalRegn03Cmn.TqLoaMotVelAndTqBasdScaFacMin.Val /end REF_CHARACTERISTIC /begin REF_MEASUREMENT /end REF_MEASUREMENT /end GROUP
/begin GROUP CalRegn03Cmn.TqLoaMotVelAndTqBasdScaFacRiseRate.Val "MICROSAR RTE" /begin SUB_GROUP /end SUB_GROUP /begin FUNCTION_LIST /end FUNCTION_LIST /begin REF_CHARACTERISTIC CalRegn03Cmn.TqLoaMotVelAndTqBasdScaFacRiseRate.Val /end REF_CHARACTERISTIC /begin REF_MEASUREMENT /end REF_MEASUREMENT /end GROUP
/begin GROUP CalRegn03Cmn.TqLoaMotVelMgnThd.Val "MICROSAR RTE" /begin SUB_GROUP /end SUB_GROUP /begin FUNCTION_LIST /end FUNCTION_LIST /begin REF_CHARACTERISTIC CalRegn03Cmn.TqLoaMotVelMgnThd.Val /end REF_CHARACTERISTIC /begin REF_MEASUREMENT /end REF_MEASUREMENT /end GROUP
/begin GROUP CalRegn03Cmn.TqLoaTqCmdLimY.Ary1D "MICROSAR RTE" /begin SUB_GROUP /end SUB_GROUP /begin FUNCTION_LIST /end FUNCTION_LIST /begin REF_CHARACTERISTIC CalRegn03Cmn.TqLoaTqCmdLimY.Ary1D /end REF_CHARACTERISTIC /begin REF_MEASUREMENT /end REF_MEASUREMENT /end GROUP
/begin GROUP CalRegn03Cmn.TqLoaTqCmdMgnThd.Val "MICROSAR RTE" /begin SUB_GROUP /end SUB_GROUP /begin FUNCTION_LIST /end FUNCTION_LIST /begin REF_CHARACTERISTIC CalRegn03Cmn.TqLoaTqCmdMgnThd.Val /end REF_CHARACTERISTIC /begin REF_MEASUREMENT /end REF_MEASUREMENT /end GROUP
/begin GROUP CalRegn03Cmn.TqLoaVehLatADifScaFacFallRate.Val "MICROSAR RTE" /begin SUB_GROUP /end SUB_GROUP /begin FUNCTION_LIST /end FUNCTION_LIST /begin REF_CHARACTERISTIC CalRegn03Cmn.TqLoaVehLatADifScaFacFallRate.Val /end REF_CHARACTERISTIC /begin REF_MEASUREMENT /end REF_MEASUREMENT /end GROUP
/begin GROUP CalRegn03Cmn.TqLoaVehLatADifScaFacRiseRate.Val "MICROSAR RTE" /begin SUB_GROUP /end SUB_GROUP /begin FUNCTION_LIST /end FUNCTION_LIST /begin REF_CHARACTERISTIC CalRegn03Cmn.TqLoaVehLatADifScaFacRiseRate.Val /end REF_CHARACTERISTIC /begin REF_MEASUREMENT /end REF_MEASUREMENT /end GROUP
/begin GROUP CalRegn03Cmn.TqLoaVehLatADifScaFacX.Ary1D "MICROSAR RTE" /begin SUB_GROUP /end SUB_GROUP /begin FUNCTION_LIST /end FUNCTION_LIST /begin REF_CHARACTERISTIC CalRegn03Cmn.TqLoaVehLatADifScaFacX.Ary1D /end REF_CHARACTERISTIC /begin REF_MEASUREMENT /end REF_MEASUREMENT /end GROUP
/begin GROUP CalRegn03Cmn.TqLoaVehLatADifScaFacY.Ary2D "MICROSAR RTE" /begin SUB_GROUP /end SUB_GROUP /begin FUNCTION_LIST /end FUNCTION_LIST /begin REF_CHARACTERISTIC CalRegn03Cmn.TqLoaVehLatADifScaFacY.Ary2D /end REF_CHARACTERISTIC /begin REF_MEASUREMENT /end REF_MEASUREMENT /end GROUP
/begin GROUP CalRegn03Cmn.TqLoaVehLatAEstimnFilFrq.Val "MICROSAR RTE" /begin SUB_GROUP /end SUB_GROUP /begin FUNCTION_LIST /end FUNCTION_LIST /begin REF_CHARACTERISTIC CalRegn03Cmn.TqLoaVehLatAEstimnFilFrq.Val /end REF_CHARACTERISTIC /begin REF_MEASUREMENT /end REF_MEASUREMENT /end GROUP
/begin GROUP CalRegn03Cmn.TqLoaVehLatAGainY.Ary1D "MICROSAR RTE" /begin SUB_GROUP /end SUB_GROUP /begin FUNCTION_LIST /end FUNCTION_LIST /begin REF_CHARACTERISTIC CalRegn03Cmn.TqLoaVehLatAGainY.Ary1D /end REF_CHARACTERISTIC /begin REF_MEASUREMENT /end REF_MEASUREMENT /end GROUP
/begin GROUP CalRegn03Cmn.TqLoaVehSpdScaFacX.Ary1D "MICROSAR RTE" /begin SUB_GROUP /end SUB_GROUP /begin FUNCTION_LIST /end FUNCTION_LIST /begin REF_CHARACTERISTIC CalRegn03Cmn.TqLoaVehSpdScaFacX.Ary1D /end REF_CHARACTERISTIC /begin REF_MEASUREMENT /end REF_MEASUREMENT /end GROUP
/begin GROUP CalRegn03Cmn.TqLoaVehSpdScaFacY.Ary1D "MICROSAR RTE" /begin SUB_GROUP /end SUB_GROUP /begin FUNCTION_LIST /end FUNCTION_LIST /begin REF_CHARACTERISTIC CalRegn03Cmn.TqLoaVehSpdScaFacY.Ary1D /end REF_CHARACTERISTIC /begin REF_MEASUREMENT /end REF_MEASUREMENT /end GROUP
/begin GROUP CalRegn03Cmn.TqLoaVehSpdX.Ary1D "MICROSAR RTE" /begin SUB_GROUP /end SUB_GROUP /begin FUNCTION_LIST /end FUNCTION_LIST /begin REF_CHARACTERISTIC CalRegn03Cmn.TqLoaVehSpdX.Ary1D /end REF_CHARACTERISTIC /begin REF_MEASUREMENT /end REF_MEASUREMENT /end GROUP
/begin GROUP CalRegn03Cmn.TqLoaVehSteerRat.Val "MICROSAR RTE" /begin SUB_GROUP /end SUB_GROUP /begin FUNCTION_LIST /end FUNCTION_LIST /begin REF_CHARACTERISTIC CalRegn03Cmn.TqLoaVehSteerRat.Val /end REF_CHARACTERISTIC /begin REF_MEASUREMENT /end REF_MEASUREMENT /end GROUP
/begin GROUP CalRegn03Cmn.TqLoaVehUnderSteerGrdt.Val "MICROSAR RTE" /begin SUB_GROUP /end SUB_GROUP /begin FUNCTION_LIST /end FUNCTION_LIST /begin REF_CHARACTERISTIC CalRegn03Cmn.TqLoaVehUnderSteerGrdt.Val /end REF_CHARACTERISTIC /begin REF_MEASUREMENT /end REF_MEASUREMENT /end GROUP
/begin GROUP CalRegn03Cmn.TqLoaVehWhlBas.Val "MICROSAR RTE" /begin SUB_GROUP /end SUB_GROUP /begin FUNCTION_LIST /end FUNCTION_LIST /begin REF_CHARACTERISTIC CalRegn03Cmn.TqLoaVehWhlBas.Val /end REF_CHARACTERISTIC /begin REF_MEASUREMENT /end REF_MEASUREMENT /end GROUP
/begin GROUP CalRegn03Cmn.WhlImbRejctnCmdMgnLp1FilFrq.Val "MICROSAR RTE" /begin SUB_GROUP /end SUB_GROUP /begin FUNCTION_LIST /end FUNCTION_LIST /begin REF_CHARACTERISTIC CalRegn03Cmn.WhlImbRejctnCmdMgnLp1FilFrq.Val /end REF_CHARACTERISTIC /begin REF_MEASUREMENT /end REF_MEASUREMENT /end GROUP
/begin GROUP CalRegn03Cmn.WhlImbRejctnCmdMgnLp2FilFrq.Val "MICROSAR RTE" /begin SUB_GROUP /end SUB_GROUP /begin FUNCTION_LIST /end FUNCTION_LIST /begin REF_CHARACTERISTIC CalRegn03Cmn.WhlImbRejctnCmdMgnLp2FilFrq.Val /end REF_CHARACTERISTIC /begin REF_MEASUREMENT /end REF_MEASUREMENT /end GROUP
/begin GROUP CalRegn03Cmn.WhlImbRejctnDcTrendLpFil.Val "MICROSAR RTE" /begin SUB_GROUP /end SUB_GROUP /begin FUNCTION_LIST /end FUNCTION_LIST /begin REF_CHARACTERISTIC CalRegn03Cmn.WhlImbRejctnDcTrendLpFil.Val /end REF_CHARACTERISTIC /begin REF_MEASUREMENT /end REF_MEASUREMENT /end GROUP
/begin GROUP CalRegn03CmnGroupA "MICROSAR RTE" /begin SUB_GROUP CalRegn03CmnGroupA.CalibrationPorts /end SUB_GROUP /begin FUNCTION_LIST /end FUNCTION_LIST /begin REF_CHARACTERISTIC /end REF_CHARACTERISTIC /begin REF_MEASUREMENT /end REF_MEASUREMENT /end GROUP
/begin GROUP CalRegn03CmnGroupA.AssiThermScaX.Ary1D "MICROSAR RTE" /begin SUB_GROUP /end SUB_GROUP /begin FUNCTION_LIST /end FUNCTION_LIST /begin REF_CHARACTERISTIC CalRegn03CmnGroupA.AssiThermScaX.Ary1D /end REF_CHARACTERISTIC /begin REF_MEASUREMENT /end REF_MEASUREMENT /end GROUP
/begin GROUP CalRegn03CmnGroupA.AssiThermScaY.Ary1D "MICROSAR RTE" /begin SUB_GROUP /end SUB_GROUP /begin FUNCTION_LIST /end FUNCTION_LIST /begin REF_CHARACTERISTIC CalRegn03CmnGroupA.AssiThermScaY.Ary1D /end REF_CHARACTERISTIC /begin REF_MEASUREMENT /end REF_MEASUREMENT /end GROUP
/begin GROUP CalRegn03CmnGroupA.CalibrationPorts "MICROSAR RTE"
 /begin SUB_GROUP CalRegn03CmnGroupA.AssiThermScaX.Ary1D CalRegn03CmnGroupA.AssiThermScaY.Ary1D CalRegn03CmnGroupA.DampgHwTqX.Ary1D CalRegn03CmnGroupA.DampgHwTqY.Ary1D CalRegn03CmnGroupA.HysCmpEffLossY.Ary1D CalRegn03CmnGroupA.HysCmpEffOffsY.Ary1D CalRegn03CmnGroupA.HysCmpHwTqScaX.Ary2D CalRegn03CmnGroupA.HysCmpHwTqScaY.Ary2D CalRegn03CmnGroupA.HysCmpHysSatnY.Ary1D CalRegn03CmnGroupA.HysCmpNegHysCmpScaX.Ary1D CalRegn03CmnGroupA.HysCmpNegHysCmpScaY.Ary1D CalRegn03CmnGroupA.HysCmpNegHysCmpX.Ary1D CalRegn03CmnGroupA.HysCmpNegHysCmpY.Ary1D CalRegn03CmnGroupA.HysCmpOutpLim.Val CalRegn03CmnGroupA.HysCmpRevGain.Val CalRegn03CmnGroupA.HysCmpRiseX.Ary1D CalRegn03CmnGroupA.HysCmpRiseY.Ary1D CalRegn03CmnGroupA.RtnVehSpdSeln.Ary1D /end SUB_GROUP
 /begin FUNCTION_LIST /end FUNCTION_LIST
 /begin REF_CHARACTERISTIC /end REF_CHARACTERISTIC
 /begin REF_MEASUREMENT /end REF_MEASUREMENT
/end GROUP
/begin GROUP CalRegn03CmnGroupA.DampgHwTqX.Ary1D "MICROSAR RTE" /begin SUB_GROUP /end SUB_GROUP /begin FUNCTION_LIST /end FUNCTION_LIST /begin REF_CHARACTERISTIC CalRegn03CmnGroupA.DampgHwTqX.Ary1D /end REF_CHARACTERISTIC /begin REF_MEASUREMENT /end REF_MEASUREMENT /end GROUP
/begin GROUP CalRegn03CmnGroupA.DampgHwTqY.Ary1D "MICROSAR RTE" /begin SUB_GROUP /end SUB_GROUP /begin FUNCTION_LIST /end FUNCTION_LIST /begin REF_CHARACTERISTIC CalRegn03CmnGroupA.DampgHwTqY.Ary1D /end REF_CHARACTERISTIC /begin REF_MEASUREMENT /end REF_MEASUREMENT /end GROUP
/begin GROUP CalRegn03CmnGroupA.HysCmpEffLossY.Ary1D "MICROSAR RTE" /begin SUB_GROUP /end SUB_GROUP /begin FUNCTION_LIST /end FUNCTION_LIST /begin REF_CHARACTERISTIC CalRegn03CmnGroupA.HysCmpEffLossY.Ary1D /end REF_CHARACTERISTIC /begin REF_MEASUREMENT /end REF_MEASUREMENT /end GROUP
/begin GROUP CalRegn03CmnGroupA.HysCmpEffOffsY.Ary1D "MICROSAR RTE" /begin SUB_GROUP /end SUB_GROUP /begin FUNCTION_LIST /end FUNCTION_LIST /begin REF_CHARACTERISTIC CalRegn03CmnGroupA.HysCmpEffOffsY.Ary1D /end REF_CHARACTERISTIC /begin REF_MEASUREMENT /end REF_MEASUREMENT /end GROUP
/begin GROUP CalRegn03CmnGroupA.HysCmpHwTqScaX.Ary2D "MICROSAR RTE" /begin SUB_GROUP /end SUB_GROUP /begin FUNCTION_LIST /end FUNCTION_LIST /begin REF_CHARACTERISTIC CalRegn03CmnGroupA.HysCmpHwTqScaX.Ary2D /end REF_CHARACTERISTIC /begin REF_MEASUREMENT /end REF_MEASUREMENT /end GROUP
/begin GROUP CalRegn03CmnGroupA.HysCmpHwTqScaY.Ary2D "MICROSAR RTE" /begin SUB_GROUP /end SUB_GROUP /begin FUNCTION_LIST /end FUNCTION_LIST /begin REF_CHARACTERISTIC CalRegn03CmnGroupA.HysCmpHwTqScaY.Ary2D /end REF_CHARACTERISTIC /begin REF_MEASUREMENT /end REF_MEASUREMENT /end GROUP
/begin GROUP CalRegn03CmnGroupA.HysCmpHysSatnY.Ary1D "MICROSAR RTE" /begin SUB_GROUP /end SUB_GROUP /begin FUNCTION_LIST /end FUNCTION_LIST /begin REF_CHARACTERISTIC CalRegn03CmnGroupA.HysCmpHysSatnY.Ary1D /end REF_CHARACTERISTIC /begin REF_MEASUREMENT /end REF_MEASUREMENT /end GROUP
/begin GROUP CalRegn03CmnGroupA.HysCmpNegHysCmpScaX.Ary1D "MICROSAR RTE" /begin SUB_GROUP /end SUB_GROUP /begin FUNCTION_LIST /end FUNCTION_LIST /begin REF_CHARACTERISTIC CalRegn03CmnGroupA.HysCmpNegHysCmpScaX.Ary1D /end REF_CHARACTERISTIC /begin REF_MEASUREMENT /end REF_MEASUREMENT /end GROUP
/begin GROUP CalRegn03CmnGroupA.HysCmpNegHysCmpScaY.Ary1D "MICROSAR RTE" /begin SUB_GROUP /end SUB_GROUP /begin FUNCTION_LIST /end FUNCTION_LIST /begin REF_CHARACTERISTIC CalRegn03CmnGroupA.HysCmpNegHysCmpScaY.Ary1D /end REF_CHARACTERISTIC /begin REF_MEASUREMENT /end REF_MEASUREMENT /end GROUP
/begin GROUP CalRegn03CmnGroupA.HysCmpNegHysCmpX.Ary1D "MICROSAR RTE" /begin SUB_GROUP /end SUB_GROUP /begin FUNCTION_LIST /end FUNCTION_LIST /begin REF_CHARACTERISTIC CalRegn03CmnGroupA.HysCmpNegHysCmpX.Ary1D /end REF_CHARACTERISTIC /begin REF_MEASUREMENT /end REF_MEASUREMENT /end GROUP
/begin GROUP CalRegn03CmnGroupA.HysCmpNegHysCmpY.Ary1D "MICROSAR RTE" /begin SUB_GROUP /end SUB_GROUP /begin FUNCTION_LIST /end FUNCTION_LIST /begin REF_CHARACTERISTIC CalRegn03CmnGroupA.HysCmpNegHysCmpY.Ary1D /end REF_CHARACTERISTIC /begin REF_MEASUREMENT /end REF_MEASUREMENT /end GROUP
/begin GROUP CalRegn03CmnGroupA.HysCmpOutpLim.Val "MICROSAR RTE" /begin SUB_GROUP /end SUB_GROUP /begin FUNCTION_LIST /end FUNCTION_LIST /begin REF_CHARACTERISTIC CalRegn03CmnGroupA.HysCmpOutpLim.Val /end REF_CHARACTERISTIC /begin REF_MEASUREMENT /end REF_MEASUREMENT /end GROUP
/begin GROUP CalRegn03CmnGroupA.HysCmpRevGain.Val "MICROSAR RTE" /begin SUB_GROUP /end SUB_GROUP /begin FUNCTION_LIST /end FUNCTION_LIST /begin REF_CHARACTERISTIC CalRegn03CmnGroupA.HysCmpRevGain.Val /end REF_CHARACTERISTIC /begin REF_MEASUREMENT /end REF_MEASUREMENT /end GROUP
/begin GROUP CalRegn03CmnGroupA.HysCmpRiseX.Ary1D "MICROSAR RTE" /begin SUB_GROUP /end SUB_GROUP /begin FUNCTION_LIST /end FUNCTION_LIST /begin REF_CHARACTERISTIC CalRegn03CmnGroupA.HysCmpRiseX.Ary1D /end REF_CHARACTERISTIC /begin REF_MEASUREMENT /end REF_MEASUREMENT /end GROUP
/begin GROUP CalRegn03CmnGroupA.HysCmpRiseY.Ary1D "MICROSAR RTE" /begin SUB_GROUP /end SUB_GROUP /begin FUNCTION_LIST /end FUNCTION_LIST /begin REF_CHARACTERISTIC CalRegn03CmnGroupA.HysCmpRiseY.Ary1D /end REF_CHARACTERISTIC /begin REF_MEASUREMENT /end REF_MEASUREMENT /end GROUP
/begin GROUP CalRegn03CmnGroupA.RtnVehSpdSeln.Ary1D "MICROSAR RTE" /begin SUB_GROUP /end SUB_GROUP /begin FUNCTION_LIST /end FUNCTION_LIST /begin REF_CHARACTERISTIC CalRegn03CmnGroupA.RtnVehSpdSeln.Ary1D /end REF_CHARACTERISTIC /begin REF_MEASUREMENT /end REF_MEASUREMENT /end GROUP
/begin GROUP CalRegn03CmnGroupB "MICROSAR RTE" /begin SUB_GROUP CalRegn03CmnGroupB.CalibrationPorts /end SUB_GROUP /begin FUNCTION_LIST /end FUNCTION_LIST /begin REF_CHARACTERISTIC /end REF_CHARACTERISTIC /begin REF_MEASUREMENT /end REF_MEASUREMENT /end GROUP
/begin GROUP CalRegn03CmnGroupB.CalibrationPorts "MICROSAR RTE"
 /begin SUB_GROUP CalRegn03CmnGroupB.EotProtnActvRegnBypMaxThd.Val CalRegn03CmnGroupB.EotProtnDeltaTqThd.Val CalRegn03CmnGroupB.EotProtnMotSpdIncptY.Ary1D CalRegn03CmnGroupB.InertiaCmpVelDampgWhlImbRejctnBlndX.Ary1D CalRegn03CmnGroupB.InertiaCmpVelDampgWhlImbRejctnBlndY.Ary1D CalRegn03CmnGroupB.PullCmpActvCmpLrnTiDecShoTerm.Val CalRegn03CmnGroupB.PullCmpActvCmpLrnTiIncShoTerm.Val CalRegn03CmnGroupB.PullCmpActvCmpLrnTiLongTerm.Val CalRegn03CmnGroupB.PullCmpActvCmpShoTermRstHwAgThd.Val CalRegn03CmnGroupB.PullCmpActvCmpShoTermRstHwTqThd.Val CalRegn03CmnGroupB.PullCmpActvCmpShoTermRstLatAThd.Val CalRegn03CmnGroupB.PullCmpActvCmpShoTermRstYawRateThd.Val CalRegn03CmnGroupB.PullCmpActvHwTqFilFrqLongTerm.Val CalRegn03CmnGroupB.PullCmpActvHwTqFilFrqLrngEna.Val CalRegn03CmnGroupB.PullCmpActvHwTqFilFrqShoTerm.Val CalRegn03CmnGroupB.PullCmpActvLongTermLim.Val CalRegn03CmnGroupB.PullCmpActvLrngEnaAgConfMinMgn.Val CalRegn03CmnGroupB.PullCmpActvLrngEnaHwAgMaxMgn.Val CalRegn03CmnGroupB.PullCmpActvLrngEnaHwTqMaxMgn.Val CalRegn03CmnGroupB.PullCmpActvLrngEnaHwVelMaxMgn.Val CalRegn03CmnGroupB.PullCmpActvLrngEnaLatAMaxMgn.Val CalRegn03CmnGroupB.PullCmpActvLrngEnaTiThd.Val CalRegn03CmnGroupB.PullCmpActvLrngEnaVehSpdMaxMgn.Val CalRegn03CmnGroupB.PullCmpActvLrngEnaVehSpdMinMgn.Val CalRegn03CmnGroupB.PullCmpActvLrngEnaVehSpdRateMaxMgn.Val CalRegn03CmnGroupB.PullCmpActvLrngEnaYawRateMaxMgn.Val CalRegn03CmnGroupB.PullCmpActvOpstSignTiShoTerm.Val CalRegn03CmnGroupB.PullCmpActvOutpMaxRate.Val CalRegn03CmnGroupB.PullCmpActvPullCmpShoTermLim.Val CalRegn03CmnGroupB.PullCmpActvPullCmpTotLim.Val CalRegn03CmnGroupB.PullCmpActvPullErrLimLongTerm.Val CalRegn03CmnGroupB.PullCmpActvPullErrMgnThd.Val CalRegn03CmnGroupB.PullCmpActvPullErrShoTermLim.Val CalRegn03CmnGroupB.PullCmpActvShoTermRampTi.Val CalRegn03CmnGroupB.PullCmpActvVehSpdScaTblX.Ary1D CalRegn03CmnGroupB.PullCmpActvVehSpdScaTblY.Ary1D CalRegn03CmnGroupB.WhlImbRejctnAutScaEna.Logl CalRegn03CmnGroupB.WhlImbRejctnAutScaTar.Val CalRegn03CmnGroupB.WhlImbRejctnRampDwnTi.Val CalRegn03CmnGroupB.WhlImbRejctnScaCncl.Val CalRegn03CmnGroupB.WhlImbRejctnUgrPoleMgn.Val CalRegn03CmnGroupB.WhlImbRejctnVehSpdEna.Val /end SUB_GROUP
 /begin FUNCTION_LIST /end FUNCTION_LIST
 /begin REF_CHARACTERISTIC /end REF_CHARACTERISTIC
 /begin REF_MEASUREMENT /end REF_MEASUREMENT
/end GROUP
/begin GROUP CalRegn03CmnGroupB.EotProtnActvRegnBypMaxThd.Val "MICROSAR RTE" /begin SUB_GROUP /end SUB_GROUP /begin FUNCTION_LIST /end FUNCTION_LIST /begin REF_CHARACTERISTIC CalRegn03CmnGroupB.EotProtnActvRegnBypMaxThd.Val /end REF_CHARACTERISTIC /begin REF_MEASUREMENT /end REF_MEASUREMENT /end GROUP
/begin GROUP CalRegn03CmnGroupB.EotProtnDeltaTqThd.Val "MICROSAR RTE" /begin SUB_GROUP /end SUB_GROUP /begin FUNCTION_LIST /end FUNCTION_LIST /begin REF_CHARACTERISTIC CalRegn03CmnGroupB.EotProtnDeltaTqThd.Val /end REF_CHARACTERISTIC /begin REF_MEASUREMENT /end REF_MEASUREMENT /end GROUP
/begin GROUP CalRegn03CmnGroupB.EotProtnMotSpdIncptY.Ary1D "MICROSAR RTE" /begin SUB_GROUP /end SUB_GROUP /begin FUNCTION_LIST /end FUNCTION_LIST /begin REF_CHARACTERISTIC CalRegn03CmnGroupB.EotProtnMotSpdIncptY.Ary1D /end REF_CHARACTERISTIC /begin REF_MEASUREMENT /end REF_MEASUREMENT /end GROUP
/begin GROUP CalRegn03CmnGroupB.InertiaCmpVelDampgWhlImbRejctnBlndX.Ary1D "MICROSAR RTE" /begin SUB_GROUP /end SUB_GROUP /begin FUNCTION_LIST /end FUNCTION_LIST
 /begin REF_CHARACTERISTIC CalRegn03CmnGroupB.InertiaCmpVelDampgWhlImbRejctnBlndX.Ary1D /end REF_CHARACTERISTIC
 /begin REF_MEASUREMENT /end REF_MEASUREMENT
/end GROUP
/begin GROUP CalRegn03CmnGroupB.InertiaCmpVelDampgWhlImbRejctnBlndY.Ary1D "MICROSAR RTE" /begin SUB_GROUP /end SUB_GROUP /begin FUNCTION_LIST /end FUNCTION_LIST
 /begin REF_CHARACTERISTIC CalRegn03CmnGroupB.InertiaCmpVelDampgWhlImbRejctnBlndY.Ary1D /end REF_CHARACTERISTIC
 /begin REF_MEASUREMENT /end REF_MEASUREMENT
/end GROUP
/begin GROUP CalRegn03CmnGroupB.PullCmpActvCmpLrnTiDecShoTerm.Val "MICROSAR RTE" /begin SUB_GROUP /end SUB_GROUP /begin FUNCTION_LIST /end FUNCTION_LIST /begin REF_CHARACTERISTIC CalRegn03CmnGroupB.PullCmpActvCmpLrnTiDecShoTerm.Val /end REF_CHARACTERISTIC /begin REF_MEASUREMENT /end REF_MEASUREMENT /end GROUP
/begin GROUP CalRegn03CmnGroupB.PullCmpActvCmpLrnTiIncShoTerm.Val "MICROSAR RTE" /begin SUB_GROUP /end SUB_GROUP /begin FUNCTION_LIST /end FUNCTION_LIST /begin REF_CHARACTERISTIC CalRegn03CmnGroupB.PullCmpActvCmpLrnTiIncShoTerm.Val /end REF_CHARACTERISTIC /begin REF_MEASUREMENT /end REF_MEASUREMENT /end GROUP
/begin GROUP CalRegn03CmnGroupB.PullCmpActvCmpLrnTiLongTerm.Val "MICROSAR RTE" /begin SUB_GROUP /end SUB_GROUP /begin FUNCTION_LIST /end FUNCTION_LIST /begin REF_CHARACTERISTIC CalRegn03CmnGroupB.PullCmpActvCmpLrnTiLongTerm.Val /end REF_CHARACTERISTIC /begin REF_MEASUREMENT /end REF_MEASUREMENT /end GROUP
/begin GROUP CalRegn03CmnGroupB.PullCmpActvCmpShoTermRstHwAgThd.Val "MICROSAR RTE" /begin SUB_GROUP /end SUB_GROUP /begin FUNCTION_LIST /end FUNCTION_LIST /begin REF_CHARACTERISTIC CalRegn03CmnGroupB.PullCmpActvCmpShoTermRstHwAgThd.Val /end REF_CHARACTERISTIC /begin REF_MEASUREMENT /end REF_MEASUREMENT /end GROUP
/begin GROUP CalRegn03CmnGroupB.PullCmpActvCmpShoTermRstHwTqThd.Val "MICROSAR RTE" /begin SUB_GROUP /end SUB_GROUP /begin FUNCTION_LIST /end FUNCTION_LIST /begin REF_CHARACTERISTIC CalRegn03CmnGroupB.PullCmpActvCmpShoTermRstHwTqThd.Val /end REF_CHARACTERISTIC /begin REF_MEASUREMENT /end REF_MEASUREMENT /end GROUP
/begin GROUP CalRegn03CmnGroupB.PullCmpActvCmpShoTermRstLatAThd.Val "MICROSAR RTE" /begin SUB_GROUP /end SUB_GROUP /begin FUNCTION_LIST /end FUNCTION_LIST /begin REF_CHARACTERISTIC CalRegn03CmnGroupB.PullCmpActvCmpShoTermRstLatAThd.Val /end REF_CHARACTERISTIC /begin REF_MEASUREMENT /end REF_MEASUREMENT /end GROUP
/begin GROUP CalRegn03CmnGroupB.PullCmpActvCmpShoTermRstYawRateThd.Val "MICROSAR RTE" /begin SUB_GROUP /end SUB_GROUP /begin FUNCTION_LIST /end FUNCTION_LIST /begin REF_CHARACTERISTIC CalRegn03CmnGroupB.PullCmpActvCmpShoTermRstYawRateThd.Val /end REF_CHARACTERISTIC /begin REF_MEASUREMENT /end REF_MEASUREMENT /end GROUP
/begin GROUP CalRegn03CmnGroupB.PullCmpActvHwTqFilFrqLongTerm.Val "MICROSAR RTE" /begin SUB_GROUP /end SUB_GROUP /begin FUNCTION_LIST /end FUNCTION_LIST /begin REF_CHARACTERISTIC CalRegn03CmnGroupB.PullCmpActvHwTqFilFrqLongTerm.Val /end REF_CHARACTERISTIC /begin REF_MEASUREMENT /end REF_MEASUREMENT /end GROUP
/begin GROUP CalRegn03CmnGroupB.PullCmpActvHwTqFilFrqLrngEna.Val "MICROSAR RTE" /begin SUB_GROUP /end SUB_GROUP /begin FUNCTION_LIST /end FUNCTION_LIST /begin REF_CHARACTERISTIC CalRegn03CmnGroupB.PullCmpActvHwTqFilFrqLrngEna.Val /end REF_CHARACTERISTIC /begin REF_MEASUREMENT /end REF_MEASUREMENT /end GROUP
/begin GROUP CalRegn03CmnGroupB.PullCmpActvHwTqFilFrqShoTerm.Val "MICROSAR RTE" /begin SUB_GROUP /end SUB_GROUP /begin FUNCTION_LIST /end FUNCTION_LIST /begin REF_CHARACTERISTIC CalRegn03CmnGroupB.PullCmpActvHwTqFilFrqShoTerm.Val /end REF_CHARACTERISTIC /begin REF_MEASUREMENT /end REF_MEASUREMENT /end GROUP
/begin GROUP CalRegn03CmnGroupB.PullCmpActvLongTermLim.Val "MICROSAR RTE" /begin SUB_GROUP /end SUB_GROUP /begin FUNCTION_LIST /end FUNCTION_LIST /begin REF_CHARACTERISTIC CalRegn03CmnGroupB.PullCmpActvLongTermLim.Val /end REF_CHARACTERISTIC /begin REF_MEASUREMENT /end REF_MEASUREMENT /end GROUP
/begin GROUP CalRegn03CmnGroupB.PullCmpActvLrngEnaAgConfMinMgn.Val "MICROSAR RTE" /begin SUB_GROUP /end SUB_GROUP /begin FUNCTION_LIST /end FUNCTION_LIST /begin REF_CHARACTERISTIC CalRegn03CmnGroupB.PullCmpActvLrngEnaAgConfMinMgn.Val /end REF_CHARACTERISTIC /begin REF_MEASUREMENT /end REF_MEASUREMENT /end GROUP
/begin GROUP CalRegn03CmnGroupB.PullCmpActvLrngEnaHwAgMaxMgn.Val "MICROSAR RTE" /begin SUB_GROUP /end SUB_GROUP /begin FUNCTION_LIST /end FUNCTION_LIST /begin REF_CHARACTERISTIC CalRegn03CmnGroupB.PullCmpActvLrngEnaHwAgMaxMgn.Val /end REF_CHARACTERISTIC /begin REF_MEASUREMENT /end REF_MEASUREMENT /end GROUP
/begin GROUP CalRegn03CmnGroupB.PullCmpActvLrngEnaHwTqMaxMgn.Val "MICROSAR RTE" /begin SUB_GROUP /end SUB_GROUP /begin FUNCTION_LIST /end FUNCTION_LIST /begin REF_CHARACTERISTIC CalRegn03CmnGroupB.PullCmpActvLrngEnaHwTqMaxMgn.Val /end REF_CHARACTERISTIC /begin REF_MEASUREMENT /end REF_MEASUREMENT /end GROUP
/**********************************************************************************************************************
* RECORD_LAYOUT
*********************************************************************************************************************/
/begin RECORD_LAYOUT RTE_RL_UBYTE FNC_VALUES 1 UBYTE ROW_DIR DIRECT /end RECORD_LAYOUT
/begin RECORD_LAYOUT RTE_RL_UWORD FNC_VALUES 1 UWORD ROW_DIR DIRECT /end RECORD_LAYOUT
/begin RECORD_LAYOUT RTE_RL_ULONG FNC_VALUES 1 ULONG ROW_DIR DIRECT /end RECORD_LAYOUT
/begin RECORD_LAYOUT RTE_RL_SWORD FNC_VALUES 1 SWORD ROW_DIR DIRECT /end RECORD_LAYOUT
/begin RECORD_LAYOUT RTE_RL_FLOAT32_IEEE FNC_VALUES 1 FLOAT32_IEEE ROW_DIR DIRECT /end RECORD_LAYOUT
/begin RECORD_LAYOUT RTE_RL_BOOLEAN FNC_VALUES 1 UBYTE ROW_DIR DIRECT /end RECORD_LAYOUT
/**********************************************************************************************************************
* COMPU_METHOD / COMPU_VTAB_RANGE
*********************************************************************************************************************/
/begin COMPU_METHOD RTE_CM_BOOLEAN "" TAB_VERB "%3.1" "" COMPU_TAB_REF RTE_CM_BOOLEAN /end COMPU_METHOD
/begin COMPU_VTAB_RANGE RTE_CM_BOOLEAN "" 2 0 0 "false" 1 255 "true" /end COMPU_VTAB_RANGE
/begin COMPU_METHOD RTE_CM_Tq6 "" RAT_FUNC "%.1" "HwNm" COEFFS 0 256 0 0 0 1 /end COMPU_METHOD
/begin COMPU_METHOD RTE_CM_Uls4 "" RAT_FUNC "%.1" "Uls" COEFFS 0 16384 0 0 0 1 /end COMPU_METHOD
/begin COMPU_METHOD RTE_CM_Spd2 "" RAT_FUNC "%.1" "kph" COEFFS 0 128 0 0 0 1 /end COMPU_METHOD
/begin COMPU_METHOD RTE_CM_Uls15 "" RAT_FUNC "%.1" "Uls" COEFFS 0 3.0517578125e-005 0 0 0 1 /end COMPU_METHOD
