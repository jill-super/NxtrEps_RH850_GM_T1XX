/begin CHARACTERISTIC StabyCmp.StabyCmpNotchFil2Struct.Rec.FilGainA1 "MICROSAR RTE" VALUE 0x0 RTE_RL_FLOAT32_IEEE 0 NO_COMPU_METHOD -3.402823466e+38 3.402823466e+38 SYMBOL_LINK "Rte_CalprmRom_CalRegn03Inin00_DEFAULT_RTE_CALPRM_GROUP.StabyCmpNotchFil2Struct_Rec.FilGainA1" 0 DISPLAY_IDENTIFIER StabyCmp.CalibrationPorts.StabyCmpNotchFil2Struct.Rec.FilGainA1 /end CHARACTERISTIC
/begin CHARACTERISTIC StabyCmp.StabyCmpNotchFil2Struct.Rec.FilGainA2 "MICROSAR RTE" VALUE 0x0 RTE_RL_FLOAT32_IEEE 0 NO_COMPU_METHOD -3.402823466e+38 3.402823466e+38 SYMBOL_LINK "Rte_CalprmRom_CalRegn03Inin00_DEFAULT_RTE_CALPRM_GROUP.StabyCmpNotchFil2Struct_Rec.FilGainA2" 0 DISPLAY_IDENTIFIER StabyCmp.CalibrationPorts.StabyCmpNotchFil2Struct.Rec.FilGainA2 /end CHARACTERISTIC
/begin CHARACTERISTIC StabyCmp.StabyCmpNotchFil2Struct.Rec.FilGainB0 "MICROSAR RTE" VALUE 0x0 RTE_RL_FLOAT32_IEEE 0 NO_COMPU_METHOD -3.402823466e+38 3.402823466e+38 SYMBOL_LINK "Rte_CalprmRom_CalRegn03Inin00_DEFAULT_RTE_CALPRM_GROUP.StabyCmpNotchFil2Struct_Rec.FilGainB0" 0 DISPLAY_IDENTIFIER StabyCmp.CalibrationPorts.StabyCmpNotchFil2Struct.Rec.FilGainB0 /end CHARACTERISTIC
/begin CHARACTERISTIC StabyCmp.StabyCmpNotchFil2Struct.Rec.FilGainB1 "MICROSAR RTE" VALUE 0x0 RTE_RL_FLOAT32_IEEE 0 NO_COMPU_METHOD -3.402823466e+38 3.402823466e+38 SYMBOL_LINK "Rte_CalprmRom_CalRegn03Inin00_DEFAULT_RTE_CALPRM_GROUP.StabyCmpNotchFil2Struct_Rec.FilGainB1" 0 DISPLAY_IDENTIFIER StabyCmp.CalibrationPorts.StabyCmpNotchFil2Struct.Rec.FilGainB1 /end CHARACTERISTIC
/begin CHARACTERISTIC StabyCmp.StabyCmpNotchFil2Struct.Rec.FilGainB2 "MICROSAR RTE" VALUE 0x0 RTE_RL_FLOAT32_IEEE 0 NO_COMPU_METHOD -3.402823466e+38 3.402823466e+38 SYMBOL_LINK "Rte_CalprmRom_CalRegn03Inin00_DEFAULT_RTE_CALPRM_GROUP.StabyCmpNotchFil2Struct_Rec.FilGainB2" 0 DISPLAY_IDENTIFIER StabyCmp.CalibrationPorts.StabyCmpNotchFil2Struct.Rec.FilGainB2 /end CHARACTERISTIC
/begin CHARACTERISTIC StabyCmp.StabyCmpNotchFil3Struct.Rec.FilGainA1 "MICROSAR RTE" VALUE 0x0 RTE_RL_FLOAT32_IEEE 0 NO_COMPU_METHOD -3.402823466e+38 3.402823466e+38 SYMBOL_LINK "Rte_CalprmRom_CalRegn03Inin00_DEFAULT_RTE_CALPRM_GROUP.StabyCmpNotchFil3Struct_Rec.FilGainA1" 0 DISPLAY_IDENTIFIER StabyCmp.CalibrationPorts.StabyCmpNotchFil3Struct.Rec.FilGainA1 /end CHARACTERISTIC
/begin CHARACTERISTIC StabyCmp.StabyCmpNotchFil3Struct.Rec.FilGainA2 "MICROSAR RTE" VALUE 0x0 RTE_RL_FLOAT32_IEEE 0 NO_COMPU_METHOD -3.402823466e+38 3.402823466e+38 SYMBOL_LINK "Rte_CalprmRom_CalRegn03Inin00_DEFAULT_RTE_CALPRM_GROUP.StabyCmpNotchFil3Struct_Rec.FilGainA2" 0 DISPLAY_IDENTIFIER StabyCmp.CalibrationPorts.StabyCmpNotchFil3Struct.Rec.FilGainA2 /end CHARACTERISTIC
/begin CHARACTERISTIC StabyCmp.StabyCmpNotchFil3Struct.Rec.FilGainB0 "MICROSAR RTE" VALUE 0x0 RTE_RL_FLOAT32_IEEE 0 NO_COMPU_METHOD -3.402823466e+38 3.402823466e+38 SYMBOL_LINK "Rte_CalprmRom_CalRegn03Inin00_DEFAULT_RTE_CALPRM_GROUP.StabyCmpNotchFil3Struct_Rec.FilGainB0" 0 DISPLAY_IDENTIFIER StabyCmp.CalibrationPorts.StabyCmpNotchFil3Struct.Rec.FilGainB0 /end CHARACTERISTIC
/begin CHARACTERISTIC StabyCmp.StabyCmpNotchFil3Struct.Rec.FilGainB1 "MICROSAR RTE" VALUE 0x0 RTE_RL_FLOAT32_IEEE 0 NO_COMPU_METHOD -3.402823466e+38 3.402823466e+38 SYMBOL_LINK "Rte_CalprmRom_CalRegn03Inin00_DEFAULT_RTE_CALPRM_GROUP.StabyCmpNotchFil3Struct_Rec.FilGainB1" 0 DISPLAY_IDENTIFIER StabyCmp.CalibrationPorts.StabyCmpNotchFil3Struct.Rec.FilGainB1 /end CHARACTERISTIC
/begin CHARACTERISTIC StabyCmp.StabyCmpNotchFil3Struct.Rec.FilGainB2 "MICROSAR RTE" VALUE 0x0 RTE_RL_FLOAT32_IEEE 0 NO_COMPU_METHOD -3.402823466e+38 3.402823466e+38 SYMBOL_LINK "Rte_CalprmRom_CalRegn03Inin00_DEFAULT_RTE_CALPRM_GROUP.StabyCmpNotchFil3Struct_Rec.FilGainB2" 0 DISPLAY_IDENTIFIER StabyCmp.CalibrationPorts.StabyCmpNotchFil3Struct.Rec.FilGainB2 /end CHARACTERISTIC
/begin CHARACTERISTIC StabyCmp.StabyCmpNotchFil4Struct.Rec.FilGainA1 "MICROSAR RTE" VALUE 0x0 RTE_RL_FLOAT32_IEEE 0 NO_COMPU_METHOD -3.402823466e+38 3.402823466e+38 SYMBOL_LINK "Rte_CalprmRom_CalRegn03Inin00_DEFAULT_RTE_CALPRM_GROUP.StabyCmpNotchFil4Struct_Rec.FilGainA1" 0 DISPLAY_IDENTIFIER StabyCmp.CalibrationPorts.StabyCmpNotchFil4Struct.Rec.FilGainA1 /end CHARACTERISTIC
/begin CHARACTERISTIC StabyCmp.StabyCmpNotchFil4Struct.Rec.FilGainA2 "MICROSAR RTE" VALUE 0x0 RTE_RL_FLOAT32_IEEE 0 NO_COMPU_METHOD -3.402823466e+38 3.402823466e+38 SYMBOL_LINK "Rte_CalprmRom_CalRegn03Inin00_DEFAULT_RTE_CALPRM_GROUP.StabyCmpNotchFil4Struct_Rec.FilGainA2" 0 DISPLAY_IDENTIFIER StabyCmp.CalibrationPorts.StabyCmpNotchFil4Struct.Rec.FilGainA2 /end CHARACTERISTIC
/begin CHARACTERISTIC StabyCmp.StabyCmpNotchFil4Struct.Rec.FilGainB0 "MICROSAR RTE" VALUE 0x0 RTE_RL_FLOAT32_IEEE 0 NO_COMPU_METHOD -3.402823466e+38 3.402823466e+38 SYMBOL_LINK "Rte_CalprmRom_CalRegn03Inin00_DEFAULT_RTE_CALPRM_GROUP.StabyCmpNotchFil4Struct_Rec.FilGainB0" 0 DISPLAY_IDENTIFIER StabyCmp.CalibrationPorts.StabyCmpNotchFil4Struct.Rec.FilGainB0 /end CHARACTERISTIC
/begin CHARACTERISTIC StabyCmp.StabyCmpNotchFil4Struct.Rec.FilGainB1 "MICROSAR RTE" VALUE 0x0 RTE_RL_FLOAT32_IEEE 0 NO_COMPU_METHOD -3.402823466e+38 3.402823466e+38 SYMBOL_LINK "Rte_CalprmRom_CalRegn03Inin00_DEFAULT_RTE_CALPRM_GROUP.StabyCmpNotchFil4Struct_Rec.FilGainB1" 0 DISPLAY_IDENTIFIER StabyCmp.CalibrationPorts.StabyCmpNotchFil4Struct.Rec.FilGainB1 /end CHARACTERISTIC
/begin CHARACTERISTIC StabyCmp.StabyCmpNotchFil4Struct.Rec.FilGainB2 "MICROSAR RTE" VALUE 0x0 RTE_RL_FLOAT32_IEEE 0 NO_COMPU_METHOD -3.402823466e+38 3.402823466e+38 SYMBOL_LINK "Rte_CalprmRom_CalRegn03Inin00_DEFAULT_RTE_CALPRM_GROUP.StabyCmpNotchFil4Struct_Rec.FilGainB2" 0 DISPLAY_IDENTIFIER StabyCmp.CalibrationPorts.StabyCmpNotchFil4Struct.Rec.FilGainB2 /end CHARACTERISTIC
/begin CHARACTERISTIC StabyCmp.StabyCmpNotchFilBilnrBlndVehSpd.Ary1D "MICROSAR RTE" VAL_BLK 0x0 RTE_RL_UWORD 0 NO_COMPU_METHOD 0 65535 MATRIX_DIM 6 1 1 SYMBOL_LINK "Rte_CalprmRom_CalRegn03Inin00GroupA_DEFAULT_RTE_CALPRM_GROUP.StabyCmpNotchFilBilnrBlndVehSpd_Ary1D" 0 DISPLAY_IDENTIFIER StabyCmp.CalibrationPorts.StabyCmpNotchFilBilnrBlndVehSpd.Ary1D /end CHARACTERISTIC
/begin CHARACTERISTIC StabyCmp.StabyCmpNotchFilBlnd02Y.Ary2D "MICROSAR RTE" VAL_BLK 0x0 RTE_RL_UWORD 0 NO_COMPU_METHOD 0 65535 MATRIX_DIM 5 6 1 SYMBOL_LINK "Rte_CalprmRom_CalRegn03Inin00GroupA_DEFAULT_RTE_CALPRM_GROUP.StabyCmpNotchFilBlnd02Y_Ary2D" 0 DISPLAY_IDENTIFIER StabyCmp.CalibrationPorts.StabyCmpNotchFilBlnd02Y.Ary2D /end CHARACTERISTIC
/begin CHARACTERISTIC StabyCmp.StabyCmpNotchFilBlnd04Y.Ary2D "MICROSAR RTE" VAL_BLK 0x0 RTE_RL_UWORD 0 NO_COMPU_METHOD 0 65535 MATRIX_DIM 5 6 1 SYMBOL_LINK "Rte_CalprmRom_CalRegn03Inin00_DEFAULT_RTE_CALPRM_GROUP.StabyCmpNotchFilBlnd04Y_Ary2D" 0 DISPLAY_IDENTIFIER StabyCmp.CalibrationPorts.StabyCmpNotchFilBlnd04Y.Ary2D /end CHARACTERISTIC
/begin CHARACTERISTIC StabyCmp.StabyCmpNotchFilBlnd12TqX.Ary2D "MICROSAR RTE" VAL_BLK 0x0 RTE_RL_UWORD 0 NO_COMPU_METHOD 0 65535 MATRIX_DIM 5 6 1 SYMBOL_LINK "Rte_CalprmRom_CalRegn03Inin00GroupA_DEFAULT_RTE_CALPRM_GROUP.StabyCmpNotchFilBlnd12TqX_Ary2D" 0 DISPLAY_IDENTIFIER StabyCmp.CalibrationPorts.StabyCmpNotchFilBlnd12TqX.Ary2D /end CHARACTERISTIC
/begin CHARACTERISTIC StabyCmp.StabyCmpNotchFilBlnd12Y.Ary2D "MICROSAR RTE" VAL_BLK 0x0 RTE_RL_UWORD 0 NO_COMPU_METHOD 0 65535 MATRIX_DIM 5 6 1 SYMBOL_LINK "Rte_CalprmRom_CalRegn03Inin00GroupA_DEFAULT_RTE_CALPRM_GROUP.StabyCmpNotchFilBlnd12Y_Ary2D" 0 DISPLAY_IDENTIFIER StabyCmp.CalibrationPorts.StabyCmpNotchFilBlnd12Y.Ary2D /end CHARACTERISTIC
/begin CHARACTERISTIC StabyCmp.StabyCmpNotchFilBlnd34TqX.Ary2D "MICROSAR RTE" VAL_BLK 0x0 RTE_RL_UWORD 0 NO_COMPU_METHOD 0 65535 MATRIX_DIM 5 6 1 SYMBOL_LINK "Rte_CalprmRom_CalRegn03Inin00_DEFAULT_RTE_CALPRM_GROUP.StabyCmpNotchFilBlnd34TqX_Ary2D" 0 DISPLAY_IDENTIFIER StabyCmp.CalibrationPorts.StabyCmpNotchFilBlnd34TqX.Ary2D /end CHARACTERISTIC
/begin CHARACTERISTIC StabyCmp.StabyCmpNotchFilBlnd34Y.Ary2D "MICROSAR RTE" VAL_BLK 0x0 RTE_RL_UWORD 0 NO_COMPU_METHOD 0 65535 MATRIX_DIM 5 6 1 SYMBOL_LINK "Rte_CalprmRom_CalRegn03Inin00_DEFAULT_RTE_CALPRM_GROUP.StabyCmpNotchFilBlnd34Y_Ary2D" 0 DISPLAY_IDENTIFIER StabyCmp.CalibrationPorts.StabyCmpNotchFilBlnd34Y.Ary2D /end CHARACTERISTIC
/begin CHARACTERISTIC SysFricLrng.FricLrngDataDft.BasLineFric "MICROSAR RTE" VAL_BLK 0x0 RTE_RL_FLOAT32_IEEE 0 NO_COMPU_METHOD -3.402823466e+38 3.402823466e+38 MATRIX_DIM 4 1 1 SYMBOL_LINK "Rte_CalprmRom_SysFricLrng_DEFAULT_RTE_CDATA_GROUP.FricLrngDataDft.BasLineFric" 0 DISPLAY_IDENTIFIER SysFricLrng.CalibrationParameters.FricLrngDataDft.BasLineFric /end CHARACTERISTIC
/begin CHARACTERISTIC SysFricLrng.FricLrngDataDft.FricOffs "MICROSAR RTE" VALUE 0x0 RTE_RL_FLOAT32_IEEE 0 NO_COMPU_METHOD -3.402823466e+38 3.402823466e+38 SYMBOL_LINK "Rte_CalprmRom_SysFricLrng_DEFAULT_RTE_CDATA_GROUP.FricLrngDataDft.FricOffs" 0 DISPLAY_IDENTIFIER SysFricLrng.CalibrationParameters.FricLrngDataDft.FricOffs /end CHARACTERISTIC
/begin CHARACTERISTIC SysFricLrng.FricLrngDataDft.Hys "MICROSAR RTE" VAL_BLK 0x0 RTE_RL_FLOAT32_IEEE 0 NO_COMPU_METHOD -3.402823466e+38 3.402823466e+38 MATRIX_DIM 4 8 1 SYMBOL_LINK "Rte_CalprmRom_SysFricLrng_DEFAULT_RTE_CDATA_GROUP.FricLrngDataDft.Hys" 0 DISPLAY_IDENTIFIER SysFricLrng.CalibrationParameters.FricLrngDataDft.Hys /end CHARACTERISTIC
/begin CHARACTERISTIC SysFricLrng.FricLrngDataDft.RngCntr "MICROSAR RTE" VAL_BLK 0x0 RTE_RL_UWORD 0 NO_COMPU_METHOD 0 65535 MATRIX_DIM 3 8 1 SYMBOL_LINK "Rte_CalprmRom_SysFricLrng_DEFAULT_RTE_CDATA_GROUP.FricLrngDataDft.RngCntr" 0 DISPLAY_IDENTIFIER SysFricLrng.CalibrationParameters.FricLrngDataDft.RngCntr /end CHARACTERISTIC
/begin CHARACTERISTIC SysFricLrng.FricLrngDataDft.SysFricLrngOperMod "MICROSAR RTE" VALUE 0x0 RTE_RL_UBYTE 0 RTE_CM_ENUM_SysFricLrngOperMod1 0 255 SYMBOL_LINK "Rte_CalprmRom_SysFricLrng_DEFAULT_RTE_CDATA_GROUP.FricLrngDataDft.SysFricLrngOperMod" 0 DISPLAY_IDENTIFIER SysFricLrng.CalibrationParameters.FricLrngDataDft.SysFricLrngOperMod /end CHARACTERISTIC
/begin CHARACTERISTIC SysFricLrng.FricLrngDataDft.VehLrndFric "MICROSAR RTE" VAL_BLK 0x0 RTE_RL_FLOAT32_IEEE 0 NO_COMPU_METHOD -3.402823466e+38 3.402823466e+38 MATRIX_DIM 4 1 1 SYMBOL_LINK "Rte_CalprmRom_SysFricLrng_DEFAULT_RTE_CDATA_GROUP.FricLrngDataDft.VehLrndFric" 0 DISPLAY_IDENTIFIER SysFricLrng.CalibrationParameters.FricLrngDataDft.VehLrndFric /end CHARACTERISTIC
/begin CHARACTERISTIC SysFricLrng.FricNonLrngDataDft.EnaFricLrng "MICROSAR RTE" VALUE 0x0 RTE_RL_BOOLEAN 0 RTE_CM_BOOLEAN 0 255 SYMBOL_LINK "Rte_CalprmRom_SysFricLrng_DEFAULT_RTE_CDATA_GROUP.FricNonLrngDataDft.EnaFricLrng" 0 DISPLAY_IDENTIFIER SysFricLrng.CalibrationParameters.FricNonLrngDataDft.EnaFricLrng /end CHARACTERISTIC
/begin CHARACTERISTIC SysFricLrng.FricNonLrngDataDft.EnaFricOffsOutp "MICROSAR RTE" VALUE 0x0 RTE_RL_BOOLEAN 0 RTE_CM_BOOLEAN 0 255 SYMBOL_LINK "Rte_CalprmRom_SysFricLrng_DEFAULT_RTE_CDATA_GROUP.FricNonLrngDataDft.EnaFricOffsOutp" 0 DISPLAY_IDENTIFIER SysFricLrng.CalibrationParameters.FricNonLrngDataDft.EnaFricOffsOutp /end CHARACTERISTIC
/begin CHARACTERISTIC SysFricLrng.FricNonLrngDataDft.EolFric "MICROSAR RTE" VALUE 0x0 RTE_RL_FLOAT32_IEEE 0 NO_COMPU_METHOD -3.402823466e+38 3.402823466e+38 SYMBOL_LINK "Rte_CalprmRom_SysFricLrng_DEFAULT_RTE_CDATA_GROUP.FricNonLrngDataDft.EolFric" 0 DISPLAY_IDENTIFIER SysFricLrng.CalibrationParameters.FricNonLrngDataDft.EolFric /end CHARACTERISTIC
/begin CHARACTERISTIC SysFricLrng.SysFricLrngAvrgFricFrq.Val "MICROSAR RTE" VALUE 0x0 RTE_RL_FLOAT32_IEEE 0 NO_COMPU_METHOD -3.402823466e+38 3.402823466e+38 SYMBOL_LINK "Rte_CalprmRom_CalRegn01Inin00_DEFAULT_RTE_CALPRM_GROUP.SysFricLrngAvrgFricFrq_Val" 0 DISPLAY_IDENTIFIER SysFricLrng.CalibrationPorts.SysFricLrngAvrgFricFrq.Val /end CHARACTERISTIC
/begin CHARACTERISTIC SysFricLrng.SysFricLrngBasLineEolFric.Val "MICROSAR RTE" VALUE 0x0 RTE_RL_FLOAT32_IEEE 0 NO_COMPU_METHOD -3.402823466e+38 3.402823466e+38 SYMBOL_LINK "Rte_CalprmRom_CalRegn01Inin00_DEFAULT_RTE_CALPRM_GROUP.SysFricLrngBasLineEolFric_Val" 0 DISPLAY_IDENTIFIER SysFricLrng.CalibrationPorts.SysFricLrngBasLineEolFric.Val /end CHARACTERISTIC
/begin CHARACTERISTIC SysFricLrng.SysFricLrngBasLineFric.Ary1D "MICROSAR RTE" VAL_BLK 0x0 RTE_RL_FLOAT32_IEEE 0 NO_COMPU_METHOD -3.402823466e+38 3.402823466e+38 MATRIX_DIM 4 1 1 SYMBOL_LINK "Rte_CalprmRom_CalRegn01Inin00_DEFAULT_RTE_CALPRM_GROUP.SysFricLrngBasLineFric_Ary1D" 0 DISPLAY_IDENTIFIER SysFricLrng.CalibrationPorts.SysFricLrngBasLineFric.Ary1D /end CHARACTERISTIC
/begin CHARACTERISTIC SysFricLrng.SysFricLrngBasLineHys.Ary2D "MICROSAR RTE" VAL_BLK 0x0 RTE_RL_FLOAT32_IEEE 0 NO_COMPU_METHOD -3.402823466e+38 3.402823466e+38 MATRIX_DIM 4 8 1 SYMBOL_LINK "Rte_CalprmRom_CalRegn01Inin00_DEFAULT_RTE_CALPRM_GROUP.SysFricLrngBasLineHys_Ary2D" 0 DISPLAY_IDENTIFIER SysFricLrng.CalibrationPorts.SysFricLrngBasLineHys.Ary2D /end CHARACTERISTIC
/begin CHARACTERISTIC SysFricLrng.SysFricLrngBasLineRngCntr.Ary2D "MICROSAR RTE" VAL_BLK 0x0 RTE_RL_UWORD 0 NO_COMPU_METHOD 0 65535 MATRIX_DIM 3 8 1 SYMBOL_LINK "Rte_CalprmRom_CalRegn01Inin00_DEFAULT_RTE_CALPRM_GROUP.SysFricLrngBasLineRngCntr_Ary2D" 0 DISPLAY_IDENTIFIER SysFricLrng.CalibrationPorts.SysFricLrngBasLineRngCntr.Ary2D /end CHARACTERISTIC
/begin CHARACTERISTIC SysFricLrng.SysFricLrngDataPrepLpFilFrq.Val "MICROSAR RTE" VALUE 0x0 RTE_RL_FLOAT32_IEEE 0 NO_COMPU_METHOD -3.402823466e+38 3.402823466e+38 SYMBOL_LINK "Rte_CalprmRom_CalRegn01Inin00_DEFAULT_RTE_CALPRM_GROUP.SysFricLrngDataPrepLpFilFrq_Val" 0 DISPLAY_IDENTIFIER SysFricLrng.CalibrationPorts.SysFricLrngDataPrepLpFilFrq.Val /end CHARACTERISTIC
/begin CHARACTERISTIC SysFricLrng.SysFricLrngEolFricDifHiLim.Val "MICROSAR RTE" VALUE 0x0 RTE_RL_FLOAT32_IEEE 0 NO_COMPU_METHOD -3.402823466e+38 3.402823466e+38 SYMBOL_LINK "Rte_CalprmRom_CalRegn01Inin00_DEFAULT_RTE_CALPRM_GROUP.SysFricLrngEolFricDifHiLim_Val" 0 DISPLAY_IDENTIFIER SysFricLrng.CalibrationPorts.SysFricLrngEolFricDifHiLim.Val /end CHARACTERISTIC
/begin CHARACTERISTIC SysFricLrng.SysFricLrngEolFricDifLoLim.Val "MICROSAR RTE" VALUE 0x0 RTE_RL_FLOAT32_IEEE 0 NO_COMPU_METHOD -3.402823466e+38 3.402823466e+38 SYMBOL_LINK "Rte_CalprmRom_CalRegn01Inin00_DEFAULT_RTE_CALPRM_GROUP.SysFricLrngEolFricDifLoLim_Val" 0 DISPLAY_IDENTIFIER SysFricLrng.CalibrationPorts.SysFricLrngEolFricDifLoLim.Val /end CHARACTERISTIC
/begin CHARACTERISTIC SysFricLrng.SysFricLrngEolFricDifScagFac.Val "MICROSAR RTE" VALUE 0x0 RTE_RL_FLOAT32_IEEE 0 NO_COMPU_METHOD -3.402823466e+38 3.402823466e+38 SYMBOL_LINK "Rte_CalprmRom_CalRegn01Inin00_DEFAULT_RTE_CALPRM_GROUP.SysFricLrngEolFricDifScagFac_Val" 0 DISPLAY_IDENTIFIER SysFricLrng.CalibrationPorts.SysFricLrngEolFricDifScagFac.Val /end CHARACTERISTIC
/begin CHARACTERISTIC SysFricLrng.SysFricLrngFricChgWght.Ary1D "MICROSAR RTE" VAL_BLK 0x0 RTE_RL_FLOAT32_IEEE 0 NO_COMPU_METHOD -3.402823466e+38 3.402823466e+38 MATRIX_DIM 4 1 1 SYMBOL_LINK "Rte_CalprmRom_CalRegn01Inin00_DEFAULT_RTE_CALPRM_GROUP.SysFricLrngFricChgWght_Ary1D" 0 DISPLAY_IDENTIFIER SysFricLrng.CalibrationPorts.SysFricLrngFricChgWght.Ary1D /end CHARACTERISTIC
/begin CHARACTERISTIC SysFricLrng.SysFricLrngFricDiagcThd.Val "MICROSAR RTE" VALUE 0x0 RTE_RL_FLOAT32_IEEE 0 NO_COMPU_METHOD -3.402823466e+38 3.402823466e+38 SYMBOL_LINK "Rte_CalprmRom_CalRegn01Inin00_DEFAULT_RTE_CALPRM_GROUP.SysFricLrngFricDiagcThd_Val" 0 DISPLAY_IDENTIFIER SysFricLrng.CalibrationPorts.SysFricLrngFricDiagcThd.Val /end CHARACTERISTIC
/begin CHARACTERISTIC SysFricLrng.SysFricLrngFricDiagcTiThd.Val "MICROSAR RTE" VALUE 0x0 RTE_RL_FLOAT32_IEEE 0 NO_COMPU_METHOD -3.402823466e+38 3.402823466e+38 SYMBOL_LINK "Rte_CalprmRom_CalRegn01Inin00_DEFAULT_RTE_CALPRM_GROUP.SysFricLrngFricDiagcTiThd_Val" 0 DISPLAY_IDENTIFIER SysFricLrng.CalibrationPorts.SysFricLrngFricDiagcTiThd.Val /end CHARACTERISTIC
/begin CHARACTERISTIC SysFricLrng.SysFricLrngFricHysHwAgPt.Ary1D "MICROSAR RTE" VAL_BLK 0x0 RTE_RL_FLOAT32_IEEE 0 NO_COMPU_METHOD -3.402823466e+38 3.402823466e+38 MATRIX_DIM 4 1 1 SYMBOL_LINK "Rte_CalprmRom_CalRegn01Inin00_DEFAULT_RTE_CALPRM_GROUP.SysFricLrngFricHysHwAgPt_Ary1D" 0 DISPLAY_IDENTIFIER SysFricLrng.CalibrationPorts.SysFricLrngFricHysHwAgPt.Ary1D /end CHARACTERISTIC
/begin CHARACTERISTIC SysFricLrng.SysFricLrngFricOffs.Val "MICROSAR RTE" VALUE 0x0 RTE_RL_FLOAT32_IEEE 0 NO_COMPU_METHOD -3.402823466e+38 3.402823466e+38 SYMBOL_LINK "Rte_CalprmRom_CalRegn01Inin00_DEFAULT_RTE_CALPRM_GROUP.SysFricLrngFricOffs_Val" 0 DISPLAY_IDENTIFIER SysFricLrng.CalibrationPorts.SysFricLrngFricOffs.Val /end CHARACTERISTIC
/begin CHARACTERISTIC SysFricLrng.SysFricLrngFricOffsHiLim.Val "MICROSAR RTE" VALUE 0x0 RTE_RL_FLOAT32_IEEE 0 NO_COMPU_METHOD -3.402823466e+38 3.402823466e+38 SYMBOL_LINK "Rte_CalprmRom_CalRegn01Inin00_DEFAULT_RTE_CALPRM_GROUP.SysFricLrngFricOffsHiLim_Val" 0 DISPLAY_IDENTIFIER SysFricLrng.CalibrationPorts.SysFricLrngFricOffsHiLim.Val /end CHARACTERISTIC
/begin CHARACTERISTIC SysFricLrng.SysFricLrngFricOffsLoLim.Val "MICROSAR RTE" VALUE 0x0 RTE_RL_FLOAT32_IEEE 0 NO_COMPU_METHOD -3.402823466e+38 3.402823466e+38 SYMBOL_LINK "Rte_CalprmRom_CalRegn01Inin00_DEFAULT_RTE_CALPRM_GROUP.SysFricLrngFricOffsLoLim_Val" 0 DISPLAY_IDENTIFIER SysFricLrng.CalibrationPorts.SysFricLrngFricOffsLoLim.Val /end CHARACTERISTIC
/begin CHARACTERISTIC SysFricLrng.SysFricLrngFricOffsLpFilFrq.Val "MICROSAR RTE" VALUE 0x0 RTE_RL_FLOAT32_IEEE 0 NO_COMPU_METHOD -3.402823466e+38 3.402823466e+38 SYMBOL_LINK "Rte_CalprmRom_CalRegn01Inin00_DEFAULT_RTE_CALPRM_GROUP.SysFricLrngFricOffsLpFilFrq_Val" 0 DISPLAY_IDENTIFIER SysFricLrng.CalibrationPorts.SysFricLrngFricOffsLpFilFrq.Val /end CHARACTERISTIC
/begin CHARACTERISTIC SysFricLrng.SysFricLrngGain.Val "MICROSAR RTE" VALUE 0x0 RTE_RL_FLOAT32_IEEE 0 NO_COMPU_METHOD -3.402823466e+38 3.402823466e+38 SYMBOL_LINK "Rte_CalprmRom_CalRegn01Inin00_DEFAULT_RTE_CALPRM_GROUP.SysFricLrngGain_Val" 0 DISPLAY_IDENTIFIER SysFricLrng.CalibrationPorts.SysFricLrngGain.Val /end CHARACTERISTIC
/begin CHARACTERISTIC SysFricLrng.SysFricLrngHwPosnAuthyThd.Val "MICROSAR RTE" VALUE 0x0 RTE_RL_FLOAT32_IEEE 0 NO_COMPU_METHOD -3.402823466e+38 3.402823466e+38 SYMBOL_LINK "Rte_CalprmRom_CalRegn01Inin00_DEFAULT_RTE_CALPRM_GROUP.SysFricLrngHwPosnAuthyThd_Val" 0 DISPLAY_IDENTIFIER SysFricLrng.CalibrationPorts.SysFricLrngHwPosnAuthyThd.Val /end CHARACTERISTIC
/begin CHARACTERISTIC SysFricLrng.SysFricLrngHwVelConstrLim.Val "MICROSAR RTE" VALUE 0x0 RTE_RL_FLOAT32_IEEE 0 NO_COMPU_METHOD -3.402823466e+38 3.402823466e+38 SYMBOL_LINK "Rte_CalprmRom_CalRegn01Inin00_DEFAULT_RTE_CALPRM_GROUP.SysFricLrngHwVelConstrLim_Val" 0 DISPLAY_IDENTIFIER SysFricLrng.CalibrationPorts.SysFricLrngHwVelConstrLim.Val /end CHARACTERISTIC
/begin CHARACTERISTIC SysFricLrng.SysFricLrngHwVelHiLim.Val "MICROSAR RTE" VALUE 0x0 RTE_RL_FLOAT32_IEEE 0 NO_COMPU_METHOD -3.402823466e+38 3.402823466e+38 SYMBOL_LINK "Rte_CalprmRom_CalRegn01Inin00_DEFAULT_RTE_CALPRM_GROUP.SysFricLrngHwVelHiLim_Val" 0 DISPLAY_IDENTIFIER SysFricLrng.CalibrationPorts.SysFricLrngHwVelHiLim.Val /end CHARACTERISTIC
/begin CHARACTERISTIC SysFricLrng.SysFricLrngHwVelLoLim.Val "MICROSAR RTE" VALUE 0x0 RTE_RL_FLOAT32_IEEE 0 NO_COMPU_METHOD -3.402823466e+38 3.402823466e+38 SYMBOL_LINK "Rte_CalprmRom_CalRegn01Inin00_DEFAULT_RTE_CALPRM_GROUP.SysFricLrngHwVelLoLim_Val" 0 DISPLAY_IDENTIFIER SysFricLrng.CalibrationPorts.SysFricLrngHwVelLoLim.Val /end CHARACTERISTIC
/begin CHARACTERISTIC SysFricLrng.SysFricLrngIgnCycFricChgLim.Val "MICROSAR RTE" VALUE 0x0 RTE_RL_FLOAT32_IEEE 0 NO_COMPU_METHOD -3.402823466e+38 3.402823466e+38 SYMBOL_LINK "Rte_CalprmRom_CalRegn01Inin00_DEFAULT_RTE_CALPRM_GROUP.SysFricLrngIgnCycFricChgLim_Val" 0 DISPLAY_IDENTIFIER SysFricLrng.CalibrationPorts.SysFricLrngIgnCycFricChgLim.Val /end CHARACTERISTIC
/begin CHARACTERISTIC SysFricLrng.SysFricLrngIvsTrsmRatX.Ary1D "MICROSAR RTE" VAL_BLK 0x0 RTE_RL_UWORD 0 NO_COMPU_METHOD 0 65535 MATRIX_DIM 10 1 1 SYMBOL_LINK "Rte_CalprmRom_CalRegn01Inin00_DEFAULT_RTE_CALPRM_GROUP.SysFricLrngIvsTrsmRatX_Ary1D" 0 DISPLAY_IDENTIFIER SysFricLrng.CalibrationPorts.SysFricLrngIvsTrsmRatX.Ary1D /end CHARACTERISTIC
/begin CHARACTERISTIC SysFricLrng.SysFricLrngIvsTrsmRatY.Ary1D "MICROSAR RTE" VAL_BLK 0x0 RTE_RL_UWORD 0 NO_COMPU_METHOD 0 65535 MATRIX_DIM 10 1 1 SYMBOL_LINK "Rte_CalprmRom_CalRegn01Inin00_DEFAULT_RTE_CALPRM_GROUP.SysFricLrngIvsTrsmRatY_Ary1D" 0 DISPLAY_IDENTIFIER SysFricLrng.CalibrationPorts.SysFricLrngIvsTrsmRatY.Ary1D /end CHARACTERISTIC
/begin CHARACTERISTIC SysFricLrng.SysFricLrngLatAHiLim.Val "MICROSAR RTE" VALUE 0x0 RTE_RL_FLOAT32_IEEE 0 NO_COMPU_METHOD -3.402823466e+38 3.402823466e+38 SYMBOL_LINK "Rte_CalprmRom_CalRegn01Inin00_DEFAULT_RTE_CALPRM_GROUP.SysFricLrngLatAHiLim_Val" 0 DISPLAY_IDENTIFIER SysFricLrng.CalibrationPorts.SysFricLrngLatAHiLim.Val /end CHARACTERISTIC
/begin CHARACTERISTIC SysFricLrng.SysFricLrngLatALoLim.Val "MICROSAR RTE" VALUE 0x0 RTE_RL_FLOAT32_IEEE 0 NO_COMPU_METHOD -3.402823466e+38 3.402823466e+38 SYMBOL_LINK "Rte_CalprmRom_CalRegn01Inin00_DEFAULT_RTE_CALPRM_GROUP.SysFricLrngLatALoLim_Val" 0 DISPLAY_IDENTIFIER SysFricLrng.CalibrationPorts.SysFricLrngLatALoLim.Val /end CHARACTERISTIC
/begin CHARACTERISTIC SysFricLrng.SysFricLrngMaskVehSpd.Ary1D "MICROSAR RTE" VAL_BLK 0x0 RTE_RL_BOOLEAN 0 RTE_CM_BOOLEAN 0 255 MATRIX_DIM 4 1 1 SYMBOL_LINK "Rte_CalprmRom_CalRegn01Inin00_DEFAULT_RTE_CALPRM_GROUP.SysFricLrngMaskVehSpd_Ary1D" 0 DISPLAY_IDENTIFIER SysFricLrng.CalibrationPorts.SysFricLrngMaskVehSpd.Ary1D /end CHARACTERISTIC
/begin CHARACTERISTIC SysFricLrng.SysFricLrngRngCntrThd.Val "MICROSAR RTE" VALUE 0x0 RTE_RL_UWORD 0 NO_COMPU_METHOD 0 65535 SYMBOL_LINK "Rte_CalprmRom_CalRegn01Inin00_DEFAULT_RTE_CALPRM_GROUP.SysFricLrngRngCntrThd_Val" 0 DISPLAY_IDENTIFIER SysFricLrng.CalibrationPorts.SysFricLrngRngCntrThd.Val /end CHARACTERISTIC
/begin CHARACTERISTIC SysFricLrng.SysFricLrngTHiLim.Val "MICROSAR RTE" VALUE 0x0 RTE_RL_FLOAT32_IEEE 0 NO_COMPU_METHOD -3.402823466e+38 3.402823466e+38 SYMBOL_LINK "Rte_CalprmRom_CalRegn01Inin00_DEFAULT_RTE_CALPRM_GROUP.SysFricLrngTHiLim_Val" 0 DISPLAY_IDENTIFIER SysFricLrng.CalibrationPorts.SysFricLrngTHiLim.Val /end CHARACTERISTIC
/begin CHARACTERISTIC SysFricLrng.SysFricLrngTLoLim.Val "MICROSAR RTE" VALUE 0x0 RTE_RL_FLOAT32_IEEE 0 NO_COMPU_METHOD -3.402823466e+38 3.402823466e+38 SYMBOL_LINK "Rte_CalprmRom_CalRegn01Inin00_DEFAULT_RTE_CALPRM_GROUP.SysFricLrngTLoLim_Val" 0 DISPLAY_IDENTIFIER SysFricLrng.CalibrationPorts.SysFricLrngTLoLim.Val /end CHARACTERISTIC
/begin CHARACTERISTIC SysFricLrng.SysFricLrngThd.Val "MICROSAR RTE" VALUE 0x0 RTE_RL_ULONG 0 NO_COMPU_METHOD 0 4294967295 SYMBOL_LINK "Rte_CalprmRom_CalRegn01Inin00_DEFAULT_RTE_CALPRM_GROUP.SysFricLrngThd_Val" 0 DISPLAY_IDENTIFIER SysFricLrng.CalibrationPorts.SysFricLrngThd.Val /end CHARACTERISTIC
/begin CHARACTERISTIC SysFricLrng.SysFricLrngVehSpd.Ary2D "MICROSAR RTE" VAL_BLK 0x0 RTE_RL_FLOAT32_IEEE 0 NO_COMPU_METHOD -3.402823466e+38 3.402823466e+38 MATRIX_DIM 2 4 1 SYMBOL_LINK "Rte_CalprmRom_CalRegn01Inin00_DEFAULT_RTE_CALPRM_GROUP.SysFricLrngVehSpd_Ary2D" 0 DISPLAY_IDENTIFIER SysFricLrng.CalibrationPorts.SysFricLrngVehSpd.Ary2D /end CHARACTERISTIC
/begin CHARACTERISTIC TEstimn.TEstimnAmbPwrMplr.Val "MICROSAR RTE" VALUE 0x0 RTE_RL_FLOAT32_IEEE 0 NO_COMPU_METHOD -3.402823466e+38 3.402823466e+38 SYMBOL_LINK "Rte_CalprmRom_CalRegn01Inin00_DEFAULT_RTE_CALPRM_GROUP.TEstimnAmbPwrMplr_Val" 0 DISPLAY_IDENTIFIER TEstimn.CalibrationPorts.TEstimnAmbPwrMplr.Val /end CHARACTERISTIC
/begin CHARACTERISTIC TEstimn.TEstimnAmbTSca.Val "MICROSAR RTE" VALUE 0x0 RTE_RL_FLOAT32_IEEE 0 NO_COMPU_METHOD -3.402823466e+38 3.402823466e+38 SYMBOL_LINK "Rte_CalprmRom_CalRegn01Inin00_DEFAULT_RTE_CALPRM_GROUP.TEstimnAmbTSca_Val" 0 DISPLAY_IDENTIFIER TEstimn.CalibrationPorts.TEstimnAmbTSca.Val /end CHARACTERISTIC
/begin CHARACTERISTIC TEstimn.TEstimnAssiMechAmbLpFilFrq.Val "MICROSAR RTE" VALUE 0x0 RTE_RL_FLOAT32_IEEE 0 NO_COMPU_METHOD -3.402823466e+38 3.402823466e+38 SYMBOL_LINK "Rte_CalprmRom_CalRegn01Inin00_DEFAULT_RTE_CALPRM_GROUP.TEstimnAssiMechAmbLpFilFrq_Val" 0 DISPLAY_IDENTIFIER TEstimn.CalibrationPorts.TEstimnAssiMechAmbLpFilFrq.Val /end CHARACTERISTIC
/begin CHARACTERISTIC TEstimn.TEstimnAssiMechAmbMplr.Val "MICROSAR RTE" VALUE 0x0 RTE_RL_FLOAT32_IEEE 0 NO_COMPU_METHOD -3.402823466e+38 3.402823466e+38 SYMBOL_LINK "Rte_CalprmRom_CalRegn01Inin00_DEFAULT_RTE_CALPRM_GROUP.TEstimnAssiMechAmbMplr_Val" 0 DISPLAY_IDENTIFIER TEstimn.CalibrationPorts.TEstimnAssiMechAmbMplr.Val /end CHARACTERISTIC
/begin CHARACTERISTIC TEstimn.TEstimnAssiMechCorrLim.Val "MICROSAR RTE" VALUE 0x0 RTE_RL_FLOAT32_IEEE 0 NO_COMPU_METHOD -3.402823466e+38 3.402823466e+38 SYMBOL_LINK "Rte_CalprmRom_CalRegn01Inin00_DEFAULT_RTE_CALPRM_GROUP.TEstimnAssiMechCorrLim_Val" 0 DISPLAY_IDENTIFIER TEstimn.CalibrationPorts.TEstimnAssiMechCorrLim.Val /end CHARACTERISTIC
/begin CHARACTERISTIC TEstimn.TEstimnAssiMechDampgSca.Val "MICROSAR RTE" VALUE 0x0 RTE_RL_FLOAT32_IEEE 0 NO_COMPU_METHOD -3.402823466e+38 3.402823466e+38 SYMBOL_LINK "Rte_CalprmRom_CalRegn01Inin00_DEFAULT_RTE_CALPRM_GROUP.TEstimnAssiMechDampgSca_Val" 0 DISPLAY_IDENTIFIER TEstimn.CalibrationPorts.TEstimnAssiMechDampgSca.Val /end CHARACTERISTIC
/begin CHARACTERISTIC TEstimn.TEstimnAssiMechDftT.Val "MICROSAR RTE" VALUE 0x0 RTE_RL_FLOAT32_IEEE 0 NO_COMPU_METHOD -3.402823466e+38 3.402823466e+38 SYMBOL_LINK "Rte_CalprmRom_CalRegn01Inin00_DEFAULT_RTE_CALPRM_GROUP.TEstimnAssiMechDftT_Val" 0 DISPLAY_IDENTIFIER TEstimn.CalibrationPorts.TEstimnAssiMechDftT.Val /end CHARACTERISTIC
/begin CHARACTERISTIC TEstimn.TEstimnAssiMechLLFilCoeffA1.Val "MICROSAR RTE" VALUE 0x0 RTE_RL_FLOAT32_IEEE 0 NO_COMPU_METHOD -3.402823466e+38 3.402823466e+38 SYMBOL_LINK "Rte_CalprmRom_CalRegn01Inin00_DEFAULT_RTE_CALPRM_GROUP.TEstimnAssiMechLLFilCoeffA1_Val" 0 DISPLAY_IDENTIFIER TEstimn.CalibrationPorts.TEstimnAssiMechLLFilCoeffA1.Val /end CHARACTERISTIC
/begin CHARACTERISTIC TEstimn.TEstimnAssiMechLLFilCoeffB0.Val "MICROSAR RTE" VALUE 0x0 RTE_RL_FLOAT32_IEEE 0 NO_COMPU_METHOD -3.402823466e+38 3.402823466e+38 SYMBOL_LINK "Rte_CalprmRom_CalRegn01Inin00_DEFAULT_RTE_CALPRM_GROUP.TEstimnAssiMechLLFilCoeffB0_Val" 0 DISPLAY_IDENTIFIER TEstimn.CalibrationPorts.TEstimnAssiMechLLFilCoeffB0.Val /end CHARACTERISTIC
/begin CHARACTERISTIC TEstimn.TEstimnAssiMechLLFilCoeffB1.Val "MICROSAR RTE" VALUE 0x0 RTE_RL_FLOAT32_IEEE 0 NO_COMPU_METHOD -3.402823466e+38 3.402823466e+38 SYMBOL_LINK "Rte_CalprmRom_CalRegn01Inin00_DEFAULT_RTE_CALPRM_GROUP.TEstimnAssiMechLLFilCoeffB1_Val" 0 DISPLAY_IDENTIFIER TEstimn.CalibrationPorts.TEstimnAssiMechLLFilCoeffB1.Val /end CHARACTERISTIC
/begin CHARACTERISTIC TEstimn.TEstimnAssiMechSlew.Val "MICROSAR RTE" VALUE 0x0 RTE_RL_FLOAT32_IEEE 0 NO_COMPU_METHOD -3.402823466e+38 3.402823466e+38 SYMBOL_LINK "Rte_CalprmRom_CalRegn01Inin00_DEFAULT_RTE_CALPRM_GROUP.TEstimnAssiMechSlew_Val" 0 DISPLAY_IDENTIFIER TEstimn.CalibrationPorts.TEstimnAssiMechSlew.Val /end CHARACTERISTIC
/begin CHARACTERISTIC TEstimn.TEstimnCorrnTAssiMech.Val "MICROSAR RTE" VALUE 0x0 RTE_RL_FLOAT32_IEEE 0 NO_COMPU_METHOD -3.402823466e+38 3.402823466e+38 SYMBOL_LINK "Rte_CalprmRom_CalRegn01Inin00_DEFAULT_RTE_CALPRM_GROUP.TEstimnCorrnTAssiMech_Val" 0 DISPLAY_IDENTIFIER TEstimn.CalibrationPorts.TEstimnCorrnTAssiMech.Val /end CHARACTERISTIC
/begin CHARACTERISTIC TEstimn.TEstimnCorrnTCu.Val "MICROSAR RTE" VALUE 0x0 RTE_RL_FLOAT32_IEEE 0 NO_COMPU_METHOD -3.402823466e+38 3.402823466e+38 SYMBOL_LINK "Rte_CalprmRom_CalRegn01Inin00_DEFAULT_RTE_CALPRM_GROUP.TEstimnCorrnTCu_Val" 0 DISPLAY_IDENTIFIER TEstimn.CalibrationPorts.TEstimnCorrnTCu.Val /end CHARACTERISTIC
/begin CHARACTERISTIC TEstimn.TEstimnCorrnTMag.Val "MICROSAR RTE" VALUE 0x0 RTE_RL_FLOAT32_IEEE 0 NO_COMPU_METHOD -3.402823466e+38 3.402823466e+38 SYMBOL_LINK "Rte_CalprmRom_CalRegn01Inin00_DEFAULT_RTE_CALPRM_GROUP.TEstimnCorrnTMag_Val" 0 DISPLAY_IDENTIFIER TEstimn.CalibrationPorts.TEstimnCorrnTMag.Val /end CHARACTERISTIC
/begin CHARACTERISTIC TEstimn.TEstimnCorrnTSi.Val "MICROSAR RTE" VALUE 0x0 RTE_RL_FLOAT32_IEEE 0 NO_COMPU_METHOD -3.402823466e+38 3.402823466e+38 SYMBOL_LINK "Rte_CalprmRom_CalRegn01Inin00_DEFAULT_RTE_CALPRM_GROUP.TEstimnCorrnTSi_Val" 0 DISPLAY_IDENTIFIER TEstimn.CalibrationPorts.TEstimnCorrnTSi.Val /end CHARACTERISTIC
/begin CHARACTERISTIC TEstimn.TEstimnCuAmbLpFilFrq.Val "MICROSAR RTE" VALUE 0x0 RTE_RL_FLOAT32_IEEE 0 NO_COMPU_METHOD -3.402823466e+38 3.402823466e+38 SYMBOL_LINK "Rte_CalprmRom_CalRegn01Inin00_DEFAULT_RTE_CALPRM_GROUP.TEstimnCuAmbLpFilFrq_Val" 0 DISPLAY_IDENTIFIER TEstimn.CalibrationPorts.TEstimnCuAmbLpFilFrq.Val /end CHARACTERISTIC
/begin CHARACTERISTIC TEstimn.TEstimnCuAmbMplr.Val "MICROSAR RTE" VALUE 0x0 RTE_RL_FLOAT32_IEEE 0 NO_COMPU_METHOD -3.402823466e+38 3.402823466e+38 SYMBOL_LINK "Rte_CalprmRom_CalRegn01Inin00_DEFAULT_RTE_CALPRM_GROUP.TEstimnCuAmbMplr_Val" 0 DISPLAY_IDENTIFIER TEstimn.CalibrationPorts.TEstimnCuAmbMplr.Val /end CHARACTERISTIC
/begin CHARACTERISTIC TEstimn.TEstimnCuCorrnLim.Val "MICROSAR RTE" VALUE 0x0 RTE_RL_FLOAT32_IEEE 0 NO_COMPU_METHOD -3.402823466e+38 3.402823466e+38 SYMBOL_LINK "Rte_CalprmRom_CalRegn01Inin00_DEFAULT_RTE_CALPRM_GROUP.TEstimnCuCorrnLim_Val" 0 DISPLAY_IDENTIFIER TEstimn.CalibrationPorts.TEstimnCuCorrnLim.Val /end CHARACTERISTIC
/begin CHARACTERISTIC TEstimn.TEstimnCuLLFilCoeffA1.Val "MICROSAR RTE" VALUE 0x0 RTE_RL_FLOAT32_IEEE 0 NO_COMPU_METHOD -3.402823466e+38 3.402823466e+38 SYMBOL_LINK "Rte_CalprmRom_CalRegn01Inin00_DEFAULT_RTE_CALPRM_GROUP.TEstimnCuLLFilCoeffA1_Val" 0 DISPLAY_IDENTIFIER TEstimn.CalibrationPorts.TEstimnCuLLFilCoeffA1.Val /end CHARACTERISTIC
/begin CHARACTERISTIC TEstimn.TEstimnCuLLFilCoeffB0.Val "MICROSAR RTE" VALUE 0x0 RTE_RL_FLOAT32_IEEE 0 NO_COMPU_METHOD -3.402823466e+38 3.402823466e+38 SYMBOL_LINK "Rte_CalprmRom_CalRegn01Inin00_DEFAULT_RTE_CALPRM_GROUP.TEstimnCuLLFilCoeffB0_Val" 0 DISPLAY_IDENTIFIER TEstimn.CalibrationPorts.TEstimnCuLLFilCoeffB0.Val /end CHARACTERISTIC
/begin CHARACTERISTIC TEstimn.TEstimnCuLLFilCoeffB1.Val "MICROSAR RTE" VALUE 0x0 RTE_RL_FLOAT32_IEEE 0 NO_COMPU_METHOD -3.402823466e+38 3.402823466e+38 SYMBOL_LINK "Rte_CalprmRom_CalRegn01Inin00_DEFAULT_RTE_CALPRM_GROUP.TEstimnCuLLFilCoeffB1_Val" 0 DISPLAY_IDENTIFIER TEstimn.CalibrationPorts.TEstimnCuLLFilCoeffB1.Val /end CHARACTERISTIC
/begin CHARACTERISTIC TEstimn.TEstimnEngTSca.Val "MICROSAR RTE" VALUE 0x0 RTE_RL_FLOAT32_IEEE 0 NO_COMPU_METHOD -3.402823466e+38 3.402823466e+38 SYMBOL_LINK "Rte_CalprmRom_CalRegn01Inin00_DEFAULT_RTE_CALPRM_GROUP.TEstimnEngTSca_Val" 0 DISPLAY_IDENTIFIER TEstimn.CalibrationPorts.TEstimnEngTSca.Val /end CHARACTERISTIC
/begin CHARACTERISTIC TEstimn.TEstimnMagAmbLpFilFrq.Val "MICROSAR RTE" VALUE 0x0 RTE_RL_FLOAT32_IEEE 0 NO_COMPU_METHOD -3.402823466e+38 3.402823466e+38 SYMBOL_LINK "Rte_CalprmRom_CalRegn01Inin00_DEFAULT_RTE_CALPRM_GROUP.TEstimnMagAmbLpFilFrq_Val" 0 DISPLAY_IDENTIFIER TEstimn.CalibrationPorts.TEstimnMagAmbLpFilFrq.Val /end CHARACTERISTIC
/begin CHARACTERISTIC TEstimn.TEstimnMagAmbMplr.Val "MICROSAR RTE" VALUE 0x0 RTE_RL_FLOAT32_IEEE 0 NO_COMPU_METHOD -3.402823466e+38 3.402823466e+38 SYMBOL_LINK "Rte_CalprmRom_CalRegn01Rt00_DEFAULT_RTE_CALPRM_GROUP.TEstimnMagAmbMplr_Val" 0 DISPLAY_IDENTIFIER TEstimn.CalibrationPorts.TEstimnMagAmbMplr.Val /end CHARACTERISTIC
/begin CHARACTERISTIC TEstimn.TEstimnMagCorrnLim.Val "MICROSAR RTE" VALUE 0x0 RTE_RL_FLOAT32_IEEE 0 NO_COMPU_METHOD -3.402823466e+38 3.402823466e+38 SYMBOL_LINK "Rte_CalprmRom_CalRegn01Inin00_DEFAULT_RTE_CALPRM_GROUP.TEstimnMagCorrnLim_Val" 0 DISPLAY_IDENTIFIER TEstimn.CalibrationPorts.TEstimnMagCorrnLim.Val /end CHARACTERISTIC
/begin CHARACTERISTIC TEstimn.TEstimnMagLLFilCoeffA1.Val "MICROSAR RTE" VALUE 0x0 RTE_RL_FLOAT32_IEEE 0 NO_COMPU_METHOD -3.402823466e+38 3.402823466e+38 SYMBOL_LINK "Rte_CalprmRom_CalRegn01Inin00_DEFAULT_RTE_CALPRM_GROUP.TEstimnMagLLFilCoeffA1_Val" 0 DISPLAY_IDENTIFIER TEstimn.CalibrationPorts.TEstimnMagLLFilCoeffA1.Val /end CHARACTERISTIC
/begin CHARACTERISTIC TEstimn.TEstimnMagLLFilCoeffB0.Val "MICROSAR RTE" VALUE 0x0 RTE_RL_FLOAT32_IEEE 0 NO_COMPU_METHOD -3.402823466e+38 3.402823466e+38 SYMBOL_LINK "Rte_CalprmRom_CalRegn01Inin00_DEFAULT_RTE_CALPRM_GROUP.TEstimnMagLLFilCoeffB0_Val" 0 DISPLAY_IDENTIFIER TEstimn.CalibrationPorts.TEstimnMagLLFilCoeffB0.Val /end CHARACTERISTIC
/begin CHARACTERISTIC TEstimn.TEstimnMagLLFilCoeffB1.Val "MICROSAR RTE" VALUE 0x0 RTE_RL_FLOAT32_IEEE 0 NO_COMPU_METHOD -3.402823466e+38 3.402823466e+38 SYMBOL_LINK "Rte_CalprmRom_CalRegn01Inin00_DEFAULT_RTE_CALPRM_GROUP.TEstimnMagLLFilCoeffB1_Val" 0 DISPLAY_IDENTIFIER TEstimn.CalibrationPorts.TEstimnMagLLFilCoeffB1.Val /end CHARACTERISTIC
/begin CHARACTERISTIC TEstimn.TEstimnSiAmbLpFilFrq.Val "MICROSAR RTE" VALUE 0x0 RTE_RL_FLOAT32_IEEE 0 NO_COMPU_METHOD -3.402823466e+38 3.402823466e+38 SYMBOL_LINK "Rte_CalprmRom_CalRegn01Inin00_DEFAULT_RTE_CALPRM_GROUP.TEstimnSiAmbLpFilFrq_Val" 0 DISPLAY_IDENTIFIER TEstimn.CalibrationPorts.TEstimnSiAmbLpFilFrq.Val /end CHARACTERISTIC
/begin CHARACTERISTIC TEstimn.TEstimnSiAmbMplr.Val "MICROSAR RTE" VALUE 0x0 RTE_RL_FLOAT32_IEEE 0 NO_COMPU_METHOD -3.402823466e+38 3.402823466e+38 SYMBOL_LINK "Rte_CalprmRom_CalRegn01Inin00_DEFAULT_RTE_CALPRM_GROUP.TEstimnSiAmbMplr_Val" 0 DISPLAY_IDENTIFIER TEstimn.CalibrationPorts.TEstimnSiAmbMplr.Val /end CHARACTERISTIC
/begin CHARACTERISTIC TEstimn.TEstimnSiCorrnLim.Val "MICROSAR RTE" VALUE 0x0 RTE_RL_FLOAT32_IEEE 0 NO_COMPU_METHOD -3.402823466e+38 3.402823466e+38 SYMBOL_LINK "Rte_CalprmRom_CalRegn01Inin00_DEFAULT_RTE_CALPRM_GROUP.TEstimnSiCorrnLim_Val" 0 DISPLAY_IDENTIFIER TEstimn.CalibrationPorts.TEstimnSiCorrnLim.Val /end CHARACTERISTIC
/begin CHARACTERISTIC TEstimn.TEstimnSiLLFilCoeffA1.Val "MICROSAR RTE" VALUE 0x0 RTE_RL_FLOAT32_IEEE 0 NO_COMPU_METHOD -3.402823466e+38 3.402823466e+38 SYMBOL_LINK "Rte_CalprmRom_CalRegn01Inin00_DEFAULT_RTE_CALPRM_GROUP.TEstimnSiLLFilCoeffA1_Val" 0 DISPLAY_IDENTIFIER TEstimn.CalibrationPorts.TEstimnSiLLFilCoeffA1.Val /end CHARACTERISTIC
/begin CHARACTERISTIC TEstimn.TEstimnSiLLFilCoeffB0.Val "MICROSAR RTE" VALUE 0x0 RTE_RL_FLOAT32_IEEE 0 NO_COMPU_METHOD -3.402823466e+38 3.402823466e+38 SYMBOL_LINK "Rte_CalprmRom_CalRegn01Inin00_DEFAULT_RTE_CALPRM_GROUP.TEstimnSiLLFilCoeffB0_Val" 0 DISPLAY_IDENTIFIER TEstimn.CalibrationPorts.TEstimnSiLLFilCoeffB0.Val /end CHARACTERISTIC
/begin CHARACTERISTIC TEstimn.TEstimnSiLLFilCoeffB1.Val "MICROSAR RTE" VALUE 0x0 RTE_RL_FLOAT32_IEEE 0 NO_COMPU_METHOD -3.402823466e+38 3.402823466e+38 SYMBOL_LINK "Rte_CalprmRom_CalRegn01Inin00_DEFAULT_RTE_CALPRM_GROUP.TEstimnSiLLFilCoeffB1_Val" 0 DISPLAY_IDENTIFIER TEstimn.CalibrationPorts.TEstimnSiLLFilCoeffB1.Val /end CHARACTERISTIC
/begin CHARACTERISTIC TEstimn.TEstimnWghtAvrgTDi.Logl "MICROSAR RTE" VALUE 0x0 RTE_RL_BOOLEAN 0 RTE_CM_BOOLEAN 0 255 SYMBOL_LINK "Rte_CalprmRom_CalRegn01Inin00_DEFAULT_RTE_CALPRM_GROUP.TEstimnWghtAvrgTDi_Logl" 0 DISPLAY_IDENTIFIER TEstimn.CalibrationPorts.TEstimnWghtAvrgTDi.Logl /end CHARACTERISTIC
/begin CHARACTERISTIC TqLoa.TqLoaDrvrTqNom.Val "MICROSAR RTE" VALUE 0x0 RTE_RL_FLOAT32_IEEE 0 NO_COMPU_METHOD -3.402823466e+38 3.402823466e+38 SYMBOL_LINK "Rte_CalprmRom_CalRegn03Cmn_DEFAULT_RTE_CALPRM_GROUP.TqLoaDrvrTqNom_Val" 0 DISPLAY_IDENTIFIER TqLoa.CalibrationPorts.TqLoaDrvrTqNom.Val /end CHARACTERISTIC
/begin CHARACTERISTIC TqLoa.TqLoaMotTqCmdLim.Val "MICROSAR RTE" VALUE 0x0 RTE_RL_FLOAT32_IEEE 0 NO_COMPU_METHOD -3.402823466e+38 3.402823466e+38 SYMBOL_LINK "Rte_CalprmRom_CalRegn03Cmn_DEFAULT_RTE_CALPRM_GROUP.TqLoaMotTqCmdLim_Val" 0 DISPLAY_IDENTIFIER TqLoa.CalibrationPorts.TqLoaMotTqCmdLim.Val /end CHARACTERISTIC
/begin CHARACTERISTIC TqLoa.TqLoaMotVelAndTqBasdScaFacFallRate.Val "MICROSAR RTE" VALUE 0x0 RTE_RL_FLOAT32_IEEE 0 NO_COMPU_METHOD -3.402823466e+38 3.402823466e+38 SYMBOL_LINK "Rte_CalprmRom_CalRegn03Cmn_DEFAULT_RTE_CALPRM_GROUP.TqLoaMotVelAndTqBasdScaFacFallRate_Val" 0 DISPLAY_IDENTIFIER TqLoa.CalibrationPorts.TqLoaMotVelAndTqBasdScaFacFallRate.Val /end CHARACTERISTIC
/begin CHARACTERISTIC TqLoa.TqLoaMotVelAndTqBasdScaFacMax.Val "MICROSAR RTE" VALUE 0x0 RTE_RL_FLOAT32_IEEE 0 NO_COMPU_METHOD -3.402823466e+38 3.402823466e+38 SYMBOL_LINK "Rte_CalprmRom_CalRegn03Cmn_DEFAULT_RTE_CALPRM_GROUP.TqLoaMotVelAndTqBasdScaFacMax_Val" 0 DISPLAY_IDENTIFIER TqLoa.CalibrationPorts.TqLoaMotVelAndTqBasdScaFacMax.Val /end CHARACTERISTIC
/begin CHARACTERISTIC TqLoa.TqLoaMotVelAndTqBasdScaFacMin.Val "MICROSAR RTE" VALUE 0x0 RTE_RL_FLOAT32_IEEE 0 NO_COMPU_METHOD -3.402823466e+38 3.402823466e+38 SYMBOL_LINK "Rte_CalprmRom_CalRegn03Cmn_DEFAULT_RTE_CALPRM_GROUP.TqLoaMotVelAndTqBasdScaFacMin_Val" 0 DISPLAY_IDENTIFIER TqLoa.CalibrationPorts.TqLoaMotVelAndTqBasdScaFacMin.Val /end CHARACTERISTIC
/begin CHARACTERISTIC TqLoa.TqLoaMotVelAndTqBasdScaFacRiseRate.Val "MICROSAR RTE" VALUE 0x0 RTE_RL_FLOAT32_IEEE 0 NO_COMPU_METHOD -3.402823466e+38 3.402823466e+38 SYMBOL_LINK "Rte_CalprmRom_CalRegn03Cmn_DEFAULT_RTE_CALPRM_GROUP.TqLoaMotVelAndTqBasdScaFacRiseRate_Val" 0 DISPLAY_IDENTIFIER TqLoa.CalibrationPorts.TqLoaMotVelAndTqBasdScaFacRiseRate.Val /end CHARACTERISTIC
/begin CHARACTERISTIC TqLoa.TqLoaMotVelMgnThd.Val "MICROSAR RTE" VALUE 0x0 RTE_RL_FLOAT32_IEEE 0 NO_COMPU_METHOD -3.402823466e+38 3.402823466e+38 SYMBOL_LINK "Rte_CalprmRom_CalRegn03Cmn_DEFAULT_RTE_CALPRM_GROUP.TqLoaMotVelMgnThd_Val" 0 DISPLAY_IDENTIFIER TqLoa.CalibrationPorts.TqLoaMotVelMgnThd.Val /end CHARACTERISTIC
/begin CHARACTERISTIC TqLoa.TqLoaTqCmdLimY.Ary1D "MICROSAR RTE" VAL_BLK 0x0 RTE_RL_UWORD 0 NO_COMPU_METHOD 0 65535 MATRIX_DIM 8 1 1 SYMBOL_LINK "Rte_CalprmRom_CalRegn03Cmn_DEFAULT_RTE_CALPRM_GROUP.TqLoaTqCmdLimY_Ary1D" 0 DISPLAY_IDENTIFIER TqLoa.CalibrationPorts.TqLoaTqCmdLimY.Ary1D /end CHARACTERISTIC
/begin CHARACTERISTIC TqLoa.TqLoaTqCmdMgnThd.Val "MICROSAR RTE" VALUE 0x0 RTE_RL_FLOAT32_IEEE 0 NO_COMPU_METHOD -3.402823466e+38 3.402823466e+38 SYMBOL_LINK "Rte_CalprmRom_CalRegn03Cmn_DEFAULT_RTE_CALPRM_GROUP.TqLoaTqCmdMgnThd_Val" 0 DISPLAY_IDENTIFIER TqLoa.CalibrationPorts.TqLoaTqCmdMgnThd.Val /end CHARACTERISTIC
/begin CHARACTERISTIC TqLoa.TqLoaVehLatADifScaFacFallRate.Val "MICROSAR RTE" VALUE 0x0 RTE_RL_FLOAT32_IEEE 0 NO_COMPU_METHOD -3.402823466e+38 3.402823466e+38 SYMBOL_LINK "Rte_CalprmRom_CalRegn03Cmn_DEFAULT_RTE_CALPRM_GROUP.TqLoaVehLatADifScaFacFallRate_Val" 0 DISPLAY_IDENTIFIER TqLoa.CalibrationPorts.TqLoaVehLatADifScaFacFallRate.Val /end CHARACTERISTIC
/begin CHARACTERISTIC TqLoa.TqLoaVehLatADifScaFacRiseRate.Val "MICROSAR RTE" VALUE 0x0 RTE_RL_FLOAT32_IEEE 0 NO_COMPU_METHOD -3.402823466e+38 3.402823466e+38 SYMBOL_LINK "Rte_CalprmRom_CalRegn03Cmn_DEFAULT_RTE_CALPRM_GROUP.TqLoaVehLatADifScaFacRiseRate_Val" 0 DISPLAY_IDENTIFIER TqLoa.CalibrationPorts.TqLoaVehLatADifScaFacRiseRate.Val /end CHARACTERISTIC
/begin CHARACTERISTIC TqLoa.TqLoaVehLatADifScaFacX.Ary1D "MICROSAR RTE" VAL_BLK 0x0 RTE_RL_UWORD 0 NO_COMPU_METHOD 0 65535 MATRIX_DIM 4 1 1 SYMBOL_LINK "Rte_CalprmRom_CalRegn03Cmn_DEFAULT_RTE_CALPRM_GROUP.TqLoaVehLatADifScaFacX_Ary1D" 0 DISPLAY_IDENTIFIER TqLoa.CalibrationPorts.TqLoaVehLatADifScaFacX.Ary1D /end CHARACTERISTIC
/begin CHARACTERISTIC TqLoa.TqLoaVehLatADifScaFacY.Ary2D "MICROSAR RTE" VAL_BLK 0x0 RTE_RL_UWORD 0 NO_COMPU_METHOD 0 65535 MATRIX_DIM 4 8 1 SYMBOL_LINK "Rte_CalprmRom_CalRegn03Cmn_DEFAULT_RTE_CALPRM_GROUP.TqLoaVehLatADifScaFacY_Ary2D" 0 DISPLAY_IDENTIFIER TqLoa.CalibrationPorts.TqLoaVehLatADifScaFacY.Ary2D /end CHARACTERISTIC
/begin CHARACTERISTIC TqLoa.TqLoaVehLatAEstimnFilFrq.Val "MICROSAR RTE" VALUE 0x0 RTE_RL_FLOAT32_IEEE 0 NO_COMPU_METHOD -3.402823466e+38 3.402823466e+38 SYMBOL_LINK "Rte_CalprmRom_CalRegn03Cmn_DEFAULT_RTE_CALPRM_GROUP.TqLoaVehLatAEstimnFilFrq_Val" 0 DISPLAY_IDENTIFIER TqLoa.CalibrationPorts.TqLoaVehLatAEstimnFilFrq.Val /end CHARACTERISTIC
/begin CHARACTERISTIC TqLoa.TqLoaVehLatAGainY.Ary1D "MICROSAR RTE" VAL_BLK 0x0 RTE_RL_UWORD 0 NO_COMPU_METHOD 0 65535 MATRIX_DIM 8 1 1 SYMBOL_LINK "Rte_CalprmRom_CalRegn03Cmn_DEFAULT_RTE_CALPRM_GROUP.TqLoaVehLatAGainY_Ary1D" 0 DISPLAY_IDENTIFIER TqLoa.CalibrationPorts.TqLoaVehLatAGainY.Ary1D /end CHARACTERISTIC
/begin CHARACTERISTIC TqLoa.TqLoaVehSpdScaFacX.Ary1D "MICROSAR RTE" VAL_BLK 0x0 RTE_RL_UWORD 0 NO_COMPU_METHOD 0 65535 MATRIX_DIM 5 1 1 SYMBOL_LINK "Rte_CalprmRom_CalRegn03Cmn_DEFAULT_RTE_CALPRM_GROUP.TqLoaVehSpdScaFacX_Ary1D" 0 DISPLAY_IDENTIFIER TqLoa.CalibrationPorts.TqLoaVehSpdScaFacX.Ary1D /end CHARACTERISTIC
/begin CHARACTERISTIC TqLoa.TqLoaVehSpdScaFacY.Ary1D "MICROSAR RTE" VAL_BLK 0x0 RTE_RL_UWORD 0 NO_COMPU_METHOD 0 65535 MATRIX_DIM 5 1 1 SYMBOL_LINK "Rte_CalprmRom_CalRegn03Cmn_DEFAULT_RTE_CALPRM_GROUP.TqLoaVehSpdScaFacY_Ary1D" 0 DISPLAY_IDENTIFIER TqLoa.CalibrationPorts.TqLoaVehSpdScaFacY.Ary1D /end CHARACTERISTIC
/begin CHARACTERISTIC TqLoa.TqLoaVehSpdX.Ary1D "MICROSAR RTE" VAL_BLK 0x0 RTE_RL_UWORD 0 NO_COMPU_METHOD 0 65535 MATRIX_DIM 8 1 1 SYMBOL_LINK "Rte_CalprmRom_CalRegn03Cmn_DEFAULT_RTE_CALPRM_GROUP.TqLoaVehSpdX_Ary1D" 0 DISPLAY_IDENTIFIER TqLoa.CalibrationPorts.TqLoaVehSpdX.Ary1D /end CHARACTERISTIC
/begin CHARACTERISTIC TqLoa.TqLoaVehSteerRat.Val "MICROSAR RTE" VALUE 0x0 RTE_RL_FLOAT32_IEEE 0 NO_COMPU_METHOD -3.402823466e+38 3.402823466e+38 SYMBOL_LINK "Rte_CalprmRom_CalRegn03Cmn_DEFAULT_RTE_CALPRM_GROUP.TqLoaVehSteerRat_Val" 0 DISPLAY_IDENTIFIER TqLoa.CalibrationPorts.TqLoaVehSteerRat.Val /end CHARACTERISTIC
/begin CHARACTERISTIC TqLoa.TqLoaVehUnderSteerGrdt.Val "MICROSAR RTE" VALUE 0x0 RTE_RL_FLOAT32_IEEE 0 NO_COMPU_METHOD -3.402823466e+38 3.402823466e+38 SYMBOL_LINK "Rte_CalprmRom_CalRegn03Cmn_DEFAULT_RTE_CALPRM_GROUP.TqLoaVehUnderSteerGrdt_Val" 0 DISPLAY_IDENTIFIER TqLoa.CalibrationPorts.TqLoaVehUnderSteerGrdt.Val /end CHARACTERISTIC
/begin CHARACTERISTIC TqLoa.TqLoaVehWhlBas.Val "MICROSAR RTE" VALUE 0x0 RTE_RL_FLOAT32_IEEE 0 NO_COMPU_METHOD -3.402823466e+38 3.402823466e+38 SYMBOL_LINK "Rte_CalprmRom_CalRegn03Cmn_DEFAULT_RTE_CALPRM_GROUP.TqLoaVehWhlBas_Val" 0 DISPLAY_IDENTIFIER TqLoa.CalibrationPorts.TqLoaVehWhlBas.Val /end CHARACTERISTIC
/begin CHARACTERISTIC TqOscn.TqOscnAmpLimY.Ary1D "MICROSAR RTE" VAL_BLK 0x0 RTE_RL_UWORD 0 NO_COMPU_METHOD 0 65535 MATRIX_DIM 11 1 1 SYMBOL_LINK "Rte_CalprmRom_CalRegn01Cmn_DEFAULT_RTE_CALPRM_GROUP.TqOscnAmpLimY_Ary1D" 0 DISPLAY_IDENTIFIER TqOscn.CalibrationPorts.TqOscnAmpLimY.Ary1D /end CHARACTERISTIC
/begin CHARACTERISTIC TqOscn.TqOscnFallRampRateCal.Val "MICROSAR RTE" VALUE 0x0 RTE_RL_FLOAT32_IEEE 0 NO_COMPU_METHOD -3.402823466e+38 3.402823466e+38 SYMBOL_LINK "Rte_CalprmRom_CalRegn01Cmn_DEFAULT_RTE_CALPRM_GROUP.TqOscnFallRampRateCal_Val" 0 DISPLAY_IDENTIFIER TqOscn.CalibrationPorts.TqOscnFallRampRateCal.Val /end CHARACTERISTIC
/begin CHARACTERISTIC TqOscn.TqOscnFrqIn.Ary1D "MICROSAR RTE" VAL_BLK 0x0 RTE_RL_UWORD 0 NO_COMPU_METHOD 0 65535 MATRIX_DIM 11 1 1 SYMBOL_LINK "Rte_CalprmRom_CalRegn01Cmn_DEFAULT_RTE_CALPRM_GROUP.TqOscnFrqIn_Ary1D" 0 DISPLAY_IDENTIFIER TqOscn.CalibrationPorts.TqOscnFrqIn.Ary1D /end CHARACTERISTIC
/begin CHARACTERISTIC TqOscn.TqOscnRisngRampRateCal.Val "MICROSAR RTE" VALUE 0x0 RTE_RL_FLOAT32_IEEE 0 NO_COMPU_METHOD -3.402823466e+38 3.402823466e+38 SYMBOL_LINK "Rte_CalprmRom_CalRegn01Cmn_DEFAULT_RTE_CALPRM_GROUP.TqOscnRisngRampRateCal_Val" 0 DISPLAY_IDENTIFIER TqOscn.CalibrationPorts.TqOscnRisngRampRateCal.Val /end CHARACTERISTIC
/begin CHARACTERISTIC TqOscn.TqOscnUseRampRateCal.Logl "MICROSAR RTE" VALUE 0x0 RTE_RL_BOOLEAN 0 RTE_CM_BOOLEAN 0 255 SYMBOL_LINK "Rte_CalprmRom_CalRegn01Cmn_DEFAULT_RTE_CALPRM_GROUP.TqOscnUseRampRateCal_Logl" 0 DISPLAY_IDENTIFIER TqOscn.CalibrationPorts.TqOscnUseRampRateCal.Logl /end CHARACTERISTIC
/begin CHARACTERISTIC TunSelnAuthy.TunSelnAuthyHwTqY.Ary1D "MICROSAR RTE" VAL_BLK 0x0 RTE_RL_UWORD 0 NO_COMPU_METHOD 0 65535 MATRIX_DIM 6 1 1 SYMBOL_LINK "Rte_CalprmRom_CalRegn01Rt00_DEFAULT_RTE_CALPRM_GROUP.TunSelnAuthyHwTqY_Ary1D" 0 DISPLAY_IDENTIFIER TunSelnAuthy.CalibrationPorts.TunSelnAuthyHwTqY.Ary1D /end CHARACTERISTIC
/begin MEASUREMENT StabyCmp.VehSpd.Val "MICROSAR RTE" FLOAT32_IEEE NO_COMPU_METHOD 0 0 -3.402823466e+38 3.402823466e+38 ECU_ADDRESS 0 SYMBOL_LINK "Rte_VehSigCdng_VehSpd_Val" 0 DISPLAY_IDENTIFIER StabyCmp.ReceiverPorts.VehSpd.Val /end MEASUREMENT
/begin MEASUREMENT StabyCmp.dStabyCmpAssiScaCmpBlnd "MICROSAR RTE" FLOAT32_IEEE NO_COMPU_METHOD 0 0 -3.402823466e+38 3.402823466e+38 ECU_ADDRESS 0 SYMBOL_LINK "Rte_StabyCmp_dStabyCmpAssiScaCmpBlnd" 0 DISPLAY_IDENTIFIER StabyCmp.PerInstanceMemories.dStabyCmpAssiScaCmpBlnd /end MEASUREMENT
/begin MEASUREMENT StabyCmp.dStabyCmpNotchFil02Blnd "MICROSAR RTE" FLOAT32_IEEE NO_COMPU_METHOD 0 0 -3.402823466e+38 3.402823466e+38 ECU_ADDRESS 0 SYMBOL_LINK "Rte_StabyCmp_dStabyCmpNotchFil02Blnd" 0 DISPLAY_IDENTIFIER StabyCmp.PerInstanceMemories.dStabyCmpNotchFil02Blnd /end MEASUREMENT
/begin MEASUREMENT StabyCmp.dStabyCmpNotchFil04Blnd "MICROSAR RTE" FLOAT32_IEEE NO_COMPU_METHOD 0 0 -3.402823466e+38 3.402823466e+38 ECU_ADDRESS 0 SYMBOL_LINK "Rte_StabyCmp_dStabyCmpNotchFil04Blnd" 0 DISPLAY_IDENTIFIER StabyCmp.PerInstanceMemories.dStabyCmpNotchFil04Blnd /end MEASUREMENT
/begin MEASUREMENT StabyCmp.dStabyCmpNotchFil12Blnd "MICROSAR RTE" FLOAT32_IEEE NO_COMPU_METHOD 0 0 -3.402823466e+38 3.402823466e+38 ECU_ADDRESS 0 SYMBOL_LINK "Rte_StabyCmp_dStabyCmpNotchFil12Blnd" 0 DISPLAY_IDENTIFIER StabyCmp.PerInstanceMemories.dStabyCmpNotchFil12Blnd /end MEASUREMENT
/begin MEASUREMENT StabyCmp.dStabyCmpNotchFil12Outp "MICROSAR RTE" FLOAT32_IEEE NO_COMPU_METHOD 0 0 -3.402823466e+38 3.402823466e+38 ECU_ADDRESS 0 SYMBOL_LINK "Rte_StabyCmp_dStabyCmpNotchFil12Outp" 0 DISPLAY_IDENTIFIER StabyCmp.PerInstanceMemories.dStabyCmpNotchFil12Outp /end MEASUREMENT
/begin MEASUREMENT StabyCmp.dStabyCmpNotchFil1Outp "MICROSAR RTE" FLOAT32_IEEE NO_COMPU_METHOD 0 0 -3.402823466e+38 3.402823466e+38 ECU_ADDRESS 0 SYMBOL_LINK "Rte_StabyCmp_dStabyCmpNotchFil1Outp" 0 DISPLAY_IDENTIFIER StabyCmp.PerInstanceMemories.dStabyCmpNotchFil1Outp /end MEASUREMENT
/begin MEASUREMENT StabyCmp.dStabyCmpNotchFil2Outp "MICROSAR RTE" FLOAT32_IEEE NO_COMPU_METHOD 0 0 -3.402823466e+38 3.402823466e+38 ECU_ADDRESS 0 SYMBOL_LINK "Rte_StabyCmp_dStabyCmpNotchFil2Outp" 0 DISPLAY_IDENTIFIER StabyCmp.PerInstanceMemories.dStabyCmpNotchFil2Outp /end MEASUREMENT
/begin MEASUREMENT StabyCmp.dStabyCmpNotchFil34Blnd "MICROSAR RTE" FLOAT32_IEEE NO_COMPU_METHOD 0 0 -3.402823466e+38 3.402823466e+38 ECU_ADDRESS 0 SYMBOL_LINK "Rte_StabyCmp_dStabyCmpNotchFil34Blnd" 0 DISPLAY_IDENTIFIER StabyCmp.PerInstanceMemories.dStabyCmpNotchFil34Blnd /end MEASUREMENT
/begin MEASUREMENT StabyCmp.dStabyCmpNotchFil34Outp "MICROSAR RTE" FLOAT32_IEEE NO_COMPU_METHOD 0 0 -3.402823466e+38 3.402823466e+38 ECU_ADDRESS 0 SYMBOL_LINK "Rte_StabyCmp_dStabyCmpNotchFil34Outp" 0 DISPLAY_IDENTIFIER StabyCmp.PerInstanceMemories.dStabyCmpNotchFil34Outp /end MEASUREMENT
/begin MEASUREMENT StabyCmp.dStabyCmpNotchFil3Outp "MICROSAR RTE" FLOAT32_IEEE NO_COMPU_METHOD 0 0 -3.402823466e+38 3.402823466e+38 ECU_ADDRESS 0 SYMBOL_LINK "Rte_StabyCmp_dStabyCmpNotchFil3Outp" 0 DISPLAY_IDENTIFIER StabyCmp.PerInstanceMemories.dStabyCmpNotchFil3Outp /end MEASUREMENT
/begin MEASUREMENT StabyCmp.dStabyCmpNotchFil4Outp "MICROSAR RTE" FLOAT32_IEEE NO_COMPU_METHOD 0 0 -3.402823466e+38 3.402823466e+38 ECU_ADDRESS 0 SYMBOL_LINK "Rte_StabyCmp_dStabyCmpNotchFil4Outp" 0 DISPLAY_IDENTIFIER StabyCmp.PerInstanceMemories.dStabyCmpNotchFil4Outp /end MEASUREMENT
/begin MEASUREMENT Swp.HwTq.Val "MICROSAR RTE" FLOAT32_IEEE NO_COMPU_METHOD 0 0 -3.402823466e+38 3.402823466e+38 ECU_ADDRESS 0 SYMBOL_LINK "Rte_SnsrOffsCorrn_HwTqCorrd_Val" 0 DISPLAY_IDENTIFIER Swp.ReceiverPorts.HwTq.Val /end MEASUREMENT
/begin MEASUREMENT Swp.HwTqSwp.Val "MICROSAR RTE" FLOAT32_IEEE NO_COMPU_METHOD 0 0 -3.402823466e+38 3.402823466e+38 ECU_ADDRESS 0 SYMBOL_LINK "Rte_Swp_HwTqSwp_Val" 0 DISPLAY_IDENTIFIER Swp.SenderPorts.HwTqSwp.Val /end MEASUREMENT
/begin MEASUREMENT Swp.MotTqCmd.Val "MICROSAR RTE" FLOAT32_IEEE NO_COMPU_METHOD 0 0 -3.402823466e+38 3.402823466e+38 ECU_ADDRESS 0 SYMBOL_LINK "Rte_AssiSumLim_MotTqCmd_Val" 0 DISPLAY_IDENTIFIER Swp.ReceiverPorts.MotTqCmd.Val /end MEASUREMENT
/begin MEASUREMENT Swp.MotTqCmdSwp.Val "MICROSAR RTE" FLOAT32_IEEE NO_COMPU_METHOD 0 0 -3.402823466e+38 3.402823466e+38 ECU_ADDRESS 0 SYMBOL_LINK "Rte_Swp_MotTqCmdSwp_Val" 0 DISPLAY_IDENTIFIER Swp.SenderPorts.MotTqCmdSwp.Val /end MEASUREMENT
/begin MEASUREMENT Swp.VehSpd.Val "MICROSAR RTE" FLOAT32_IEEE NO_COMPU_METHOD 0 0 -3.402823466e+38 3.402823466e+38 ECU_ADDRESS 0 SYMBOL_LINK "Rte_VehSigCdng_VehSpd_Val" 0 DISPLAY_IDENTIFIER Swp.ReceiverPorts.VehSpd.Val /end MEASUREMENT
/begin MEASUREMENT Swp.VehSpdVld.Logl "MICROSAR RTE" UBYTE RTE_CM_BOOLEAN 0 0 0 255 ECU_ADDRESS 0 SYMBOL_LINK "Rte_VehSigCdng_VehSpdVld_Logl" 0 DISPLAY_IDENTIFIER Swp.ReceiverPorts.VehSpdVld.Logl /end MEASUREMENT
/begin MEASUREMENT SysFricLrng.AssiMechT.Val "MICROSAR RTE" FLOAT32_IEEE NO_COMPU_METHOD 0 0 -3.402823466e+38 3.402823466e+38 ECU_ADDRESS 0 SYMBOL_LINK "Rte_TEstimn_AssiMechT_Val" 0 DISPLAY_IDENTIFIER SysFricLrng.ReceiverPorts.AssiMechT.Val /end MEASUREMENT
/begin MEASUREMENT SysFricLrng.AssiMechTLpFil.FilGain "MICROSAR RTE" FLOAT32_IEEE NO_COMPU_METHOD 0 0 -3.402823466e+38 3.402823466e+38 ECU_ADDRESS 0 SYMBOL_LINK "Rte_SysFricLrng_AssiMechTLpFil.FilGain" 0 DISPLAY_IDENTIFIER SysFricLrng.PerInstanceMemories.AssiMechTLpFil.FilGain /end MEASUREMENT
/begin MEASUREMENT SysFricLrng.AssiMechTLpFil.FilSt "MICROSAR RTE" FLOAT32_IEEE NO_COMPU_METHOD 0 0 -3.402823466e+38 3.402823466e+38 ECU_ADDRESS 0 SYMBOL_LINK "Rte_SysFricLrng_AssiMechTLpFil.FilSt" 0 DISPLAY_IDENTIFIER SysFricLrng.PerInstanceMemories.AssiMechTLpFil.FilSt /end MEASUREMENT
/begin MEASUREMENT SysFricLrng.AvrgFricLpFil1.FilGain "MICROSAR RTE" FLOAT32_IEEE NO_COMPU_METHOD 0 0 -3.402823466e+38 3.402823466e+38 ECU_ADDRESS 0 SYMBOL_LINK "Rte_SysFricLrng_AvrgFricLpFil1.FilGain" 0 DISPLAY_IDENTIFIER SysFricLrng.PerInstanceMemories.AvrgFricLpFil1.FilGain /end MEASUREMENT
/begin MEASUREMENT SysFricLrng.AvrgFricLpFil1.FilSt "MICROSAR RTE" FLOAT32_IEEE NO_COMPU_METHOD 0 0 -3.402823466e+38 3.402823466e+38 ECU_ADDRESS 0 SYMBOL_LINK "Rte_SysFricLrng_AvrgFricLpFil1.FilSt" 0 DISPLAY_IDENTIFIER SysFricLrng.PerInstanceMemories.AvrgFricLpFil1.FilSt /end MEASUREMENT
/begin MEASUREMENT SysFricLrng.AvrgFricLpFil2.FilGain "MICROSAR RTE" FLOAT32_IEEE NO_COMPU_METHOD 0 0 -3.402823466e+38 3.402823466e+38 ECU_ADDRESS 0 SYMBOL_LINK "Rte_SysFricLrng_AvrgFricLpFil2.FilGain" 0 DISPLAY_IDENTIFIER SysFricLrng.PerInstanceMemories.AvrgFricLpFil2.FilGain /end MEASUREMENT
/begin MEASUREMENT SysFricLrng.AvrgFricLpFil2.FilSt "MICROSAR RTE" FLOAT32_IEEE NO_COMPU_METHOD 0 0 -3.402823466e+38 3.402823466e+38 ECU_ADDRESS 0 SYMBOL_LINK "Rte_SysFricLrng_AvrgFricLpFil2.FilSt" 0 DISPLAY_IDENTIFIER SysFricLrng.PerInstanceMemories.AvrgFricLpFil2.FilSt /end MEASUREMENT
/begin MEASUREMENT SysFricLrng.AvrgFricLpFil3.FilGain "MICROSAR RTE" FLOAT32_IEEE NO_COMPU_METHOD 0 0 -3.402823466e+38 3.402823466e+38 ECU_ADDRESS 0 SYMBOL_LINK "Rte_SysFricLrng_AvrgFricLpFil3.FilGain" 0 DISPLAY_IDENTIFIER SysFricLrng.PerInstanceMemories.AvrgFricLpFil3.FilGain /end MEASUREMENT
/begin MEASUREMENT SysFricLrng.AvrgFricLpFil3.FilSt "MICROSAR RTE" FLOAT32_IEEE NO_COMPU_METHOD 0 0 -3.402823466e+38 3.402823466e+38 ECU_ADDRESS 0 SYMBOL_LINK "Rte_SysFricLrng_AvrgFricLpFil3.FilSt" 0 DISPLAY_IDENTIFIER SysFricLrng.PerInstanceMemories.AvrgFricLpFil3.FilSt /end MEASUREMENT
/begin MEASUREMENT SysFricLrng.AvrgFricLpFil4.FilGain "MICROSAR RTE" FLOAT32_IEEE NO_COMPU_METHOD 0 0 -3.402823466e+38 3.402823466e+38 ECU_ADDRESS 0 SYMBOL_LINK "Rte_SysFricLrng_AvrgFricLpFil4.FilGain" 0 DISPLAY_IDENTIFIER SysFricLrng.PerInstanceMemories.AvrgFricLpFil4.FilGain /end MEASUREMENT
/begin MEASUREMENT SysFricLrng.AvrgFricLpFil4.FilSt "MICROSAR RTE" FLOAT32_IEEE NO_COMPU_METHOD 0 0 -3.402823466e+38 3.402823466e+38 ECU_ADDRESS 0 SYMBOL_LINK "Rte_SysFricLrng_AvrgFricLpFil4.FilSt" 0 DISPLAY_IDENTIFIER SysFricLrng.PerInstanceMemories.AvrgFricLpFil4.FilSt /end MEASUREMENT
/begin MEASUREMENT SysFricLrng.ColTqAry "MICROSAR RTE" FLOAT32_IEEE NO_COMPU_METHOD 0 0 -3.402823466e+38 3.402823466e+38 MATRIX_DIM 12 1 1 ECU_ADDRESS 0 SYMBOL_LINK "Rte_SysFricLrng_ColTqAry" 0 DISPLAY_IDENTIFIER SysFricLrng.PerInstanceMemories.ColTqAry /end MEASUREMENT
/begin MEASUREMENT SysFricLrng.ColTqLpFil.FilGain "MICROSAR RTE" FLOAT32_IEEE NO_COMPU_METHOD 0 0 -3.402823466e+38 3.402823466e+38 ECU_ADDRESS 0 SYMBOL_LINK "Rte_SysFricLrng_ColTqLpFil.FilGain" 0 DISPLAY_IDENTIFIER SysFricLrng.PerInstanceMemories.ColTqLpFil.FilGain /end MEASUREMENT
/begin MEASUREMENT SysFricLrng.ColTqLpFil.FilSt "MICROSAR RTE" FLOAT32_IEEE NO_COMPU_METHOD 0 0 -3.402823466e+38 3.402823466e+38 ECU_ADDRESS 0 SYMBOL_LINK "Rte_SysFricLrng_ColTqLpFil.FilSt" 0 DISPLAY_IDENTIFIER SysFricLrng.PerInstanceMemories.ColTqLpFil.FilSt /end MEASUREMENT
/begin MEASUREMENT SysFricLrng.EstimdFric "MICROSAR RTE" FLOAT32_IEEE NO_COMPU_METHOD 0 0 -3.402823466e+38 3.402823466e+38 ECU_ADDRESS 0 SYMBOL_LINK "Rte_SysFricLrng_EstimdFric" 0 DISPLAY_IDENTIFIER SysFricLrng.PerInstanceMemories.EstimdFric /end MEASUREMENT
/begin MEASUREMENT SysFricLrng.FilAvrgFric "MICROSAR RTE" FLOAT32_IEEE NO_COMPU_METHOD 0 0 -3.402823466e+38 3.402823466e+38 MATRIX_DIM 4 1 1 ECU_ADDRESS 0 SYMBOL_LINK "Rte_SysFricLrng_FilAvrgFric" 0 DISPLAY_IDENTIFIER SysFricLrng.PerInstanceMemories.FilAvrgFric /end MEASUREMENT
/begin MEASUREMENT SysFricLrng.FricChgLpFil.FilGain "MICROSAR RTE" FLOAT32_IEEE NO_COMPU_METHOD 0 0 -3.402823466e+38 3.402823466e+38 ECU_ADDRESS 0 SYMBOL_LINK "Rte_SysFricLrng_FricChgLpFil.FilGain" 0 DISPLAY_IDENTIFIER SysFricLrng.PerInstanceMemories.FricChgLpFil.FilGain /end MEASUREMENT
/begin MEASUREMENT SysFricLrng.FricChgLpFil.FilSt "MICROSAR RTE" FLOAT32_IEEE NO_COMPU_METHOD 0 0 -3.402823466e+38 3.402823466e+38 ECU_ADDRESS 0 SYMBOL_LINK "Rte_SysFricLrng_FricChgLpFil.FilSt" 0 DISPLAY_IDENTIFIER SysFricLrng.PerInstanceMemories.FricChgLpFil.FilSt /end MEASUREMENT
/begin MEASUREMENT SysFricLrng.FricLrngCustEna.Logl "MICROSAR RTE" UBYTE RTE_CM_BOOLEAN 0 0 0 255 ECU_ADDRESS 0 SYMBOL_LINK "Rte_SysFricLrng_FricLrngCustEna_Logl" 0 DISPLAY_IDENTIFIER SysFricLrng.ReceiverPorts.FricLrngCustEna.Logl /end MEASUREMENT
/begin MEASUREMENT SysFricLrng.FricLrngData.BasLineFric "MICROSAR RTE" FLOAT32_IEEE NO_COMPU_METHOD 0 0 -3.402823466e+38 3.402823466e+38 MATRIX_DIM 4 1 1 ECU_ADDRESS 0 SYMBOL_LINK "Rte_SysFricLrng_FricLrngData.BasLineFric" 0 DISPLAY_IDENTIFIER SysFricLrng.PerInstanceMemories.FricLrngData.BasLineFric /end MEASUREMENT
/begin MEASUREMENT SysFricLrng.FricLrngData.FricOffs "MICROSAR RTE" FLOAT32_IEEE NO_COMPU_METHOD 0 0 -3.402823466e+38 3.402823466e+38 ECU_ADDRESS 0 SYMBOL_LINK "Rte_SysFricLrng_FricLrngData.FricOffs" 0 DISPLAY_IDENTIFIER SysFricLrng.PerInstanceMemories.FricLrngData.FricOffs /end MEASUREMENT
/begin MEASUREMENT SysFricLrng.FricLrngData.Hys "MICROSAR RTE" FLOAT32_IEEE NO_COMPU_METHOD 0 0 -3.402823466e+38 3.402823466e+38 MATRIX_DIM 4 8 1 ECU_ADDRESS 0 SYMBOL_LINK "Rte_SysFricLrng_FricLrngData.Hys" 0 DISPLAY_IDENTIFIER SysFricLrng.PerInstanceMemories.FricLrngData.Hys /end MEASUREMENT
/begin MEASUREMENT SysFricLrng.FricLrngData.RngCntr "MICROSAR RTE" UWORD NO_COMPU_METHOD 0 0 0 65535 MATRIX_DIM 3 8 1 ECU_ADDRESS 0 SYMBOL_LINK "Rte_SysFricLrng_FricLrngData.RngCntr" 0 DISPLAY_IDENTIFIER SysFricLrng.PerInstanceMemories.FricLrngData.RngCntr /end MEASUREMENT
/begin MEASUREMENT SysFricLrng.FricLrngData.SysFricLrngOperMod "MICROSAR RTE" UBYTE RTE_CM_ENUM_SysFricLrngOperMod1 0 0 0 255 ECU_ADDRESS 0 SYMBOL_LINK "Rte_SysFricLrng_FricLrngData.SysFricLrngOperMod" 0 DISPLAY_IDENTIFIER SysFricLrng.PerInstanceMemories.FricLrngData.SysFricLrngOperMod /end MEASUREMENT
/begin MEASUREMENT SysFricLrng.FricLrngData.VehLrndFric "MICROSAR RTE" FLOAT32_IEEE NO_COMPU_METHOD 0 0 -3.402823466e+38 3.402823466e+38 MATRIX_DIM 4 1 1 ECU_ADDRESS 0 SYMBOL_LINK "Rte_SysFricLrng_FricLrngData.VehLrndFric" 0 DISPLAY_IDENTIFIER SysFricLrng.PerInstanceMemories.FricLrngData.VehLrndFric /end MEASUREMENT
/begin MEASUREMENT SysFricLrng.FricLrngDi.Logl "MICROSAR RTE" UBYTE RTE_CM_BOOLEAN 0 0 0 255 ECU_ADDRESS 0 SYMBOL_LINK "Rte_CmnMfgSrv_FricLrngDi_Logl" 0 DISPLAY_IDENTIFIER SysFricLrng.ReceiverPorts.FricLrngDi.Logl /end MEASUREMENT
/begin MEASUREMENT SysFricLrng.FricLrngOperModPrev "MICROSAR RTE" UBYTE RTE_CM_ENUM_SysFricLrngOperMod1 0 0 0 255 ECU_ADDRESS 0 SYMBOL_LINK "Rte_SysFricLrng_FricLrngOperModPrev" 0 DISPLAY_IDENTIFIER SysFricLrng.PerInstanceMemories.FricLrngOperModPrev /end MEASUREMENT
/begin MEASUREMENT SysFricLrng.FricLrngRunOneTi "MICROSAR RTE" UBYTE RTE_CM_BOOLEAN 0 0 0 255 ECU_ADDRESS 0 SYMBOL_LINK "Rte_SysFricLrng_FricLrngRunOneTi" 0 DISPLAY_IDENTIFIER SysFricLrng.PerInstanceMemories.FricLrngRunOneTi /end MEASUREMENT
/begin MEASUREMENT SysFricLrng.FricNonLrngData.EnaFricLrng "MICROSAR RTE" UBYTE RTE_CM_BOOLEAN 0 0 0 255 ECU_ADDRESS 0 SYMBOL_LINK "Rte_SysFricLrng_FricNonLrngData.EnaFricLrng" 0 DISPLAY_IDENTIFIER SysFricLrng.PerInstanceMemories.FricNonLrngData.EnaFricLrng /end MEASUREMENT
/begin MEASUREMENT SysFricLrng.FricNonLrngData.EnaFricOffsOutp "MICROSAR RTE" UBYTE RTE_CM_BOOLEAN 0 0 0 255 ECU_ADDRESS 0 SYMBOL_LINK "Rte_SysFricLrng_FricNonLrngData.EnaFricOffsOutp" 0 DISPLAY_IDENTIFIER SysFricLrng.PerInstanceMemories.FricNonLrngData.EnaFricOffsOutp /end MEASUREMENT
/begin MEASUREMENT SysFricLrng.FricNonLrngData.EolFric "MICROSAR RTE" FLOAT32_IEEE NO_COMPU_METHOD 0 0 -3.402823466e+38 3.402823466e+38 ECU_ADDRESS 0 SYMBOL_LINK "Rte_SysFricLrng_FricNonLrngData.EolFric" 0 DISPLAY_IDENTIFIER SysFricLrng.PerInstanceMemories.FricNonLrngData.EolFric /end MEASUREMENT
/begin MEASUREMENT SysFricLrng.FricOffs "MICROSAR RTE" FLOAT32_IEEE NO_COMPU_METHOD 0 0 -3.402823466e+38 3.402823466e+38 ECU_ADDRESS 0 SYMBOL_LINK "Rte_SysFricLrng_FricOffs" 0 DISPLAY_IDENTIFIER SysFricLrng.PerInstanceMemories.FricOffs /end MEASUREMENT
/begin MEASUREMENT SysFricLrng.FricOffsOutpDi "MICROSAR RTE" UBYTE RTE_CM_BOOLEAN 0 0 0 255 ECU_ADDRESS 0 SYMBOL_LINK "Rte_SysFricLrng_FricOffsOutpDi" 0 DISPLAY_IDENTIFIER SysFricLrng.PerInstanceMemories.FricOffsOutpDi /end MEASUREMENT
/begin MEASUREMENT SysFricLrng.HwAg.Val "MICROSAR RTE" FLOAT32_IEEE NO_COMPU_METHOD 0 0 -3.402823466e+38 3.402823466e+38 ECU_ADDRESS 0 SYMBOL_LINK "Rte_HwAgSysArbn_PinionAg_Val" 0 DISPLAY_IDENTIFIER SysFricLrng.ReceiverPorts.HwAg.Val /end MEASUREMENT
/begin MEASUREMENT SysFricLrng.HwAgAuthy.Val "MICROSAR RTE" FLOAT32_IEEE NO_COMPU_METHOD 0 0 -3.402823466e+38 3.402823466e+38 ECU_ADDRESS 0 SYMBOL_LINK "Rte_HwAgSysArbn_PinionAgConf_Val" 0 DISPLAY_IDENTIFIER SysFricLrng.ReceiverPorts.HwAgAuthy.Val /end MEASUREMENT
/begin MEASUREMENT SysFricLrng.HwAgAuthyLpFil.FilGain "MICROSAR RTE" FLOAT32_IEEE NO_COMPU_METHOD 0 0 -3.402823466e+38 3.402823466e+38 ECU_ADDRESS 0 SYMBOL_LINK "Rte_SysFricLrng_HwAgAuthyLpFil.FilGain" 0 DISPLAY_IDENTIFIER SysFricLrng.PerInstanceMemories.HwAgAuthyLpFil.FilGain /end MEASUREMENT
/begin MEASUREMENT SysFricLrng.HwAgAuthyLpFil.FilSt "MICROSAR RTE" FLOAT32_IEEE NO_COMPU_METHOD 0 0 -3.402823466e+38 3.402823466e+38 ECU_ADDRESS 0 SYMBOL_LINK "Rte_SysFricLrng_HwAgAuthyLpFil.FilSt" 0 DISPLAY_IDENTIFIER SysFricLrng.PerInstanceMemories.HwAgAuthyLpFil.FilSt /end MEASUREMENT
/begin MEASUREMENT SysFricLrng.HwAgBuf "MICROSAR RTE" FLOAT32_IEEE NO_COMPU_METHOD 0 0 -3.402823466e+38 3.402823466e+38 MATRIX_DIM 12 1 1 ECU_ADDRESS 0 SYMBOL_LINK "Rte_SysFricLrng_HwAgBuf" 0 DISPLAY_IDENTIFIER SysFricLrng.PerInstanceMemories.HwAgBuf /end MEASUREMENT
/begin MEASUREMENT SysFricLrng.HwAgLpFil.FilGain "MICROSAR RTE" FLOAT32_IEEE NO_COMPU_METHOD 0 0 -3.402823466e+38 3.402823466e+38 ECU_ADDRESS 0 SYMBOL_LINK "Rte_SysFricLrng_HwAgLpFil.FilGain" 0 DISPLAY_IDENTIFIER SysFricLrng.PerInstanceMemories.HwAgLpFil.FilGain /end MEASUREMENT
/begin MEASUREMENT SysFricLrng.HwAgLpFil.FilSt "MICROSAR RTE" FLOAT32_IEEE NO_COMPU_METHOD 0 0 -3.402823466e+38 3.402823466e+38 ECU_ADDRESS 0 SYMBOL_LINK "Rte_SysFricLrng_HwAgLpFil.FilSt" 0 DISPLAY_IDENTIFIER SysFricLrng.PerInstanceMemories.HwAgLpFil.FilSt /end MEASUREMENT
/begin MEASUREMENT SysFricLrng.HwTq.Val "MICROSAR RTE" FLOAT32_IEEE NO_COMPU_METHOD 0 0 -3.402823466e+38 3.402823466e+38 ECU_ADDRESS 0 SYMBOL_LINK "Rte_Swp_HwTqSwp_Val" 0 DISPLAY_IDENTIFIER SysFricLrng.ReceiverPorts.HwTq.Val /end MEASUREMENT
/begin MEASUREMENT SysFricLrng.HwVel.Val "MICROSAR RTE" FLOAT32_IEEE NO_COMPU_METHOD 0 0 -3.402823466e+38 3.402823466e+38 ECU_ADDRESS 0 SYMBOL_LINK "Rte_HwAgSysArbn_HwVel_Val" 0 DISPLAY_IDENTIFIER SysFricLrng.ReceiverPorts.HwVel.Val /end MEASUREMENT
/begin MEASUREMENT SysFricLrng.HwVelBuf "MICROSAR RTE" FLOAT32_IEEE NO_COMPU_METHOD 0 0 -3.402823466e+38 3.402823466e+38 MATRIX_DIM 12 1 1 ECU_ADDRESS 0 SYMBOL_LINK "Rte_SysFricLrng_HwVelBuf" 0 DISPLAY_IDENTIFIER SysFricLrng.PerInstanceMemories.HwVelBuf /end MEASUREMENT
/begin MEASUREMENT SysFricLrng.HwVelLpFil.FilGain "MICROSAR RTE" FLOAT32_IEEE NO_COMPU_METHOD 0 0 -3.402823466e+38 3.402823466e+38 ECU_ADDRESS 0 SYMBOL_LINK "Rte_SysFricLrng_HwVelLpFil.FilGain" 0 DISPLAY_IDENTIFIER SysFricLrng.PerInstanceMemories.HwVelLpFil.FilGain /end MEASUREMENT
/begin MEASUREMENT SysFricLrng.HwVelLpFil.FilSt "MICROSAR RTE" FLOAT32_IEEE NO_COMPU_METHOD 0 0 -3.402823466e+38 3.402823466e+38 ECU_ADDRESS 0 SYMBOL_LINK "Rte_SysFricLrng_HwVelLpFil.FilSt" 0 DISPLAY_IDENTIFIER SysFricLrng.PerInstanceMemories.HwVelLpFil.FilSt /end MEASUREMENT
/begin MEASUREMENT SysFricLrng.LatALpFil.FilGain "MICROSAR RTE" FLOAT32_IEEE NO_COMPU_METHOD 0 0 -3.402823466e+38 3.402823466e+38 ECU_ADDRESS 0 SYMBOL_LINK "Rte_SysFricLrng_LatALpFil.FilGain" 0 DISPLAY_IDENTIFIER SysFricLrng.PerInstanceMemories.LatALpFil.FilGain /end MEASUREMENT
/begin MEASUREMENT SysFricLrng.LatALpFil.FilSt "MICROSAR RTE" FLOAT32_IEEE NO_COMPU_METHOD 0 0 -3.402823466e+38 3.402823466e+38 ECU_ADDRESS 0 SYMBOL_LINK "Rte_SysFricLrng_LatALpFil.FilSt" 0 DISPLAY_IDENTIFIER SysFricLrng.PerInstanceMemories.LatALpFil.FilSt /end MEASUREMENT
/begin MEASUREMENT SysFricLrng.MaxLrndFric.Val "MICROSAR RTE" FLOAT32_IEEE NO_COMPU_METHOD 0 0 -3.402823466e+38 3.402823466e+38 ECU_ADDRESS 0 SYMBOL_LINK "Rte_SysFricLrng_MaxLrndFric_Val" 0 DISPLAY_IDENTIFIER SysFricLrng.SenderPorts.MaxLrndFric.Val /end MEASUREMENT
/begin MEASUREMENT SysFricLrng.MotTqCmdCrf.Val "MICROSAR RTE" FLOAT32_IEEE NO_COMPU_METHOD 0 0 -3.402823466e+38 3.402823466e+38 ECU_ADDRESS 0 SYMBOL_LINK "Rte_MotTqTranlDampg_MotTqCmdCrfDampd_Val" 0 DISPLAY_IDENTIFIER SysFricLrng.ReceiverPorts.MotTqCmdCrf.Val /end MEASUREMENT
/begin MEASUREMENT SysFricLrng.PrevFricOffs "MICROSAR RTE" FLOAT32_IEEE NO_COMPU_METHOD 0 0 -3.402823466e+38 3.402823466e+38 ECU_ADDRESS 0 SYMBOL_LINK "Rte_SysFricLrng_PrevFricOffs" 0 DISPLAY_IDENTIFIER SysFricLrng.PerInstanceMemories.PrevFricOffs /end MEASUREMENT
/begin MEASUREMENT SysFricLrng.PrevMaxRawAvrgFric "MICROSAR RTE" FLOAT32_IEEE NO_COMPU_METHOD 0 0 -3.402823466e+38 3.402823466e+38 ECU_ADDRESS 0 SYMBOL_LINK "Rte_SysFricLrng_PrevMaxRawAvrgFric" 0 DISPLAY_IDENTIFIER SysFricLrng.PerInstanceMemories.PrevMaxRawAvrgFric /end MEASUREMENT
/begin MEASUREMENT SysFricLrng.RawAvrgFric "MICROSAR RTE" FLOAT32_IEEE NO_COMPU_METHOD 0 0 -3.402823466e+38 3.402823466e+38 MATRIX_DIM 4 1 1 ECU_ADDRESS 0 SYMBOL_LINK "Rte_SysFricLrng_RawAvrgFric" 0 DISPLAY_IDENTIFIER SysFricLrng.PerInstanceMemories.RawAvrgFric /end MEASUREMENT
/begin MEASUREMENT SysFricLrng.RefTmrLrngConstr "MICROSAR RTE" ULONG NO_COMPU_METHOD 0 0 0 4294967295 ECU_ADDRESS 0 SYMBOL_LINK "Rte_SysFricLrng_RefTmrLrngConstr" 0 DISPLAY_IDENTIFIER SysFricLrng.PerInstanceMemories.RefTmrLrngConstr /end MEASUREMENT
/begin MEASUREMENT SysFricLrng.RefTmrNtc "MICROSAR RTE" ULONG NO_COMPU_METHOD 0 0 0 4294967295 ECU_ADDRESS 0 SYMBOL_LINK "Rte_SysFricLrng_RefTmrNtc" 0 DISPLAY_IDENTIFIER SysFricLrng.PerInstanceMemories.RefTmrNtc /end MEASUREMENT
/begin MEASUREMENT SysFricLrng.SatnAvrgFric "MICROSAR RTE" FLOAT32_IEEE NO_COMPU_METHOD 0 0 -3.402823466e+38 3.402823466e+38 MATRIX_DIM 4 1 1 ECU_ADDRESS 0 SYMBOL_LINK "Rte_SysFricLrng_SatnAvrgFric" 0 DISPLAY_IDENTIFIER SysFricLrng.PerInstanceMemories.SatnAvrgFric /end MEASUREMENT
/begin MEASUREMENT SysFricLrng.SatnEstimdFric "MICROSAR RTE" FLOAT32_IEEE NO_COMPU_METHOD 0 0 -3.402823466e+38 3.402823466e+38 ECU_ADDRESS 0 SYMBOL_LINK "Rte_SysFricLrng_SatnEstimdFric" 0 DISPLAY_IDENTIFIER SysFricLrng.PerInstanceMemories.SatnEstimdFric /end MEASUREMENT
/begin MEASUREMENT SysFricLrng.SysFricEstimd.Val "MICROSAR RTE" FLOAT32_IEEE NO_COMPU_METHOD 0 0 -3.402823466e+38 3.402823466e+38 ECU_ADDRESS 0 SYMBOL_LINK "Rte_SysFricLrng_SysFricEstimd_Val" 0 DISPLAY_IDENTIFIER SysFricLrng.SenderPorts.SysFricEstimd.Val /end MEASUREMENT
/begin MEASUREMENT SysFricLrng.SysFricOffs.Val "MICROSAR RTE" FLOAT32_IEEE NO_COMPU_METHOD 0 0 -3.402823466e+38 3.402823466e+38 ECU_ADDRESS 0 SYMBOL_LINK "Rte_SysFricLrng_SysFricOffs_Val" 0 DISPLAY_IDENTIFIER SysFricLrng.SenderPorts.SysFricOffs.Val /end MEASUREMENT
/begin MEASUREMENT SysFricLrng.SysSatnFricEstimd.Val "MICROSAR RTE" FLOAT32_IEEE NO_COMPU_METHOD 0 0 -3.402823466e+38 3.402823466e+38 ECU_ADDRESS 0 SYMBOL_LINK "Rte_SysFricLrng_SysSatnFricEstimd_Val" 0 DISPLAY_IDENTIFIER SysFricLrng.SenderPorts.SysSatnFricEstimd.Val /end MEASUREMENT
/begin MEASUREMENT SysFricLrng.VehBasLineFric "MICROSAR RTE" FLOAT32_IEEE NO_COMPU_METHOD 0 0 -3.402823466e+38 3.402823466e+38 MATRIX_DIM 4 1 1 ECU_ADDRESS 0 SYMBOL_LINK "Rte_SysFricLrng_VehBasLineFric" 0 DISPLAY_IDENTIFIER SysFricLrng.PerInstanceMemories.VehBasLineFric /end MEASUREMENT
/begin MEASUREMENT SysFricLrng.VehLatA.Val "MICROSAR RTE" FLOAT32_IEEE NO_COMPU_METHOD 0 0 -3.402823466e+38 3.402823466e+38 ECU_ADDRESS 0 SYMBOL_LINK "Rte_VehSigCdng_VehLatAEstimd_Val" 0 DISPLAY_IDENTIFIER SysFricLrng.ReceiverPorts.VehLatA.Val /end MEASUREMENT
/begin MEASUREMENT SysFricLrng.VehSpd.Val "MICROSAR RTE" FLOAT32_IEEE NO_COMPU_METHOD 0 0 -3.402823466e+38 3.402823466e+38 ECU_ADDRESS 0 SYMBOL_LINK "Rte_VehSigCdng_VehSpd_Val" 0 DISPLAY_IDENTIFIER SysFricLrng.ReceiverPorts.VehSpd.Val /end MEASUREMENT
/begin MEASUREMENT SysFricLrng.VehSpdLpFil.FilGain "MICROSAR RTE" FLOAT32_IEEE NO_COMPU_METHOD 0 0 -3.402823466e+38 3.402823466e+38 ECU_ADDRESS 0 SYMBOL_LINK "Rte_SysFricLrng_VehSpdLpFil.FilGain" 0 DISPLAY_IDENTIFIER SysFricLrng.PerInstanceMemories.VehSpdLpFil.FilGain /end MEASUREMENT
/begin MEASUREMENT SysFricLrng.VehSpdLpFil.FilSt "MICROSAR RTE" FLOAT32_IEEE NO_COMPU_METHOD 0 0 -3.402823466e+38 3.402823466e+38 ECU_ADDRESS 0 SYMBOL_LINK "Rte_SysFricLrng_VehSpdLpFil.FilSt" 0 DISPLAY_IDENTIFIER SysFricLrng.PerInstanceMemories.VehSpdLpFil.FilSt /end MEASUREMENT
/begin MEASUREMENT SysFricLrng.VehSpdVld.Logl "MICROSAR RTE" UBYTE RTE_CM_BOOLEAN 0 0 0 255 ECU_ADDRESS 0 SYMBOL_LINK "Rte_VehSigCdng_VehSpdVld_Logl" 0 DISPLAY_IDENTIFIER SysFricLrng.ReceiverPorts.VehSpdVld.Logl /end MEASUREMENT
/begin MEASUREMENT SysStMod.PwrSplyEnaReq.Logl "MICROSAR RTE" UBYTE RTE_CM_BOOLEAN 0 0 0 255 ECU_ADDRESS 0 SYMBOL_LINK "Rte_GmVehPwrMod_PwrSplyEnaReq_Logl" 0 DISPLAY_IDENTIFIER SysStMod.ReceiverPorts.PwrSplyEnaReq.Logl /end MEASUREMENT
/begin MEASUREMENT SysStMod.StrtUpSt.Val "MICROSAR RTE" UBYTE NO_COMPU_METHOD 0 0 0 255 ECU_ADDRESS 0 SYMBOL_LINK "Rte_PwrUpSeq_StrtUpSt_Val" 0 DISPLAY_IDENTIFIER SysStMod.ReceiverPorts.StrtUpSt.Val /end MEASUREMENT
/begin MEASUREMENT SysStMod.SysSt.Val "MICROSAR RTE" UBYTE RTE_CM_ENUM_SysSt1 0 0 0 255 ECU_ADDRESS 0 SYMBOL_LINK "Rte_SysStMod_SysSt_Val" 0 DISPLAY_IDENTIFIER SysStMod.SenderPorts.SysSt.Val /end MEASUREMENT
/begin MEASUREMENT SysStMod.SysStFltOutpReqDi.Logl "MICROSAR RTE" UBYTE RTE_CM_BOOLEAN 0 0 0 255 ECU_ADDRESS 0 SYMBOL_LINK "Rte_DiagcMgr_SysStFltOutpReqDi_Logl" 0 DISPLAY_IDENTIFIER SysStMod.ReceiverPorts.SysStFltOutpReqDi.Logl /end MEASUREMENT
/begin MEASUREMENT SysStMod.SysStImdtTranReqOff.Logl "MICROSAR RTE" UBYTE RTE_CM_BOOLEAN 0 0 0 255 ECU_ADDRESS 0 SYMBOL_LINK "Rte_CmnMfgSrv_SysStImdtTranReqOff_Logl" 0 DISPLAY_IDENTIFIER SysStMod.ReceiverPorts.SysStImdtTranReqOff.Logl /end MEASUREMENT
/begin MEASUREMENT SysStMod.SysStModPrevSysSt "MICROSAR RTE" UBYTE RTE_CM_ENUM_SysSt1 0 0 0 255 ECU_ADDRESS 0 SYMBOL_LINK "Rte_SysStMod_SysStModPrevSysSt" 0 DISPLAY_IDENTIFIER SysStMod.PerInstanceMemories.SysStModPrevSysSt /end MEASUREMENT
/begin MEASUREMENT SysStMod.SysStReqDi.Logl "MICROSAR RTE" UBYTE RTE_CM_BOOLEAN 0 0 0 255 ECU_ADDRESS 0 SYMBOL_LINK "Rte_StOutpCtrl_SysStReqDi_Logl" 0 DISPLAY_IDENTIFIER SysStMod.ReceiverPorts.SysStReqDi.Logl /end MEASUREMENT
/begin MEASUREMENT SysStMod.SysStReqEna.Logl "MICROSAR RTE" UBYTE RTE_CM_BOOLEAN 0 0 0 255 ECU_ADDRESS 0 SYMBOL_LINK "Rte_GmVehPwrMod_SysStReqEna_Logl" 0 DISPLAY_IDENTIFIER SysStMod.ReceiverPorts.SysStReqEna.Logl /end MEASUREMENT
/begin MEASUREMENT SysStMod.SysStWrmIninCmpl.Logl "MICROSAR RTE" UBYTE RTE_CM_BOOLEAN 0 0 0 255 ECU_ADDRESS 0 SYMBOL_LINK "Rte_PwrUpSeq_SysStWrmIninCmpl_Logl" 0 DISPLAY_IDENTIFIER SysStMod.ReceiverPorts.SysStWrmIninCmpl.Logl /end MEASUREMENT
/begin MEASUREMENT SysStMod.dSysStModTranVect "MICROSAR RTE" UWORD NO_COMPU_METHOD 0 0 0.0 31.0 ECU_ADDRESS 0 SYMBOL_LINK "Rte_SysStMod_dSysStModTranVect" 0 DISPLAY_IDENTIFIER SysStMod.PerInstanceMemories.dSysStModTranVect /end MEASUREMENT
/begin MEASUREMENT TEstimn.AmbT.Val "MICROSAR RTE" FLOAT32_IEEE NO_COMPU_METHOD 0 0 -3.402823466e+38 3.402823466e+38 ECU_ADDRESS 0 SYMBOL_LINK "Rte_GmMsg3F1BusHiSpd_AmbT_Val" 0 DISPLAY_IDENTIFIER TEstimn.ReceiverPorts.AmbT.Val /end MEASUREMENT
/begin MEASUREMENT TEstimn.AmbTVld.Logl "MICROSAR RTE" UBYTE RTE_CM_BOOLEAN 0 0 0 255 ECU_ADDRESS 0 SYMBOL_LINK "Rte_TEstimn_AmbTVld_Logl" 0 DISPLAY_IDENTIFIER TEstimn.ReceiverPorts.AmbTVld.Logl /end MEASUREMENT
/begin MEASUREMENT TEstimn.AmbTVldPrev "MICROSAR RTE" UBYTE RTE_CM_BOOLEAN 0 0 0 255 ECU_ADDRESS 0 SYMBOL_LINK "Rte_TEstimn_AmbTVldPrev" 0 DISPLAY_IDENTIFIER TEstimn.PerInstanceMemories.AmbTVldPrev /end MEASUREMENT
/begin MEASUREMENT TEstimn.AssiMechFilLp.FilGain "MICROSAR RTE" FLOAT32_IEEE NO_COMPU_METHOD 0 0 -3.402823466e+38 3.402823466e+38 ECU_ADDRESS 0 SYMBOL_LINK "Rte_TEstimn_AssiMechFilLp.FilGain" 0 DISPLAY_IDENTIFIER TEstimn.PerInstanceMemories.AssiMechFilLp.FilGain /end MEASUREMENT
/begin MEASUREMENT TEstimn.AssiMechFilLp.FilSt "MICROSAR RTE" FLOAT32_IEEE NO_COMPU_METHOD 0 0 -3.402823466e+38 3.402823466e+38 ECU_ADDRESS 0 SYMBOL_LINK "Rte_TEstimn_AssiMechFilLp.FilSt" 0 DISPLAY_IDENTIFIER TEstimn.PerInstanceMemories.AssiMechFilLp.FilSt /end MEASUREMENT
/begin MEASUREMENT TEstimn.AssiMechT.Val "MICROSAR RTE" FLOAT32_IEEE NO_COMPU_METHOD 0 0 -3.402823466e+38 3.402823466e+38 ECU_ADDRESS 0 SYMBOL_LINK "Rte_TEstimn_AssiMechT_Val" 0 DISPLAY_IDENTIFIER TEstimn.SenderPorts.AssiMechT.Val /end MEASUREMENT
/begin MEASUREMENT TEstimn.AssiMechTEstimnDi.Logl "MICROSAR RTE" UBYTE RTE_CM_BOOLEAN 0 0 0 255 ECU_ADDRESS 0 SYMBOL_LINK "Rte_CmnMfgSrv_AssiMechTEstimnDi_Logl" 0 DISPLAY_IDENTIFIER TEstimn.ReceiverPorts.AssiMechTEstimnDi.Logl /end MEASUREMENT
/begin MEASUREMENT TEstimn.AssiMechTEstimnPrev "MICROSAR RTE" FLOAT32_IEEE NO_COMPU_METHOD 0 0 -3.402823466e+38 3.402823466e+38 ECU_ADDRESS 0 SYMBOL_LINK "Rte_TEstimn_AssiMechTEstimnPrev" 0 DISPLAY_IDENTIFIER TEstimn.PerInstanceMemories.AssiMechTEstimnPrev /end MEASUREMENT
/begin MEASUREMENT TEstimn.AssiMechTInitEna "MICROSAR RTE" UBYTE RTE_CM_BOOLEAN 0 0 0 255 ECU_ADDRESS 0 SYMBOL_LINK "Rte_TEstimn_AssiMechTInitEna" 0 DISPLAY_IDENTIFIER TEstimn.PerInstanceMemories.AssiMechTInitEna /end MEASUREMENT
/begin MEASUREMENT TEstimn.AssiMechTSlewLimPrev "MICROSAR RTE" FLOAT32_IEEE NO_COMPU_METHOD 0 0 -3.402823466e+38 3.402823466e+38 ECU_ADDRESS 0 SYMBOL_LINK "Rte_TEstimn_AssiMechTSlewLimPrev" 0 DISPLAY_IDENTIFIER TEstimn.PerInstanceMemories.AssiMechTSlewLimPrev /end MEASUREMENT
/begin MEASUREMENT TEstimn.CuFilLp.FilGain "MICROSAR RTE" FLOAT32_IEEE NO_COMPU_METHOD 0 0 -3.402823466e+38 3.402823466e+38 ECU_ADDRESS 0 SYMBOL_LINK "Rte_TEstimn_CuFilLp.FilGain" 0 DISPLAY_IDENTIFIER TEstimn.PerInstanceMemories.CuFilLp.FilGain /end MEASUREMENT
/begin MEASUREMENT TEstimn.CuFilLp.FilSt "MICROSAR RTE" FLOAT32_IEEE NO_COMPU_METHOD 0 0 -3.402823466e+38 3.402823466e+38 ECU_ADDRESS 0 SYMBOL_LINK "Rte_TEstimn_CuFilLp.FilSt" 0 DISPLAY_IDENTIFIER TEstimn.PerInstanceMemories.CuFilLp.FilSt /end MEASUREMENT
/begin MEASUREMENT TEstimn.CuTEstimnPrev "MICROSAR RTE" FLOAT32_IEEE NO_COMPU_METHOD 0 0 -3.402823466e+38 3.402823466e+38 ECU_ADDRESS 0 SYMBOL_LINK "Rte_TEstimn_CuTEstimnPrev" 0 DISPLAY_IDENTIFIER TEstimn.PerInstanceMemories.CuTEstimnPrev /end MEASUREMENT
/begin MEASUREMENT TEstimn.EcuTFild.Val "MICROSAR RTE" FLOAT32_IEEE NO_COMPU_METHOD 0 0 -3.402823466e+38 3.402823466e+38 ECU_ADDRESS 0 SYMBOL_LINK "Rte_EcuTMeas_EcuTFild_Val" 0 DISPLAY_IDENTIFIER TEstimn.ReceiverPorts.EcuTFild.Val /end MEASUREMENT
/begin MEASUREMENT TEstimn.EngOilT.Val "MICROSAR RTE" FLOAT32_IEEE NO_COMPU_METHOD 0 0 -3.402823466e+38 3.402823466e+38 ECU_ADDRESS 0 SYMBOL_LINK "Rte_GmMsg4D1BusHiSpd_EngOilT_Val" 0 DISPLAY_IDENTIFIER TEstimn.ReceiverPorts.EngOilT.Val /end MEASUREMENT
/begin MEASUREMENT TEstimn.EngOilTVld.Logl "MICROSAR RTE" UBYTE RTE_CM_BOOLEAN 0 0 0 255 ECU_ADDRESS 0 SYMBOL_LINK "Rte_TEstimn_EngOilTVld_Logl" 0 DISPLAY_IDENTIFIER TEstimn.ReceiverPorts.EngOilTVld.Logl /end MEASUREMENT
/begin MEASUREMENT TEstimn.EngOilTVldPrev "MICROSAR RTE" UBYTE RTE_CM_BOOLEAN 0 0 0 255 ECU_ADDRESS 0 SYMBOL_LINK "Rte_TEstimn_EngOilTVldPrev" 0 DISPLAY_IDENTIFIER TEstimn.PerInstanceMemories.EngOilTVldPrev /end MEASUREMENT
/begin MEASUREMENT TEstimn.HwVel.Val "MICROSAR RTE" FLOAT32_IEEE NO_COMPU_METHOD 0 0 -3.402823466e+38 3.402823466e+38 ECU_ADDRESS 0 SYMBOL_LINK "Rte_HwAgSysArbn_HwVel_Val" 0 DISPLAY_IDENTIFIER TEstimn.ReceiverPorts.HwVel.Val /end MEASUREMENT
/begin MEASUREMENT TEstimn.MagFilLp.FilGain "MICROSAR RTE" FLOAT32_IEEE NO_COMPU_METHOD 0 0 -3.402823466e+38 3.402823466e+38 ECU_ADDRESS 0 SYMBOL_LINK "Rte_TEstimn_MagFilLp.FilGain" 0 DISPLAY_IDENTIFIER TEstimn.PerInstanceMemories.MagFilLp.FilGain /end MEASUREMENT
/begin MEASUREMENT TEstimn.MagFilLp.FilSt "MICROSAR RTE" FLOAT32_IEEE NO_COMPU_METHOD 0 0 -3.402823466e+38 3.402823466e+38 ECU_ADDRESS 0 SYMBOL_LINK "Rte_TEstimn_MagFilLp.FilSt" 0 DISPLAY_IDENTIFIER TEstimn.PerInstanceMemories.MagFilLp.FilSt /end MEASUREMENT
/begin MEASUREMENT TEstimn.MagTEstimnPrev "MICROSAR RTE" FLOAT32_IEEE NO_COMPU_METHOD 0 0 -3.402823466e+38 3.402823466e+38 ECU_ADDRESS 0 SYMBOL_LINK "Rte_TEstimn_MagTEstimnPrev" 0 DISPLAY_IDENTIFIER TEstimn.PerInstanceMemories.MagTEstimnPrev /end MEASUREMENT
/begin MEASUREMENT TEstimn.MotCurrPeakEstimd.Val "MICROSAR RTE" FLOAT32_IEEE NO_COMPU_METHOD 0 0 -3.402823466e+38 3.402823466e+38 ECU_ADDRESS 0 SYMBOL_LINK "Rte_MotCurrPeakEstimn_MotCurrPeakEstimdFild_Val" 0 DISPLAY_IDENTIFIER TEstimn.ReceiverPorts.MotCurrPeakEstimd.Val /end MEASUREMENT
/begin MEASUREMENT TEstimn.MotFetT.Val "MICROSAR RTE" FLOAT32_IEEE NO_COMPU_METHOD 0 0 -3.402823466e+38 3.402823466e+38 ECU_ADDRESS 0 SYMBOL_LINK "Rte_TEstimn_MotFetT_Val" 0 DISPLAY_IDENTIFIER TEstimn.SenderPorts.MotFetT.Val /end MEASUREMENT
/begin MEASUREMENT TEstimn.MotMagT.Val "MICROSAR RTE" FLOAT32_IEEE NO_COMPU_METHOD 0 0 -3.402823466e+38 3.402823466e+38 ECU_ADDRESS 0 SYMBOL_LINK "Rte_TEstimn_MotMagT_Val" 0 DISPLAY_IDENTIFIER TEstimn.SenderPorts.MotMagT.Val /end MEASUREMENT
/begin MEASUREMENT TEstimn.MotWidgT.Val "MICROSAR RTE" FLOAT32_IEEE NO_COMPU_METHOD 0 0 -3.402823466e+38 3.402823466e+38 ECU_ADDRESS 0 SYMBOL_LINK "Rte_TEstimn_MotWidgT_Val" 0 DISPLAY_IDENTIFIER TEstimn.SenderPorts.MotWidgT.Val /end MEASUREMENT
/begin MEASUREMENT TEstimn.SiFilLp.FilGain "MICROSAR RTE" FLOAT32_IEEE NO_COMPU_METHOD 0 0 -3.402823466e+38 3.402823466e+38 ECU_ADDRESS 0 SYMBOL_LINK "Rte_TEstimn_SiFilLp.FilGain" 0 DISPLAY_IDENTIFIER TEstimn.PerInstanceMemories.SiFilLp.FilGain /end MEASUREMENT
/begin MEASUREMENT TEstimn.SiFilLp.FilSt "MICROSAR RTE" FLOAT32_IEEE NO_COMPU_METHOD 0 0 -3.402823466e+38 3.402823466e+38 ECU_ADDRESS 0 SYMBOL_LINK "Rte_TEstimn_SiFilLp.FilSt" 0 DISPLAY_IDENTIFIER TEstimn.PerInstanceMemories.SiFilLp.FilSt /end MEASUREMENT
/begin MEASUREMENT TEstimn.SiTEstimnPrev "MICROSAR RTE" FLOAT32_IEEE NO_COMPU_METHOD 0 0 -3.402823466e+38 3.402823466e+38 ECU_ADDRESS 0 SYMBOL_LINK "Rte_TEstimn_SiTEstimnPrev" 0 DISPLAY_IDENTIFIER TEstimn.PerInstanceMemories.SiTEstimnPrev /end MEASUREMENT
/begin MEASUREMENT TEstimn.dTEstimnAmbPwr "MICROSAR RTE" FLOAT32_IEEE NO_COMPU_METHOD 0 0 -3.402823466e+38 3.402823466e+38 ECU_ADDRESS 0 SYMBOL_LINK "Rte_TEstimn_dTEstimnAmbPwr" 0 DISPLAY_IDENTIFIER TEstimn.PerInstanceMemories.dTEstimnAmbPwr /end MEASUREMENT
/begin MEASUREMENT TEstimn.dTEstimnAssiMechCorrn "MICROSAR RTE" FLOAT32_IEEE NO_COMPU_METHOD 0 0 -3.402823466e+38 3.402823466e+38 ECU_ADDRESS 0 SYMBOL_LINK "Rte_TEstimn_dTEstimnAssiMechCorrn" 0 DISPLAY_IDENTIFIER TEstimn.PerInstanceMemories.dTEstimnAssiMechCorrn /end MEASUREMENT
/begin MEASUREMENT TEstimn.dTEstimnAssiMechDampgSca "MICROSAR RTE" FLOAT32_IEEE NO_COMPU_METHOD 0 0 -3.402823466e+38 3.402823466e+38 ECU_ADDRESS 0 SYMBOL_LINK "Rte_TEstimn_dTEstimnAssiMechDampgSca" 0 DISPLAY_IDENTIFIER TEstimn.PerInstanceMemories.dTEstimnAssiMechDampgSca /end MEASUREMENT
/begin MEASUREMENT TEstimn.dTEstimnAssiMechFil "MICROSAR RTE" FLOAT32_IEEE NO_COMPU_METHOD 0 0 -3.402823466e+38 3.402823466e+38 ECU_ADDRESS 0 SYMBOL_LINK "Rte_TEstimn_dTEstimnAssiMechFil" 0 DISPLAY_IDENTIFIER TEstimn.PerInstanceMemories.dTEstimnAssiMechFil /end MEASUREMENT
/begin MEASUREMENT TEstimn.dTEstimnAssiMechLLFil "MICROSAR RTE" FLOAT32_IEEE NO_COMPU_METHOD 0 0 -3.402823466e+38 3.402823466e+38 ECU_ADDRESS 0 SYMBOL_LINK "Rte_TEstimn_dTEstimnAssiMechLLFil" 0 DISPLAY_IDENTIFIER TEstimn.PerInstanceMemories.dTEstimnAssiMechLLFil /end MEASUREMENT
/begin MEASUREMENT TEstimn.dTEstimnCuCorrn "MICROSAR RTE" FLOAT32_IEEE NO_COMPU_METHOD 0 0 -3.402823466e+38 3.402823466e+38 ECU_ADDRESS 0 SYMBOL_LINK "Rte_TEstimn_dTEstimnCuCorrn" 0 DISPLAY_IDENTIFIER TEstimn.PerInstanceMemories.dTEstimnCuCorrn /end MEASUREMENT
/begin MEASUREMENT TEstimn.dTEstimnCuLLFil "MICROSAR RTE" FLOAT32_IEEE NO_COMPU_METHOD 0 0 -3.402823466e+38 3.402823466e+38 ECU_ADDRESS 0 SYMBOL_LINK "Rte_TEstimn_dTEstimnCuLLFil" 0 DISPLAY_IDENTIFIER TEstimn.PerInstanceMemories.dTEstimnCuLLFil /end MEASUREMENT
/begin MEASUREMENT TEstimn.dTEstimnMagCorrn "MICROSAR RTE" FLOAT32_IEEE NO_COMPU_METHOD 0 0 -3.402823466e+38 3.402823466e+38 ECU_ADDRESS 0 SYMBOL_LINK "Rte_TEstimn_dTEstimnMagCorrn" 0 DISPLAY_IDENTIFIER TEstimn.PerInstanceMemories.dTEstimnMagCorrn /end MEASUREMENT
/begin MEASUREMENT TEstimn.dTEstimnMagLLFil "MICROSAR RTE" FLOAT32_IEEE NO_COMPU_METHOD 0 0 -3.402823466e+38 3.402823466e+38 ECU_ADDRESS 0 SYMBOL_LINK "Rte_TEstimn_dTEstimnMagLLFil" 0 DISPLAY_IDENTIFIER TEstimn.PerInstanceMemories.dTEstimnMagLLFil /end MEASUREMENT
/begin MEASUREMENT TEstimn.dTEstimnScadAmbT "MICROSAR RTE" FLOAT32_IEEE NO_COMPU_METHOD 0 0 -3.402823466e+38 3.402823466e+38 ECU_ADDRESS 0 SYMBOL_LINK "Rte_TEstimn_dTEstimnScadAmbT" 0 DISPLAY_IDENTIFIER TEstimn.PerInstanceMemories.dTEstimnScadAmbT /end MEASUREMENT
/begin MEASUREMENT TEstimn.dTEstimnScadEngT "MICROSAR RTE" FLOAT32_IEEE NO_COMPU_METHOD 0 0 -3.402823466e+38 3.402823466e+38 ECU_ADDRESS 0 SYMBOL_LINK "Rte_TEstimn_dTEstimnScadEngT" 0 DISPLAY_IDENTIFIER TEstimn.PerInstanceMemories.dTEstimnScadEngT /end MEASUREMENT
/begin MEASUREMENT TEstimn.dTEstimnSiCorrn "MICROSAR RTE" FLOAT32_IEEE NO_COMPU_METHOD 0 0 -3.402823466e+38 3.402823466e+38 ECU_ADDRESS 0 SYMBOL_LINK "Rte_TEstimn_dTEstimnSiCorrn" 0 DISPLAY_IDENTIFIER TEstimn.PerInstanceMemories.dTEstimnSiCorrn /end MEASUREMENT
/begin MEASUREMENT TEstimn.dTEstimnSiLLFilv "MICROSAR RTE" FLOAT32_IEEE NO_COMPU_METHOD 0 0 -3.402823466e+38 3.402823466e+38 ECU_ADDRESS 0 SYMBOL_LINK "Rte_TEstimn_dTEstimnSiLLFilv" 0 DISPLAY_IDENTIFIER TEstimn.PerInstanceMemories.dTEstimnSiLLFilv /end MEASUREMENT
/begin MEASUREMENT TEstimn.dTEstimnWghtAvrgT "MICROSAR RTE" FLOAT32_IEEE NO_COMPU_METHOD 0 0 -3.402823466e+38 3.402823466e+38 ECU_ADDRESS 0 SYMBOL_LINK "Rte_TEstimn_dTEstimnWghtAvrgT" 0 DISPLAY_IDENTIFIER TEstimn.PerInstanceMemories.dTEstimnWghtAvrgT /end MEASUREMENT
/begin MEASUREMENT TmplMonr.DiagcStsIvtr1Inactv.Logl "MICROSAR RTE" UBYTE RTE_CM_BOOLEAN 0 0 0 255 ECU_ADDRESS 0 SYMBOL_LINK "Rte_DiagcMgr_DiagcStsIvtr1Inactv_Logl" 0 DISPLAY_IDENTIFIER TmplMonr.ReceiverPorts.DiagcStsIvtr1Inactv.Logl /end MEASUREMENT
/begin MEASUREMENT TmplMonr.DiagcStsIvtr2Inactv.Logl "MICROSAR RTE" UBYTE RTE_CM_BOOLEAN 0 0 0 255 ECU_ADDRESS 0 SYMBOL_LINK "Rte_DiagcMgr_DiagcStsIvtr2Inactv_Logl" 0 DISPLAY_IDENTIFIER TmplMonr.ReceiverPorts.DiagcStsIvtr2Inactv.Logl /end MEASUREMENT
/begin MEASUREMENT TmplMonr.StrtUpSt.Val "MICROSAR RTE" UBYTE NO_COMPU_METHOD 0 0 0 255 ECU_ADDRESS 0 SYMBOL_LINK "Rte_PwrUpSeq_StrtUpSt_Val" 0 DISPLAY_IDENTIFIER TmplMonr.ReceiverPorts.StrtUpSt.Val /end MEASUREMENT
/begin MEASUREMENT TmplMonr.TmplMonrIninCntr "MICROSAR RTE" UBYTE NO_COMPU_METHOD 0 0 0 255 ECU_ADDRESS 0 SYMBOL_LINK "Rte_TmplMonr_TmplMonrIninCntr" 0 DISPLAY_IDENTIFIER TmplMonr.PerInstanceMemories.TmplMonrIninCntr /end MEASUREMENT
/begin MEASUREMENT TmplMonr.TmplMonrIninTestCmpl.Logl "MICROSAR RTE" UBYTE RTE_CM_BOOLEAN 0 0 0 255 ECU_ADDRESS 0 SYMBOL_LINK "Rte_TmplMonr_TmplMonrIninTestCmpl_Logl" 0 DISPLAY_IDENTIFIER TmplMonr.SenderPorts.TmplMonrIninTestCmpl.Logl /end MEASUREMENT
/begin MEASUREMENT TmplMonr.TmplMonrIninTestCmplFlg "MICROSAR RTE" UBYTE RTE_CM_BOOLEAN 0 0 0 255 ECU_ADDRESS 0 SYMBOL_LINK "Rte_TmplMonr_TmplMonrIninTestCmplFlg" 0 DISPLAY_IDENTIFIER TmplMonr.PerInstanceMemories.TmplMonrIninTestCmplFlg /end MEASUREMENT
/begin MEASUREMENT TmplMonr.TmplMonrNtc40PrmByte "MICROSAR RTE" UBYTE NO_COMPU_METHOD 0 0 0 255 ECU_ADDRESS 0 SYMBOL_LINK "Rte_TmplMonr_TmplMonrNtc40PrmByte" 0 DISPLAY_IDENTIFIER TmplMonr.PerInstanceMemories.TmplMonrNtc40PrmByte /end MEASUREMENT
/begin MEASUREMENT TmplMonr.TmplMonrSpiReadWrOrderFlg1 "MICROSAR RTE" UBYTE RTE_CM_BOOLEAN 0 0 0 255 ECU_ADDRESS 0 SYMBOL_LINK "Rte_TmplMonr_TmplMonrSpiReadWrOrderFlg1" 0 DISPLAY_IDENTIFIER TmplMonr.PerInstanceMemories.TmplMonrSpiReadWrOrderFlg1 /end MEASUREMENT
/begin MEASUREMENT TmplMonr.TmplMonrSpiReadWrOrderFlg2 "MICROSAR RTE" UBYTE RTE_CM_BOOLEAN 0 0 0 255 ECU_ADDRESS 0 SYMBOL_LINK "Rte_TmplMonr_TmplMonrSpiReadWrOrderFlg2" 0 DISPLAY_IDENTIFIER TmplMonr.PerInstanceMemories.TmplMonrSpiReadWrOrderFlg2 /end MEASUREMENT
/begin MEASUREMENT TmplMonr.TmplMonrWdgRstrtCnt "MICROSAR RTE" UBYTE NO_COMPU_METHOD 0 0 0 255 ECU_ADDRESS 0 SYMBOL_LINK "Rte_TmplMonr_TmplMonrWdgRstrtCnt" 0 DISPLAY_IDENTIFIER TmplMonr.PerInstanceMemories.TmplMonrWdgRstrtCnt /end MEASUREMENT
/begin MEASUREMENT TqLoa.MotAgLoaMtgtnEna.Logl "MICROSAR RTE" UBYTE RTE_CM_BOOLEAN 0 0 0 255 ECU_ADDRESS 0 SYMBOL_LINK "Rte_LoaMgr_MotAgLoaMtgtnEna_Logl" 0 DISPLAY_IDENTIFIER TqLoa.ReceiverPorts.MotAgLoaMtgtnEna.Logl /end MEASUREMENT
/begin MEASUREMENT TqLoa.MotTqCmdPrev "MICROSAR RTE" FLOAT32_IEEE NO_COMPU_METHOD 0 0 -3.402823466e+38 3.402823466e+38 ECU_ADDRESS 0 SYMBOL_LINK "Rte_TqLoa_MotTqCmdPrev" 0 DISPLAY_IDENTIFIER TqLoa.PerInstanceMemories.MotTqCmdPrev /end MEASUREMENT
/begin MEASUREMENT TqLoa.MotVelAndTqBasdScaFacPrev "MICROSAR RTE" FLOAT32_IEEE NO_COMPU_METHOD 0 0 -3.402823466e+38 3.402823466e+38 ECU_ADDRESS 0 SYMBOL_LINK "Rte_TqLoa_MotVelAndTqBasdScaFacPrev" 0 DISPLAY_IDENTIFIER TqLoa.PerInstanceMemories.MotVelAndTqBasdScaFacPrev /end MEASUREMENT
/begin MEASUREMENT TqLoa.MotVelCrf.Val "MICROSAR RTE" FLOAT32_IEEE NO_COMPU_METHOD 0 0 -3.402823466e+38 3.402823466e+38 ECU_ADDRESS 0 SYMBOL_LINK "Rte_CDD_MotVel_MotVelCrf_Val" 0 DISPLAY_IDENTIFIER TqLoa.ReceiverPorts.MotVelCrf.Val /end MEASUREMENT
/begin MEASUREMENT TqLoa.PinionAg.Val "MICROSAR RTE" FLOAT32_IEEE NO_COMPU_METHOD 0 0 -3.402823466e+38 3.402823466e+38 ECU_ADDRESS 0 SYMBOL_LINK "Rte_HwAgSysArbn_PinionAg_Val" 0 DISPLAY_IDENTIFIER TqLoa.ReceiverPorts.PinionAg.Val /end MEASUREMENT
/begin MEASUREMENT TqLoa.PinionAgConf.Val "MICROSAR RTE" FLOAT32_IEEE NO_COMPU_METHOD 0 0 -3.402823466e+38 3.402823466e+38 ECU_ADDRESS 0 SYMBOL_LINK "Rte_HwAgSysArbn_PinionAgConf_Val" 0 DISPLAY_IDENTIFIER TqLoa.ReceiverPorts.PinionAgConf.Val /end MEASUREMENT
/begin MEASUREMENT TqLoa.TqLoaAvl.Logl "MICROSAR RTE" UBYTE RTE_CM_BOOLEAN 0 0 0 255 ECU_ADDRESS 0 SYMBOL_LINK "Rte_TqLoa_TqLoaAvl_Logl" 0 DISPLAY_IDENTIFIER TqLoa.SenderPorts.TqLoaAvl.Logl /end MEASUREMENT
/begin MEASUREMENT TqLoa.TqLoaCmd.Val "MICROSAR RTE" FLOAT32_IEEE NO_COMPU_METHOD 0 0 -3.402823466e+38 3.402823466e+38 ECU_ADDRESS 0 SYMBOL_LINK "Rte_TqLoa_TqLoaCmd_Val" 0 DISPLAY_IDENTIFIER TqLoa.SenderPorts.TqLoaCmd.Val /end MEASUREMENT
/begin MEASUREMENT TqLoa.VehLatA.Val "MICROSAR RTE" FLOAT32_IEEE NO_COMPU_METHOD 0 0 -3.402823466e+38 3.402823466e+38 ECU_ADDRESS 0 SYMBOL_LINK "Rte_VehSigCdng_VehLatAEstimd_Val" 0 DISPLAY_IDENTIFIER TqLoa.ReceiverPorts.VehLatA.Val /end MEASUREMENT
/begin MEASUREMENT TqLoa.VehLatADifScaFacPrev "MICROSAR RTE" FLOAT32_IEEE NO_COMPU_METHOD 0 0 -3.402823466e+38 3.402823466e+38 ECU_ADDRESS 0 SYMBOL_LINK "Rte_TqLoa_VehLatADifScaFacPrev" 0 DISPLAY_IDENTIFIER TqLoa.PerInstanceMemories.VehLatADifScaFacPrev /end MEASUREMENT
/begin MEASUREMENT TqLoa.VehLatAEstimnFil.FilGain "MICROSAR RTE" FLOAT32_IEEE NO_COMPU_METHOD 0 0 -3.402823466e+38 3.402823466e+38 ECU_ADDRESS 0 SYMBOL_LINK "Rte_TqLoa_VehLatAEstimnFil.FilGain" 0 DISPLAY_IDENTIFIER TqLoa.PerInstanceMemories.VehLatAEstimnFil.FilGain /end MEASUREMENT
/begin MEASUREMENT TqLoa.VehLatAEstimnFil.FilSt "MICROSAR RTE" FLOAT32_IEEE NO_COMPU_METHOD 0 0 -3.402823466e+38 3.402823466e+38 ECU_ADDRESS 0 SYMBOL_LINK "Rte_TqLoa_VehLatAEstimnFil.FilSt" 0 DISPLAY_IDENTIFIER TqLoa.PerInstanceMemories.VehLatAEstimnFil.FilSt /end MEASUREMENT
/begin MEASUREMENT TqLoa.VehLatAVld.Logl "MICROSAR RTE" UBYTE RTE_CM_BOOLEAN 0 0 0 255 ECU_ADDRESS 0 SYMBOL_LINK "Rte_VehSigCdng_VehLatAVld_Logl" 0 DISPLAY_IDENTIFIER TqLoa.ReceiverPorts.VehLatAVld.Logl /end MEASUREMENT
/begin MEASUREMENT TqLoa.VehSpd.Val "MICROSAR RTE" FLOAT32_IEEE NO_COMPU_METHOD 0 0 -3.402823466e+38 3.402823466e+38 ECU_ADDRESS 0 SYMBOL_LINK "Rte_VehSigCdng_VehSpd_Val" 0 DISPLAY_IDENTIFIER TqLoa.ReceiverPorts.VehSpd.Val /end MEASUREMENT
/begin MEASUREMENT TqLoa.VehSpdVld.Logl "MICROSAR RTE" UBYTE RTE_CM_BOOLEAN 0 0 0 255 ECU_ADDRESS 0 SYMBOL_LINK "Rte_VehSigCdng_VehSpdVld_Logl" 0 DISPLAY_IDENTIFIER TqLoa.ReceiverPorts.VehSpdVld.Logl /end MEASUREMENT
/begin MEASUREMENT TqLoa.dTqLoaMotTqCmdPreScag "MICROSAR RTE" FLOAT32_IEEE NO_COMPU_METHOD 0 0 -3.402823466e+38 3.402823466e+38 ECU_ADDRESS 0 SYMBOL_LINK "Rte_TqLoa_dTqLoaMotTqCmdPreScag" 0 DISPLAY_IDENTIFIER TqLoa.PerInstanceMemories.dTqLoaMotTqCmdPreScag /end MEASUREMENT
/begin MEASUREMENT TqLoa.dTqLoaMotVelAndTqBasdScaFac "MICROSAR RTE" FLOAT32_IEEE NO_COMPU_METHOD 0 0 -3.402823466e+38 3.402823466e+38 ECU_ADDRESS 0 SYMBOL_LINK "Rte_TqLoa_dTqLoaMotVelAndTqBasdScaFac" 0 DISPLAY_IDENTIFIER TqLoa.PerInstanceMemories.dTqLoaMotVelAndTqBasdScaFac /end MEASUREMENT
/begin MEASUREMENT TqLoa.dTqLoaScaFacFinal "MICROSAR RTE" FLOAT32_IEEE NO_COMPU_METHOD 0 0 -3.402823466e+38 3.402823466e+38 ECU_ADDRESS 0 SYMBOL_LINK "Rte_TqLoa_dTqLoaScaFacFinal" 0 DISPLAY_IDENTIFIER TqLoa.PerInstanceMemories.dTqLoaScaFacFinal /end MEASUREMENT
/begin MEASUREMENT TqLoa.dTqLoaVehLatADifScaFac "MICROSAR RTE" FLOAT32_IEEE NO_COMPU_METHOD 0 0 -3.402823466e+38 3.402823466e+38 ECU_ADDRESS 0 SYMBOL_LINK "Rte_TqLoa_dTqLoaVehLatADifScaFac" 0 DISPLAY_IDENTIFIER TqLoa.PerInstanceMemories.dTqLoaVehLatADifScaFac /end MEASUREMENT
/begin MEASUREMENT TqLoa.dTqLoaVehLatAEstimn "MICROSAR RTE" FLOAT32_IEEE NO_COMPU_METHOD 0 0 -3.402823466e+38 3.402823466e+38 ECU_ADDRESS 0 SYMBOL_LINK "Rte_TqLoa_dTqLoaVehLatAEstimn" 0 DISPLAY_IDENTIFIER TqLoa.PerInstanceMemories.dTqLoaVehLatAEstimn /end MEASUREMENT
/begin MEASUREMENT TqLoa.dTqLoaVehSpdBasdScaFac "MICROSAR RTE" FLOAT32_IEEE NO_COMPU_METHOD 0 0 -3.402823466e+38 3.402823466e+38 ECU_ADDRESS 0 SYMBOL_LINK "Rte_TqLoa_dTqLoaVehSpdBasdScaFac" 0 DISPLAY_IDENTIFIER TqLoa.PerInstanceMemories.dTqLoaVehSpdBasdScaFac /end MEASUREMENT
/begin MEASUREMENT TqOscn.AmpRampSt "MICROSAR RTE" FLOAT32_IEEE NO_COMPU_METHOD 0 0 -3.402823466e+38 3.402823466e+38 ECU_ADDRESS 0 SYMBOL_LINK "Rte_TqOscn_AmpRampSt" 0 DISPLAY_IDENTIFIER TqOscn.PerInstanceMemories.AmpRampSt /end MEASUREMENT
/begin MEASUREMENT TqOscn.HwOscnActv.Logl "MICROSAR RTE" UBYTE RTE_CM_BOOLEAN 0 0 0 255 ECU_ADDRESS 0 SYMBOL_LINK "Rte_TqOscn_HwOscnActv_Logl" 0 DISPLAY_IDENTIFIER TqOscn.SenderPorts.HwOscnActv.Logl /end MEASUREMENT
/begin MEASUREMENT TqOscn.HwOscnCmd.Val "MICROSAR RTE" FLOAT32_IEEE NO_COMPU_METHOD 0 0 -3.402823466e+38 3.402823466e+38 ECU_ADDRESS 0 SYMBOL_LINK "Rte_TqOscn_HwOscnCmd_Val" 0 DISPLAY_IDENTIFIER TqOscn.SenderPorts.HwOscnCmd.Val /end MEASUREMENT
/begin MEASUREMENT TqOscn.HwOscnDcThdExcdd.Logl "MICROSAR RTE" UBYTE RTE_CM_BOOLEAN 0 0 0 255 ECU_ADDRESS 0 SYMBOL_LINK "Rte_TqOscn_HwOscnDcThdExcdd_Logl" 0 DISPLAY_IDENTIFIER TqOscn.SenderPorts.HwOscnDcThdExcdd.Logl /end MEASUREMENT
/begin MEASUREMENT TqOscn.HwOscnEna.Logl "MICROSAR RTE" UBYTE RTE_CM_BOOLEAN 0 0 0 255 ECU_ADDRESS 0 SYMBOL_LINK "Rte_GmOvrlStMgr_HwOscnEna_Logl" 0 DISPLAY_IDENTIFIER TqOscn.ReceiverPorts.HwOscnEna.Logl /end MEASUREMENT
/begin MEASUREMENT TqOscn.HwOscnFallRampRate.Val "MICROSAR RTE" FLOAT32_IEEE NO_COMPU_METHOD 0 0 -3.402823466e+38 3.402823466e+38 ECU_ADDRESS 0 SYMBOL_LINK "Rte_TqOscn_HwOscnFallRampRate_Val" 0 DISPLAY_IDENTIFIER TqOscn.ReceiverPorts.HwOscnFallRampRate.Val /end MEASUREMENT
/begin MEASUREMENT TqOscn.HwOscnFrq.Val "MICROSAR RTE" FLOAT32_IEEE NO_COMPU_METHOD 0 0 -3.402823466e+38 3.402823466e+38 ECU_ADDRESS 0 SYMBOL_LINK "Rte_GmOvrlStMgr_HwOscnFrq_Val" 0 DISPLAY_IDENTIFIER TqOscn.ReceiverPorts.HwOscnFrq.Val /end MEASUREMENT
/begin MEASUREMENT TqOscn.HwOscnMotAmp.Val "MICROSAR RTE" FLOAT32_IEEE NO_COMPU_METHOD 0 0 -3.402823466e+38 3.402823466e+38 ECU_ADDRESS 0 SYMBOL_LINK "Rte_GmOvrlStMgr_HwOscnMotAmp_Val" 0 DISPLAY_IDENTIFIER TqOscn.ReceiverPorts.HwOscnMotAmp.Val /end MEASUREMENT
/begin MEASUREMENT TqOscn.HwOscnRisngRampRate.Val "MICROSAR RTE" FLOAT32_IEEE NO_COMPU_METHOD 0 0 -3.402823466e+38 3.402823466e+38 ECU_ADDRESS 0 SYMBOL_LINK "Rte_TqOscn_HwOscnRisngRampRate_Val" 0 DISPLAY_IDENTIFIER TqOscn.ReceiverPorts.HwOscnRisngRampRate.Val /end MEASUREMENT
/begin MEASUREMENT TqOscn.PreFinalCmdLpFil.FilGain "MICROSAR RTE" FLOAT32_IEEE NO_COMPU_METHOD 0 0 -3.402823466e+38 3.402823466e+38 ECU_ADDRESS 0 SYMBOL_LINK "Rte_TqOscn_PreFinalCmdLpFil.FilGain" 0 DISPLAY_IDENTIFIER TqOscn.PerInstanceMemories.PreFinalCmdLpFil.FilGain /end MEASUREMENT
/begin MEASUREMENT TqOscn.PreFinalCmdLpFil.FilSt "MICROSAR RTE" FLOAT32_IEEE NO_COMPU_METHOD 0 0 -3.402823466e+38 3.402823466e+38 ECU_ADDRESS 0 SYMBOL_LINK "Rte_TqOscn_PreFinalCmdLpFil.FilSt" 0 DISPLAY_IDENTIFIER TqOscn.PerInstanceMemories.PreFinalCmdLpFil.FilSt /end MEASUREMENT
/begin MEASUREMENT TqOscn.PrevActv "MICROSAR RTE" UBYTE RTE_CM_BOOLEAN 0 0 0 255 ECU_ADDRESS 0 SYMBOL_LINK "Rte_TqOscn_PrevActv" 0 DISPLAY_IDENTIFIER TqOscn.PerInstanceMemories.PrevActv /end MEASUREMENT
/begin MEASUREMENT TqOscn.PrevDcThdExcdd "MICROSAR RTE" UBYTE RTE_CM_BOOLEAN 0 0 0 255 ECU_ADDRESS 0 SYMBOL_LINK "Rte_TqOscn_PrevDcThdExcdd" 0 DISPLAY_IDENTIFIER TqOscn.PerInstanceMemories.PrevDcThdExcdd /end MEASUREMENT
/begin MEASUREMENT TqOscn.PrevEna "MICROSAR RTE" UBYTE RTE_CM_BOOLEAN 0 0 0 255 ECU_ADDRESS 0 SYMBOL_LINK "Rte_TqOscn_PrevEna" 0 DISPLAY_IDENTIFIER TqOscn.PerInstanceMemories.PrevEna /end MEASUREMENT
/begin MEASUREMENT TqOscn.PrevFallRampRate "MICROSAR RTE" FLOAT32_IEEE NO_COMPU_METHOD 0 0 -3.402823466e+38 3.402823466e+38 ECU_ADDRESS 0 SYMBOL_LINK "Rte_TqOscn_PrevFallRampRate" 0 DISPLAY_IDENTIFIER TqOscn.PerInstanceMemories.PrevFallRampRate /end MEASUREMENT
/begin MEASUREMENT TqOscn.PrevLimdAmp "MICROSAR RTE" FLOAT32_IEEE NO_COMPU_METHOD 0 0 -3.402823466e+38 3.402823466e+38 ECU_ADDRESS 0 SYMBOL_LINK "Rte_TqOscn_PrevLimdAmp" 0 DISPLAY_IDENTIFIER TqOscn.PerInstanceMemories.PrevLimdAmp /end MEASUREMENT
/begin MEASUREMENT TqOscn.PrevPhaAg "MICROSAR RTE" FLOAT32_IEEE NO_COMPU_METHOD 0 0 -3.402823466e+38 3.402823466e+38 ECU_ADDRESS 0 SYMBOL_LINK "Rte_TqOscn_PrevPhaAg" 0 DISPLAY_IDENTIFIER TqOscn.PerInstanceMemories.PrevPhaAg /end MEASUREMENT
/begin MEASUREMENT TqOscn.PrevPhaAgInc "MICROSAR RTE" FLOAT32_IEEE NO_COMPU_METHOD 0 0 -3.402823466e+38 3.402823466e+38 ECU_ADDRESS 0 SYMBOL_LINK "Rte_TqOscn_PrevPhaAgInc" 0 DISPLAY_IDENTIFIER TqOscn.PerInstanceMemories.PrevPhaAgInc /end MEASUREMENT
/begin MEASUREMENT TqOscn.PrevRisngRampRate "MICROSAR RTE" FLOAT32_IEEE NO_COMPU_METHOD 0 0 -3.402823466e+38 3.402823466e+38 ECU_ADDRESS 0 SYMBOL_LINK "Rte_TqOscn_PrevRisngRampRate" 0 DISPLAY_IDENTIFIER TqOscn.PerInstanceMemories.PrevRisngRampRate /end MEASUREMENT
/begin MEASUREMENT TqOscn.dTqOscnNonZeroAmpFlg "MICROSAR RTE" UBYTE RTE_CM_BOOLEAN 0 0 0 255 ECU_ADDRESS 0 SYMBOL_LINK "Rte_TqOscn_dTqOscnNonZeroAmpFlg" 0 DISPLAY_IDENTIFIER TqOscn.PerInstanceMemories.dTqOscnNonZeroAmpFlg /end MEASUREMENT
/begin MEASUREMENT TqOscn.dTqOscnPreFinalCmd "MICROSAR RTE" FLOAT32_IEEE NO_COMPU_METHOD 0 0 -3.402823466e+38 3.402823466e+38 ECU_ADDRESS 0 SYMBOL_LINK "Rte_TqOscn_dTqOscnPreFinalCmd" 0 DISPLAY_IDENTIFIER TqOscn.PerInstanceMemories.dTqOscnPreFinalCmd /end MEASUREMENT
/begin MEASUREMENT TqOscn.dTqOscnRateLimdAmp "MICROSAR RTE" FLOAT32_IEEE NO_COMPU_METHOD 0 0 -3.402823466e+38 3.402823466e+38 ECU_ADDRESS 0 SYMBOL_LINK "Rte_TqOscn_dTqOscnRateLimdAmp" 0 DISPLAY_IDENTIFIER TqOscn.PerInstanceMemories.dTqOscnRateLimdAmp /end MEASUREMENT
/begin MEASUREMENT TqOscn.dTqOscnSinCmd "MICROSAR RTE" FLOAT32_IEEE NO_COMPU_METHOD 0 0 -3.402823466e+38 3.402823466e+38 ECU_ADDRESS 0 SYMBOL_LINK "Rte_TqOscn_dTqOscnSinCmd" 0 DISPLAY_IDENTIFIER TqOscn.PerInstanceMemories.dTqOscnSinCmd /end MEASUREMENT
/begin MEASUREMENT TunSelnAuthy.HwTq.Val "MICROSAR RTE" FLOAT32_IEEE NO_COMPU_METHOD 0 0 -3.402823466e+38 3.402823466e+38 ECU_ADDRESS 0 SYMBOL_LINK "Rte_Swp_HwTqSwp_Val" 0 DISPLAY_IDENTIFIER TunSelnAuthy.ReceiverPorts.HwTq.Val /end MEASUREMENT
/begin MEASUREMENT TunSelnAuthy.HwVel.Val "MICROSAR RTE" FLOAT32_IEEE NO_COMPU_METHOD 0 0 -3.402823466e+38 3.402823466e+38 ECU_ADDRESS 0 SYMBOL_LINK "Rte_HwAgSysArbn_HwVel_Val" 0 DISPLAY_IDENTIFIER TunSelnAuthy.ReceiverPorts.HwVel.Val /end MEASUREMENT
/begin GROUP StabyCmp.StabyCmpNotchFil2Struct.Rec "MICROSAR RTE" /begin SUB_GROUP /end SUB_GROUP /begin FUNCTION_LIST /end FUNCTION_LIST
 /begin REF_CHARACTERISTIC StabyCmp.StabyCmpNotchFil2Struct.Rec.FilGainA1 StabyCmp.StabyCmpNotchFil2Struct.Rec.FilGainA2 StabyCmp.StabyCmpNotchFil2Struct.Rec.FilGainB0 StabyCmp.StabyCmpNotchFil2Struct.Rec.FilGainB1 StabyCmp.StabyCmpNotchFil2Struct.Rec.FilGainB2 /end REF_CHARACTERISTIC
 /begin REF_MEASUREMENT /end REF_MEASUREMENT
/end GROUP
/begin GROUP StabyCmp.StabyCmpNotchFil3Struct.Rec "MICROSAR RTE" /begin SUB_GROUP /end SUB_GROUP /begin FUNCTION_LIST /end FUNCTION_LIST
 /begin REF_CHARACTERISTIC StabyCmp.StabyCmpNotchFil3Struct.Rec.FilGainA1 StabyCmp.StabyCmpNotchFil3Struct.Rec.FilGainA2 StabyCmp.StabyCmpNotchFil3Struct.Rec.FilGainB0 StabyCmp.StabyCmpNotchFil3Struct.Rec.FilGainB1 StabyCmp.StabyCmpNotchFil3Struct.Rec.FilGainB2 /end REF_CHARACTERISTIC
 /begin REF_MEASUREMENT /end REF_MEASUREMENT
/end GROUP
/begin GROUP StabyCmp.StabyCmpNotchFil4Struct.Rec "MICROSAR RTE" /begin SUB_GROUP /end SUB_GROUP /begin FUNCTION_LIST /end FUNCTION_LIST
 /begin REF_CHARACTERISTIC StabyCmp.StabyCmpNotchFil4Struct.Rec.FilGainA1 StabyCmp.StabyCmpNotchFil4Struct.Rec.FilGainA2 StabyCmp.StabyCmpNotchFil4Struct.Rec.FilGainB0 StabyCmp.StabyCmpNotchFil4Struct.Rec.FilGainB1 StabyCmp.StabyCmpNotchFil4Struct.Rec.FilGainB2 /end REF_CHARACTERISTIC
 /begin REF_MEASUREMENT /end REF_MEASUREMENT
/end GROUP
/begin GROUP StabyCmp.StabyCmpNotchFilBilnrBlndVehSpd.Ary1D "MICROSAR RTE" /begin SUB_GROUP /end SUB_GROUP /begin FUNCTION_LIST /end FUNCTION_LIST /begin REF_CHARACTERISTIC StabyCmp.StabyCmpNotchFilBilnrBlndVehSpd.Ary1D /end REF_CHARACTERISTIC /begin REF_MEASUREMENT /end REF_MEASUREMENT /end GROUP
/begin GROUP StabyCmp.StabyCmpNotchFilBlnd02Y.Ary2D "MICROSAR RTE" /begin SUB_GROUP /end SUB_GROUP /begin FUNCTION_LIST /end FUNCTION_LIST /begin REF_CHARACTERISTIC StabyCmp.StabyCmpNotchFilBlnd02Y.Ary2D /end REF_CHARACTERISTIC /begin REF_MEASUREMENT /end REF_MEASUREMENT /end GROUP
/begin GROUP StabyCmp.StabyCmpNotchFilBlnd04Y.Ary2D "MICROSAR RTE" /begin SUB_GROUP /end SUB_GROUP /begin FUNCTION_LIST /end FUNCTION_LIST /begin REF_CHARACTERISTIC StabyCmp.StabyCmpNotchFilBlnd04Y.Ary2D /end REF_CHARACTERISTIC /begin REF_MEASUREMENT /end REF_MEASUREMENT /end GROUP
/begin GROUP StabyCmp.StabyCmpNotchFilBlnd12TqX.Ary2D "MICROSAR RTE" /begin SUB_GROUP /end SUB_GROUP /begin FUNCTION_LIST /end FUNCTION_LIST /begin REF_CHARACTERISTIC StabyCmp.StabyCmpNotchFilBlnd12TqX.Ary2D /end REF_CHARACTERISTIC /begin REF_MEASUREMENT /end REF_MEASUREMENT /end GROUP
/begin GROUP StabyCmp.StabyCmpNotchFilBlnd12Y.Ary2D "MICROSAR RTE" /begin SUB_GROUP /end SUB_GROUP /begin FUNCTION_LIST /end FUNCTION_LIST /begin REF_CHARACTERISTIC StabyCmp.StabyCmpNotchFilBlnd12Y.Ary2D /end REF_CHARACTERISTIC /begin REF_MEASUREMENT /end REF_MEASUREMENT /end GROUP
/begin GROUP StabyCmp.StabyCmpNotchFilBlnd34TqX.Ary2D "MICROSAR RTE" /begin SUB_GROUP /end SUB_GROUP /begin FUNCTION_LIST /end FUNCTION_LIST /begin REF_CHARACTERISTIC StabyCmp.StabyCmpNotchFilBlnd34TqX.Ary2D /end REF_CHARACTERISTIC /begin REF_MEASUREMENT /end REF_MEASUREMENT /end GROUP
/begin GROUP StabyCmp.StabyCmpNotchFilBlnd34Y.Ary2D "MICROSAR RTE" /begin SUB_GROUP /end SUB_GROUP /begin FUNCTION_LIST /end FUNCTION_LIST /begin REF_CHARACTERISTIC StabyCmp.StabyCmpNotchFilBlnd34Y.Ary2D /end REF_CHARACTERISTIC /begin REF_MEASUREMENT /end REF_MEASUREMENT /end GROUP
/begin GROUP StabyCmp.VehSpd.Val "MICROSAR RTE" /begin SUB_GROUP /end SUB_GROUP /begin FUNCTION_LIST /end FUNCTION_LIST /begin REF_CHARACTERISTIC /end REF_CHARACTERISTIC /begin REF_MEASUREMENT StabyCmp.VehSpd.Val /end REF_MEASUREMENT /end GROUP
/begin GROUP StabyCmp.dStabyCmpAssiScaCmpBlnd "MICROSAR RTE" /begin SUB_GROUP /end SUB_GROUP /begin FUNCTION_LIST /end FUNCTION_LIST /begin REF_CHARACTERISTIC /end REF_CHARACTERISTIC /begin REF_MEASUREMENT StabyCmp.dStabyCmpAssiScaCmpBlnd /end REF_MEASUREMENT /end GROUP
/begin GROUP StabyCmp.dStabyCmpNotchFil02Blnd "MICROSAR RTE" /begin SUB_GROUP /end SUB_GROUP /begin FUNCTION_LIST /end FUNCTION_LIST /begin REF_CHARACTERISTIC /end REF_CHARACTERISTIC /begin REF_MEASUREMENT StabyCmp.dStabyCmpNotchFil02Blnd /end REF_MEASUREMENT /end GROUP
/begin GROUP StabyCmp.dStabyCmpNotchFil04Blnd "MICROSAR RTE" /begin SUB_GROUP /end SUB_GROUP /begin FUNCTION_LIST /end FUNCTION_LIST /begin REF_CHARACTERISTIC /end REF_CHARACTERISTIC /begin REF_MEASUREMENT StabyCmp.dStabyCmpNotchFil04Blnd /end REF_MEASUREMENT /end GROUP
/begin GROUP StabyCmp.dStabyCmpNotchFil12Blnd "MICROSAR RTE" /begin SUB_GROUP /end SUB_GROUP /begin FUNCTION_LIST /end FUNCTION_LIST /begin REF_CHARACTERISTIC /end REF_CHARACTERISTIC /begin REF_MEASUREMENT StabyCmp.dStabyCmpNotchFil12Blnd /end REF_MEASUREMENT /end GROUP
/begin GROUP StabyCmp.dStabyCmpNotchFil12Outp "MICROSAR RTE" /begin SUB_GROUP /end SUB_GROUP /begin FUNCTION_LIST /end FUNCTION_LIST /begin REF_CHARACTERISTIC /end REF_CHARACTERISTIC /begin REF_MEASUREMENT StabyCmp.dStabyCmpNotchFil12Outp /end REF_MEASUREMENT /end GROUP
/begin GROUP StabyCmp.dStabyCmpNotchFil1Outp "MICROSAR RTE" /begin SUB_GROUP /end SUB_GROUP /begin FUNCTION_LIST /end FUNCTION_LIST /begin REF_CHARACTERISTIC /end REF_CHARACTERISTIC /begin REF_MEASUREMENT StabyCmp.dStabyCmpNotchFil1Outp /end REF_MEASUREMENT /end GROUP
/begin GROUP StabyCmp.dStabyCmpNotchFil2Outp "MICROSAR RTE" /begin SUB_GROUP /end SUB_GROUP /begin FUNCTION_LIST /end FUNCTION_LIST /begin REF_CHARACTERISTIC /end REF_CHARACTERISTIC /begin REF_MEASUREMENT StabyCmp.dStabyCmpNotchFil2Outp /end REF_MEASUREMENT /end GROUP
/begin GROUP StabyCmp.dStabyCmpNotchFil34Blnd "MICROSAR RTE" /begin SUB_GROUP /end SUB_GROUP /begin FUNCTION_LIST /end FUNCTION_LIST /begin REF_CHARACTERISTIC /end REF_CHARACTERISTIC /begin REF_MEASUREMENT StabyCmp.dStabyCmpNotchFil34Blnd /end REF_MEASUREMENT /end GROUP
/begin GROUP StabyCmp.dStabyCmpNotchFil34Outp "MICROSAR RTE" /begin SUB_GROUP /end SUB_GROUP /begin FUNCTION_LIST /end FUNCTION_LIST /begin REF_CHARACTERISTIC /end REF_CHARACTERISTIC /begin REF_MEASUREMENT StabyCmp.dStabyCmpNotchFil34Outp /end REF_MEASUREMENT /end GROUP
/begin GROUP StabyCmp.dStabyCmpNotchFil3Outp "MICROSAR RTE" /begin SUB_GROUP /end SUB_GROUP /begin FUNCTION_LIST /end FUNCTION_LIST /begin REF_CHARACTERISTIC /end REF_CHARACTERISTIC /begin REF_MEASUREMENT StabyCmp.dStabyCmpNotchFil3Outp /end REF_MEASUREMENT /end GROUP
/begin GROUP StabyCmp.dStabyCmpNotchFil4Outp "MICROSAR RTE" /begin SUB_GROUP /end SUB_GROUP /begin FUNCTION_LIST /end FUNCTION_LIST /begin REF_CHARACTERISTIC /end REF_CHARACTERISTIC /begin REF_MEASUREMENT StabyCmp.dStabyCmpNotchFil4Outp /end REF_MEASUREMENT /end GROUP
/begin GROUP Swp "MICROSAR RTE" /begin SUB_GROUP Swp.ReceiverPorts Swp.SenderPorts /end SUB_GROUP /begin FUNCTION_LIST /end FUNCTION_LIST /begin REF_CHARACTERISTIC /end REF_CHARACTERISTIC /begin REF_MEASUREMENT /end REF_MEASUREMENT /end GROUP
/begin GROUP Swp.HwTq.Val "MICROSAR RTE" /begin SUB_GROUP /end SUB_GROUP /begin FUNCTION_LIST /end FUNCTION_LIST /begin REF_CHARACTERISTIC /end REF_CHARACTERISTIC /begin REF_MEASUREMENT Swp.HwTq.Val /end REF_MEASUREMENT /end GROUP
/begin GROUP Swp.HwTqSwp.Val "MICROSAR RTE" /begin SUB_GROUP /end SUB_GROUP /begin FUNCTION_LIST /end FUNCTION_LIST /begin REF_CHARACTERISTIC /end REF_CHARACTERISTIC /begin REF_MEASUREMENT Swp.HwTqSwp.Val /end REF_MEASUREMENT /end GROUP
/begin GROUP Swp.MotTqCmd.Val "MICROSAR RTE" /begin SUB_GROUP /end SUB_GROUP /begin FUNCTION_LIST /end FUNCTION_LIST /begin REF_CHARACTERISTIC /end REF_CHARACTERISTIC /begin REF_MEASUREMENT Swp.MotTqCmd.Val /end REF_MEASUREMENT /end GROUP
/begin GROUP Swp.MotTqCmdSwp.Val "MICROSAR RTE" /begin SUB_GROUP /end SUB_GROUP /begin FUNCTION_LIST /end FUNCTION_LIST /begin REF_CHARACTERISTIC /end REF_CHARACTERISTIC /begin REF_MEASUREMENT Swp.MotTqCmdSwp.Val /end REF_MEASUREMENT /end GROUP
/begin GROUP Swp.ReceiverPorts "MICROSAR RTE"
 /begin SUB_GROUP Swp.HwTq.Val Swp.MotTqCmd.Val Swp.VehSpd.Val Swp.VehSpdVld.Logl /end SUB_GROUP
 /begin FUNCTION_LIST /end FUNCTION_LIST
 /begin REF_CHARACTERISTIC /end REF_CHARACTERISTIC
 /begin REF_MEASUREMENT /end REF_MEASUREMENT
/end GROUP
/begin GROUP Swp.SenderPorts "MICROSAR RTE" /begin SUB_GROUP Swp.HwTqSwp.Val Swp.MotTqCmdSwp.Val /end SUB_GROUP /begin FUNCTION_LIST /end FUNCTION_LIST /begin REF_CHARACTERISTIC /end REF_CHARACTERISTIC /begin REF_MEASUREMENT /end REF_MEASUREMENT /end GROUP
/begin GROUP Swp.VehSpd.Val "MICROSAR RTE" /begin SUB_GROUP /end SUB_GROUP /begin FUNCTION_LIST /end FUNCTION_LIST /begin REF_CHARACTERISTIC /end REF_CHARACTERISTIC /begin REF_MEASUREMENT Swp.VehSpd.Val /end REF_MEASUREMENT /end GROUP
/begin GROUP Swp.VehSpdVld.Logl "MICROSAR RTE" /begin SUB_GROUP /end SUB_GROUP /begin FUNCTION_LIST /end FUNCTION_LIST /begin REF_CHARACTERISTIC /end REF_CHARACTERISTIC /begin REF_MEASUREMENT Swp.VehSpdVld.Logl /end REF_MEASUREMENT /end GROUP
/begin GROUP SysFricLrng "MICROSAR RTE"
 /begin SUB_GROUP SysFricLrng.CalibrationParameters SysFricLrng.CalibrationPorts SysFricLrng.PerInstanceMemories SysFricLrng.ReceiverPorts SysFricLrng.SenderPorts /end SUB_GROUP
 /begin FUNCTION_LIST /end FUNCTION_LIST
 /begin REF_CHARACTERISTIC /end REF_CHARACTERISTIC
 /begin REF_MEASUREMENT /end REF_MEASUREMENT
/end GROUP
/begin GROUP SysFricLrng.AssiMechT.Val "MICROSAR RTE" /begin SUB_GROUP /end SUB_GROUP /begin FUNCTION_LIST /end FUNCTION_LIST /begin REF_CHARACTERISTIC /end REF_CHARACTERISTIC /begin REF_MEASUREMENT SysFricLrng.AssiMechT.Val /end REF_MEASUREMENT /end GROUP
/begin GROUP SysFricLrng.AssiMechTLpFil "MICROSAR RTE" /begin SUB_GROUP /end SUB_GROUP /begin FUNCTION_LIST /end FUNCTION_LIST /begin REF_CHARACTERISTIC /end REF_CHARACTERISTIC
 /begin REF_MEASUREMENT SysFricLrng.AssiMechTLpFil.FilGain SysFricLrng.AssiMechTLpFil.FilSt /end REF_MEASUREMENT
/end GROUP
/begin GROUP SysFricLrng.AvrgFricLpFil1 "MICROSAR RTE" /begin SUB_GROUP /end SUB_GROUP /begin FUNCTION_LIST /end FUNCTION_LIST /begin REF_CHARACTERISTIC /end REF_CHARACTERISTIC
 /begin REF_MEASUREMENT SysFricLrng.AvrgFricLpFil1.FilGain SysFricLrng.AvrgFricLpFil1.FilSt /end REF_MEASUREMENT
/end GROUP
/begin GROUP SysFricLrng.AvrgFricLpFil2 "MICROSAR RTE" /begin SUB_GROUP /end SUB_GROUP /begin FUNCTION_LIST /end FUNCTION_LIST /begin REF_CHARACTERISTIC /end REF_CHARACTERISTIC
 /begin REF_MEASUREMENT SysFricLrng.AvrgFricLpFil2.FilGain SysFricLrng.AvrgFricLpFil2.FilSt /end REF_MEASUREMENT
/end GROUP
/begin GROUP SysFricLrng.AvrgFricLpFil3 "MICROSAR RTE" /begin SUB_GROUP /end SUB_GROUP /begin FUNCTION_LIST /end FUNCTION_LIST /begin REF_CHARACTERISTIC /end REF_CHARACTERISTIC
 /begin REF_MEASUREMENT SysFricLrng.AvrgFricLpFil3.FilGain SysFricLrng.AvrgFricLpFil3.FilSt /end REF_MEASUREMENT
/end GROUP
/begin GROUP SysFricLrng.AvrgFricLpFil4 "MICROSAR RTE" /begin SUB_GROUP /end SUB_GROUP /begin FUNCTION_LIST /end FUNCTION_LIST /begin REF_CHARACTERISTIC /end REF_CHARACTERISTIC
 /begin REF_MEASUREMENT SysFricLrng.AvrgFricLpFil4.FilGain SysFricLrng.AvrgFricLpFil4.FilSt /end REF_MEASUREMENT
/end GROUP
/begin GROUP SysFricLrng.CalibrationParameters "MICROSAR RTE" /begin SUB_GROUP SysFricLrng.FricLrngDataDft SysFricLrng.FricNonLrngDataDft /end SUB_GROUP /begin FUNCTION_LIST /end FUNCTION_LIST /begin REF_CHARACTERISTIC /end REF_CHARACTERISTIC /begin REF_MEASUREMENT /end REF_MEASUREMENT /end GROUP
/begin GROUP SysFricLrng.CalibrationPorts "MICROSAR RTE"
 /begin SUB_GROUP SysFricLrng.SysFricLrngAvrgFricFrq.Val SysFricLrng.SysFricLrngBasLineEolFric.Val SysFricLrng.SysFricLrngBasLineFric.Ary1D SysFricLrng.SysFricLrngBasLineHys.Ary2D SysFricLrng.SysFricLrngBasLineRngCntr.Ary2D SysFricLrng.SysFricLrngDataPrepLpFilFrq.Val SysFricLrng.SysFricLrngEolFricDifHiLim.Val SysFricLrng.SysFricLrngEolFricDifLoLim.Val SysFricLrng.SysFricLrngEolFricDifScagFac.Val SysFricLrng.SysFricLrngFricChgWght.Ary1D SysFricLrng.SysFricLrngFricDiagcThd.Val SysFricLrng.SysFricLrngFricDiagcTiThd.Val SysFricLrng.SysFricLrngFricHysHwAgPt.Ary1D SysFricLrng.SysFricLrngFricOffs.Val SysFricLrng.SysFricLrngFricOffsHiLim.Val SysFricLrng.SysFricLrngFricOffsLoLim.Val SysFricLrng.SysFricLrngFricOffsLpFilFrq.Val SysFricLrng.SysFricLrngGain.Val SysFricLrng.SysFricLrngHwPosnAuthyThd.Val SysFricLrng.SysFricLrngHwVelConstrLim.Val SysFricLrng.SysFricLrngHwVelHiLim.Val SysFricLrng.SysFricLrngHwVelLoLim.Val SysFricLrng.SysFricLrngIgnCycFricChgLim.Val SysFricLrng.SysFricLrngIvsTrsmRatX.Ary1D SysFricLrng.SysFricLrngIvsTrsmRatY.Ary1D SysFricLrng.SysFricLrngLatAHiLim.Val SysFricLrng.SysFricLrngLatALoLim.Val SysFricLrng.SysFricLrngMaskVehSpd.Ary1D SysFricLrng.SysFricLrngRngCntrThd.Val SysFricLrng.SysFricLrngTHiLim.Val SysFricLrng.SysFricLrngTLoLim.Val SysFricLrng.SysFricLrngThd.Val SysFricLrng.SysFricLrngVehSpd.Ary2D /end SUB_GROUP
 /begin FUNCTION_LIST /end FUNCTION_LIST
 /begin REF_CHARACTERISTIC /end REF_CHARACTERISTIC
 /begin REF_MEASUREMENT /end REF_MEASUREMENT
/end GROUP
/begin GROUP SysFricLrng.ColTqAry "MICROSAR RTE" /begin SUB_GROUP /end SUB_GROUP /begin FUNCTION_LIST /end FUNCTION_LIST /begin REF_CHARACTERISTIC /end REF_CHARACTERISTIC /begin REF_MEASUREMENT SysFricLrng.ColTqAry /end REF_MEASUREMENT /end GROUP
/begin GROUP SysFricLrng.ColTqLpFil "MICROSAR RTE" /begin SUB_GROUP /end SUB_GROUP /begin FUNCTION_LIST /end FUNCTION_LIST /begin REF_CHARACTERISTIC /end REF_CHARACTERISTIC
 /begin REF_MEASUREMENT SysFricLrng.ColTqLpFil.FilGain SysFricLrng.ColTqLpFil.FilSt /end REF_MEASUREMENT
/end GROUP
/begin GROUP SysFricLrng.EstimdFric "MICROSAR RTE" /begin SUB_GROUP /end SUB_GROUP /begin FUNCTION_LIST /end FUNCTION_LIST /begin REF_CHARACTERISTIC /end REF_CHARACTERISTIC /begin REF_MEASUREMENT SysFricLrng.EstimdFric /end REF_MEASUREMENT /end GROUP
/begin GROUP SysFricLrng.FilAvrgFric "MICROSAR RTE" /begin SUB_GROUP /end SUB_GROUP /begin FUNCTION_LIST /end FUNCTION_LIST /begin REF_CHARACTERISTIC /end REF_CHARACTERISTIC /begin REF_MEASUREMENT SysFricLrng.FilAvrgFric /end REF_MEASUREMENT /end GROUP
/begin GROUP SysFricLrng.FricChgLpFil "MICROSAR RTE" /begin SUB_GROUP /end SUB_GROUP /begin FUNCTION_LIST /end FUNCTION_LIST /begin REF_CHARACTERISTIC /end REF_CHARACTERISTIC
 /begin REF_MEASUREMENT SysFricLrng.FricChgLpFil.FilGain SysFricLrng.FricChgLpFil.FilSt /end REF_MEASUREMENT
/end GROUP
/begin GROUP SysFricLrng.FricLrngCustEna.Logl "MICROSAR RTE" /begin SUB_GROUP /end SUB_GROUP /begin FUNCTION_LIST /end FUNCTION_LIST /begin REF_CHARACTERISTIC /end REF_CHARACTERISTIC /begin REF_MEASUREMENT SysFricLrng.FricLrngCustEna.Logl /end REF_MEASUREMENT /end GROUP
/begin GROUP SysFricLrng.FricLrngData "MICROSAR RTE" /begin SUB_GROUP /end SUB_GROUP /begin FUNCTION_LIST /end FUNCTION_LIST /begin REF_CHARACTERISTIC /end REF_CHARACTERISTIC
 /begin REF_MEASUREMENT SysFricLrng.FricLrngData.BasLineFric SysFricLrng.FricLrngData.FricOffs SysFricLrng.FricLrngData.Hys SysFricLrng.FricLrngData.RngCntr SysFricLrng.FricLrngData.SysFricLrngOperMod SysFricLrng.FricLrngData.VehLrndFric /end REF_MEASUREMENT
/end GROUP
/begin GROUP SysFricLrng.FricLrngDataDft "MICROSAR RTE" /begin SUB_GROUP /end SUB_GROUP /begin FUNCTION_LIST /end FUNCTION_LIST
 /begin REF_CHARACTERISTIC SysFricLrng.FricLrngDataDft.BasLineFric SysFricLrng.FricLrngDataDft.FricOffs SysFricLrng.FricLrngDataDft.Hys SysFricLrng.FricLrngDataDft.RngCntr SysFricLrng.FricLrngDataDft.SysFricLrngOperMod SysFricLrng.FricLrngDataDft.VehLrndFric /end REF_CHARACTERISTIC
 /begin REF_MEASUREMENT /end REF_MEASUREMENT
/end GROUP
/begin GROUP SysFricLrng.FricLrngDi.Logl "MICROSAR RTE" /begin SUB_GROUP /end SUB_GROUP /begin FUNCTION_LIST /end FUNCTION_LIST /begin REF_CHARACTERISTIC /end REF_CHARACTERISTIC /begin REF_MEASUREMENT SysFricLrng.FricLrngDi.Logl /end REF_MEASUREMENT /end GROUP
/begin GROUP SysFricLrng.FricLrngOperModPrev "MICROSAR RTE" /begin SUB_GROUP /end SUB_GROUP /begin FUNCTION_LIST /end FUNCTION_LIST /begin REF_CHARACTERISTIC /end REF_CHARACTERISTIC /begin REF_MEASUREMENT SysFricLrng.FricLrngOperModPrev /end REF_MEASUREMENT /end GROUP
/begin GROUP SysFricLrng.FricLrngRunOneTi "MICROSAR RTE" /begin SUB_GROUP /end SUB_GROUP /begin FUNCTION_LIST /end FUNCTION_LIST /begin REF_CHARACTERISTIC /end REF_CHARACTERISTIC /begin REF_MEASUREMENT SysFricLrng.FricLrngRunOneTi /end REF_MEASUREMENT /end GROUP
/begin GROUP SysFricLrng.FricNonLrngData "MICROSAR RTE" /begin SUB_GROUP /end SUB_GROUP /begin FUNCTION_LIST /end FUNCTION_LIST /begin REF_CHARACTERISTIC /end REF_CHARACTERISTIC
 /begin REF_MEASUREMENT SysFricLrng.FricNonLrngData.EnaFricLrng SysFricLrng.FricNonLrngData.EnaFricOffsOutp SysFricLrng.FricNonLrngData.EolFric /end REF_MEASUREMENT
/end GROUP
/begin GROUP SysFricLrng.FricNonLrngDataDft "MICROSAR RTE" /begin SUB_GROUP /end SUB_GROUP /begin FUNCTION_LIST /end FUNCTION_LIST
 /begin REF_CHARACTERISTIC SysFricLrng.FricNonLrngDataDft.EnaFricLrng SysFricLrng.FricNonLrngDataDft.EnaFricOffsOutp SysFricLrng.FricNonLrngDataDft.EolFric /end REF_CHARACTERISTIC
 /begin REF_MEASUREMENT /end REF_MEASUREMENT
/end GROUP
/begin GROUP SysFricLrng.FricOffs "MICROSAR RTE" /begin SUB_GROUP /end SUB_GROUP /begin FUNCTION_LIST /end FUNCTION_LIST /begin REF_CHARACTERISTIC /end REF_CHARACTERISTIC /begin REF_MEASUREMENT SysFricLrng.FricOffs /end REF_MEASUREMENT /end GROUP
/begin GROUP SysFricLrng.FricOffsOutpDi "MICROSAR RTE" /begin SUB_GROUP /end SUB_GROUP /begin FUNCTION_LIST /end FUNCTION_LIST /begin REF_CHARACTERISTIC /end REF_CHARACTERISTIC /begin REF_MEASUREMENT SysFricLrng.FricOffsOutpDi /end REF_MEASUREMENT /end GROUP
/begin GROUP SysFricLrng.HwAg.Val "MICROSAR RTE" /begin SUB_GROUP /end SUB_GROUP /begin FUNCTION_LIST /end FUNCTION_LIST /begin REF_CHARACTERISTIC /end REF_CHARACTERISTIC /begin REF_MEASUREMENT SysFricLrng.HwAg.Val /end REF_MEASUREMENT /end GROUP
/begin GROUP SysFricLrng.HwAgAuthy.Val "MICROSAR RTE" /begin SUB_GROUP /end SUB_GROUP /begin FUNCTION_LIST /end FUNCTION_LIST /begin REF_CHARACTERISTIC /end REF_CHARACTERISTIC /begin REF_MEASUREMENT SysFricLrng.HwAgAuthy.Val /end REF_MEASUREMENT /end GROUP
/begin GROUP SysFricLrng.HwAgAuthyLpFil "MICROSAR RTE" /begin SUB_GROUP /end SUB_GROUP /begin FUNCTION_LIST /end FUNCTION_LIST /begin REF_CHARACTERISTIC /end REF_CHARACTERISTIC
 /begin REF_MEASUREMENT SysFricLrng.HwAgAuthyLpFil.FilGain SysFricLrng.HwAgAuthyLpFil.FilSt /end REF_MEASUREMENT
/end GROUP
/begin GROUP SysFricLrng.HwAgBuf "MICROSAR RTE" /begin SUB_GROUP /end SUB_GROUP /begin FUNCTION_LIST /end FUNCTION_LIST /begin REF_CHARACTERISTIC /end REF_CHARACTERISTIC /begin REF_MEASUREMENT SysFricLrng.HwAgBuf /end REF_MEASUREMENT /end GROUP
/begin GROUP SysFricLrng.HwAgLpFil "MICROSAR RTE" /begin SUB_GROUP /end SUB_GROUP /begin FUNCTION_LIST /end FUNCTION_LIST /begin REF_CHARACTERISTIC /end REF_CHARACTERISTIC /begin REF_MEASUREMENT SysFricLrng.HwAgLpFil.FilGain SysFricLrng.HwAgLpFil.FilSt /end REF_MEASUREMENT /end GROUP
/begin GROUP SysFricLrng.HwTq.Val "MICROSAR RTE" /begin SUB_GROUP /end SUB_GROUP /begin FUNCTION_LIST /end FUNCTION_LIST /begin REF_CHARACTERISTIC /end REF_CHARACTERISTIC /begin REF_MEASUREMENT SysFricLrng.HwTq.Val /end REF_MEASUREMENT /end GROUP
/begin GROUP SysFricLrng.HwVel.Val "MICROSAR RTE" /begin SUB_GROUP /end SUB_GROUP /begin FUNCTION_LIST /end FUNCTION_LIST /begin REF_CHARACTERISTIC /end REF_CHARACTERISTIC /begin REF_MEASUREMENT SysFricLrng.HwVel.Val /end REF_MEASUREMENT /end GROUP
/begin GROUP SysFricLrng.HwVelBuf "MICROSAR RTE" /begin SUB_GROUP /end SUB_GROUP /begin FUNCTION_LIST /end FUNCTION_LIST /begin REF_CHARACTERISTIC /end REF_CHARACTERISTIC /begin REF_MEASUREMENT SysFricLrng.HwVelBuf /end REF_MEASUREMENT /end GROUP
/begin GROUP SysFricLrng.HwVelLpFil "MICROSAR RTE" /begin SUB_GROUP /end SUB_GROUP /begin FUNCTION_LIST /end FUNCTION_LIST /begin REF_CHARACTERISTIC /end REF_CHARACTERISTIC
 /begin REF_MEASUREMENT SysFricLrng.HwVelLpFil.FilGain SysFricLrng.HwVelLpFil.FilSt /end REF_MEASUREMENT
/end GROUP
/begin GROUP SysFricLrng.LatALpFil "MICROSAR RTE" /begin SUB_GROUP /end SUB_GROUP /begin FUNCTION_LIST /end FUNCTION_LIST /begin REF_CHARACTERISTIC /end REF_CHARACTERISTIC /begin REF_MEASUREMENT SysFricLrng.LatALpFil.FilGain SysFricLrng.LatALpFil.FilSt /end REF_MEASUREMENT /end GROUP
/begin GROUP SysFricLrng.MaxLrndFric.Val "MICROSAR RTE" /begin SUB_GROUP /end SUB_GROUP /begin FUNCTION_LIST /end FUNCTION_LIST /begin REF_CHARACTERISTIC /end REF_CHARACTERISTIC /begin REF_MEASUREMENT SysFricLrng.MaxLrndFric.Val /end REF_MEASUREMENT /end GROUP
/begin GROUP SysFricLrng.MotTqCmdCrf.Val "MICROSAR RTE" /begin SUB_GROUP /end SUB_GROUP /begin FUNCTION_LIST /end FUNCTION_LIST /begin REF_CHARACTERISTIC /end REF_CHARACTERISTIC /begin REF_MEASUREMENT SysFricLrng.MotTqCmdCrf.Val /end REF_MEASUREMENT /end GROUP
/begin GROUP SysFricLrng.PerInstanceMemories "MICROSAR RTE"
 /begin SUB_GROUP SysFricLrng.AssiMechTLpFil SysFricLrng.AvrgFricLpFil1 SysFricLrng.AvrgFricLpFil2 SysFricLrng.AvrgFricLpFil3 SysFricLrng.AvrgFricLpFil4 SysFricLrng.ColTqAry SysFricLrng.ColTqLpFil SysFricLrng.EstimdFric SysFricLrng.FilAvrgFric SysFricLrng.FricChgLpFil SysFricLrng.FricLrngData SysFricLrng.FricLrngOperModPrev SysFricLrng.FricLrngRunOneTi SysFricLrng.FricNonLrngData SysFricLrng.FricOffs SysFricLrng.FricOffsOutpDi SysFricLrng.HwAgAuthyLpFil SysFricLrng.HwAgBuf SysFricLrng.HwAgLpFil SysFricLrng.HwVelBuf SysFricLrng.HwVelLpFil SysFricLrng.LatALpFil SysFricLrng.PrevFricOffs SysFricLrng.PrevMaxRawAvrgFric SysFricLrng.RawAvrgFric SysFricLrng.RefTmrLrngConstr SysFricLrng.RefTmrNtc SysFricLrng.SatnAvrgFric SysFricLrng.SatnEstimdFric SysFricLrng.VehBasLineFric SysFricLrng.VehSpdLpFil /end SUB_GROUP
 /begin FUNCTION_LIST /end FUNCTION_LIST
 /begin REF_CHARACTERISTIC /end REF_CHARACTERISTIC
 /begin REF_MEASUREMENT /end REF_MEASUREMENT
/end GROUP
/begin GROUP SysFricLrng.PrevFricOffs "MICROSAR RTE" /begin SUB_GROUP /end SUB_GROUP /begin FUNCTION_LIST /end FUNCTION_LIST /begin REF_CHARACTERISTIC /end REF_CHARACTERISTIC /begin REF_MEASUREMENT SysFricLrng.PrevFricOffs /end REF_MEASUREMENT /end GROUP
/begin GROUP SysFricLrng.PrevMaxRawAvrgFric "MICROSAR RTE" /begin SUB_GROUP /end SUB_GROUP /begin FUNCTION_LIST /end FUNCTION_LIST /begin REF_CHARACTERISTIC /end REF_CHARACTERISTIC /begin REF_MEASUREMENT SysFricLrng.PrevMaxRawAvrgFric /end REF_MEASUREMENT /end GROUP
/begin GROUP SysFricLrng.RawAvrgFric "MICROSAR RTE" /begin SUB_GROUP /end SUB_GROUP /begin FUNCTION_LIST /end FUNCTION_LIST /begin REF_CHARACTERISTIC /end REF_CHARACTERISTIC /begin REF_MEASUREMENT SysFricLrng.RawAvrgFric /end REF_MEASUREMENT /end GROUP
/begin GROUP SysFricLrng.ReceiverPorts "MICROSAR RTE"
 /begin SUB_GROUP SysFricLrng.AssiMechT.Val SysFricLrng.FricLrngCustEna.Logl SysFricLrng.FricLrngDi.Logl SysFricLrng.HwAg.Val SysFricLrng.HwAgAuthy.Val SysFricLrng.HwTq.Val SysFricLrng.HwVel.Val SysFricLrng.MotTqCmdCrf.Val SysFricLrng.VehLatA.Val SysFricLrng.VehSpd.Val SysFricLrng.VehSpdVld.Logl /end SUB_GROUP
 /begin FUNCTION_LIST /end FUNCTION_LIST
 /begin REF_CHARACTERISTIC /end REF_CHARACTERISTIC
 /begin REF_MEASUREMENT /end REF_MEASUREMENT
/end GROUP
/begin GROUP SysFricLrng.RefTmrLrngConstr "MICROSAR RTE" /begin SUB_GROUP /end SUB_GROUP /begin FUNCTION_LIST /end FUNCTION_LIST /begin REF_CHARACTERISTIC /end REF_CHARACTERISTIC /begin REF_MEASUREMENT SysFricLrng.RefTmrLrngConstr /end REF_MEASUREMENT /end GROUP
/begin GROUP SysFricLrng.RefTmrNtc "MICROSAR RTE" /begin SUB_GROUP /end SUB_GROUP /begin FUNCTION_LIST /end FUNCTION_LIST /begin REF_CHARACTERISTIC /end REF_CHARACTERISTIC /begin REF_MEASUREMENT SysFricLrng.RefTmrNtc /end REF_MEASUREMENT /end GROUP
/begin GROUP SysFricLrng.SatnAvrgFric "MICROSAR RTE" /begin SUB_GROUP /end SUB_GROUP /begin FUNCTION_LIST /end FUNCTION_LIST /begin REF_CHARACTERISTIC /end REF_CHARACTERISTIC /begin REF_MEASUREMENT SysFricLrng.SatnAvrgFric /end REF_MEASUREMENT /end GROUP
/begin GROUP SysFricLrng.SatnEstimdFric "MICROSAR RTE" /begin SUB_GROUP /end SUB_GROUP /begin FUNCTION_LIST /end FUNCTION_LIST /begin REF_CHARACTERISTIC /end REF_CHARACTERISTIC /begin REF_MEASUREMENT SysFricLrng.SatnEstimdFric /end REF_MEASUREMENT /end GROUP
/begin GROUP SysFricLrng.SenderPorts "MICROSAR RTE"
 /begin SUB_GROUP SysFricLrng.MaxLrndFric.Val SysFricLrng.SysFricEstimd.Val SysFricLrng.SysFricOffs.Val SysFricLrng.SysSatnFricEstimd.Val /end SUB_GROUP
 /begin FUNCTION_LIST /end FUNCTION_LIST
 /begin REF_CHARACTERISTIC /end REF_CHARACTERISTIC
 /begin REF_MEASUREMENT /end REF_MEASUREMENT
/end GROUP
/begin GROUP SysFricLrng.SysFricEstimd.Val "MICROSAR RTE" /begin SUB_GROUP /end SUB_GROUP /begin FUNCTION_LIST /end FUNCTION_LIST /begin REF_CHARACTERISTIC /end REF_CHARACTERISTIC /begin REF_MEASUREMENT SysFricLrng.SysFricEstimd.Val /end REF_MEASUREMENT /end GROUP
/begin GROUP SysFricLrng.SysFricLrngAvrgFricFrq.Val "MICROSAR RTE" /begin SUB_GROUP /end SUB_GROUP /begin FUNCTION_LIST /end FUNCTION_LIST /begin REF_CHARACTERISTIC SysFricLrng.SysFricLrngAvrgFricFrq.Val /end REF_CHARACTERISTIC /begin REF_MEASUREMENT /end REF_MEASUREMENT /end GROUP
/begin GROUP SysFricLrng.SysFricLrngBasLineEolFric.Val "MICROSAR RTE" /begin SUB_GROUP /end SUB_GROUP /begin FUNCTION_LIST /end FUNCTION_LIST /begin REF_CHARACTERISTIC SysFricLrng.SysFricLrngBasLineEolFric.Val /end REF_CHARACTERISTIC /begin REF_MEASUREMENT /end REF_MEASUREMENT /end GROUP
/begin GROUP SysFricLrng.SysFricLrngBasLineFric.Ary1D "MICROSAR RTE" /begin SUB_GROUP /end SUB_GROUP /begin FUNCTION_LIST /end FUNCTION_LIST /begin REF_CHARACTERISTIC SysFricLrng.SysFricLrngBasLineFric.Ary1D /end REF_CHARACTERISTIC /begin REF_MEASUREMENT /end REF_MEASUREMENT /end GROUP
/begin GROUP SysFricLrng.SysFricLrngBasLineHys.Ary2D "MICROSAR RTE" /begin SUB_GROUP /end SUB_GROUP /begin FUNCTION_LIST /end FUNCTION_LIST /begin REF_CHARACTERISTIC SysFricLrng.SysFricLrngBasLineHys.Ary2D /end REF_CHARACTERISTIC /begin REF_MEASUREMENT /end REF_MEASUREMENT /end GROUP
/begin GROUP SysFricLrng.SysFricLrngBasLineRngCntr.Ary2D "MICROSAR RTE" /begin SUB_GROUP /end SUB_GROUP /begin FUNCTION_LIST /end FUNCTION_LIST /begin REF_CHARACTERISTIC SysFricLrng.SysFricLrngBasLineRngCntr.Ary2D /end REF_CHARACTERISTIC /begin REF_MEASUREMENT /end REF_MEASUREMENT /end GROUP
/begin GROUP SysFricLrng.SysFricLrngDataPrepLpFilFrq.Val "MICROSAR RTE" /begin SUB_GROUP /end SUB_GROUP /begin FUNCTION_LIST /end FUNCTION_LIST /begin REF_CHARACTERISTIC SysFricLrng.SysFricLrngDataPrepLpFilFrq.Val /end REF_CHARACTERISTIC /begin REF_MEASUREMENT /end REF_MEASUREMENT /end GROUP
/begin GROUP SysFricLrng.SysFricLrngEolFricDifHiLim.Val "MICROSAR RTE" /begin SUB_GROUP /end SUB_GROUP /begin FUNCTION_LIST /end FUNCTION_LIST /begin REF_CHARACTERISTIC SysFricLrng.SysFricLrngEolFricDifHiLim.Val /end REF_CHARACTERISTIC /begin REF_MEASUREMENT /end REF_MEASUREMENT /end GROUP
/begin GROUP SysFricLrng.SysFricLrngEolFricDifLoLim.Val "MICROSAR RTE" /begin SUB_GROUP /end SUB_GROUP /begin FUNCTION_LIST /end FUNCTION_LIST /begin REF_CHARACTERISTIC SysFricLrng.SysFricLrngEolFricDifLoLim.Val /end REF_CHARACTERISTIC /begin REF_MEASUREMENT /end REF_MEASUREMENT /end GROUP
/begin GROUP SysFricLrng.SysFricLrngEolFricDifScagFac.Val "MICROSAR RTE" /begin SUB_GROUP /end SUB_GROUP /begin FUNCTION_LIST /end FUNCTION_LIST /begin REF_CHARACTERISTIC SysFricLrng.SysFricLrngEolFricDifScagFac.Val /end REF_CHARACTERISTIC /begin REF_MEASUREMENT /end REF_MEASUREMENT /end GROUP
/begin GROUP SysFricLrng.SysFricLrngFricChgWght.Ary1D "MICROSAR RTE" /begin SUB_GROUP /end SUB_GROUP /begin FUNCTION_LIST /end FUNCTION_LIST /begin REF_CHARACTERISTIC SysFricLrng.SysFricLrngFricChgWght.Ary1D /end REF_CHARACTERISTIC /begin REF_MEASUREMENT /end REF_MEASUREMENT /end GROUP
/begin GROUP SysFricLrng.SysFricLrngFricDiagcThd.Val "MICROSAR RTE" /begin SUB_GROUP /end SUB_GROUP /begin FUNCTION_LIST /end FUNCTION_LIST /begin REF_CHARACTERISTIC SysFricLrng.SysFricLrngFricDiagcThd.Val /end REF_CHARACTERISTIC /begin REF_MEASUREMENT /end REF_MEASUREMENT /end GROUP
/begin GROUP SysFricLrng.SysFricLrngFricDiagcTiThd.Val "MICROSAR RTE" /begin SUB_GROUP /end SUB_GROUP /begin FUNCTION_LIST /end FUNCTION_LIST /begin REF_CHARACTERISTIC SysFricLrng.SysFricLrngFricDiagcTiThd.Val /end REF_CHARACTERISTIC /begin REF_MEASUREMENT /end REF_MEASUREMENT /end GROUP
/begin GROUP SysFricLrng.SysFricLrngFricHysHwAgPt.Ary1D "MICROSAR RTE" /begin SUB_GROUP /end SUB_GROUP /begin FUNCTION_LIST /end FUNCTION_LIST /begin REF_CHARACTERISTIC SysFricLrng.SysFricLrngFricHysHwAgPt.Ary1D /end REF_CHARACTERISTIC /begin REF_MEASUREMENT /end REF_MEASUREMENT /end GROUP
/begin GROUP SysFricLrng.SysFricLrngFricOffs.Val "MICROSAR RTE" /begin SUB_GROUP /end SUB_GROUP /begin FUNCTION_LIST /end FUNCTION_LIST /begin REF_CHARACTERISTIC SysFricLrng.SysFricLrngFricOffs.Val /end REF_CHARACTERISTIC /begin REF_MEASUREMENT /end REF_MEASUREMENT /end GROUP
/begin GROUP SysFricLrng.SysFricLrngFricOffsHiLim.Val "MICROSAR RTE" /begin SUB_GROUP /end SUB_GROUP /begin FUNCTION_LIST /end FUNCTION_LIST /begin REF_CHARACTERISTIC SysFricLrng.SysFricLrngFricOffsHiLim.Val /end REF_CHARACTERISTIC /begin REF_MEASUREMENT /end REF_MEASUREMENT /end GROUP
/begin GROUP SysFricLrng.SysFricLrngFricOffsLoLim.Val "MICROSAR RTE" /begin SUB_GROUP /end SUB_GROUP /begin FUNCTION_LIST /end FUNCTION_LIST /begin REF_CHARACTERISTIC SysFricLrng.SysFricLrngFricOffsLoLim.Val /end REF_CHARACTERISTIC /begin REF_MEASUREMENT /end REF_MEASUREMENT /end GROUP
/begin GROUP SysFricLrng.SysFricLrngFricOffsLpFilFrq.Val "MICROSAR RTE" /begin SUB_GROUP /end SUB_GROUP /begin FUNCTION_LIST /end FUNCTION_LIST /begin REF_CHARACTERISTIC SysFricLrng.SysFricLrngFricOffsLpFilFrq.Val /end REF_CHARACTERISTIC /begin REF_MEASUREMENT /end REF_MEASUREMENT /end GROUP
/begin GROUP SysFricLrng.SysFricLrngGain.Val "MICROSAR RTE" /begin SUB_GROUP /end SUB_GROUP /begin FUNCTION_LIST /end FUNCTION_LIST /begin REF_CHARACTERISTIC SysFricLrng.SysFricLrngGain.Val /end REF_CHARACTERISTIC /begin REF_MEASUREMENT /end REF_MEASUREMENT /end GROUP
/begin GROUP SysFricLrng.SysFricLrngHwPosnAuthyThd.Val "MICROSAR RTE" /begin SUB_GROUP /end SUB_GROUP /begin FUNCTION_LIST /end FUNCTION_LIST /begin REF_CHARACTERISTIC SysFricLrng.SysFricLrngHwPosnAuthyThd.Val /end REF_CHARACTERISTIC /begin REF_MEASUREMENT /end REF_MEASUREMENT /end GROUP
/begin GROUP SysFricLrng.SysFricLrngHwVelConstrLim.Val "MICROSAR RTE" /begin SUB_GROUP /end SUB_GROUP /begin FUNCTION_LIST /end FUNCTION_LIST /begin REF_CHARACTERISTIC SysFricLrng.SysFricLrngHwVelConstrLim.Val /end REF_CHARACTERISTIC /begin REF_MEASUREMENT /end REF_MEASUREMENT /end GROUP
/begin GROUP SysFricLrng.SysFricLrngHwVelHiLim.Val "MICROSAR RTE" /begin SUB_GROUP /end SUB_GROUP /begin FUNCTION_LIST /end FUNCTION_LIST /begin REF_CHARACTERISTIC SysFricLrng.SysFricLrngHwVelHiLim.Val /end REF_CHARACTERISTIC /begin REF_MEASUREMENT /end REF_MEASUREMENT /end GROUP
/begin GROUP SysFricLrng.SysFricLrngHwVelLoLim.Val "MICROSAR RTE" /begin SUB_GROUP /end SUB_GROUP /begin FUNCTION_LIST /end FUNCTION_LIST /begin REF_CHARACTERISTIC SysFricLrng.SysFricLrngHwVelLoLim.Val /end REF_CHARACTERISTIC /begin REF_MEASUREMENT /end REF_MEASUREMENT /end GROUP
/begin GROUP SysFricLrng.SysFricLrngIgnCycFricChgLim.Val "MICROSAR RTE" /begin SUB_GROUP /end SUB_GROUP /begin FUNCTION_LIST /end FUNCTION_LIST /begin REF_CHARACTERISTIC SysFricLrng.SysFricLrngIgnCycFricChgLim.Val /end REF_CHARACTERISTIC /begin REF_MEASUREMENT /end REF_MEASUREMENT /end GROUP
/begin GROUP SysFricLrng.SysFricLrngIvsTrsmRatX.Ary1D "MICROSAR RTE" /begin SUB_GROUP /end SUB_GROUP /begin FUNCTION_LIST /end FUNCTION_LIST /begin REF_CHARACTERISTIC SysFricLrng.SysFricLrngIvsTrsmRatX.Ary1D /end REF_CHARACTERISTIC /begin REF_MEASUREMENT /end REF_MEASUREMENT /end GROUP
/begin GROUP SysFricLrng.SysFricLrngIvsTrsmRatY.Ary1D "MICROSAR RTE" /begin SUB_GROUP /end SUB_GROUP /begin FUNCTION_LIST /end FUNCTION_LIST /begin REF_CHARACTERISTIC SysFricLrng.SysFricLrngIvsTrsmRatY.Ary1D /end REF_CHARACTERISTIC /begin REF_MEASUREMENT /end REF_MEASUREMENT /end GROUP
/begin GROUP SysFricLrng.SysFricLrngLatAHiLim.Val "MICROSAR RTE" /begin SUB_GROUP /end SUB_GROUP /begin FUNCTION_LIST /end FUNCTION_LIST /begin REF_CHARACTERISTIC SysFricLrng.SysFricLrngLatAHiLim.Val /end REF_CHARACTERISTIC /begin REF_MEASUREMENT /end REF_MEASUREMENT /end GROUP
/begin GROUP SysFricLrng.SysFricLrngLatALoLim.Val "MICROSAR RTE" /begin SUB_GROUP /end SUB_GROUP /begin FUNCTION_LIST /end FUNCTION_LIST /begin REF_CHARACTERISTIC SysFricLrng.SysFricLrngLatALoLim.Val /end REF_CHARACTERISTIC /begin REF_MEASUREMENT /end REF_MEASUREMENT /end GROUP
/begin GROUP SysFricLrng.SysFricLrngMaskVehSpd.Ary1D "MICROSAR RTE" /begin SUB_GROUP /end SUB_GROUP /begin FUNCTION_LIST /end FUNCTION_LIST /begin REF_CHARACTERISTIC SysFricLrng.SysFricLrngMaskVehSpd.Ary1D /end REF_CHARACTERISTIC /begin REF_MEASUREMENT /end REF_MEASUREMENT /end GROUP
/begin GROUP SysFricLrng.SysFricLrngRngCntrThd.Val "MICROSAR RTE" /begin SUB_GROUP /end SUB_GROUP /begin FUNCTION_LIST /end FUNCTION_LIST /begin REF_CHARACTERISTIC SysFricLrng.SysFricLrngRngCntrThd.Val /end REF_CHARACTERISTIC /begin REF_MEASUREMENT /end REF_MEASUREMENT /end GROUP
/begin GROUP SysFricLrng.SysFricLrngTHiLim.Val "MICROSAR RTE" /begin SUB_GROUP /end SUB_GROUP /begin FUNCTION_LIST /end FUNCTION_LIST /begin REF_CHARACTERISTIC SysFricLrng.SysFricLrngTHiLim.Val /end REF_CHARACTERISTIC /begin REF_MEASUREMENT /end REF_MEASUREMENT /end GROUP
/begin GROUP SysFricLrng.SysFricLrngTLoLim.Val "MICROSAR RTE" /begin SUB_GROUP /end SUB_GROUP /begin FUNCTION_LIST /end FUNCTION_LIST /begin REF_CHARACTERISTIC SysFricLrng.SysFricLrngTLoLim.Val /end REF_CHARACTERISTIC /begin REF_MEASUREMENT /end REF_MEASUREMENT /end GROUP
/begin GROUP SysFricLrng.SysFricLrngThd.Val "MICROSAR RTE" /begin SUB_GROUP /end SUB_GROUP /begin FUNCTION_LIST /end FUNCTION_LIST /begin REF_CHARACTERISTIC SysFricLrng.SysFricLrngThd.Val /end REF_CHARACTERISTIC /begin REF_MEASUREMENT /end REF_MEASUREMENT /end GROUP
/begin GROUP SysFricLrng.SysFricLrngVehSpd.Ary2D "MICROSAR RTE" /begin SUB_GROUP /end SUB_GROUP /begin FUNCTION_LIST /end FUNCTION_LIST /begin REF_CHARACTERISTIC SysFricLrng.SysFricLrngVehSpd.Ary2D /end REF_CHARACTERISTIC /begin REF_MEASUREMENT /end REF_MEASUREMENT /end GROUP
/begin GROUP SysFricLrng.SysFricOffs.Val "MICROSAR RTE" /begin SUB_GROUP /end SUB_GROUP /begin FUNCTION_LIST /end FUNCTION_LIST /begin REF_CHARACTERISTIC /end REF_CHARACTERISTIC /begin REF_MEASUREMENT SysFricLrng.SysFricOffs.Val /end REF_MEASUREMENT /end GROUP
/begin GROUP SysFricLrng.SysSatnFricEstimd.Val "MICROSAR RTE" /begin SUB_GROUP /end SUB_GROUP /begin FUNCTION_LIST /end FUNCTION_LIST /begin REF_CHARACTERISTIC /end REF_CHARACTERISTIC /begin REF_MEASUREMENT SysFricLrng.SysSatnFricEstimd.Val /end REF_MEASUREMENT /end GROUP
/begin GROUP SysFricLrng.VehBasLineFric "MICROSAR RTE" /begin SUB_GROUP /end SUB_GROUP /begin FUNCTION_LIST /end FUNCTION_LIST /begin REF_CHARACTERISTIC /end REF_CHARACTERISTIC /begin REF_MEASUREMENT SysFricLrng.VehBasLineFric /end REF_MEASUREMENT /end GROUP
/begin GROUP SysFricLrng.VehLatA.Val "MICROSAR RTE" /begin SUB_GROUP /end SUB_GROUP /begin FUNCTION_LIST /end FUNCTION_LIST /begin REF_CHARACTERISTIC /end REF_CHARACTERISTIC /begin REF_MEASUREMENT SysFricLrng.VehLatA.Val /end REF_MEASUREMENT /end GROUP
/begin GROUP SysFricLrng.VehSpd.Val "MICROSAR RTE" /begin SUB_GROUP /end SUB_GROUP /begin FUNCTION_LIST /end FUNCTION_LIST /begin REF_CHARACTERISTIC /end REF_CHARACTERISTIC /begin REF_MEASUREMENT SysFricLrng.VehSpd.Val /end REF_MEASUREMENT /end GROUP
/begin GROUP SysFricLrng.VehSpdLpFil "MICROSAR RTE" /begin SUB_GROUP /end SUB_GROUP /begin FUNCTION_LIST /end FUNCTION_LIST /begin REF_CHARACTERISTIC /end REF_CHARACTERISTIC
 /begin REF_MEASUREMENT SysFricLrng.VehSpdLpFil.FilGain SysFricLrng.VehSpdLpFil.FilSt /end REF_MEASUREMENT
/end GROUP
/begin GROUP SysFricLrng.VehSpdVld.Logl "MICROSAR RTE" /begin SUB_GROUP /end SUB_GROUP /begin FUNCTION_LIST /end FUNCTION_LIST /begin REF_CHARACTERISTIC /end REF_CHARACTERISTIC /begin REF_MEASUREMENT SysFricLrng.VehSpdVld.Logl /end REF_MEASUREMENT /end GROUP
/begin GROUP SysStMod "MICROSAR RTE"
 /begin SUB_GROUP SysStMod.PerInstanceMemories SysStMod.ReceiverPorts SysStMod.SenderPorts /end SUB_GROUP
 /begin FUNCTION_LIST /end FUNCTION_LIST
 /begin REF_CHARACTERISTIC /end REF_CHARACTERISTIC
 /begin REF_MEASUREMENT /end REF_MEASUREMENT
/end GROUP
/begin GROUP SysStMod.PerInstanceMemories "MICROSAR RTE" /begin SUB_GROUP SysStMod.SysStModPrevSysSt SysStMod.dSysStModTranVect /end SUB_GROUP /begin FUNCTION_LIST /end FUNCTION_LIST /begin REF_CHARACTERISTIC /end REF_CHARACTERISTIC /begin REF_MEASUREMENT /end REF_MEASUREMENT /end GROUP
/begin GROUP SysStMod.PwrSplyEnaReq.Logl "MICROSAR RTE" /begin SUB_GROUP /end SUB_GROUP /begin FUNCTION_LIST /end FUNCTION_LIST /begin REF_CHARACTERISTIC /end REF_CHARACTERISTIC /begin REF_MEASUREMENT SysStMod.PwrSplyEnaReq.Logl /end REF_MEASUREMENT /end GROUP
/begin GROUP SysStMod.ReceiverPorts "MICROSAR RTE"
 /begin SUB_GROUP SysStMod.PwrSplyEnaReq.Logl SysStMod.StrtUpSt.Val SysStMod.SysStFltOutpReqDi.Logl SysStMod.SysStImdtTranReqOff.Logl SysStMod.SysStReqDi.Logl SysStMod.SysStReqEna.Logl SysStMod.SysStWrmIninCmpl.Logl /end SUB_GROUP
 /begin FUNCTION_LIST /end FUNCTION_LIST
 /begin REF_CHARACTERISTIC /end REF_CHARACTERISTIC
 /begin REF_MEASUREMENT /end REF_MEASUREMENT
/end GROUP
/begin GROUP SysStMod.SenderPorts "MICROSAR RTE" /begin SUB_GROUP SysStMod.SysSt.Val /end SUB_GROUP /begin FUNCTION_LIST /end FUNCTION_LIST /begin REF_CHARACTERISTIC /end REF_CHARACTERISTIC /begin REF_MEASUREMENT /end REF_MEASUREMENT /end GROUP
/begin GROUP SysStMod.StrtUpSt.Val "MICROSAR RTE" /begin SUB_GROUP /end SUB_GROUP /begin FUNCTION_LIST /end FUNCTION_LIST /begin REF_CHARACTERISTIC /end REF_CHARACTERISTIC /begin REF_MEASUREMENT SysStMod.StrtUpSt.Val /end REF_MEASUREMENT /end GROUP
/begin GROUP SysStMod.SysSt.Val "MICROSAR RTE" /begin SUB_GROUP /end SUB_GROUP /begin FUNCTION_LIST /end FUNCTION_LIST /begin REF_CHARACTERISTIC /end REF_CHARACTERISTIC /begin REF_MEASUREMENT SysStMod.SysSt.Val /end REF_MEASUREMENT /end GROUP
/begin GROUP SysStMod.SysStFltOutpReqDi.Logl "MICROSAR RTE" /begin SUB_GROUP /end SUB_GROUP /begin FUNCTION_LIST /end FUNCTION_LIST /begin REF_CHARACTERISTIC /end REF_CHARACTERISTIC /begin REF_MEASUREMENT SysStMod.SysStFltOutpReqDi.Logl /end REF_MEASUREMENT /end GROUP
/begin GROUP SysStMod.SysStImdtTranReqOff.Logl "MICROSAR RTE" /begin SUB_GROUP /end SUB_GROUP /begin FUNCTION_LIST /end FUNCTION_LIST /begin REF_CHARACTERISTIC /end REF_CHARACTERISTIC /begin REF_MEASUREMENT SysStMod.SysStImdtTranReqOff.Logl /end REF_MEASUREMENT /end GROUP
/begin GROUP SysStMod.SysStModPrevSysSt "MICROSAR RTE" /begin SUB_GROUP /end SUB_GROUP /begin FUNCTION_LIST /end FUNCTION_LIST /begin REF_CHARACTERISTIC /end REF_CHARACTERISTIC /begin REF_MEASUREMENT SysStMod.SysStModPrevSysSt /end REF_MEASUREMENT /end GROUP
/begin GROUP SysStMod.SysStReqDi.Logl "MICROSAR RTE" /begin SUB_GROUP /end SUB_GROUP /begin FUNCTION_LIST /end FUNCTION_LIST /begin REF_CHARACTERISTIC /end REF_CHARACTERISTIC /begin REF_MEASUREMENT SysStMod.SysStReqDi.Logl /end REF_MEASUREMENT /end GROUP
/begin GROUP SysStMod.SysStReqEna.Logl "MICROSAR RTE" /begin SUB_GROUP /end SUB_GROUP /begin FUNCTION_LIST /end FUNCTION_LIST /begin REF_CHARACTERISTIC /end REF_CHARACTERISTIC /begin REF_MEASUREMENT SysStMod.SysStReqEna.Logl /end REF_MEASUREMENT /end GROUP
/begin GROUP SysStMod.SysStWrmIninCmpl.Logl "MICROSAR RTE" /begin SUB_GROUP /end SUB_GROUP /begin FUNCTION_LIST /end FUNCTION_LIST /begin REF_CHARACTERISTIC /end REF_CHARACTERISTIC /begin REF_MEASUREMENT SysStMod.SysStWrmIninCmpl.Logl /end REF_MEASUREMENT /end GROUP
/begin GROUP SysStMod.dSysStModTranVect "MICROSAR RTE" /begin SUB_GROUP /end SUB_GROUP /begin FUNCTION_LIST /end FUNCTION_LIST /begin REF_CHARACTERISTIC /end REF_CHARACTERISTIC /begin REF_MEASUREMENT SysStMod.dSysStModTranVect /end REF_MEASUREMENT /end GROUP
/begin GROUP TEstimn "MICROSAR RTE"
 /begin SUB_GROUP TEstimn.CalibrationPorts TEstimn.PerInstanceMemories TEstimn.ReceiverPorts TEstimn.SenderPorts /end SUB_GROUP
 /begin FUNCTION_LIST /end FUNCTION_LIST
 /begin REF_CHARACTERISTIC /end REF_CHARACTERISTIC
 /begin REF_MEASUREMENT /end REF_MEASUREMENT
/end GROUP
/begin GROUP TEstimn.AmbT.Val "MICROSAR RTE" /begin SUB_GROUP /end SUB_GROUP /begin FUNCTION_LIST /end FUNCTION_LIST /begin REF_CHARACTERISTIC /end REF_CHARACTERISTIC /begin REF_MEASUREMENT TEstimn.AmbT.Val /end REF_MEASUREMENT /end GROUP
/begin GROUP TEstimn.AmbTVld.Logl "MICROSAR RTE" /begin SUB_GROUP /end SUB_GROUP /begin FUNCTION_LIST /end FUNCTION_LIST /begin REF_CHARACTERISTIC /end REF_CHARACTERISTIC /begin REF_MEASUREMENT TEstimn.AmbTVld.Logl /end REF_MEASUREMENT /end GROUP
/begin GROUP TEstimn.AmbTVldPrev "MICROSAR RTE" /begin SUB_GROUP /end SUB_GROUP /begin FUNCTION_LIST /end FUNCTION_LIST /begin REF_CHARACTERISTIC /end REF_CHARACTERISTIC /begin REF_MEASUREMENT TEstimn.AmbTVldPrev /end REF_MEASUREMENT /end GROUP
/begin GROUP TEstimn.AssiMechFilLp "MICROSAR RTE" /begin SUB_GROUP /end SUB_GROUP /begin FUNCTION_LIST /end FUNCTION_LIST /begin REF_CHARACTERISTIC /end REF_CHARACTERISTIC /begin REF_MEASUREMENT TEstimn.AssiMechFilLp.FilGain TEstimn.AssiMechFilLp.FilSt /end REF_MEASUREMENT /end GROUP
/begin GROUP TEstimn.AssiMechT.Val "MICROSAR RTE" /begin SUB_GROUP /end SUB_GROUP /begin FUNCTION_LIST /end FUNCTION_LIST /begin REF_CHARACTERISTIC /end REF_CHARACTERISTIC /begin REF_MEASUREMENT TEstimn.AssiMechT.Val /end REF_MEASUREMENT /end GROUP
/begin GROUP TEstimn.AssiMechTEstimnDi.Logl "MICROSAR RTE" /begin SUB_GROUP /end SUB_GROUP /begin FUNCTION_LIST /end FUNCTION_LIST /begin REF_CHARACTERISTIC /end REF_CHARACTERISTIC /begin REF_MEASUREMENT TEstimn.AssiMechTEstimnDi.Logl /end REF_MEASUREMENT /end GROUP
/begin GROUP TEstimn.AssiMechTEstimnPrev "MICROSAR RTE" /begin SUB_GROUP /end SUB_GROUP /begin FUNCTION_LIST /end FUNCTION_LIST /begin REF_CHARACTERISTIC /end REF_CHARACTERISTIC /begin REF_MEASUREMENT TEstimn.AssiMechTEstimnPrev /end REF_MEASUREMENT /end GROUP
/begin GROUP TEstimn.AssiMechTInitEna "MICROSAR RTE" /begin SUB_GROUP /end SUB_GROUP /begin FUNCTION_LIST /end FUNCTION_LIST /begin REF_CHARACTERISTIC /end REF_CHARACTERISTIC /begin REF_MEASUREMENT TEstimn.AssiMechTInitEna /end REF_MEASUREMENT /end GROUP
/begin GROUP TEstimn.AssiMechTSlewLimPrev "MICROSAR RTE" /begin SUB_GROUP /end SUB_GROUP /begin FUNCTION_LIST /end FUNCTION_LIST /begin REF_CHARACTERISTIC /end REF_CHARACTERISTIC /begin REF_MEASUREMENT TEstimn.AssiMechTSlewLimPrev /end REF_MEASUREMENT /end GROUP
/begin GROUP TEstimn.CalibrationPorts "MICROSAR RTE"
 /begin SUB_GROUP TEstimn.TEstimnAmbPwrMplr.Val TEstimn.TEstimnAmbTSca.Val TEstimn.TEstimnAssiMechAmbLpFilFrq.Val TEstimn.TEstimnAssiMechAmbMplr.Val TEstimn.TEstimnAssiMechCorrLim.Val TEstimn.TEstimnAssiMechDampgSca.Val TEstimn.TEstimnAssiMechDftT.Val TEstimn.TEstimnAssiMechLLFilCoeffA1.Val TEstimn.TEstimnAssiMechLLFilCoeffB0.Val TEstimn.TEstimnAssiMechLLFilCoeffB1.Val TEstimn.TEstimnAssiMechSlew.Val TEstimn.TEstimnCorrnTAssiMech.Val TEstimn.TEstimnCorrnTCu.Val TEstimn.TEstimnCorrnTMag.Val TEstimn.TEstimnCorrnTSi.Val TEstimn.TEstimnCuAmbLpFilFrq.Val TEstimn.TEstimnCuAmbMplr.Val TEstimn.TEstimnCuCorrnLim.Val TEstimn.TEstimnCuLLFilCoeffA1.Val TEstimn.TEstimnCuLLFilCoeffB0.Val TEstimn.TEstimnCuLLFilCoeffB1.Val TEstimn.TEstimnEngTSca.Val TEstimn.TEstimnMagAmbLpFilFrq.Val TEstimn.TEstimnMagAmbMplr.Val TEstimn.TEstimnMagCorrnLim.Val TEstimn.TEstimnMagLLFilCoeffA1.Val TEstimn.TEstimnMagLLFilCoeffB0.Val TEstimn.TEstimnMagLLFilCoeffB1.Val TEstimn.TEstimnSiAmbLpFilFrq.Val TEstimn.TEstimnSiAmbMplr.Val TEstimn.TEstimnSiCorrnLim.Val TEstimn.TEstimnSiLLFilCoeffA1.Val TEstimn.TEstimnSiLLFilCoeffB0.Val TEstimn.TEstimnSiLLFilCoeffB1.Val TEstimn.TEstimnWghtAvrgTDi.Logl /end SUB_GROUP
 /begin FUNCTION_LIST /end FUNCTION_LIST
 /begin REF_CHARACTERISTIC /end REF_CHARACTERISTIC
 /begin REF_MEASUREMENT /end REF_MEASUREMENT
/end GROUP
/begin GROUP TEstimn.CuFilLp "MICROSAR RTE" /begin SUB_GROUP /end SUB_GROUP /begin FUNCTION_LIST /end FUNCTION_LIST /begin REF_CHARACTERISTIC /end REF_CHARACTERISTIC /begin REF_MEASUREMENT TEstimn.CuFilLp.FilGain TEstimn.CuFilLp.FilSt /end REF_MEASUREMENT /end GROUP
/begin GROUP TEstimn.CuTEstimnPrev "MICROSAR RTE" /begin SUB_GROUP /end SUB_GROUP /begin FUNCTION_LIST /end FUNCTION_LIST /begin REF_CHARACTERISTIC /end REF_CHARACTERISTIC /begin REF_MEASUREMENT TEstimn.CuTEstimnPrev /end REF_MEASUREMENT /end GROUP
/begin GROUP TEstimn.EcuTFild.Val "MICROSAR RTE" /begin SUB_GROUP /end SUB_GROUP /begin FUNCTION_LIST /end FUNCTION_LIST /begin REF_CHARACTERISTIC /end REF_CHARACTERISTIC /begin REF_MEASUREMENT TEstimn.EcuTFild.Val /end REF_MEASUREMENT /end GROUP
/begin GROUP TEstimn.EngOilT.Val "MICROSAR RTE" /begin SUB_GROUP /end SUB_GROUP /begin FUNCTION_LIST /end FUNCTION_LIST /begin REF_CHARACTERISTIC /end REF_CHARACTERISTIC /begin REF_MEASUREMENT TEstimn.EngOilT.Val /end REF_MEASUREMENT /end GROUP
/begin GROUP TEstimn.EngOilTVld.Logl "MICROSAR RTE" /begin SUB_GROUP /end SUB_GROUP /begin FUNCTION_LIST /end FUNCTION_LIST /begin REF_CHARACTERISTIC /end REF_CHARACTERISTIC /begin REF_MEASUREMENT TEstimn.EngOilTVld.Logl /end REF_MEASUREMENT /end GROUP
/begin GROUP TEstimn.EngOilTVldPrev "MICROSAR RTE" /begin SUB_GROUP /end SUB_GROUP /begin FUNCTION_LIST /end FUNCTION_LIST /begin REF_CHARACTERISTIC /end REF_CHARACTERISTIC /begin REF_MEASUREMENT TEstimn.EngOilTVldPrev /end REF_MEASUREMENT /end GROUP
/begin GROUP TEstimn.HwVel.Val "MICROSAR RTE" /begin SUB_GROUP /end SUB_GROUP /begin FUNCTION_LIST /end FUNCTION_LIST /begin REF_CHARACTERISTIC /end REF_CHARACTERISTIC /begin REF_MEASUREMENT TEstimn.HwVel.Val /end REF_MEASUREMENT /end GROUP
/begin GROUP TEstimn.MagFilLp "MICROSAR RTE" /begin SUB_GROUP /end SUB_GROUP /begin FUNCTION_LIST /end FUNCTION_LIST /begin REF_CHARACTERISTIC /end REF_CHARACTERISTIC /begin REF_MEASUREMENT TEstimn.MagFilLp.FilGain TEstimn.MagFilLp.FilSt /end REF_MEASUREMENT /end GROUP
/begin GROUP TEstimn.MagTEstimnPrev "MICROSAR RTE" /begin SUB_GROUP /end SUB_GROUP /begin FUNCTION_LIST /end FUNCTION_LIST /begin REF_CHARACTERISTIC /end REF_CHARACTERISTIC /begin REF_MEASUREMENT TEstimn.MagTEstimnPrev /end REF_MEASUREMENT /end GROUP
/begin GROUP TEstimn.MotCurrPeakEstimd.Val "MICROSAR RTE" /begin SUB_GROUP /end SUB_GROUP /begin FUNCTION_LIST /end FUNCTION_LIST /begin REF_CHARACTERISTIC /end REF_CHARACTERISTIC /begin REF_MEASUREMENT TEstimn.MotCurrPeakEstimd.Val /end REF_MEASUREMENT /end GROUP
/begin GROUP TEstimn.MotFetT.Val "MICROSAR RTE" /begin SUB_GROUP /end SUB_GROUP /begin FUNCTION_LIST /end FUNCTION_LIST /begin REF_CHARACTERISTIC /end REF_CHARACTERISTIC /begin REF_MEASUREMENT TEstimn.MotFetT.Val /end REF_MEASUREMENT /end GROUP
/begin GROUP TEstimn.MotMagT.Val "MICROSAR RTE" /begin SUB_GROUP /end SUB_GROUP /begin FUNCTION_LIST /end FUNCTION_LIST /begin REF_CHARACTERISTIC /end REF_CHARACTERISTIC /begin REF_MEASUREMENT TEstimn.MotMagT.Val /end REF_MEASUREMENT /end GROUP
/begin GROUP TEstimn.MotWidgT.Val "MICROSAR RTE" /begin SUB_GROUP /end SUB_GROUP /begin FUNCTION_LIST /end FUNCTION_LIST /begin REF_CHARACTERISTIC /end REF_CHARACTERISTIC /begin REF_MEASUREMENT TEstimn.MotWidgT.Val /end REF_MEASUREMENT /end GROUP
/begin GROUP TEstimn.PerInstanceMemories "MICROSAR RTE"
 /begin SUB_GROUP TEstimn.AmbTVldPrev TEstimn.AssiMechFilLp TEstimn.AssiMechTEstimnPrev TEstimn.AssiMechTInitEna TEstimn.AssiMechTSlewLimPrev TEstimn.CuFilLp TEstimn.CuTEstimnPrev TEstimn.EngOilTVldPrev TEstimn.MagFilLp TEstimn.MagTEstimnPrev TEstimn.SiFilLp TEstimn.SiTEstimnPrev TEstimn.dTEstimnAmbPwr TEstimn.dTEstimnAssiMechCorrn TEstimn.dTEstimnAssiMechDampgSca TEstimn.dTEstimnAssiMechFil TEstimn.dTEstimnAssiMechLLFil TEstimn.dTEstimnCuCorrn TEstimn.dTEstimnCuLLFil TEstimn.dTEstimnMagCorrn TEstimn.dTEstimnMagLLFil TEstimn.dTEstimnScadAmbT TEstimn.dTEstimnScadEngT TEstimn.dTEstimnSiCorrn TEstimn.dTEstimnSiLLFilv TEstimn.dTEstimnWghtAvrgT /end SUB_GROUP
 /begin FUNCTION_LIST /end FUNCTION_LIST
 /begin REF_CHARACTERISTIC /end REF_CHARACTERISTIC
 /begin REF_MEASUREMENT /end REF_MEASUREMENT
/end GROUP
/begin GROUP TEstimn.ReceiverPorts "MICROSAR RTE"
 /begin SUB_GROUP TEstimn.AmbT.Val TEstimn.AmbTVld.Logl TEstimn.AssiMechTEstimnDi.Logl TEstimn.EcuTFild.Val TEstimn.EngOilT.Val TEstimn.EngOilTVld.Logl TEstimn.HwVel.Val TEstimn.MotCurrPeakEstimd.Val /end SUB_GROUP
 /begin FUNCTION_LIST /end FUNCTION_LIST
 /begin REF_CHARACTERISTIC /end REF_CHARACTERISTIC
 /begin REF_MEASUREMENT /end REF_MEASUREMENT
/end GROUP
/begin GROUP TEstimn.SenderPorts "MICROSAR RTE"
 /begin SUB_GROUP TEstimn.AssiMechT.Val TEstimn.MotFetT.Val TEstimn.MotMagT.Val TEstimn.MotWidgT.Val /end SUB_GROUP
 /begin FUNCTION_LIST /end FUNCTION_LIST
 /begin REF_CHARACTERISTIC /end REF_CHARACTERISTIC
 /begin REF_MEASUREMENT /end REF_MEASUREMENT
/end GROUP
/begin GROUP TEstimn.SiFilLp "MICROSAR RTE" /begin SUB_GROUP /end SUB_GROUP /begin FUNCTION_LIST /end FUNCTION_LIST /begin REF_CHARACTERISTIC /end REF_CHARACTERISTIC /begin REF_MEASUREMENT TEstimn.SiFilLp.FilGain TEstimn.SiFilLp.FilSt /end REF_MEASUREMENT /end GROUP
/begin GROUP TEstimn.SiTEstimnPrev "MICROSAR RTE" /begin SUB_GROUP /end SUB_GROUP /begin FUNCTION_LIST /end FUNCTION_LIST /begin REF_CHARACTERISTIC /end REF_CHARACTERISTIC /begin REF_MEASUREMENT TEstimn.SiTEstimnPrev /end REF_MEASUREMENT /end GROUP
/begin GROUP TEstimn.TEstimnAmbPwrMplr.Val "MICROSAR RTE" /begin SUB_GROUP /end SUB_GROUP /begin FUNCTION_LIST /end FUNCTION_LIST /begin REF_CHARACTERISTIC TEstimn.TEstimnAmbPwrMplr.Val /end REF_CHARACTERISTIC /begin REF_MEASUREMENT /end REF_MEASUREMENT /end GROUP
/begin GROUP TEstimn.TEstimnAmbTSca.Val "MICROSAR RTE" /begin SUB_GROUP /end SUB_GROUP /begin FUNCTION_LIST /end FUNCTION_LIST /begin REF_CHARACTERISTIC TEstimn.TEstimnAmbTSca.Val /end REF_CHARACTERISTIC /begin REF_MEASUREMENT /end REF_MEASUREMENT /end GROUP
/begin GROUP TEstimn.TEstimnAssiMechAmbLpFilFrq.Val "MICROSAR RTE" /begin SUB_GROUP /end SUB_GROUP /begin FUNCTION_LIST /end FUNCTION_LIST /begin REF_CHARACTERISTIC TEstimn.TEstimnAssiMechAmbLpFilFrq.Val /end REF_CHARACTERISTIC /begin REF_MEASUREMENT /end REF_MEASUREMENT /end GROUP
/begin GROUP TEstimn.TEstimnAssiMechAmbMplr.Val "MICROSAR RTE" /begin SUB_GROUP /end SUB_GROUP /begin FUNCTION_LIST /end FUNCTION_LIST /begin REF_CHARACTERISTIC TEstimn.TEstimnAssiMechAmbMplr.Val /end REF_CHARACTERISTIC /begin REF_MEASUREMENT /end REF_MEASUREMENT /end GROUP
/begin GROUP TEstimn.TEstimnAssiMechCorrLim.Val "MICROSAR RTE" /begin SUB_GROUP /end SUB_GROUP /begin FUNCTION_LIST /end FUNCTION_LIST /begin REF_CHARACTERISTIC TEstimn.TEstimnAssiMechCorrLim.Val /end REF_CHARACTERISTIC /begin REF_MEASUREMENT /end REF_MEASUREMENT /end GROUP
/begin GROUP TEstimn.TEstimnAssiMechDampgSca.Val "MICROSAR RTE" /begin SUB_GROUP /end SUB_GROUP /begin FUNCTION_LIST /end FUNCTION_LIST /begin REF_CHARACTERISTIC TEstimn.TEstimnAssiMechDampgSca.Val /end REF_CHARACTERISTIC /begin REF_MEASUREMENT /end REF_MEASUREMENT /end GROUP
/begin GROUP TEstimn.TEstimnAssiMechDftT.Val "MICROSAR RTE" /begin SUB_GROUP /end SUB_GROUP /begin FUNCTION_LIST /end FUNCTION_LIST /begin REF_CHARACTERISTIC TEstimn.TEstimnAssiMechDftT.Val /end REF_CHARACTERISTIC /begin REF_MEASUREMENT /end REF_MEASUREMENT /end GROUP
/begin GROUP TEstimn.TEstimnAssiMechLLFilCoeffA1.Val "MICROSAR RTE" /begin SUB_GROUP /end SUB_GROUP /begin FUNCTION_LIST /end FUNCTION_LIST /begin REF_CHARACTERISTIC TEstimn.TEstimnAssiMechLLFilCoeffA1.Val /end REF_CHARACTERISTIC /begin REF_MEASUREMENT /end REF_MEASUREMENT /end GROUP
/begin GROUP TEstimn.TEstimnAssiMechLLFilCoeffB0.Val "MICROSAR RTE" /begin SUB_GROUP /end SUB_GROUP /begin FUNCTION_LIST /end FUNCTION_LIST /begin REF_CHARACTERISTIC TEstimn.TEstimnAssiMechLLFilCoeffB0.Val /end REF_CHARACTERISTIC /begin REF_MEASUREMENT /end REF_MEASUREMENT /end GROUP
/begin GROUP TEstimn.TEstimnAssiMechLLFilCoeffB1.Val "MICROSAR RTE" /begin SUB_GROUP /end SUB_GROUP /begin FUNCTION_LIST /end FUNCTION_LIST /begin REF_CHARACTERISTIC TEstimn.TEstimnAssiMechLLFilCoeffB1.Val /end REF_CHARACTERISTIC /begin REF_MEASUREMENT /end REF_MEASUREMENT /end GROUP
/begin GROUP TEstimn.TEstimnAssiMechSlew.Val "MICROSAR RTE" /begin SUB_GROUP /end SUB_GROUP /begin FUNCTION_LIST /end FUNCTION_LIST /begin REF_CHARACTERISTIC TEstimn.TEstimnAssiMechSlew.Val /end REF_CHARACTERISTIC /begin REF_MEASUREMENT /end REF_MEASUREMENT /end GROUP
/begin GROUP TEstimn.TEstimnCorrnTAssiMech.Val "MICROSAR RTE" /begin SUB_GROUP /end SUB_GROUP /begin FUNCTION_LIST /end FUNCTION_LIST /begin REF_CHARACTERISTIC TEstimn.TEstimnCorrnTAssiMech.Val /end REF_CHARACTERISTIC /begin REF_MEASUREMENT /end REF_MEASUREMENT /end GROUP
/begin GROUP TEstimn.TEstimnCorrnTCu.Val "MICROSAR RTE" /begin SUB_GROUP /end SUB_GROUP /begin FUNCTION_LIST /end FUNCTION_LIST /begin REF_CHARACTERISTIC TEstimn.TEstimnCorrnTCu.Val /end REF_CHARACTERISTIC /begin REF_MEASUREMENT /end REF_MEASUREMENT /end GROUP
/begin GROUP TEstimn.TEstimnCorrnTMag.Val "MICROSAR RTE" /begin SUB_GROUP /end SUB_GROUP /begin FUNCTION_LIST /end FUNCTION_LIST /begin REF_CHARACTERISTIC TEstimn.TEstimnCorrnTMag.Val /end REF_CHARACTERISTIC /begin REF_MEASUREMENT /end REF_MEASUREMENT /end GROUP
/begin GROUP TEstimn.TEstimnCorrnTSi.Val "MICROSAR RTE" /begin SUB_GROUP /end SUB_GROUP /begin FUNCTION_LIST /end FUNCTION_LIST /begin REF_CHARACTERISTIC TEstimn.TEstimnCorrnTSi.Val /end REF_CHARACTERISTIC /begin REF_MEASUREMENT /end REF_MEASUREMENT /end GROUP
/begin GROUP TEstimn.TEstimnCuAmbLpFilFrq.Val "MICROSAR RTE" /begin SUB_GROUP /end SUB_GROUP /begin FUNCTION_LIST /end FUNCTION_LIST /begin REF_CHARACTERISTIC TEstimn.TEstimnCuAmbLpFilFrq.Val /end REF_CHARACTERISTIC /begin REF_MEASUREMENT /end REF_MEASUREMENT /end GROUP
/begin GROUP TEstimn.TEstimnCuAmbMplr.Val "MICROSAR RTE" /begin SUB_GROUP /end SUB_GROUP /begin FUNCTION_LIST /end FUNCTION_LIST /begin REF_CHARACTERISTIC TEstimn.TEstimnCuAmbMplr.Val /end REF_CHARACTERISTIC /begin REF_MEASUREMENT /end REF_MEASUREMENT /end GROUP
/begin GROUP TEstimn.TEstimnCuCorrnLim.Val "MICROSAR RTE" /begin SUB_GROUP /end SUB_GROUP /begin FUNCTION_LIST /end FUNCTION_LIST /begin REF_CHARACTERISTIC TEstimn.TEstimnCuCorrnLim.Val /end REF_CHARACTERISTIC /begin REF_MEASUREMENT /end REF_MEASUREMENT /end GROUP
/begin GROUP TEstimn.TEstimnCuLLFilCoeffA1.Val "MICROSAR RTE" /begin SUB_GROUP /end SUB_GROUP /begin FUNCTION_LIST /end FUNCTION_LIST /begin REF_CHARACTERISTIC TEstimn.TEstimnCuLLFilCoeffA1.Val /end REF_CHARACTERISTIC /begin REF_MEASUREMENT /end REF_MEASUREMENT /end GROUP
/begin GROUP TEstimn.TEstimnCuLLFilCoeffB0.Val "MICROSAR RTE" /begin SUB_GROUP /end SUB_GROUP /begin FUNCTION_LIST /end FUNCTION_LIST /begin REF_CHARACTERISTIC TEstimn.TEstimnCuLLFilCoeffB0.Val /end REF_CHARACTERISTIC /begin REF_MEASUREMENT /end REF_MEASUREMENT /end GROUP
/begin GROUP TEstimn.TEstimnCuLLFilCoeffB1.Val "MICROSAR RTE" /begin SUB_GROUP /end SUB_GROUP /begin FUNCTION_LIST /end FUNCTION_LIST /begin REF_CHARACTERISTIC TEstimn.TEstimnCuLLFilCoeffB1.Val /end REF_CHARACTERISTIC /begin REF_MEASUREMENT /end REF_MEASUREMENT /end GROUP
/begin GROUP TEstimn.TEstimnEngTSca.Val "MICROSAR RTE" /begin SUB_GROUP /end SUB_GROUP /begin FUNCTION_LIST /end FUNCTION_LIST /begin REF_CHARACTERISTIC TEstimn.TEstimnEngTSca.Val /end REF_CHARACTERISTIC /begin REF_MEASUREMENT /end REF_MEASUREMENT /end GROUP
/begin GROUP TEstimn.TEstimnMagAmbLpFilFrq.Val "MICROSAR RTE" /begin SUB_GROUP /end SUB_GROUP /begin FUNCTION_LIST /end FUNCTION_LIST /begin REF_CHARACTERISTIC TEstimn.TEstimnMagAmbLpFilFrq.Val /end REF_CHARACTERISTIC /begin REF_MEASUREMENT /end REF_MEASUREMENT /end GROUP
/begin GROUP TEstimn.TEstimnMagAmbMplr.Val "MICROSAR RTE" /begin SUB_GROUP /end SUB_GROUP /begin FUNCTION_LIST /end FUNCTION_LIST /begin REF_CHARACTERISTIC TEstimn.TEstimnMagAmbMplr.Val /end REF_CHARACTERISTIC /begin REF_MEASUREMENT /end REF_MEASUREMENT /end GROUP
/begin GROUP TEstimn.TEstimnMagCorrnLim.Val "MICROSAR RTE" /begin SUB_GROUP /end SUB_GROUP /begin FUNCTION_LIST /end FUNCTION_LIST /begin REF_CHARACTERISTIC TEstimn.TEstimnMagCorrnLim.Val /end REF_CHARACTERISTIC /begin REF_MEASUREMENT /end REF_MEASUREMENT /end GROUP
/begin GROUP TEstimn.TEstimnMagLLFilCoeffA1.Val "MICROSAR RTE" /begin SUB_GROUP /end SUB_GROUP /begin FUNCTION_LIST /end FUNCTION_LIST /begin REF_CHARACTERISTIC TEstimn.TEstimnMagLLFilCoeffA1.Val /end REF_CHARACTERISTIC /begin REF_MEASUREMENT /end REF_MEASUREMENT /end GROUP
/begin GROUP TEstimn.TEstimnMagLLFilCoeffB0.Val "MICROSAR RTE" /begin SUB_GROUP /end SUB_GROUP /begin FUNCTION_LIST /end FUNCTION_LIST /begin REF_CHARACTERISTIC TEstimn.TEstimnMagLLFilCoeffB0.Val /end REF_CHARACTERISTIC /begin REF_MEASUREMENT /end REF_MEASUREMENT /end GROUP
/begin GROUP TEstimn.TEstimnMagLLFilCoeffB1.Val "MICROSAR RTE" /begin SUB_GROUP /end SUB_GROUP /begin FUNCTION_LIST /end FUNCTION_LIST /begin REF_CHARACTERISTIC TEstimn.TEstimnMagLLFilCoeffB1.Val /end REF_CHARACTERISTIC /begin REF_MEASUREMENT /end REF_MEASUREMENT /end GROUP
/begin GROUP TEstimn.TEstimnSiAmbLpFilFrq.Val "MICROSAR RTE" /begin SUB_GROUP /end SUB_GROUP /begin FUNCTION_LIST /end FUNCTION_LIST /begin REF_CHARACTERISTIC TEstimn.TEstimnSiAmbLpFilFrq.Val /end REF_CHARACTERISTIC /begin REF_MEASUREMENT /end REF_MEASUREMENT /end GROUP
/begin GROUP TEstimn.TEstimnSiAmbMplr.Val "MICROSAR RTE" /begin SUB_GROUP /end SUB_GROUP /begin FUNCTION_LIST /end FUNCTION_LIST /begin REF_CHARACTERISTIC TEstimn.TEstimnSiAmbMplr.Val /end REF_CHARACTERISTIC /begin REF_MEASUREMENT /end REF_MEASUREMENT /end GROUP
/begin GROUP TEstimn.TEstimnSiCorrnLim.Val "MICROSAR RTE" /begin SUB_GROUP /end SUB_GROUP /begin FUNCTION_LIST /end FUNCTION_LIST /begin REF_CHARACTERISTIC TEstimn.TEstimnSiCorrnLim.Val /end REF_CHARACTERISTIC /begin REF_MEASUREMENT /end REF_MEASUREMENT /end GROUP
/begin GROUP TEstimn.TEstimnSiLLFilCoeffA1.Val "MICROSAR RTE" /begin SUB_GROUP /end SUB_GROUP /begin FUNCTION_LIST /end FUNCTION_LIST /begin REF_CHARACTERISTIC TEstimn.TEstimnSiLLFilCoeffA1.Val /end REF_CHARACTERISTIC /begin REF_MEASUREMENT /end REF_MEASUREMENT /end GROUP
/begin GROUP TEstimn.TEstimnSiLLFilCoeffB0.Val "MICROSAR RTE" /begin SUB_GROUP /end SUB_GROUP /begin FUNCTION_LIST /end FUNCTION_LIST /begin REF_CHARACTERISTIC TEstimn.TEstimnSiLLFilCoeffB0.Val /end REF_CHARACTERISTIC /begin REF_MEASUREMENT /end REF_MEASUREMENT /end GROUP
/begin GROUP TEstimn.TEstimnSiLLFilCoeffB1.Val "MICROSAR RTE" /begin SUB_GROUP /end SUB_GROUP /begin FUNCTION_LIST /end FUNCTION_LIST /begin REF_CHARACTERISTIC TEstimn.TEstimnSiLLFilCoeffB1.Val /end REF_CHARACTERISTIC /begin REF_MEASUREMENT /end REF_MEASUREMENT /end GROUP
/begin GROUP TEstimn.TEstimnWghtAvrgTDi.Logl "MICROSAR RTE" /begin SUB_GROUP /end SUB_GROUP /begin FUNCTION_LIST /end FUNCTION_LIST /begin REF_CHARACTERISTIC TEstimn.TEstimnWghtAvrgTDi.Logl /end REF_CHARACTERISTIC /begin REF_MEASUREMENT /end REF_MEASUREMENT /end GROUP
/begin GROUP TEstimn.dTEstimnAmbPwr "MICROSAR RTE" /begin SUB_GROUP /end SUB_GROUP /begin FUNCTION_LIST /end FUNCTION_LIST /begin REF_CHARACTERISTIC /end REF_CHARACTERISTIC /begin REF_MEASUREMENT TEstimn.dTEstimnAmbPwr /end REF_MEASUREMENT /end GROUP
/begin GROUP TEstimn.dTEstimnAssiMechCorrn "MICROSAR RTE" /begin SUB_GROUP /end SUB_GROUP /begin FUNCTION_LIST /end FUNCTION_LIST /begin REF_CHARACTERISTIC /end REF_CHARACTERISTIC /begin REF_MEASUREMENT TEstimn.dTEstimnAssiMechCorrn /end REF_MEASUREMENT /end GROUP
/begin GROUP TEstimn.dTEstimnAssiMechDampgSca "MICROSAR RTE" /begin SUB_GROUP /end SUB_GROUP /begin FUNCTION_LIST /end FUNCTION_LIST /begin REF_CHARACTERISTIC /end REF_CHARACTERISTIC /begin REF_MEASUREMENT TEstimn.dTEstimnAssiMechDampgSca /end REF_MEASUREMENT /end GROUP
/begin GROUP TEstimn.dTEstimnAssiMechFil "MICROSAR RTE" /begin SUB_GROUP /end SUB_GROUP /begin FUNCTION_LIST /end FUNCTION_LIST /begin REF_CHARACTERISTIC /end REF_CHARACTERISTIC /begin REF_MEASUREMENT TEstimn.dTEstimnAssiMechFil /end REF_MEASUREMENT /end GROUP
/begin GROUP TEstimn.dTEstimnAssiMechLLFil "MICROSAR RTE" /begin SUB_GROUP /end SUB_GROUP /begin FUNCTION_LIST /end FUNCTION_LIST /begin REF_CHARACTERISTIC /end REF_CHARACTERISTIC /begin REF_MEASUREMENT TEstimn.dTEstimnAssiMechLLFil /end REF_MEASUREMENT /end GROUP
/begin GROUP TEstimn.dTEstimnCuCorrn "MICROSAR RTE" /begin SUB_GROUP /end SUB_GROUP /begin FUNCTION_LIST /end FUNCTION_LIST /begin REF_CHARACTERISTIC /end REF_CHARACTERISTIC /begin REF_MEASUREMENT TEstimn.dTEstimnCuCorrn /end REF_MEASUREMENT /end GROUP
/begin GROUP TEstimn.dTEstimnCuLLFil "MICROSAR RTE" /begin SUB_GROUP /end SUB_GROUP /begin FUNCTION_LIST /end FUNCTION_LIST /begin REF_CHARACTERISTIC /end REF_CHARACTERISTIC /begin REF_MEASUREMENT TEstimn.dTEstimnCuLLFil /end REF_MEASUREMENT /end GROUP
/begin GROUP TEstimn.dTEstimnMagCorrn "MICROSAR RTE" /begin SUB_GROUP /end SUB_GROUP /begin FUNCTION_LIST /end FUNCTION_LIST /begin REF_CHARACTERISTIC /end REF_CHARACTERISTIC /begin REF_MEASUREMENT TEstimn.dTEstimnMagCorrn /end REF_MEASUREMENT /end GROUP
/begin GROUP TEstimn.dTEstimnMagLLFil "MICROSAR RTE" /begin SUB_GROUP /end SUB_GROUP /begin FUNCTION_LIST /end FUNCTION_LIST /begin REF_CHARACTERISTIC /end REF_CHARACTERISTIC /begin REF_MEASUREMENT TEstimn.dTEstimnMagLLFil /end REF_MEASUREMENT /end GROUP
/begin GROUP TEstimn.dTEstimnScadAmbT "MICROSAR RTE" /begin SUB_GROUP /end SUB_GROUP /begin FUNCTION_LIST /end FUNCTION_LIST /begin REF_CHARACTERISTIC /end REF_CHARACTERISTIC /begin REF_MEASUREMENT TEstimn.dTEstimnScadAmbT /end REF_MEASUREMENT /end GROUP
/begin GROUP TEstimn.dTEstimnScadEngT "MICROSAR RTE" /begin SUB_GROUP /end SUB_GROUP /begin FUNCTION_LIST /end FUNCTION_LIST /begin REF_CHARACTERISTIC /end REF_CHARACTERISTIC /begin REF_MEASUREMENT TEstimn.dTEstimnScadEngT /end REF_MEASUREMENT /end GROUP
/begin GROUP TEstimn.dTEstimnSiCorrn "MICROSAR RTE" /begin SUB_GROUP /end SUB_GROUP /begin FUNCTION_LIST /end FUNCTION_LIST /begin REF_CHARACTERISTIC /end REF_CHARACTERISTIC /begin REF_MEASUREMENT TEstimn.dTEstimnSiCorrn /end REF_MEASUREMENT /end GROUP
/begin GROUP TEstimn.dTEstimnSiLLFilv "MICROSAR RTE" /begin SUB_GROUP /end SUB_GROUP /begin FUNCTION_LIST /end FUNCTION_LIST /begin REF_CHARACTERISTIC /end REF_CHARACTERISTIC /begin REF_MEASUREMENT TEstimn.dTEstimnSiLLFilv /end REF_MEASUREMENT /end GROUP
/begin GROUP TEstimn.dTEstimnWghtAvrgT "MICROSAR RTE" /begin SUB_GROUP /end SUB_GROUP /begin FUNCTION_LIST /end FUNCTION_LIST /begin REF_CHARACTERISTIC /end REF_CHARACTERISTIC /begin REF_MEASUREMENT TEstimn.dTEstimnWghtAvrgT /end REF_MEASUREMENT /end GROUP
/begin GROUP TmplMonr "MICROSAR RTE"
 /begin SUB_GROUP TmplMonr.PerInstanceMemories TmplMonr.ReceiverPorts TmplMonr.SenderPorts /end SUB_GROUP
 /begin FUNCTION_LIST /end FUNCTION_LIST
 /begin REF_CHARACTERISTIC /end REF_CHARACTERISTIC
 /begin REF_MEASUREMENT /end REF_MEASUREMENT
/end GROUP
/begin GROUP TmplMonr.DiagcStsIvtr1Inactv.Logl "MICROSAR RTE" /begin SUB_GROUP /end SUB_GROUP /begin FUNCTION_LIST /end FUNCTION_LIST /begin REF_CHARACTERISTIC /end REF_CHARACTERISTIC /begin REF_MEASUREMENT TmplMonr.DiagcStsIvtr1Inactv.Logl /end REF_MEASUREMENT /end GROUP
/begin GROUP TmplMonr.DiagcStsIvtr2Inactv.Logl "MICROSAR RTE" /begin SUB_GROUP /end SUB_GROUP /begin FUNCTION_LIST /end FUNCTION_LIST /begin REF_CHARACTERISTIC /end REF_CHARACTERISTIC /begin REF_MEASUREMENT TmplMonr.DiagcStsIvtr2Inactv.Logl /end REF_MEASUREMENT /end GROUP
/begin GROUP TmplMonr.PerInstanceMemories "MICROSAR RTE"
 /begin SUB_GROUP TmplMonr.TmplMonrIninCntr TmplMonr.TmplMonrIninTestCmplFlg TmplMonr.TmplMonrNtc40PrmByte TmplMonr.TmplMonrSpiReadWrOrderFlg1 TmplMonr.TmplMonrSpiReadWrOrderFlg2 TmplMonr.TmplMonrWdgRstrtCnt /end SUB_GROUP
 /begin FUNCTION_LIST /end FUNCTION_LIST
 /begin REF_CHARACTERISTIC /end REF_CHARACTERISTIC
 /begin REF_MEASUREMENT /end REF_MEASUREMENT
/end GROUP
/begin GROUP TmplMonr.ReceiverPorts "MICROSAR RTE"
 /begin SUB_GROUP TmplMonr.DiagcStsIvtr1Inactv.Logl TmplMonr.DiagcStsIvtr2Inactv.Logl TmplMonr.StrtUpSt.Val /end SUB_GROUP
 /begin FUNCTION_LIST /end FUNCTION_LIST
 /begin REF_CHARACTERISTIC /end REF_CHARACTERISTIC
 /begin REF_MEASUREMENT /end REF_MEASUREMENT
/end GROUP
/begin GROUP TmplMonr.SenderPorts "MICROSAR RTE" /begin SUB_GROUP TmplMonr.TmplMonrIninTestCmpl.Logl /end SUB_GROUP /begin FUNCTION_LIST /end FUNCTION_LIST /begin REF_CHARACTERISTIC /end REF_CHARACTERISTIC /begin REF_MEASUREMENT /end REF_MEASUREMENT /end GROUP
/begin GROUP TmplMonr.StrtUpSt.Val "MICROSAR RTE" /begin SUB_GROUP /end SUB_GROUP /begin FUNCTION_LIST /end FUNCTION_LIST /begin REF_CHARACTERISTIC /end REF_CHARACTERISTIC /begin REF_MEASUREMENT TmplMonr.StrtUpSt.Val /end REF_MEASUREMENT /end GROUP
/begin GROUP TmplMonr.TmplMonrIninCntr "MICROSAR RTE" /begin SUB_GROUP /end SUB_GROUP /begin FUNCTION_LIST /end FUNCTION_LIST /begin REF_CHARACTERISTIC /end REF_CHARACTERISTIC /begin REF_MEASUREMENT TmplMonr.TmplMonrIninCntr /end REF_MEASUREMENT /end GROUP
/begin GROUP TmplMonr.TmplMonrIninTestCmpl.Logl "MICROSAR RTE" /begin SUB_GROUP /end SUB_GROUP /begin FUNCTION_LIST /end FUNCTION_LIST /begin REF_CHARACTERISTIC /end REF_CHARACTERISTIC /begin REF_MEASUREMENT TmplMonr.TmplMonrIninTestCmpl.Logl /end REF_MEASUREMENT /end GROUP
/begin GROUP TmplMonr.TmplMonrIninTestCmplFlg "MICROSAR RTE" /begin SUB_GROUP /end SUB_GROUP /begin FUNCTION_LIST /end FUNCTION_LIST /begin REF_CHARACTERISTIC /end REF_CHARACTERISTIC /begin REF_MEASUREMENT TmplMonr.TmplMonrIninTestCmplFlg /end REF_MEASUREMENT /end GROUP
/begin GROUP TmplMonr.TmplMonrNtc40PrmByte "MICROSAR RTE" /begin SUB_GROUP /end SUB_GROUP /begin FUNCTION_LIST /end FUNCTION_LIST /begin REF_CHARACTERISTIC /end REF_CHARACTERISTIC /begin REF_MEASUREMENT TmplMonr.TmplMonrNtc40PrmByte /end REF_MEASUREMENT /end GROUP
/begin GROUP TmplMonr.TmplMonrSpiReadWrOrderFlg1 "MICROSAR RTE" /begin SUB_GROUP /end SUB_GROUP /begin FUNCTION_LIST /end FUNCTION_LIST /begin REF_CHARACTERISTIC /end REF_CHARACTERISTIC /begin REF_MEASUREMENT TmplMonr.TmplMonrSpiReadWrOrderFlg1 /end REF_MEASUREMENT /end GROUP
/begin GROUP TmplMonr.TmplMonrSpiReadWrOrderFlg2 "MICROSAR RTE" /begin SUB_GROUP /end SUB_GROUP /begin FUNCTION_LIST /end FUNCTION_LIST /begin REF_CHARACTERISTIC /end REF_CHARACTERISTIC /begin REF_MEASUREMENT TmplMonr.TmplMonrSpiReadWrOrderFlg2 /end REF_MEASUREMENT /end GROUP
/begin GROUP TmplMonr.TmplMonrWdgRstrtCnt "MICROSAR RTE" /begin SUB_GROUP /end SUB_GROUP /begin FUNCTION_LIST /end FUNCTION_LIST /begin REF_CHARACTERISTIC /end REF_CHARACTERISTIC /begin REF_MEASUREMENT TmplMonr.TmplMonrWdgRstrtCnt /end REF_MEASUREMENT /end GROUP
/begin GROUP TqLoa "MICROSAR RTE"
 /begin SUB_GROUP TqLoa.CalibrationPorts TqLoa.PerInstanceMemories TqLoa.ReceiverPorts TqLoa.SenderPorts /end SUB_GROUP
 /begin FUNCTION_LIST /end FUNCTION_LIST
 /begin REF_CHARACTERISTIC /end REF_CHARACTERISTIC
 /begin REF_MEASUREMENT /end REF_MEASUREMENT
/end GROUP
/begin GROUP TqLoa.CalibrationPorts "MICROSAR RTE"
 /begin SUB_GROUP TqLoa.TqLoaDrvrTqNom.Val TqLoa.TqLoaMotTqCmdLim.Val TqLoa.TqLoaMotVelAndTqBasdScaFacFallRate.Val TqLoa.TqLoaMotVelAndTqBasdScaFacMax.Val TqLoa.TqLoaMotVelAndTqBasdScaFacMin.Val TqLoa.TqLoaMotVelAndTqBasdScaFacRiseRate.Val TqLoa.TqLoaMotVelMgnThd.Val TqLoa.TqLoaTqCmdLimY.Ary1D TqLoa.TqLoaTqCmdMgnThd.Val TqLoa.TqLoaVehLatADifScaFacFallRate.Val TqLoa.TqLoaVehLatADifScaFacRiseRate.Val TqLoa.TqLoaVehLatADifScaFacX.Ary1D TqLoa.TqLoaVehLatADifScaFacY.Ary2D TqLoa.TqLoaVehLatAEstimnFilFrq.Val TqLoa.TqLoaVehLatAGainY.Ary1D TqLoa.TqLoaVehSpdScaFacX.Ary1D TqLoa.TqLoaVehSpdScaFacY.Ary1D TqLoa.TqLoaVehSpdX.Ary1D TqLoa.TqLoaVehSteerRat.Val TqLoa.TqLoaVehUnderSteerGrdt.Val TqLoa.TqLoaVehWhlBas.Val /end SUB_GROUP
 /begin FUNCTION_LIST /end FUNCTION_LIST
 /begin REF_CHARACTERISTIC /end REF_CHARACTERISTIC
 /begin REF_MEASUREMENT /end REF_MEASUREMENT
/end GROUP
/begin GROUP TqLoa.MotAgLoaMtgtnEna.Logl "MICROSAR RTE" /begin SUB_GROUP /end SUB_GROUP /begin FUNCTION_LIST /end FUNCTION_LIST /begin REF_CHARACTERISTIC /end REF_CHARACTERISTIC /begin REF_MEASUREMENT TqLoa.MotAgLoaMtgtnEna.Logl /end REF_MEASUREMENT /end GROUP
/begin GROUP TqLoa.MotTqCmdPrev "MICROSAR RTE" /begin SUB_GROUP /end SUB_GROUP /begin FUNCTION_LIST /end FUNCTION_LIST /begin REF_CHARACTERISTIC /end REF_CHARACTERISTIC /begin REF_MEASUREMENT TqLoa.MotTqCmdPrev /end REF_MEASUREMENT /end GROUP
/begin GROUP TqLoa.MotVelAndTqBasdScaFacPrev "MICROSAR RTE" /begin SUB_GROUP /end SUB_GROUP /begin FUNCTION_LIST /end FUNCTION_LIST /begin REF_CHARACTERISTIC /end REF_CHARACTERISTIC /begin REF_MEASUREMENT TqLoa.MotVelAndTqBasdScaFacPrev /end REF_MEASUREMENT /end GROUP
/begin GROUP TqLoa.MotVelCrf.Val "MICROSAR RTE" /begin SUB_GROUP /end SUB_GROUP /begin FUNCTION_LIST /end FUNCTION_LIST /begin REF_CHARACTERISTIC /end REF_CHARACTERISTIC /begin REF_MEASUREMENT TqLoa.MotVelCrf.Val /end REF_MEASUREMENT /end GROUP
/begin GROUP TqLoa.PerInstanceMemories "MICROSAR RTE"
 /begin SUB_GROUP TqLoa.MotTqCmdPrev TqLoa.MotVelAndTqBasdScaFacPrev TqLoa.VehLatADifScaFacPrev TqLoa.VehLatAEstimnFil TqLoa.dTqLoaMotTqCmdPreScag TqLoa.dTqLoaMotVelAndTqBasdScaFac TqLoa.dTqLoaScaFacFinal TqLoa.dTqLoaVehLatADifScaFac TqLoa.dTqLoaVehLatAEstimn TqLoa.dTqLoaVehSpdBasdScaFac /end SUB_GROUP
 /begin FUNCTION_LIST /end FUNCTION_LIST
 /begin REF_CHARACTERISTIC /end REF_CHARACTERISTIC
 /begin REF_MEASUREMENT /end REF_MEASUREMENT
/end GROUP
/begin GROUP TqLoa.PinionAg.Val "MICROSAR RTE" /begin SUB_GROUP /end SUB_GROUP /begin FUNCTION_LIST /end FUNCTION_LIST /begin REF_CHARACTERISTIC /end REF_CHARACTERISTIC /begin REF_MEASUREMENT TqLoa.PinionAg.Val /end REF_MEASUREMENT /end GROUP
/begin GROUP TqLoa.PinionAgConf.Val "MICROSAR RTE" /begin SUB_GROUP /end SUB_GROUP /begin FUNCTION_LIST /end FUNCTION_LIST /begin REF_CHARACTERISTIC /end REF_CHARACTERISTIC /begin REF_MEASUREMENT TqLoa.PinionAgConf.Val /end REF_MEASUREMENT /end GROUP
/begin GROUP TqLoa.ReceiverPorts "MICROSAR RTE"
 /begin SUB_GROUP TqLoa.MotAgLoaMtgtnEna.Logl TqLoa.MotVelCrf.Val TqLoa.PinionAg.Val TqLoa.PinionAgConf.Val TqLoa.VehLatA.Val TqLoa.VehLatAVld.Logl TqLoa.VehSpd.Val TqLoa.VehSpdVld.Logl /end SUB_GROUP
 /begin FUNCTION_LIST /end FUNCTION_LIST
 /begin REF_CHARACTERISTIC /end REF_CHARACTERISTIC
 /begin REF_MEASUREMENT /end REF_MEASUREMENT
/end GROUP
/begin GROUP TqLoa.SenderPorts "MICROSAR RTE" /begin SUB_GROUP TqLoa.TqLoaAvl.Logl TqLoa.TqLoaCmd.Val /end SUB_GROUP /begin FUNCTION_LIST /end FUNCTION_LIST /begin REF_CHARACTERISTIC /end REF_CHARACTERISTIC /begin REF_MEASUREMENT /end REF_MEASUREMENT /end GROUP
/begin GROUP TqLoa.TqLoaAvl.Logl "MICROSAR RTE" /begin SUB_GROUP /end SUB_GROUP /begin FUNCTION_LIST /end FUNCTION_LIST /begin REF_CHARACTERISTIC /end REF_CHARACTERISTIC /begin REF_MEASUREMENT TqLoa.TqLoaAvl.Logl /end REF_MEASUREMENT /end GROUP
/begin GROUP TqLoa.TqLoaCmd.Val "MICROSAR RTE" /begin SUB_GROUP /end SUB_GROUP /begin FUNCTION_LIST /end FUNCTION_LIST /begin REF_CHARACTERISTIC /end REF_CHARACTERISTIC /begin REF_MEASUREMENT TqLoa.TqLoaCmd.Val /end REF_MEASUREMENT /end GROUP
/begin GROUP TqLoa.TqLoaDrvrTqNom.Val "MICROSAR RTE" /begin SUB_GROUP /end SUB_GROUP /begin FUNCTION_LIST /end FUNCTION_LIST /begin REF_CHARACTERISTIC TqLoa.TqLoaDrvrTqNom.Val /end REF_CHARACTERISTIC /begin REF_MEASUREMENT /end REF_MEASUREMENT /end GROUP
/begin GROUP TqLoa.TqLoaMotTqCmdLim.Val "MICROSAR RTE" /begin SUB_GROUP /end SUB_GROUP /begin FUNCTION_LIST /end FUNCTION_LIST /begin REF_CHARACTERISTIC TqLoa.TqLoaMotTqCmdLim.Val /end REF_CHARACTERISTIC /begin REF_MEASUREMENT /end REF_MEASUREMENT /end GROUP
/begin GROUP TqLoa.TqLoaMotVelAndTqBasdScaFacFallRate.Val "MICROSAR RTE" /begin SUB_GROUP /end SUB_GROUP /begin FUNCTION_LIST /end FUNCTION_LIST /begin REF_CHARACTERISTIC TqLoa.TqLoaMotVelAndTqBasdScaFacFallRate.Val /end REF_CHARACTERISTIC /begin REF_MEASUREMENT /end REF_MEASUREMENT /end GROUP
/begin GROUP TqLoa.TqLoaMotVelAndTqBasdScaFacMax.Val "MICROSAR RTE" /begin SUB_GROUP /end SUB_GROUP /begin FUNCTION_LIST /end FUNCTION_LIST /begin REF_CHARACTERISTIC TqLoa.TqLoaMotVelAndTqBasdScaFacMax.Val /end REF_CHARACTERISTIC /begin REF_MEASUREMENT /end REF_MEASUREMENT /end GROUP
/begin GROUP TqLoa.TqLoaMotVelAndTqBasdScaFacMin.Val "MICROSAR RTE" /begin SUB_GROUP /end SUB_GROUP /begin FUNCTION_LIST /end FUNCTION_LIST /begin REF_CHARACTERISTIC TqLoa.TqLoaMotVelAndTqBasdScaFacMin.Val /end REF_CHARACTERISTIC /begin REF_MEASUREMENT /end REF_MEASUREMENT /end GROUP
/begin GROUP TqLoa.TqLoaMotVelAndTqBasdScaFacRiseRate.Val "MICROSAR RTE" /begin SUB_GROUP /end SUB_GROUP /begin FUNCTION_LIST /end FUNCTION_LIST /begin REF_CHARACTERISTIC TqLoa.TqLoaMotVelAndTqBasdScaFacRiseRate.Val /end REF_CHARACTERISTIC /begin REF_MEASUREMENT /end REF_MEASUREMENT /end GROUP
/begin GROUP TqLoa.TqLoaMotVelMgnThd.Val "MICROSAR RTE" /begin SUB_GROUP /end SUB_GROUP /begin FUNCTION_LIST /end FUNCTION_LIST /begin REF_CHARACTERISTIC TqLoa.TqLoaMotVelMgnThd.Val /end REF_CHARACTERISTIC /begin REF_MEASUREMENT /end REF_MEASUREMENT /end GROUP
/begin GROUP TqLoa.TqLoaTqCmdLimY.Ary1D "MICROSAR RTE" /begin SUB_GROUP /end SUB_GROUP /begin FUNCTION_LIST /end FUNCTION_LIST /begin REF_CHARACTERISTIC TqLoa.TqLoaTqCmdLimY.Ary1D /end REF_CHARACTERISTIC /begin REF_MEASUREMENT /end REF_MEASUREMENT /end GROUP
/begin GROUP TqLoa.TqLoaTqCmdMgnThd.Val "MICROSAR RTE" /begin SUB_GROUP /end SUB_GROUP /begin FUNCTION_LIST /end FUNCTION_LIST /begin REF_CHARACTERISTIC TqLoa.TqLoaTqCmdMgnThd.Val /end REF_CHARACTERISTIC /begin REF_MEASUREMENT /end REF_MEASUREMENT /end GROUP
/begin GROUP TqLoa.TqLoaVehLatADifScaFacFallRate.Val "MICROSAR RTE" /begin SUB_GROUP /end SUB_GROUP /begin FUNCTION_LIST /end FUNCTION_LIST /begin REF_CHARACTERISTIC TqLoa.TqLoaVehLatADifScaFacFallRate.Val /end REF_CHARACTERISTIC /begin REF_MEASUREMENT /end REF_MEASUREMENT /end GROUP
/begin GROUP TqLoa.TqLoaVehLatADifScaFacRiseRate.Val "MICROSAR RTE" /begin SUB_GROUP /end SUB_GROUP /begin FUNCTION_LIST /end FUNCTION_LIST /begin REF_CHARACTERISTIC TqLoa.TqLoaVehLatADifScaFacRiseRate.Val /end REF_CHARACTERISTIC /begin REF_MEASUREMENT /end REF_MEASUREMENT /end GROUP
/begin GROUP TqLoa.TqLoaVehLatADifScaFacX.Ary1D "MICROSAR RTE" /begin SUB_GROUP /end SUB_GROUP /begin FUNCTION_LIST /end FUNCTION_LIST /begin REF_CHARACTERISTIC TqLoa.TqLoaVehLatADifScaFacX.Ary1D /end REF_CHARACTERISTIC /begin REF_MEASUREMENT /end REF_MEASUREMENT /end GROUP
/begin GROUP TqLoa.TqLoaVehLatADifScaFacY.Ary2D "MICROSAR RTE" /begin SUB_GROUP /end SUB_GROUP /begin FUNCTION_LIST /end FUNCTION_LIST /begin REF_CHARACTERISTIC TqLoa.TqLoaVehLatADifScaFacY.Ary2D /end REF_CHARACTERISTIC /begin REF_MEASUREMENT /end REF_MEASUREMENT /end GROUP
/begin GROUP TqLoa.TqLoaVehLatAEstimnFilFrq.Val "MICROSAR RTE" /begin SUB_GROUP /end SUB_GROUP /begin FUNCTION_LIST /end FUNCTION_LIST /begin REF_CHARACTERISTIC TqLoa.TqLoaVehLatAEstimnFilFrq.Val /end REF_CHARACTERISTIC /begin REF_MEASUREMENT /end REF_MEASUREMENT /end GROUP
/begin GROUP TqLoa.TqLoaVehLatAGainY.Ary1D "MICROSAR RTE" /begin SUB_GROUP /end SUB_GROUP /begin FUNCTION_LIST /end FUNCTION_LIST /begin REF_CHARACTERISTIC TqLoa.TqLoaVehLatAGainY.Ary1D /end REF_CHARACTERISTIC /begin REF_MEASUREMENT /end REF_MEASUREMENT /end GROUP
/begin GROUP TqLoa.TqLoaVehSpdScaFacX.Ary1D "MICROSAR RTE" /begin SUB_GROUP /end SUB_GROUP /begin FUNCTION_LIST /end FUNCTION_LIST /begin REF_CHARACTERISTIC TqLoa.TqLoaVehSpdScaFacX.Ary1D /end REF_CHARACTERISTIC /begin REF_MEASUREMENT /end REF_MEASUREMENT /end GROUP
/begin GROUP TqLoa.TqLoaVehSpdScaFacY.Ary1D "MICROSAR RTE" /begin SUB_GROUP /end SUB_GROUP /begin FUNCTION_LIST /end FUNCTION_LIST /begin REF_CHARACTERISTIC TqLoa.TqLoaVehSpdScaFacY.Ary1D /end REF_CHARACTERISTIC /begin REF_MEASUREMENT /end REF_MEASUREMENT /end GROUP
/begin GROUP TqLoa.TqLoaVehSpdX.Ary1D "MICROSAR RTE" /begin SUB_GROUP /end SUB_GROUP /begin FUNCTION_LIST /end FUNCTION_LIST /begin REF_CHARACTERISTIC TqLoa.TqLoaVehSpdX.Ary1D /end REF_CHARACTERISTIC /begin REF_MEASUREMENT /end REF_MEASUREMENT /end GROUP
/begin GROUP TqLoa.TqLoaVehSteerRat.Val "MICROSAR RTE" /begin SUB_GROUP /end SUB_GROUP /begin FUNCTION_LIST /end FUNCTION_LIST /begin REF_CHARACTERISTIC TqLoa.TqLoaVehSteerRat.Val /end REF_CHARACTERISTIC /begin REF_MEASUREMENT /end REF_MEASUREMENT /end GROUP
/begin GROUP TqLoa.TqLoaVehUnderSteerGrdt.Val "MICROSAR RTE" /begin SUB_GROUP /end SUB_GROUP /begin FUNCTION_LIST /end FUNCTION_LIST /begin REF_CHARACTERISTIC TqLoa.TqLoaVehUnderSteerGrdt.Val /end REF_CHARACTERISTIC /begin REF_MEASUREMENT /end REF_MEASUREMENT /end GROUP
/begin GROUP TqLoa.TqLoaVehWhlBas.Val "MICROSAR RTE" /begin SUB_GROUP /end SUB_GROUP /begin FUNCTION_LIST /end FUNCTION_LIST /begin REF_CHARACTERISTIC TqLoa.TqLoaVehWhlBas.Val /end REF_CHARACTERISTIC /begin REF_MEASUREMENT /end REF_MEASUREMENT /end GROUP
/begin GROUP TqLoa.VehLatA.Val "MICROSAR RTE" /begin SUB_GROUP /end SUB_GROUP /begin FUNCTION_LIST /end FUNCTION_LIST /begin REF_CHARACTERISTIC /end REF_CHARACTERISTIC /begin REF_MEASUREMENT TqLoa.VehLatA.Val /end REF_MEASUREMENT /end GROUP
/begin GROUP TqLoa.VehLatADifScaFacPrev "MICROSAR RTE" /begin SUB_GROUP /end SUB_GROUP /begin FUNCTION_LIST /end FUNCTION_LIST /begin REF_CHARACTERISTIC /end REF_CHARACTERISTIC /begin REF_MEASUREMENT TqLoa.VehLatADifScaFacPrev /end REF_MEASUREMENT /end GROUP
/begin GROUP TqLoa.VehLatAEstimnFil "MICROSAR RTE" /begin SUB_GROUP /end SUB_GROUP /begin FUNCTION_LIST /end FUNCTION_LIST /begin REF_CHARACTERISTIC /end REF_CHARACTERISTIC
 /begin REF_MEASUREMENT TqLoa.VehLatAEstimnFil.FilGain TqLoa.VehLatAEstimnFil.FilSt /end REF_MEASUREMENT
/end GROUP
/begin GROUP TqLoa.VehLatAVld.Logl "MICROSAR RTE" /begin SUB_GROUP /end SUB_GROUP /begin FUNCTION_LIST /end FUNCTION_LIST /begin REF_CHARACTERISTIC /end REF_CHARACTERISTIC /begin REF_MEASUREMENT TqLoa.VehLatAVld.Logl /end REF_MEASUREMENT /end GROUP
/begin GROUP TqLoa.VehSpd.Val "MICROSAR RTE" /begin SUB_GROUP /end SUB_GROUP /begin FUNCTION_LIST /end FUNCTION_LIST /begin REF_CHARACTERISTIC /end REF_CHARACTERISTIC /begin REF_MEASUREMENT TqLoa.VehSpd.Val /end REF_MEASUREMENT /end GROUP
/begin GROUP TqLoa.VehSpdVld.Logl "MICROSAR RTE" /begin SUB_GROUP /end SUB_GROUP /begin FUNCTION_LIST /end FUNCTION_LIST /begin REF_CHARACTERISTIC /end REF_CHARACTERISTIC /begin REF_MEASUREMENT TqLoa.VehSpdVld.Logl /end REF_MEASUREMENT /end GROUP
/begin GROUP TqLoa.dTqLoaMotTqCmdPreScag "MICROSAR RTE" /begin SUB_GROUP /end SUB_GROUP /begin FUNCTION_LIST /end FUNCTION_LIST /begin REF_CHARACTERISTIC /end REF_CHARACTERISTIC /begin REF_MEASUREMENT TqLoa.dTqLoaMotTqCmdPreScag /end REF_MEASUREMENT /end GROUP
/begin GROUP TqLoa.dTqLoaMotVelAndTqBasdScaFac "MICROSAR RTE" /begin SUB_GROUP /end SUB_GROUP /begin FUNCTION_LIST /end FUNCTION_LIST /begin REF_CHARACTERISTIC /end REF_CHARACTERISTIC /begin REF_MEASUREMENT TqLoa.dTqLoaMotVelAndTqBasdScaFac /end REF_MEASUREMENT /end GROUP
/begin GROUP TqLoa.dTqLoaScaFacFinal "MICROSAR RTE" /begin SUB_GROUP /end SUB_GROUP /begin FUNCTION_LIST /end FUNCTION_LIST /begin REF_CHARACTERISTIC /end REF_CHARACTERISTIC /begin REF_MEASUREMENT TqLoa.dTqLoaScaFacFinal /end REF_MEASUREMENT /end GROUP
/begin GROUP TqLoa.dTqLoaVehLatADifScaFac "MICROSAR RTE" /begin SUB_GROUP /end SUB_GROUP /begin FUNCTION_LIST /end FUNCTION_LIST /begin REF_CHARACTERISTIC /end REF_CHARACTERISTIC /begin REF_MEASUREMENT TqLoa.dTqLoaVehLatADifScaFac /end REF_MEASUREMENT /end GROUP
/begin GROUP TqLoa.dTqLoaVehLatAEstimn "MICROSAR RTE" /begin SUB_GROUP /end SUB_GROUP /begin FUNCTION_LIST /end FUNCTION_LIST /begin REF_CHARACTERISTIC /end REF_CHARACTERISTIC /begin REF_MEASUREMENT TqLoa.dTqLoaVehLatAEstimn /end REF_MEASUREMENT /end GROUP
/begin GROUP TqLoa.dTqLoaVehSpdBasdScaFac "MICROSAR RTE" /begin SUB_GROUP /end SUB_GROUP /begin FUNCTION_LIST /end FUNCTION_LIST /begin REF_CHARACTERISTIC /end REF_CHARACTERISTIC /begin REF_MEASUREMENT TqLoa.dTqLoaVehSpdBasdScaFac /end REF_MEASUREMENT /end GROUP
/begin GROUP TqOscn "MICROSAR RTE"
 /begin SUB_GROUP TqOscn.CalibrationPorts TqOscn.PerInstanceMemories TqOscn.ReceiverPorts TqOscn.SenderPorts /end SUB_GROUP
 /begin FUNCTION_LIST /end FUNCTION_LIST
 /begin REF_CHARACTERISTIC /end REF_CHARACTERISTIC
 /begin REF_MEASUREMENT /end REF_MEASUREMENT
/end GROUP
/begin GROUP TqOscn.AmpRampSt "MICROSAR RTE" /begin SUB_GROUP /end SUB_GROUP /begin FUNCTION_LIST /end FUNCTION_LIST /begin REF_CHARACTERISTIC /end REF_CHARACTERISTIC /begin REF_MEASUREMENT TqOscn.AmpRampSt /end REF_MEASUREMENT /end GROUP
/begin GROUP TqOscn.CalibrationPorts "MICROSAR RTE"
 /begin SUB_GROUP TqOscn.TqOscnAmpLimY.Ary1D TqOscn.TqOscnFallRampRateCal.Val TqOscn.TqOscnFrqIn.Ary1D TqOscn.TqOscnRisngRampRateCal.Val TqOscn.TqOscnUseRampRateCal.Logl /end SUB_GROUP
 /begin FUNCTION_LIST /end FUNCTION_LIST
 /begin REF_CHARACTERISTIC /end REF_CHARACTERISTIC
 /begin REF_MEASUREMENT /end REF_MEASUREMENT
/end GROUP
/begin GROUP TqOscn.HwOscnActv.Logl "MICROSAR RTE" /begin SUB_GROUP /end SUB_GROUP /begin FUNCTION_LIST /end FUNCTION_LIST /begin REF_CHARACTERISTIC /end REF_CHARACTERISTIC /begin REF_MEASUREMENT TqOscn.HwOscnActv.Logl /end REF_MEASUREMENT /end GROUP
/begin GROUP TqOscn.HwOscnCmd.Val "MICROSAR RTE" /begin SUB_GROUP /end SUB_GROUP /begin FUNCTION_LIST /end FUNCTION_LIST /begin REF_CHARACTERISTIC /end REF_CHARACTERISTIC /begin REF_MEASUREMENT TqOscn.HwOscnCmd.Val /end REF_MEASUREMENT /end GROUP
/begin GROUP TqOscn.HwOscnDcThdExcdd.Logl "MICROSAR RTE" /begin SUB_GROUP /end SUB_GROUP /begin FUNCTION_LIST /end FUNCTION_LIST /begin REF_CHARACTERISTIC /end REF_CHARACTERISTIC /begin REF_MEASUREMENT TqOscn.HwOscnDcThdExcdd.Logl /end REF_MEASUREMENT /end GROUP
/begin GROUP TqOscn.HwOscnEna.Logl "MICROSAR RTE" /begin SUB_GROUP /end SUB_GROUP /begin FUNCTION_LIST /end FUNCTION_LIST /begin REF_CHARACTERISTIC /end REF_CHARACTERISTIC /begin REF_MEASUREMENT TqOscn.HwOscnEna.Logl /end REF_MEASUREMENT /end GROUP
/begin GROUP TqOscn.HwOscnFallRampRate.Val "MICROSAR RTE" /begin SUB_GROUP /end SUB_GROUP /begin FUNCTION_LIST /end FUNCTION_LIST /begin REF_CHARACTERISTIC /end REF_CHARACTERISTIC /begin REF_MEASUREMENT TqOscn.HwOscnFallRampRate.Val /end REF_MEASUREMENT /end GROUP
/begin GROUP TqOscn.HwOscnFrq.Val "MICROSAR RTE" /begin SUB_GROUP /end SUB_GROUP /begin FUNCTION_LIST /end FUNCTION_LIST /begin REF_CHARACTERISTIC /end REF_CHARACTERISTIC /begin REF_MEASUREMENT TqOscn.HwOscnFrq.Val /end REF_MEASUREMENT /end GROUP
/begin GROUP TqOscn.HwOscnMotAmp.Val "MICROSAR RTE" /begin SUB_GROUP /end SUB_GROUP /begin FUNCTION_LIST /end FUNCTION_LIST /begin REF_CHARACTERISTIC /end REF_CHARACTERISTIC /begin REF_MEASUREMENT TqOscn.HwOscnMotAmp.Val /end REF_MEASUREMENT /end GROUP
/begin GROUP TqOscn.HwOscnRisngRampRate.Val "MICROSAR RTE" /begin SUB_GROUP /end SUB_GROUP /begin FUNCTION_LIST /end FUNCTION_LIST /begin REF_CHARACTERISTIC /end REF_CHARACTERISTIC /begin REF_MEASUREMENT TqOscn.HwOscnRisngRampRate.Val /end REF_MEASUREMENT /end GROUP
/begin GROUP TqOscn.PerInstanceMemories "MICROSAR RTE"
 /begin SUB_GROUP TqOscn.AmpRampSt TqOscn.PreFinalCmdLpFil TqOscn.PrevActv TqOscn.PrevDcThdExcdd TqOscn.PrevEna TqOscn.PrevFallRampRate TqOscn.PrevLimdAmp TqOscn.PrevPhaAg TqOscn.PrevPhaAgInc TqOscn.PrevRisngRampRate TqOscn.dTqOscnNonZeroAmpFlg TqOscn.dTqOscnPreFinalCmd TqOscn.dTqOscnRateLimdAmp TqOscn.dTqOscnSinCmd /end SUB_GROUP
 /begin FUNCTION_LIST /end FUNCTION_LIST
 /begin REF_CHARACTERISTIC /end REF_CHARACTERISTIC
 /begin REF_MEASUREMENT /end REF_MEASUREMENT
/end GROUP
/begin GROUP TqOscn.PreFinalCmdLpFil "MICROSAR RTE" /begin SUB_GROUP /end SUB_GROUP /begin FUNCTION_LIST /end FUNCTION_LIST /begin REF_CHARACTERISTIC /end REF_CHARACTERISTIC
 /begin REF_MEASUREMENT TqOscn.PreFinalCmdLpFil.FilGain TqOscn.PreFinalCmdLpFil.FilSt /end REF_MEASUREMENT
/end GROUP
/begin GROUP TqOscn.PrevActv "MICROSAR RTE" /begin SUB_GROUP /end SUB_GROUP /begin FUNCTION_LIST /end FUNCTION_LIST /begin REF_CHARACTERISTIC /end REF_CHARACTERISTIC /begin REF_MEASUREMENT TqOscn.PrevActv /end REF_MEASUREMENT /end GROUP
/begin GROUP TqOscn.PrevDcThdExcdd "MICROSAR RTE" /begin SUB_GROUP /end SUB_GROUP /begin FUNCTION_LIST /end FUNCTION_LIST /begin REF_CHARACTERISTIC /end REF_CHARACTERISTIC /begin REF_MEASUREMENT TqOscn.PrevDcThdExcdd /end REF_MEASUREMENT /end GROUP
/begin GROUP TqOscn.PrevEna "MICROSAR RTE" /begin SUB_GROUP /end SUB_GROUP /begin FUNCTION_LIST /end FUNCTION_LIST /begin REF_CHARACTERISTIC /end REF_CHARACTERISTIC /begin REF_MEASUREMENT TqOscn.PrevEna /end REF_MEASUREMENT /end GROUP
/begin GROUP TqOscn.PrevFallRampRate "MICROSAR RTE" /begin SUB_GROUP /end SUB_GROUP /begin FUNCTION_LIST /end FUNCTION_LIST /begin REF_CHARACTERISTIC /end REF_CHARACTERISTIC /begin REF_MEASUREMENT TqOscn.PrevFallRampRate /end REF_MEASUREMENT /end GROUP
/begin GROUP TqOscn.PrevLimdAmp "MICROSAR RTE" /begin SUB_GROUP /end SUB_GROUP /begin FUNCTION_LIST /end FUNCTION_LIST /begin REF_CHARACTERISTIC /end REF_CHARACTERISTIC /begin REF_MEASUREMENT TqOscn.PrevLimdAmp /end REF_MEASUREMENT /end GROUP
/begin GROUP TqOscn.PrevPhaAg "MICROSAR RTE" /begin SUB_GROUP /end SUB_GROUP /begin FUNCTION_LIST /end FUNCTION_LIST /begin REF_CHARACTERISTIC /end REF_CHARACTERISTIC /begin REF_MEASUREMENT TqOscn.PrevPhaAg /end REF_MEASUREMENT /end GROUP
/begin GROUP TqOscn.PrevPhaAgInc "MICROSAR RTE" /begin SUB_GROUP /end SUB_GROUP /begin FUNCTION_LIST /end FUNCTION_LIST /begin REF_CHARACTERISTIC /end REF_CHARACTERISTIC /begin REF_MEASUREMENT TqOscn.PrevPhaAgInc /end REF_MEASUREMENT /end GROUP
/begin GROUP TqOscn.PrevRisngRampRate "MICROSAR RTE" /begin SUB_GROUP /end SUB_GROUP /begin FUNCTION_LIST /end FUNCTION_LIST /begin REF_CHARACTERISTIC /end REF_CHARACTERISTIC /begin REF_MEASUREMENT TqOscn.PrevRisngRampRate /end REF_MEASUREMENT /end GROUP
/begin GROUP TqOscn.ReceiverPorts "MICROSAR RTE"
 /begin SUB_GROUP TqOscn.HwOscnEna.Logl TqOscn.HwOscnFallRampRate.Val TqOscn.HwOscnFrq.Val TqOscn.HwOscnMotAmp.Val TqOscn.HwOscnRisngRampRate.Val /end SUB_GROUP
 /begin FUNCTION_LIST /end FUNCTION_LIST
 /begin REF_CHARACTERISTIC /end REF_CHARACTERISTIC
 /begin REF_MEASUREMENT /end REF_MEASUREMENT
/end GROUP
/begin GROUP TqOscn.SenderPorts "MICROSAR RTE"
 /begin SUB_GROUP TqOscn.HwOscnActv.Logl TqOscn.HwOscnCmd.Val TqOscn.HwOscnDcThdExcdd.Logl /end SUB_GROUP
 /begin FUNCTION_LIST /end FUNCTION_LIST
 /begin REF_CHARACTERISTIC /end REF_CHARACTERISTIC
 /begin REF_MEASUREMENT /end REF_MEASUREMENT
/end GROUP
/begin GROUP TqOscn.TqOscnAmpLimY.Ary1D "MICROSAR RTE" /begin SUB_GROUP /end SUB_GROUP /begin FUNCTION_LIST /end FUNCTION_LIST /begin REF_CHARACTERISTIC TqOscn.TqOscnAmpLimY.Ary1D /end REF_CHARACTERISTIC /begin REF_MEASUREMENT /end REF_MEASUREMENT /end GROUP
/begin GROUP TqOscn.TqOscnFallRampRateCal.Val "MICROSAR RTE" /begin SUB_GROUP /end SUB_GROUP /begin FUNCTION_LIST /end FUNCTION_LIST /begin REF_CHARACTERISTIC TqOscn.TqOscnFallRampRateCal.Val /end REF_CHARACTERISTIC /begin REF_MEASUREMENT /end REF_MEASUREMENT /end GROUP
/begin GROUP TqOscn.TqOscnFrqIn.Ary1D "MICROSAR RTE" /begin SUB_GROUP /end SUB_GROUP /begin FUNCTION_LIST /end FUNCTION_LIST /begin REF_CHARACTERISTIC TqOscn.TqOscnFrqIn.Ary1D /end REF_CHARACTERISTIC /begin REF_MEASUREMENT /end REF_MEASUREMENT /end GROUP
/begin GROUP TqOscn.TqOscnRisngRampRateCal.Val "MICROSAR RTE" /begin SUB_GROUP /end SUB_GROUP /begin FUNCTION_LIST /end FUNCTION_LIST /begin REF_CHARACTERISTIC TqOscn.TqOscnRisngRampRateCal.Val /end REF_CHARACTERISTIC /begin REF_MEASUREMENT /end REF_MEASUREMENT /end GROUP
/begin GROUP TqOscn.TqOscnUseRampRateCal.Logl "MICROSAR RTE" /begin SUB_GROUP /end SUB_GROUP /begin FUNCTION_LIST /end FUNCTION_LIST /begin REF_CHARACTERISTIC TqOscn.TqOscnUseRampRateCal.Logl /end REF_CHARACTERISTIC /begin REF_MEASUREMENT /end REF_MEASUREMENT /end GROUP
/begin GROUP TqOscn.dTqOscnNonZeroAmpFlg "MICROSAR RTE" /begin SUB_GROUP /end SUB_GROUP /begin FUNCTION_LIST /end FUNCTION_LIST /begin REF_CHARACTERISTIC /end REF_CHARACTERISTIC /begin REF_MEASUREMENT TqOscn.dTqOscnNonZeroAmpFlg /end REF_MEASUREMENT /end GROUP
/begin GROUP TqOscn.dTqOscnPreFinalCmd "MICROSAR RTE" /begin SUB_GROUP /end SUB_GROUP /begin FUNCTION_LIST /end FUNCTION_LIST /begin REF_CHARACTERISTIC /end REF_CHARACTERISTIC /begin REF_MEASUREMENT TqOscn.dTqOscnPreFinalCmd /end REF_MEASUREMENT /end GROUP
/begin GROUP TqOscn.dTqOscnRateLimdAmp "MICROSAR RTE" /begin SUB_GROUP /end SUB_GROUP /begin FUNCTION_LIST /end FUNCTION_LIST /begin REF_CHARACTERISTIC /end REF_CHARACTERISTIC /begin REF_MEASUREMENT TqOscn.dTqOscnRateLimdAmp /end REF_MEASUREMENT /end GROUP
/begin GROUP TqOscn.dTqOscnSinCmd "MICROSAR RTE" /begin SUB_GROUP /end SUB_GROUP /begin FUNCTION_LIST /end FUNCTION_LIST /begin REF_CHARACTERISTIC /end REF_CHARACTERISTIC /begin REF_MEASUREMENT TqOscn.dTqOscnSinCmd /end REF_MEASUREMENT /end GROUP
/begin GROUP TunSelnAuthy "MICROSAR RTE" /begin SUB_GROUP TunSelnAuthy.CalibrationPorts TunSelnAuthy.ReceiverPorts /end SUB_GROUP /begin FUNCTION_LIST /end FUNCTION_LIST /begin REF_CHARACTERISTIC /end REF_CHARACTERISTIC /begin REF_MEASUREMENT /end REF_MEASUREMENT /end GROUP
/begin GROUP TunSelnAuthy.CalibrationPorts "MICROSAR RTE"
 /begin SUB_GROUP TunSelnAuthy.TunSelnAuthyHwTqY.Ary1D TunSelnAuthy.TunSelnAuthyHwVelY.Ary1D TunSelnAuthy.TunSelnAuthyTunSelnRtDiCmd.Logl TunSelnAuthy.TunSelnAuthyVehSpdX.Ary1D /end SUB_GROUP
 /begin FUNCTION_LIST /end FUNCTION_LIST
 /begin REF_CHARACTERISTIC /end REF_CHARACTERISTIC
 /begin REF_MEASUREMENT /end REF_MEASUREMENT
/end GROUP
/begin GROUP TunSelnAuthy.HwTq.Val "MICROSAR RTE" /begin SUB_GROUP /end SUB_GROUP /begin FUNCTION_LIST /end FUNCTION_LIST /begin REF_CHARACTERISTIC /end REF_CHARACTERISTIC /begin REF_MEASUREMENT TunSelnAuthy.HwTq.Val /end REF_MEASUREMENT /end GROUP
/begin GROUP TunSelnAuthy.HwVel.Val "MICROSAR RTE" /begin SUB_GROUP /end SUB_GROUP /begin FUNCTION_LIST /end FUNCTION_LIST /begin REF_CHARACTERISTIC /end REF_CHARACTERISTIC /begin REF_MEASUREMENT TunSelnAuthy.HwVel.Val /end REF_MEASUREMENT /end GROUP
/begin GROUP TunSelnAuthy.ReceiverPorts "MICROSAR RTE"
 /begin SUB_GROUP TunSelnAuthy.HwTq.Val TunSelnAuthy.HwVel.Val TunSelnAuthy.TunSelnRtDi.Logl TunSelnAuthy.VehSpd.Val /end SUB_GROUP
 /begin FUNCTION_LIST /end FUNCTION_LIST
 /begin REF_CHARACTERISTIC /end REF_CHARACTERISTIC
 /begin REF_MEASUREMENT /end REF_MEASUREMENT
/end GROUP
/begin GROUP TunSelnAuthy.TunSelnAuthyHwTqY.Ary1D "MICROSAR RTE" /begin SUB_GROUP /end SUB_GROUP /begin FUNCTION_LIST /end FUNCTION_LIST /begin REF_CHARACTERISTIC TunSelnAuthy.TunSelnAuthyHwTqY.Ary1D /end REF_CHARACTERISTIC /begin REF_MEASUREMENT /end REF_MEASUREMENT /end GROUP
/**********************************************************************************************************************
* RECORD_LAYOUT
*********************************************************************************************************************/
/begin RECORD_LAYOUT RTE_RL_UBYTE FNC_VALUES 1 UBYTE ROW_DIR DIRECT /end RECORD_LAYOUT
/begin RECORD_LAYOUT RTE_RL_UWORD FNC_VALUES 1 UWORD ROW_DIR DIRECT /end RECORD_LAYOUT
/begin RECORD_LAYOUT RTE_RL_ULONG FNC_VALUES 1 ULONG ROW_DIR DIRECT /end RECORD_LAYOUT
/begin RECORD_LAYOUT RTE_RL_FLOAT32_IEEE FNC_VALUES 1 FLOAT32_IEEE ROW_DIR DIRECT /end RECORD_LAYOUT
/begin RECORD_LAYOUT RTE_RL_BOOLEAN FNC_VALUES 1 UBYTE ROW_DIR DIRECT /end RECORD_LAYOUT
/**********************************************************************************************************************
* COMPU_METHOD / COMPU_VTAB_RANGE
*********************************************************************************************************************/
/begin COMPU_METHOD RTE_CM_BOOLEAN "" TAB_VERB "%3.1" "" COMPU_TAB_REF RTE_CM_BOOLEAN /end COMPU_METHOD
/begin COMPU_VTAB_RANGE RTE_CM_BOOLEAN "" 2 0 0 "false" 1 255 "true" /end COMPU_VTAB_RANGE
/begin COMPU_METHOD RTE_CM_ENUM_SysSt1 "" TAB_VERB "%.1" "" COMPU_TAB_REF RTE_CM_ENUM_SysSt1 /end COMPU_METHOD
/begin COMPU_VTAB_RANGE RTE_CM_ENUM_SysSt1 "" 4 0 0 "SYSST_DI" 1 1 "SYSST_OFF" 2 2 "SYSST_ENA" 3 3 "SYSST_WRMININ" /end COMPU_VTAB_RANGE
/begin COMPU_METHOD RTE_CM_ENUM_SysFricLrngOperMod1 "" TAB_VERB "%.1" "" COMPU_TAB_REF RTE_CM_ENUM_SysFricLrngOperMod1 /end COMPU_METHOD
/begin COMPU_VTAB_RANGE RTE_CM_ENUM_SysFricLrngOperMod1 "" 5 0 0 "SYSFRICLRNGOPERMOD_CALIBRATION" 1 1 "SYSFRICLRNGOPERMOD_NORMAL" 2 2 "SYSFRICLRNGOPERMOD_CLEAR" 3 3 "SYSFRICLRNGOPERMOD_IDLE" 4 4 "SYSFRICLRNGOPERMOD_BASELINE" /end COMPU_VTAB_RANGE
