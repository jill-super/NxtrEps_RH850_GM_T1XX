/begin CHARACTERISTIC CDD_MotAg0Meas.MotAg0CoeffTblDft "MICROSAR RTE" VAL_BLK 0x0 RTE_RL_FLOAT32_IEEE 0 NO_COMPU_METHOD -3.402823466e+38 3.402823466e+38 MATRIX_DIM 26 1 1 SYMBOL_LINK "Rte_CalprmRom_CDD_MotAg0Meas_DEFAULT_RTE_CDATA_GROUP.MotAg0CoeffTblDft" 0 DISPLAY_IDENTIFIER CDD_MotAg0Meas.CalibrationParameters.MotAg0CoeffTblDft /end CHARACTERISTIC
/begin CHARACTERISTIC CDD_MotAg1Meas.MotAg1CoeffTblDft "MICROSAR RTE" VAL_BLK 0x0 RTE_RL_FLOAT32_IEEE 0 NO_COMPU_METHOD -3.402823466e+38 3.402823466e+38 MATRIX_DIM 26 1 1 SYMBOL_LINK "Rte_CalprmRom_CDD_MotAg1Meas_DEFAULT_RTE_CDATA_GROUP.MotAg1CoeffTblDft" 0 DISPLAY_IDENTIFIER CDD_MotAg1Meas.CalibrationParameters.MotAg1CoeffTblDft /end CHARACTERISTIC
/begin CHARACTERISTIC CDD_MotAgCmp.MotAgCmpMotAgBackEmfDft "MICROSAR RTE" VALUE 0x0 RTE_RL_UWORD 0 RTE_CM_Ag9 0 0.9999847412 SYMBOL_LINK "Rte_CalprmRom_CDD_MotAgCmp_DEFAULT_RTE_CDATA_GROUP.MotAgCmpMotAgBackEmfDft" 0 DISPLAY_IDENTIFIER CDD_MotAgCmp.CalibrationParameters.MotAgCmpMotAgBackEmfDft /end CHARACTERISTIC
/begin CHARACTERISTIC CDD_MotAgCmp.SysGlbPrmMotPoleCnt.Val "MICROSAR RTE" VALUE 0x0 RTE_RL_UBYTE 0 NO_COMPU_METHOD 2 12 SYMBOL_LINK "Rte_CalprmRom_CalRegn01Inin00_DEFAULT_RTE_CALPRM_GROUP.SysGlbPrmMotPoleCnt_Val" 0 DISPLAY_IDENTIFIER CDD_MotAgCmp.CalibrationPorts.SysGlbPrmMotPoleCnt.Val /end CHARACTERISTIC
/begin CHARACTERISTIC CDD_MotAgCmp.SysGlbPrmSysKineRat.Val "MICROSAR RTE" VALUE 0x0 RTE_RL_FLOAT32_IEEE 0 NO_COMPU_METHOD -3.402823466e+38 3.402823466e+38 SYMBOL_LINK "Rte_CalprmRom_CalRegn03Inin00_DEFAULT_RTE_CALPRM_GROUP.SysGlbPrmSysKineRat_Val" 0 DISPLAY_IDENTIFIER CDD_MotAgCmp.CalibrationPorts.SysGlbPrmSysKineRat.Val /end CHARACTERISTIC
/begin CHARACTERISTIC CDD_MotCurrRegVltgLimr.MotCurrRegCfgCurrLoopSecOrderTrfFctEna.Logl "MICROSAR RTE" VALUE 0x0 RTE_RL_BOOLEAN 0 RTE_CM_BOOLEAN 0 255 SYMBOL_LINK "Rte_CalprmRom_CalRegn01Cmn_DEFAULT_RTE_CALPRM_GROUP.MotCurrRegCfgCurrLoopSecOrderTrfFctEna_Logl" 0 DISPLAY_IDENTIFIER CDD_MotCurrRegVltgLimr.CalibrationPorts.MotCurrRegCfgCurrLoopSecOrderTrfFctEna.Logl /end CHARACTERISTIC
/begin CHARACTERISTIC CDD_MotCurrRegVltgLimr.MotCurrRegCfgMotRVirtDax.Val "MICROSAR RTE" VALUE 0x0 RTE_RL_FLOAT32_IEEE 0 NO_COMPU_METHOD 0.0 0.2 SYMBOL_LINK "Rte_CalprmRom_CalRegn01Cmn_DEFAULT_RTE_CALPRM_GROUP.MotCurrRegCfgMotRVirtDax_Val" 0 DISPLAY_IDENTIFIER CDD_MotCurrRegVltgLimr.CalibrationPorts.MotCurrRegCfgMotRVirtDax.Val /end CHARACTERISTIC
/begin CHARACTERISTIC CDD_MotCurrRegVltgLimr.MotCurrRegCfgMotRVirtQax.Val "MICROSAR RTE" VALUE 0x0 RTE_RL_FLOAT32_IEEE 0 NO_COMPU_METHOD 0.0 0.2 SYMBOL_LINK "Rte_CalprmRom_CalRegn01Cmn_DEFAULT_RTE_CALPRM_GROUP.MotCurrRegCfgMotRVirtQax_Val" 0 DISPLAY_IDENTIFIER CDD_MotCurrRegVltgLimr.CalibrationPorts.MotCurrRegCfgMotRVirtQax.Val /end CHARACTERISTIC
/begin CHARACTERISTIC CDD_MotCurrRegVltgLimr.MotCurrRegVltgLimrCurrLoaScarSlewRate.Val "MICROSAR RTE" VALUE 0x0 RTE_RL_FLOAT32_IEEE 0 NO_COMPU_METHOD 0.0 1000.0 SYMBOL_LINK "Rte_CalprmRom_CalRegn01Cmn_DEFAULT_RTE_CALPRM_GROUP.MotCurrRegVltgLimrCurrLoaScarSlewRate_Val" 0 DISPLAY_IDENTIFIER CDD_MotCurrRegVltgLimr.CalibrationPorts.MotCurrRegVltgLimrCurrLoaScarSlewRate.Val /end CHARACTERISTIC
/begin CHARACTERISTIC CDD_MotCurrRegVltgLimr.MotCurrRegVltgLimrDaxAntiWdupCoeff.Val "MICROSAR RTE" VALUE 0x0 RTE_RL_FLOAT32_IEEE 0 NO_COMPU_METHOD -25 25 SYMBOL_LINK "Rte_CalprmRom_CalRegn01Cmn_DEFAULT_RTE_CALPRM_GROUP.MotCurrRegVltgLimrDaxAntiWdupCoeff_Val" 0 DISPLAY_IDENTIFIER CDD_MotCurrRegVltgLimr.CalibrationPorts.MotCurrRegVltgLimrDaxAntiWdupCoeff.Val /end CHARACTERISTIC
/begin CHARACTERISTIC CDD_MotCurrRegVltgLimr.MotCurrRegVltgLimrDualEcuLoaScarSlewRate.Val "MICROSAR RTE" VALUE 0x0 RTE_RL_FLOAT32_IEEE 0 NO_COMPU_METHOD -3.402823466e+38 3.402823466e+38 SYMBOL_LINK "Rte_CalprmRom_CalRegn01Cmn_DEFAULT_RTE_CALPRM_GROUP.MotCurrRegVltgLimrDualEcuLoaScarSlewRate_Val" 0 DISPLAY_IDENTIFIER CDD_MotCurrRegVltgLimr.CalibrationPorts.MotCurrRegVltgLimrDualEcuLoaScarSlewRate.Val /end CHARACTERISTIC
/begin CHARACTERISTIC CDD_MotCurrRegVltgLimr.MotCurrRegVltgLimrIvtrLoaScarSlewRate.Val "MICROSAR RTE" VALUE 0x0 RTE_RL_FLOAT32_IEEE 0 NO_COMPU_METHOD 0.0 1000.0 SYMBOL_LINK "Rte_CalprmRom_CalRegn01Cmn_DEFAULT_RTE_CALPRM_GROUP.MotCurrRegVltgLimrIvtrLoaScarSlewRate_Val" 0 DISPLAY_IDENTIFIER CDD_MotCurrRegVltgLimr.CalibrationPorts.MotCurrRegVltgLimrIvtrLoaScarSlewRate.Val /end CHARACTERISTIC
/begin CHARACTERISTIC CDD_MotCurrRegVltgLimr.MotCurrRegVltgLimrMotCurrPredEna.Logl "MICROSAR RTE" VALUE 0x0 RTE_RL_BOOLEAN 0 RTE_CM_BOOLEAN 0 255 SYMBOL_LINK "Rte_CalprmRom_CalRegn01Cmn_DEFAULT_RTE_CALPRM_GROUP.MotCurrRegVltgLimrMotCurrPredEna_Logl" 0 DISPLAY_IDENTIFIER CDD_MotCurrRegVltgLimr.CalibrationPorts.MotCurrRegVltgLimrMotCurrPredEna.Logl /end CHARACTERISTIC
/begin CHARACTERISTIC CDD_MotCurrRegVltgLimr.MotCurrRegVltgLimrMotCurrPredTi.Val "MICROSAR RTE" VALUE 0x0 RTE_RL_FLOAT32_IEEE 0 NO_COMPU_METHOD -3.402823466e+38 3.402823466e+38 SYMBOL_LINK "Rte_CalprmRom_CalRegn01Cmn_DEFAULT_RTE_CALPRM_GROUP.MotCurrRegVltgLimrMotCurrPredTi_Val" 0 DISPLAY_IDENTIFIER CDD_MotCurrRegVltgLimr.CalibrationPorts.MotCurrRegVltgLimrMotCurrPredTi.Val /end CHARACTERISTIC
/begin CHARACTERISTIC CDD_MotCurrRegVltgLimr.MotCurrRegVltgLimrMotCurrQaxRefMdfnRplEna.Logl "MICROSAR RTE" VALUE 0x0 RTE_RL_BOOLEAN 0 RTE_CM_BOOLEAN 0 255 SYMBOL_LINK "Rte_CalprmRom_CalRegn01Cmn_DEFAULT_RTE_CALPRM_GROUP.MotCurrRegVltgLimrMotCurrQaxRefMdfnRplEna_Logl" 0 DISPLAY_IDENTIFIER CDD_MotCurrRegVltgLimr.CalibrationPorts.MotCurrRegVltgLimrMotCurrQaxRefMdfnRplEna.Logl /end CHARACTERISTIC
/begin CHARACTERISTIC CDD_MotCurrRegVltgLimr.MotCurrRegVltgLimrMotVltgBrdgFilEna.Logl "MICROSAR RTE" VALUE 0x0 RTE_RL_BOOLEAN 0 RTE_CM_BOOLEAN 0 255 SYMBOL_LINK "Rte_CalprmRom_CalRegn01Cmn_DEFAULT_RTE_CALPRM_GROUP.MotCurrRegVltgLimrMotVltgBrdgFilEna_Logl" 0 DISPLAY_IDENTIFIER CDD_MotCurrRegVltgLimr.CalibrationPorts.MotCurrRegVltgLimrMotVltgBrdgFilEna.Logl /end CHARACTERISTIC
/begin CHARACTERISTIC CDD_MotCurrRegVltgLimr.MotCurrRegVltgLimrMotVltgBrdgLpFilFrq.Val "MICROSAR RTE" VALUE 0x0 RTE_RL_FLOAT32_IEEE 0 NO_COMPU_METHOD -3.402823466e+38 3.402823466e+38 SYMBOL_LINK "Rte_CalprmRom_CalRegn01Cmn_DEFAULT_RTE_CALPRM_GROUP.MotCurrRegVltgLimrMotVltgBrdgLpFilFrq_Val" 0 DISPLAY_IDENTIFIER CDD_MotCurrRegVltgLimr.CalibrationPorts.MotCurrRegVltgLimrMotVltgBrdgLpFilFrq.Val /end CHARACTERISTIC
/begin CHARACTERISTIC CDD_MotCurrRegVltgLimr.MotCurrRegVltgLimrMotVltgDaxIntglHiLim.Val "MICROSAR RTE" VALUE 0x0 RTE_RL_FLOAT32_IEEE 0 NO_COMPU_METHOD -3.402823466e+38 3.402823466e+38 SYMBOL_LINK "Rte_CalprmRom_CalRegn01Cmn_DEFAULT_RTE_CALPRM_GROUP.MotCurrRegVltgLimrMotVltgDaxIntglHiLim_Val" 0 DISPLAY_IDENTIFIER CDD_MotCurrRegVltgLimr.CalibrationPorts.MotCurrRegVltgLimrMotVltgDaxIntglHiLim.Val /end CHARACTERISTIC
/begin CHARACTERISTIC CDD_MotCurrRegVltgLimr.MotCurrRegVltgLimrMotVltgDaxIntglLoLim.Val "MICROSAR RTE" VALUE 0x0 RTE_RL_FLOAT32_IEEE 0 NO_COMPU_METHOD -3.402823466e+38 3.402823466e+38 SYMBOL_LINK "Rte_CalprmRom_CalRegn01Cmn_DEFAULT_RTE_CALPRM_GROUP.MotCurrRegVltgLimrMotVltgDaxIntglLoLim_Val" 0 DISPLAY_IDENTIFIER CDD_MotCurrRegVltgLimr.CalibrationPorts.MotCurrRegVltgLimrMotVltgDaxIntglLoLim.Val /end CHARACTERISTIC
/begin CHARACTERISTIC CDD_MotCurrRegVltgLimr.MotCurrRegVltgLimrMotVltgQaxFfFilEna.Logl "MICROSAR RTE" VALUE 0x0 RTE_RL_BOOLEAN 0 RTE_CM_BOOLEAN 0 255 SYMBOL_LINK "Rte_CalprmRom_CalRegn01Cmn_DEFAULT_RTE_CALPRM_GROUP.MotCurrRegVltgLimrMotVltgQaxFfFilEna_Logl" 0 DISPLAY_IDENTIFIER CDD_MotCurrRegVltgLimr.CalibrationPorts.MotCurrRegVltgLimrMotVltgQaxFfFilEna.Logl /end CHARACTERISTIC
/begin CHARACTERISTIC CDD_MotCurrRegVltgLimr.MotCurrRegVltgLimrMotVltgQaxFfLpFilFrq.Val "MICROSAR RTE" VALUE 0x0 RTE_RL_FLOAT32_IEEE 0 NO_COMPU_METHOD -3.402823466e+38 3.402823466e+38 SYMBOL_LINK "Rte_CalprmRom_CalRegn01Cmn_DEFAULT_RTE_CALPRM_GROUP.MotCurrRegVltgLimrMotVltgQaxFfLpFilFrq_Val" 0 DISPLAY_IDENTIFIER CDD_MotCurrRegVltgLimr.CalibrationPorts.MotCurrRegVltgLimrMotVltgQaxFfLpFilFrq.Val /end CHARACTERISTIC
/begin CHARACTERISTIC CDD_MotCurrRegVltgLimr.MotCurrRegVltgLimrMotVltgQaxIntglHiLim.Val "MICROSAR RTE" VALUE 0x0 RTE_RL_FLOAT32_IEEE 0 NO_COMPU_METHOD -3.402823466e+38 3.402823466e+38 SYMBOL_LINK "Rte_CalprmRom_CalRegn01Cmn_DEFAULT_RTE_CALPRM_GROUP.MotCurrRegVltgLimrMotVltgQaxIntglHiLim_Val" 0 DISPLAY_IDENTIFIER CDD_MotCurrRegVltgLimr.CalibrationPorts.MotCurrRegVltgLimrMotVltgQaxIntglHiLim.Val /end CHARACTERISTIC
/begin CHARACTERISTIC CDD_MotCurrRegVltgLimr.MotCurrRegVltgLimrMotVltgQaxIntglLoLim.Val "MICROSAR RTE" VALUE 0x0 RTE_RL_FLOAT32_IEEE 0 NO_COMPU_METHOD -3.402823466e+38 3.402823466e+38 SYMBOL_LINK "Rte_CalprmRom_CalRegn01Cmn_DEFAULT_RTE_CALPRM_GROUP.MotCurrRegVltgLimrMotVltgQaxIntglLoLim_Val" 0 DISPLAY_IDENTIFIER CDD_MotCurrRegVltgLimr.CalibrationPorts.MotCurrRegVltgLimrMotVltgQaxIntglLoLim.Val /end CHARACTERISTIC
/begin CHARACTERISTIC CDD_MotCurrRegVltgLimr.MotCurrRegVltgLimrQaxAntiWdupCoeff.Val "MICROSAR RTE" VALUE 0x0 RTE_RL_FLOAT32_IEEE 0 NO_COMPU_METHOD -25 25 SYMBOL_LINK "Rte_CalprmRom_CalRegn01Cmn_DEFAULT_RTE_CALPRM_GROUP.MotCurrRegVltgLimrQaxAntiWdupCoeff_Val" 0 DISPLAY_IDENTIFIER CDD_MotCurrRegVltgLimr.CalibrationPorts.MotCurrRegVltgLimrQaxAntiWdupCoeff.Val /end CHARACTERISTIC
/begin CHARACTERISTIC CDD_MotCurrRegVltgLimr.MotCurrRegVltgLimrQaxAntiWdupScagDi.Logl "MICROSAR RTE" VALUE 0x0 RTE_RL_BOOLEAN 0 RTE_CM_BOOLEAN 0 255 SYMBOL_LINK "Rte_CalprmRom_CalRegn01Cmn_DEFAULT_RTE_CALPRM_GROUP.MotCurrRegVltgLimrQaxAntiWdupScagDi_Logl" 0 DISPLAY_IDENTIFIER CDD_MotCurrRegVltgLimr.CalibrationPorts.MotCurrRegVltgLimrQaxAntiWdupScagDi.Logl /end CHARACTERISTIC
/begin CHARACTERISTIC CDD_MotCurrRegVltgLimr.MotRefMdlFbCtrlDi.Logl "MICROSAR RTE" VALUE 0x0 RTE_RL_BOOLEAN 0 RTE_CM_BOOLEAN 0 255 SYMBOL_LINK "Rte_CalprmRom_CalRegn01Cmn_DEFAULT_RTE_CALPRM_GROUP.MotRefMdlFbCtrlDi_Logl" 0 DISPLAY_IDENTIFIER CDD_MotCurrRegVltgLimr.CalibrationPorts.MotRefMdlFbCtrlDi.Logl /end CHARACTERISTIC
/begin CHARACTERISTIC CDD_MotCurrRegVltgLimr.MotRefMdlIvtrDeadTiBrdgVltgSca.Val "MICROSAR RTE" VALUE 0x0 RTE_RL_FLOAT32_IEEE 0 NO_COMPU_METHOD 0.98 1 SYMBOL_LINK "Rte_CalprmRom_CalRegn01Cmn_DEFAULT_RTE_CALPRM_GROUP.MotRefMdlIvtrDeadTiBrdgVltgSca_Val" 0 DISPLAY_IDENTIFIER CDD_MotCurrRegVltgLimr.CalibrationPorts.MotRefMdlIvtrDeadTiBrdgVltgSca.Val /end CHARACTERISTIC
/begin CHARACTERISTIC CDD_MotRplCoggCmd.MotRplCoggCmdHrmncOrder1Elec.Val "MICROSAR RTE" VALUE 0x0 RTE_RL_UBYTE 0 NO_COMPU_METHOD 0 255 SYMBOL_LINK "Rte_CalprmRom_CalRegn01Cmn_DEFAULT_RTE_CALPRM_GROUP.MotRplCoggCmdHrmncOrder1Elec_Val" 0 DISPLAY_IDENTIFIER CDD_MotRplCoggCmd.CalibrationPorts.MotRplCoggCmdHrmncOrder1Elec.Val /end CHARACTERISTIC
/begin CHARACTERISTIC CDD_MotRplCoggCmd.MotRplCoggCmdHrmncOrder2Elec.Val "MICROSAR RTE" VALUE 0x0 RTE_RL_UBYTE 0 NO_COMPU_METHOD 0 255 SYMBOL_LINK "Rte_CalprmRom_CalRegn01Cmn_DEFAULT_RTE_CALPRM_GROUP.MotRplCoggCmdHrmncOrder2Elec_Val" 0 DISPLAY_IDENTIFIER CDD_MotRplCoggCmd.CalibrationPorts.MotRplCoggCmdHrmncOrder2Elec.Val /end CHARACTERISTIC
/begin CHARACTERISTIC CDD_MotRplCoggCmd.MotRplCoggCmdHrmncOrder3Elec.Val "MICROSAR RTE" VALUE 0x0 RTE_RL_UBYTE 0 NO_COMPU_METHOD 0 255 SYMBOL_LINK "Rte_CalprmRom_CalRegn01Cmn_DEFAULT_RTE_CALPRM_GROUP.MotRplCoggCmdHrmncOrder3Elec_Val" 0 DISPLAY_IDENTIFIER CDD_MotRplCoggCmd.CalibrationPorts.MotRplCoggCmdHrmncOrder3Elec.Val /end CHARACTERISTIC
/begin MEASUREMENT CDD_McuDiagc.SlowLoopCntr.Val "MICROSAR RTE" UWORD NO_COMPU_METHOD 0 0 0 65535 ECU_ADDRESS 0 SYMBOL_LINK "Rte_CDD_MotCtrlMgr_SlowLoopCntr_Val" 0 DISPLAY_IDENTIFIER CDD_McuDiagc.ReceiverPorts.SlowLoopCntr.Val /end MEASUREMENT
/begin MEASUREMENT CDD_McuDiagc.dMcuDiagcFastLoopCntrMax "MICROSAR RTE" UWORD NO_COMPU_METHOD 0 0 0 65535 ECU_ADDRESS 0 SYMBOL_LINK "Rte_CDD_McuDiagc_dMcuDiagcFastLoopCntrMax" 0 DISPLAY_IDENTIFIER CDD_McuDiagc.PerInstanceMemories.dMcuDiagcFastLoopCntrMax /end MEASUREMENT
/begin MEASUREMENT CDD_McuDiagc.dMcuDiagcFastLoopCntrMin "MICROSAR RTE" UWORD NO_COMPU_METHOD 0 0 0 65535 ECU_ADDRESS 0 SYMBOL_LINK "Rte_CDD_McuDiagc_dMcuDiagcFastLoopCntrMin" 0 DISPLAY_IDENTIFIER CDD_McuDiagc.PerInstanceMemories.dMcuDiagcFastLoopCntrMin /end MEASUREMENT
/begin MEASUREMENT CDD_McuDiagc.dMcuDiagcLoopCntr2MilliSecMotCtrlDif "MICROSAR RTE" UWORD NO_COMPU_METHOD 0 0 0 65535 ECU_ADDRESS 0 SYMBOL_LINK "Rte_CDD_McuDiagc_dMcuDiagcLoopCntr2MilliSecMotCtrlDif" 0 DISPLAY_IDENTIFIER CDD_McuDiagc.PerInstanceMemories.dMcuDiagcLoopCntr2MilliSecMotCtrlDif /end MEASUREMENT
/begin MEASUREMENT CDD_MotAg0Meas.MotAg0CoeffTbl "MICROSAR RTE" FLOAT32_IEEE NO_COMPU_METHOD 0 0 -3.402823466e+38 3.402823466e+38 MATRIX_DIM 26 1 1 ECU_ADDRESS 0 SYMBOL_LINK "Rte_CDD_MotAg0Meas_MotAg0CoeffTbl" 0 DISPLAY_IDENTIFIER CDD_MotAg0Meas.PerInstanceMemories.MotAg0CoeffTbl /end MEASUREMENT
/begin MEASUREMENT CDD_MotAg0Meas.MotAg0CorrnTbl "MICROSAR RTE" SBYTE NO_COMPU_METHOD 0 0 -128 127 MATRIX_DIM 128 1 1 ECU_ADDRESS 0 SYMBOL_LINK "Rte_CDD_MotAg0Meas_MotAg0CorrnTbl" 0 DISPLAY_IDENTIFIER CDD_MotAg0Meas.PerInstanceMemories.MotAg0CorrnTbl /end MEASUREMENT
/begin MEASUREMENT CDD_MotAg0Meas.MotAg0ErrParFltCntPrev "MICROSAR RTE" UWORD NO_COMPU_METHOD 0 0 0 65535 ECU_ADDRESS 0 SYMBOL_LINK "Rte_CDD_MotAg0Meas_MotAg0ErrParFltCntPrev" 0 DISPLAY_IDENTIFIER CDD_MotAg0Meas.PerInstanceMemories.MotAg0ErrParFltCntPrev /end MEASUREMENT
/begin MEASUREMENT CDD_MotAg0Meas.MotAg0ErrParFltNtcStInfoCntPrev "MICROSAR RTE" UWORD NO_COMPU_METHOD 0 0 0 65535 ECU_ADDRESS 0 SYMBOL_LINK "Rte_CDD_MotAg0Meas_MotAg0ErrParFltNtcStInfoCntPrev" 0 DISPLAY_IDENTIFIER CDD_MotAg0Meas.PerInstanceMemories.MotAg0ErrParFltNtcStInfoCntPrev /end MEASUREMENT
/begin MEASUREMENT CDD_MotAg0Meas.MotAg0ErrPrev "MICROSAR RTE" UBYTE NO_COMPU_METHOD 0 0 0.0 31.0 ECU_ADDRESS 0 SYMBOL_LINK "Rte_CDD_MotAg0Meas_MotAg0ErrPrev" 0 DISPLAY_IDENTIFIER CDD_MotAg0Meas.PerInstanceMemories.MotAg0ErrPrev /end MEASUREMENT
/begin MEASUREMENT CDD_MotAg0Meas.MotAg0ErrReg.Val "MICROSAR RTE" ULONG NO_COMPU_METHOD 0 0 0 67108863 ECU_ADDRESS 0 SYMBOL_LINK "Rte_CDD_MotCtrlMgr_MotAg0ErrReg_Val" 0 DISPLAY_IDENTIFIER CDD_MotAg0Meas.ReceiverPorts.MotAg0ErrReg.Val /end MEASUREMENT
/begin MEASUREMENT CDD_MotAg0Meas.MotAg0MeclQlfr.Val "MICROSAR RTE" UBYTE RTE_CM_ENUM_SigQlfr1 0 0 0 255 ECU_ADDRESS 0 SYMBOL_LINK "Rte_CDD_MotAg0Meas_MotAg0MeclQlfr_Val" 0 DISPLAY_IDENTIFIER CDD_MotAg0Meas.SenderPorts.MotAg0MeclQlfr.Val /end MEASUREMENT
/begin MEASUREMENT CDD_MotAg0Meas.MotAg0MeclRollgCntrPrev "MICROSAR RTE" UBYTE NO_COMPU_METHOD 0 0 0.0 255.0 ECU_ADDRESS 0 SYMBOL_LINK "Rte_CDD_MotAg0Meas_MotAg0MeclRollgCntrPrev" 0 DISPLAY_IDENTIFIER CDD_MotAg0Meas.PerInstanceMemories.MotAg0MeclRollgCntrPrev /end MEASUREMENT
/begin MEASUREMENT CDD_MotAg0Meas.MotAg0ParFltCnt.Val "MICROSAR RTE" UWORD NO_COMPU_METHOD 0 0 0 65535 ECU_ADDRESS 0 SYMBOL_LINK "Rte_CDD_MotCtrlMgr_MotAg0ParFltCnt_Val" 0 DISPLAY_IDENTIFIER CDD_MotAg0Meas.ReceiverPorts.MotAg0ParFltCnt.Val /end MEASUREMENT
/begin MEASUREMENT CDD_MotAg0Meas.MotAg0ParFltCntPrev "MICROSAR RTE" UWORD NO_COMPU_METHOD 0 0 0 65535 ECU_ADDRESS 0 SYMBOL_LINK "Rte_CDD_MotAg0Meas_MotAg0ParFltCntPrev" 0 DISPLAY_IDENTIFIER CDD_MotAg0Meas.PerInstanceMemories.MotAg0ParFltCntPrev /end MEASUREMENT
/begin MEASUREMENT CDD_MotAg0Meas.MotAg0ParFltNtcStInfoCntPrev "MICROSAR RTE" UWORD NO_COMPU_METHOD 0 0 0 65535 ECU_ADDRESS 0 SYMBOL_LINK "Rte_CDD_MotAg0Meas_MotAg0ParFltNtcStInfoCntPrev" 0 DISPLAY_IDENTIFIER CDD_MotAg0Meas.PerInstanceMemories.MotAg0ParFltNtcStInfoCntPrev /end MEASUREMENT
/begin MEASUREMENT CDD_MotAg0Meas.MotAg0RawMeclPrev "MICROSAR RTE" UWORD RTE_CM_Ag5 0 0 0 0.9999847412 ECU_ADDRESS 0 SYMBOL_LINK "Rte_CDD_MotAg0Meas_MotAg0RawMeclPrev" 0 DISPLAY_IDENTIFIER CDD_MotAg0Meas.PerInstanceMemories.MotAg0RawMeclPrev /end MEASUREMENT
/begin MEASUREMENT CDD_MotAg0Meas.MotAg0VltgFltCnt.Val "MICROSAR RTE" UWORD NO_COMPU_METHOD 0 0 0 65535 ECU_ADDRESS 0 SYMBOL_LINK "Rte_CDD_MotCtrlMgr_MotAg0VltgFltCnt_Val" 0 DISPLAY_IDENTIFIER CDD_MotAg0Meas.ReceiverPorts.MotAg0VltgFltCnt.Val /end MEASUREMENT
/begin MEASUREMENT CDD_MotAg0Meas.MotAg0VltgFltCntPrev "MICROSAR RTE" UWORD NO_COMPU_METHOD 0 0 0 65535 ECU_ADDRESS 0 SYMBOL_LINK "Rte_CDD_MotAg0Meas_MotAg0VltgFltCntPrev" 0 DISPLAY_IDENTIFIER CDD_MotAg0Meas.PerInstanceMemories.MotAg0VltgFltCntPrev /end MEASUREMENT
/begin MEASUREMENT CDD_MotAg0Meas.MotAg0VltgFltNtcStInfoCntPrev "MICROSAR RTE" UWORD NO_COMPU_METHOD 0 0 0 65535 ECU_ADDRESS 0 SYMBOL_LINK "Rte_CDD_MotAg0Meas_MotAg0VltgFltNtcStInfoCntPrev" 0 DISPLAY_IDENTIFIER CDD_MotAg0Meas.PerInstanceMemories.MotAg0VltgFltNtcStInfoCntPrev /end MEASUREMENT
/begin MEASUREMENT CDD_MotAg0Meas.dMotAg0MeasMotAg0RawAgReg "MICROSAR RTE" ULONG NO_COMPU_METHOD 0 0 0 67108863 ECU_ADDRESS 0 SYMBOL_LINK "Rte_CDD_MotAg0Meas_dMotAg0MeasMotAg0RawAgReg" 0 DISPLAY_IDENTIFIER CDD_MotAg0Meas.PerInstanceMemories.dMotAg0MeasMotAg0RawAgReg /end MEASUREMENT
/begin MEASUREMENT CDD_MotAg0Meas.dMotAg0MeasMotAg0RawErrReg "MICROSAR RTE" ULONG NO_COMPU_METHOD 0 0 0 67108863 ECU_ADDRESS 0 SYMBOL_LINK "Rte_CDD_MotAg0Meas_dMotAg0MeasMotAg0RawErrReg" 0 DISPLAY_IDENTIFIER CDD_MotAg0Meas.PerInstanceMemories.dMotAg0MeasMotAg0RawErrReg /end MEASUREMENT
/begin MEASUREMENT CDD_MotAg0Meas.dMotAg0MeasMotAg0RawTurnCntrReg "MICROSAR RTE" ULONG NO_COMPU_METHOD 0 0 0 67108863 ECU_ADDRESS 0 SYMBOL_LINK "Rte_CDD_MotAg0Meas_dMotAg0MeasMotAg0RawTurnCntrReg" 0 DISPLAY_IDENTIFIER CDD_MotAg0Meas.PerInstanceMemories.dMotAg0MeasMotAg0RawTurnCntrReg /end MEASUREMENT
/begin MEASUREMENT CDD_MotAg1Meas.MotAg1CoeffTbl "MICROSAR RTE" FLOAT32_IEEE NO_COMPU_METHOD 0 0 -3.402823466e+38 3.402823466e+38 MATRIX_DIM 26 1 1 ECU_ADDRESS 0 SYMBOL_LINK "Rte_CDD_MotAg1Meas_MotAg1CoeffTbl" 0 DISPLAY_IDENTIFIER CDD_MotAg1Meas.PerInstanceMemories.MotAg1CoeffTbl /end MEASUREMENT
/begin MEASUREMENT CDD_MotAg1Meas.MotAg1CorrnTbl "MICROSAR RTE" SBYTE NO_COMPU_METHOD 0 0 -128 127 MATRIX_DIM 128 1 1 ECU_ADDRESS 0 SYMBOL_LINK "Rte_CDD_MotAg1Meas_MotAg1CorrnTbl" 0 DISPLAY_IDENTIFIER CDD_MotAg1Meas.PerInstanceMemories.MotAg1CorrnTbl /end MEASUREMENT
/begin MEASUREMENT CDD_MotAg1Meas.MotAg1ErrParFltCntPrev "MICROSAR RTE" UWORD NO_COMPU_METHOD 0 0 0 65535 ECU_ADDRESS 0 SYMBOL_LINK "Rte_CDD_MotAg1Meas_MotAg1ErrParFltCntPrev" 0 DISPLAY_IDENTIFIER CDD_MotAg1Meas.PerInstanceMemories.MotAg1ErrParFltCntPrev /end MEASUREMENT
/begin MEASUREMENT CDD_MotAg1Meas.MotAg1ErrParFltNtcStInfoCntPrev "MICROSAR RTE" UWORD NO_COMPU_METHOD 0 0 0 65535 ECU_ADDRESS 0 SYMBOL_LINK "Rte_CDD_MotAg1Meas_MotAg1ErrParFltNtcStInfoCntPrev" 0 DISPLAY_IDENTIFIER CDD_MotAg1Meas.PerInstanceMemories.MotAg1ErrParFltNtcStInfoCntPrev /end MEASUREMENT
/begin MEASUREMENT CDD_MotAg1Meas.MotAg1ErrPrev "MICROSAR RTE" UBYTE NO_COMPU_METHOD 0 0 0.0 31.0 ECU_ADDRESS 0 SYMBOL_LINK "Rte_CDD_MotAg1Meas_MotAg1ErrPrev" 0 DISPLAY_IDENTIFIER CDD_MotAg1Meas.PerInstanceMemories.MotAg1ErrPrev /end MEASUREMENT
/begin MEASUREMENT CDD_MotAg1Meas.MotAg1ErrReg.Val "MICROSAR RTE" ULONG NO_COMPU_METHOD 0 0 0 67108863 ECU_ADDRESS 0 SYMBOL_LINK "Rte_CDD_MotCtrlMgr_MotAg1ErrReg_Val" 0 DISPLAY_IDENTIFIER CDD_MotAg1Meas.ReceiverPorts.MotAg1ErrReg.Val /end MEASUREMENT
/begin MEASUREMENT CDD_MotAg1Meas.MotAg1MeclQlfr.Val "MICROSAR RTE" UBYTE RTE_CM_ENUM_SigQlfr1 0 0 0 255 ECU_ADDRESS 0 SYMBOL_LINK "Rte_CDD_MotAg1Meas_MotAg1MeclQlfr_Val" 0 DISPLAY_IDENTIFIER CDD_MotAg1Meas.SenderPorts.MotAg1MeclQlfr.Val /end MEASUREMENT
/begin MEASUREMENT CDD_MotAg1Meas.MotAg1MeclRollgCntrPrev "MICROSAR RTE" UBYTE NO_COMPU_METHOD 0 0 0.0 255.0 ECU_ADDRESS 0 SYMBOL_LINK "Rte_CDD_MotAg1Meas_MotAg1MeclRollgCntrPrev" 0 DISPLAY_IDENTIFIER CDD_MotAg1Meas.PerInstanceMemories.MotAg1MeclRollgCntrPrev /end MEASUREMENT
/begin MEASUREMENT CDD_MotAg1Meas.MotAg1ParFltCnt.Val "MICROSAR RTE" UWORD NO_COMPU_METHOD 0 0 0 65535 ECU_ADDRESS 0 SYMBOL_LINK "Rte_CDD_MotCtrlMgr_MotAg1ParFltCnt_Val" 0 DISPLAY_IDENTIFIER CDD_MotAg1Meas.ReceiverPorts.MotAg1ParFltCnt.Val /end MEASUREMENT
/begin MEASUREMENT CDD_MotAg1Meas.MotAg1ParFltCntPrev "MICROSAR RTE" UWORD NO_COMPU_METHOD 0 0 0 65535 ECU_ADDRESS 0 SYMBOL_LINK "Rte_CDD_MotAg1Meas_MotAg1ParFltCntPrev" 0 DISPLAY_IDENTIFIER CDD_MotAg1Meas.PerInstanceMemories.MotAg1ParFltCntPrev /end MEASUREMENT
/begin MEASUREMENT CDD_MotAg1Meas.MotAg1ParFltNtcStInfoCntPrev "MICROSAR RTE" UWORD NO_COMPU_METHOD 0 0 0 65535 ECU_ADDRESS 0 SYMBOL_LINK "Rte_CDD_MotAg1Meas_MotAg1ParFltNtcStInfoCntPrev" 0 DISPLAY_IDENTIFIER CDD_MotAg1Meas.PerInstanceMemories.MotAg1ParFltNtcStInfoCntPrev /end MEASUREMENT
/begin MEASUREMENT CDD_MotAg1Meas.MotAg1RawMeclPrev "MICROSAR RTE" UWORD RTE_CM_Ag5 0 0 0 0.9999847412 ECU_ADDRESS 0 SYMBOL_LINK "Rte_CDD_MotAg1Meas_MotAg1RawMeclPrev" 0 DISPLAY_IDENTIFIER CDD_MotAg1Meas.PerInstanceMemories.MotAg1RawMeclPrev /end MEASUREMENT
/begin MEASUREMENT CDD_MotAg1Meas.MotAg1VltgFltCnt.Val "MICROSAR RTE" UWORD NO_COMPU_METHOD 0 0 0 65535 ECU_ADDRESS 0 SYMBOL_LINK "Rte_CDD_MotCtrlMgr_MotAg1VltgFltCnt_Val" 0 DISPLAY_IDENTIFIER CDD_MotAg1Meas.ReceiverPorts.MotAg1VltgFltCnt.Val /end MEASUREMENT
/begin MEASUREMENT CDD_MotAg1Meas.MotAg1VltgFltCntPrev "MICROSAR RTE" UWORD NO_COMPU_METHOD 0 0 0 65535 ECU_ADDRESS 0 SYMBOL_LINK "Rte_CDD_MotAg1Meas_MotAg1VltgFltCntPrev" 0 DISPLAY_IDENTIFIER CDD_MotAg1Meas.PerInstanceMemories.MotAg1VltgFltCntPrev /end MEASUREMENT
/begin MEASUREMENT CDD_MotAg1Meas.MotAg1VltgFltNtcStInfoCntPrev "MICROSAR RTE" UWORD NO_COMPU_METHOD 0 0 0 65535 ECU_ADDRESS 0 SYMBOL_LINK "Rte_CDD_MotAg1Meas_MotAg1VltgFltNtcStInfoCntPrev" 0 DISPLAY_IDENTIFIER CDD_MotAg1Meas.PerInstanceMemories.MotAg1VltgFltNtcStInfoCntPrev /end MEASUREMENT
/begin MEASUREMENT CDD_MotAg1Meas.dMotAg1MeasMotAg1RawAgReg "MICROSAR RTE" ULONG NO_COMPU_METHOD 0 0 0 67108863 ECU_ADDRESS 0 SYMBOL_LINK "Rte_CDD_MotAg1Meas_dMotAg1MeasMotAg1RawAgReg" 0 DISPLAY_IDENTIFIER CDD_MotAg1Meas.PerInstanceMemories.dMotAg1MeasMotAg1RawAgReg /end MEASUREMENT
/begin MEASUREMENT CDD_MotAg1Meas.dMotAg1MeasMotAg1RawErrReg "MICROSAR RTE" ULONG NO_COMPU_METHOD 0 0 0 67108863 ECU_ADDRESS 0 SYMBOL_LINK "Rte_CDD_MotAg1Meas_dMotAg1MeasMotAg1RawErrReg" 0 DISPLAY_IDENTIFIER CDD_MotAg1Meas.PerInstanceMemories.dMotAg1MeasMotAg1RawErrReg /end MEASUREMENT
/begin MEASUREMENT CDD_MotAg1Meas.dMotAg1MeasMotAg1RawTurnCntrReg "MICROSAR RTE" ULONG NO_COMPU_METHOD 0 0 0 67108863 ECU_ADDRESS 0 SYMBOL_LINK "Rte_CDD_MotAg1Meas_dMotAg1MeasMotAg1RawTurnCntrReg" 0 DISPLAY_IDENTIFIER CDD_MotAg1Meas.PerInstanceMemories.dMotAg1MeasMotAg1RawTurnCntrReg /end MEASUREMENT
/begin MEASUREMENT CDD_MotAgArbn.MotAgARollgCntPrev "MICROSAR RTE" UBYTE NO_COMPU_METHOD 0 0 0 255 ECU_ADDRESS 0 SYMBOL_LINK "Rte_CDD_MotAgArbn_MotAgARollgCntPrev" 0 DISPLAY_IDENTIFIER CDD_MotAgArbn.PerInstanceMemories.MotAgARollgCntPrev /end MEASUREMENT
/begin MEASUREMENT CDD_MotAgArbn.MotAgAStallCntPrev "MICROSAR RTE" UBYTE NO_COMPU_METHOD 0 0 0 255 ECU_ADDRESS 0 SYMBOL_LINK "Rte_CDD_MotAgArbn_MotAgAStallCntPrev" 0 DISPLAY_IDENTIFIER CDD_MotAgArbn.PerInstanceMemories.MotAgAStallCntPrev /end MEASUREMENT
/begin MEASUREMENT CDD_MotAgArbn.MotAgBRollgCntPrev "MICROSAR RTE" UBYTE NO_COMPU_METHOD 0 0 0 255 ECU_ADDRESS 0 SYMBOL_LINK "Rte_CDD_MotAgArbn_MotAgBRollgCntPrev" 0 DISPLAY_IDENTIFIER CDD_MotAgArbn.PerInstanceMemories.MotAgBRollgCntPrev /end MEASUREMENT
/begin MEASUREMENT CDD_MotAgArbn.MotAgBStallCntPrev "MICROSAR RTE" UBYTE NO_COMPU_METHOD 0 0 0 255 ECU_ADDRESS 0 SYMBOL_LINK "Rte_CDD_MotAgArbn_MotAgBStallCntPrev" 0 DISPLAY_IDENTIFIER CDD_MotAgArbn.PerInstanceMemories.MotAgBStallCntPrev /end MEASUREMENT
/begin MEASUREMENT CDD_MotAgArbn.MotAgMeclPrev "MICROSAR RTE" UWORD NO_COMPU_METHOD 0 0 0 65535 ECU_ADDRESS 0 SYMBOL_LINK "Rte_CDD_MotAgArbn_MotAgMeclPrev" 0 DISPLAY_IDENTIFIER CDD_MotAgArbn.PerInstanceMemories.MotAgMeclPrev /end MEASUREMENT
/begin MEASUREMENT CDD_MotAgCmp.AssiMechPolarity.Val "MICROSAR RTE" SBYTE NO_COMPU_METHOD 0 0 -1.0 1.0 ECU_ADDRESS 0 SYMBOL_LINK "Rte_PolarityCfg_AssiMechPolarity_Val" 0 DISPLAY_IDENTIFIER CDD_MotAgCmp.ReceiverPorts.AssiMechPolarity.Val /end MEASUREMENT
/begin MEASUREMENT CDD_MotAgCmp.CmpEnaCntr "MICROSAR RTE" UBYTE NO_COMPU_METHOD 0 0 0 255 ECU_ADDRESS 0 SYMBOL_LINK "Rte_CDD_MotAgCmp_CmpEnaCntr" 0 DISPLAY_IDENTIFIER CDD_MotAgCmp.PerInstanceMemories.CmpEnaCntr /end MEASUREMENT
/begin MEASUREMENT CDD_MotAgCmp.DigMotHwPosn "MICROSAR RTE" FLOAT32_IEEE NO_COMPU_METHOD 0 0 -3.402823466e+38 3.402823466e+38 ECU_ADDRESS 0 SYMBOL_LINK "Rte_CDD_MotAgCmp_DigMotHwPosn" 0 DISPLAY_IDENTIFIER CDD_MotAgCmp.PerInstanceMemories.DigMotHwPosn /end MEASUREMENT
/begin MEASUREMENT CDD_MotAgCmp.MotAgCmpMotAgBackEmf "MICROSAR RTE" UWORD RTE_CM_Ag9 0 0 0 0.9999847412 ECU_ADDRESS 0 SYMBOL_LINK "Rte_CDD_MotAgCmp_MotAgCmpMotAgBackEmf" 0 DISPLAY_IDENTIFIER CDD_MotAgCmp.PerInstanceMemories.MotAgCmpMotAgBackEmf /end MEASUREMENT
/begin MEASUREMENT CDD_MotAgCmp.MotAgCmpMotCtrlMotAgCumvAlgndMrfRevSVPrev "MICROSAR RTE" SLONG RTE_CM_Ag8 0 0 -32768 32767.9999847411 ECU_ADDRESS 0 SYMBOL_LINK "Rte_CDD_MotAgCmp_MotAgCmpMotCtrlMotAgCumvAlgndMrfRevSVPrev" 0 DISPLAY_IDENTIFIER CDD_MotAgCmp.PerInstanceMemories.MotAgCmpMotCtrlMotAgCumvAlgndMrfRevSVPrev /end MEASUREMENT
/begin MEASUREMENT CDD_MotAgCmp.MotAgCmpMotCtrlMotAgMeclPrev "MICROSAR RTE" SLONG RTE_CM_Ag8 0 0 -32768 32767.9999847411 ECU_ADDRESS 0 SYMBOL_LINK "Rte_CDD_MotAgCmp_MotAgCmpMotCtrlMotAgMeclPrev" 0 DISPLAY_IDENTIFIER CDD_MotAgCmp.PerInstanceMemories.MotAgCmpMotCtrlMotAgMeclPrev /end MEASUREMENT
/begin MEASUREMENT CDD_MotAgCmp.MotAgCumvAlgndCrf.Val "MICROSAR RTE" SLONG RTE_CM_Ag7 0 0 -262144 262143.9998 ECU_ADDRESS 0 SYMBOL_LINK "Rte_CDD_MotAgCmp_MotAgCumvAlgndCrf_Val" 0 DISPLAY_IDENTIFIER CDD_MotAgCmp.SenderPorts.MotAgCumvAlgndCrf.Val /end MEASUREMENT
/begin MEASUREMENT CDD_MotAgCmp.MotAgCumvAlgndMrf.Val "MICROSAR RTE" SLONG RTE_CM_Ag7 0 0 -262144 262143.9998 ECU_ADDRESS 0 SYMBOL_LINK "Rte_CDD_MotAgCmp_MotAgCumvAlgndMrf_Val" 0 DISPLAY_IDENTIFIER CDD_MotAgCmp.SenderPorts.MotAgCumvAlgndMrf.Val /end MEASUREMENT
/begin MEASUREMENT CDD_MotAgCmp.MotAgCumvAlgndMrfRev.Val "MICROSAR RTE" SLONG RTE_CM_Ag8 0 0 -32768 32767.9999847411 ECU_ADDRESS 0 SYMBOL_LINK "Rte_CDD_MotCtrlMgr_MotAgCumvAlgndMrfRev_Val" 0 DISPLAY_IDENTIFIER CDD_MotAgCmp.ReceiverPorts.MotAgCumvAlgndMrfRev.Val /end MEASUREMENT
/begin MEASUREMENT CDD_MotAgCmp.MotAgCumvAlgndVld.Logl "MICROSAR RTE" UBYTE RTE_CM_BOOLEAN 0 0 0 255 ECU_ADDRESS 0 SYMBOL_LINK "Rte_CDD_MotAgCmp_MotAgCumvAlgndVld_Logl" 0 DISPLAY_IDENTIFIER CDD_MotAgCmp.SenderPorts.MotAgCumvAlgndVld.Logl /end MEASUREMENT
/begin MEASUREMENT CDD_MotAgCmp.MotAgCumvInid.Logl "MICROSAR RTE" UBYTE RTE_CM_BOOLEAN 0 0 0 255 ECU_ADDRESS 0 SYMBOL_LINK "Rte_CDD_MotCtrlMgr_MotAgCumvInid_Logl" 0 DISPLAY_IDENTIFIER CDD_MotAgCmp.ReceiverPorts.MotAgCumvInid.Logl /end MEASUREMENT
/begin MEASUREMENT CDD_MotCtrlMgr.Adc0ScanGroup2Ref0.Val "MICROSAR RTE" FLOAT32_IEEE NO_COMPU_METHOD 0 0 -3.402823466e+38 3.402823466e+38 ECU_ADDRESS 0 SYMBOL_LINK "Rte_CDD_MotCtrlMgr_Adc0ScanGroup2Ref0_Val" 0 DISPLAY_IDENTIFIER CDD_MotCtrlMgr.SenderPorts.Adc0ScanGroup2Ref0.Val /end MEASUREMENT
/begin MEASUREMENT CDD_MotCtrlMgr.Adc0ScanGroup2Ref1.Val "MICROSAR RTE" FLOAT32_IEEE NO_COMPU_METHOD 0 0 -3.402823466e+38 3.402823466e+38 ECU_ADDRESS 0 SYMBOL_LINK "Rte_CDD_MotCtrlMgr_Adc0ScanGroup2Ref1_Val" 0 DISPLAY_IDENTIFIER CDD_MotCtrlMgr.SenderPorts.Adc0ScanGroup2Ref1.Val /end MEASUREMENT
/begin MEASUREMENT CDD_MotCtrlMgr.Adc0ScanGroup3Ref0.Val "MICROSAR RTE" FLOAT32_IEEE NO_COMPU_METHOD 0 0 -3.402823466e+38 3.402823466e+38 ECU_ADDRESS 0 SYMBOL_LINK "Rte_CDD_MotCtrlMgr_Adc0ScanGroup3Ref0_Val" 0 DISPLAY_IDENTIFIER CDD_MotCtrlMgr.SenderPorts.Adc0ScanGroup3Ref0.Val /end MEASUREMENT
/begin MEASUREMENT CDD_MotCtrlMgr.Adc0ScanGroup3Ref1.Val "MICROSAR RTE" FLOAT32_IEEE NO_COMPU_METHOD 0 0 -3.402823466e+38 3.402823466e+38 ECU_ADDRESS 0 SYMBOL_LINK "Rte_CDD_MotCtrlMgr_Adc0ScanGroup3Ref1_Val" 0 DISPLAY_IDENTIFIER CDD_MotCtrlMgr.SenderPorts.Adc0ScanGroup3Ref1.Val /end MEASUREMENT
/begin MEASUREMENT CDD_MotCtrlMgr.Adc0SelfDiag0.Val "MICROSAR RTE" FLOAT32_IEEE NO_COMPU_METHOD 0 0 0.0 5.0 ECU_ADDRESS 0 SYMBOL_LINK "Rte_CDD_MotCtrlMgr_Adc0SelfDiag0_Val" 0 DISPLAY_IDENTIFIER CDD_MotCtrlMgr.SenderPorts.Adc0SelfDiag0.Val /end MEASUREMENT
/begin MEASUREMENT CDD_MotCtrlMgr.Adc0SelfDiag2.Val "MICROSAR RTE" FLOAT32_IEEE NO_COMPU_METHOD 0 0 0.0 5.0 ECU_ADDRESS 0 SYMBOL_LINK "Rte_CDD_MotCtrlMgr_Adc0SelfDiag2_Val" 0 DISPLAY_IDENTIFIER CDD_MotCtrlMgr.SenderPorts.Adc0SelfDiag2.Val /end MEASUREMENT
/begin MEASUREMENT CDD_MotCtrlMgr.Adc0SelfDiag4.Val "MICROSAR RTE" FLOAT32_IEEE NO_COMPU_METHOD 0 0 0.0 5.0 ECU_ADDRESS 0 SYMBOL_LINK "Rte_CDD_MotCtrlMgr_Adc0SelfDiag4_Val" 0 DISPLAY_IDENTIFIER CDD_MotCtrlMgr.SenderPorts.Adc0SelfDiag4.Val /end MEASUREMENT
/begin MEASUREMENT CDD_MotCtrlMgr.AdcDiagcEndPtrOutp.Val "MICROSAR RTE" UBYTE NO_COMPU_METHOD 0 0 0 255 ECU_ADDRESS 0 SYMBOL_LINK "Rte_CDD_AdcDiagc_AdcDiagcEndPtrOutp_Val" 0 DISPLAY_IDENTIFIER CDD_MotCtrlMgr.ReceiverPorts.AdcDiagcEndPtrOutp.Val /end MEASUREMENT
/begin MEASUREMENT CDD_MotCtrlMgr.AdcDiagcStrtPtrOutp.Val "MICROSAR RTE" UBYTE NO_COMPU_METHOD 0 0 0 255 ECU_ADDRESS 0 SYMBOL_LINK "Rte_CDD_AdcDiagc_AdcDiagcStrtPtrOutp_Val" 0 DISPLAY_IDENTIFIER CDD_MotCtrlMgr.ReceiverPorts.AdcDiagcStrtPtrOutp.Val /end MEASUREMENT
/begin MEASUREMENT CDD_MotCtrlMgr.BrdgVltg.Val "MICROSAR RTE" FLOAT32_IEEE NO_COMPU_METHOD 0 0 6.0 26.5 ECU_ADDRESS 0 SYMBOL_LINK "Rte_BattVltg_BrdgVltg_Val" 0 DISPLAY_IDENTIFIER CDD_MotCtrlMgr.ReceiverPorts.BrdgVltg.Val /end MEASUREMENT
/begin MEASUREMENT CDD_MotCtrlMgr.CurrMeasCorrlnSts.Val "MICROSAR RTE" UBYTE NO_COMPU_METHOD 0 0 0 255 ECU_ADDRESS 0 SYMBOL_LINK "Rte_CurrMeasCorrln_CurrMeasCorrlnSts_Val" 0 DISPLAY_IDENTIFIER CDD_MotCtrlMgr.ReceiverPorts.CurrMeasCorrlnSts.Val /end MEASUREMENT
/begin MEASUREMENT CDD_MotCtrlMgr.CurrMeasLoaMtgtnEna.Logl "MICROSAR RTE" UBYTE RTE_CM_BOOLEAN 0 0 0 255 ECU_ADDRESS 0 SYMBOL_LINK "Rte_LoaMgr_CurrMeasLoaMtgtnEna_Logl" 0 DISPLAY_IDENTIFIER CDD_MotCtrlMgr.ReceiverPorts.CurrMeasLoaMtgtnEna.Logl /end MEASUREMENT
/begin MEASUREMENT CDD_MotCtrlMgr.CurrMeasWrmIninTestCmpl.Logl "MICROSAR RTE" UBYTE RTE_CM_BOOLEAN 0 0 0 255 ECU_ADDRESS 0 SYMBOL_LINK "Rte_CDD_CurrMeas_CurrMeasWrmIninTestCmpl_Logl" 0 DISPLAY_IDENTIFIER CDD_MotCtrlMgr.ReceiverPorts.CurrMeasWrmIninTestCmpl.Logl /end MEASUREMENT
/begin MEASUREMENT CDD_MotCtrlMgr.DiagcStsIvtr1Inactv.Logl "MICROSAR RTE" UBYTE RTE_CM_BOOLEAN 0 0 0 255 ECU_ADDRESS 0 SYMBOL_LINK "Rte_DiagcMgr_DiagcStsIvtr1Inactv_Logl" 0 DISPLAY_IDENTIFIER CDD_MotCtrlMgr.ReceiverPorts.DiagcStsIvtr1Inactv.Logl /end MEASUREMENT
/begin MEASUREMENT CDD_MotCtrlMgr.DiagcStsIvtr2Inactv.Logl "MICROSAR RTE" UBYTE RTE_CM_BOOLEAN 0 0 0 255 ECU_ADDRESS 0 SYMBOL_LINK "Rte_DiagcMgr_DiagcStsIvtr2Inactv_Logl" 0 DISPLAY_IDENTIFIER CDD_MotCtrlMgr.ReceiverPorts.DiagcStsIvtr2Inactv.Logl /end MEASUREMENT
/begin MEASUREMENT CDD_MotCtrlMgr.DualEcuMotCtrlMtgtnEna.Logl "MICROSAR RTE" UBYTE RTE_CM_BOOLEAN 0 0 0 255 ECU_ADDRESS 0 SYMBOL_LINK "Rte_CDD_MotCtrlMgr_DualEcuMotCtrlMtgtnEna_Logl" 0 DISPLAY_IDENTIFIER CDD_MotCtrlMgr.ReceiverPorts.DualEcuMotCtrlMtgtnEna.Logl /end MEASUREMENT
/begin MEASUREMENT CDD_MotCtrlMgr.EcuTFild.Val "MICROSAR RTE" FLOAT32_IEEE NO_COMPU_METHOD 0 0 -50.0 150.0 ECU_ADDRESS 0 SYMBOL_LINK "Rte_EcuTMeas_EcuTFild_Val" 0 DISPLAY_IDENTIFIER CDD_MotCtrlMgr.ReceiverPorts.EcuTFild.Val /end MEASUREMENT
/begin MEASUREMENT CDD_MotCtrlMgr.FastLoopCntr.Val "MICROSAR RTE" UWORD NO_COMPU_METHOD 0 0 0 65535 ECU_ADDRESS 0 SYMBOL_LINK "Rte_CDD_MotCtrlMgr_FastLoopCntr_Val" 0 DISPLAY_IDENTIFIER CDD_MotCtrlMgr.SenderPorts.FastLoopCntr.Val /end MEASUREMENT
/begin MEASUREMENT CDD_MotCtrlMgr.IvtrLoaMtgtnEna.Logl "MICROSAR RTE" UBYTE RTE_CM_BOOLEAN 0 0 0 255 ECU_ADDRESS 0 SYMBOL_LINK "Rte_LoaMgr_IvtrLoaMtgtnEna_Logl" 0 DISPLAY_IDENTIFIER CDD_MotCtrlMgr.ReceiverPorts.IvtrLoaMtgtnEna.Logl /end MEASUREMENT
/begin MEASUREMENT CDD_MotCtrlMgr.LoopCntr2MilliSec.Val "MICROSAR RTE" UWORD NO_COMPU_METHOD 0 0 0 65535 ECU_ADDRESS 0 SYMBOL_LINK "Rte_CDD_McuDiagc_LoopCntr2MilliSec_Val" 0 DISPLAY_IDENTIFIER CDD_MotCtrlMgr.ReceiverPorts.LoopCntr2MilliSec.Val /end MEASUREMENT
/begin MEASUREMENT CDD_MotCtrlMgr.MotAg0ErrReg.Val "MICROSAR RTE" ULONG NO_COMPU_METHOD 0 0 0 67108863 ECU_ADDRESS 0 SYMBOL_LINK "Rte_CDD_MotCtrlMgr_MotAg0ErrReg_Val" 0 DISPLAY_IDENTIFIER CDD_MotCtrlMgr.SenderPorts.MotAg0ErrReg.Val /end MEASUREMENT
/begin MEASUREMENT CDD_MotCtrlMgr.MotAg0Mecl.Val "MICROSAR RTE" UWORD RTE_CM_Ag5 0 0 0 0.9999847412 ECU_ADDRESS 0 SYMBOL_LINK "Rte_CDD_MotCtrlMgr_MotAg0Mecl_Val" 0 DISPLAY_IDENTIFIER CDD_MotCtrlMgr.SenderPorts.MotAg0Mecl.Val /end MEASUREMENT
/begin MEASUREMENT CDD_MotCtrlMgr.MotAg0MeclQlfr.Val "MICROSAR RTE" UBYTE RTE_CM_ENUM_SigQlfr1 0 0 0 255 ECU_ADDRESS 0 SYMBOL_LINK "Rte_CDD_MotAg0Meas_MotAg0MeclQlfr_Val" 0 DISPLAY_IDENTIFIER CDD_MotCtrlMgr.ReceiverPorts.MotAg0MeclQlfr.Val /end MEASUREMENT
/begin MEASUREMENT CDD_MotCtrlMgr.MotAg0MeclRollgCntr.Val "MICROSAR RTE" UBYTE NO_COMPU_METHOD 0 0 0 255 ECU_ADDRESS 0 SYMBOL_LINK "Rte_CDD_MotCtrlMgr_MotAg0MeclRollgCntr_Val" 0 DISPLAY_IDENTIFIER CDD_MotCtrlMgr.SenderPorts.MotAg0MeclRollgCntr.Val /end MEASUREMENT
/begin MEASUREMENT CDD_MotCtrlMgr.MotAg0ParFltCnt.Val "MICROSAR RTE" UWORD NO_COMPU_METHOD 0 0 0 65535 ECU_ADDRESS 0 SYMBOL_LINK "Rte_CDD_MotCtrlMgr_MotAg0ParFltCnt_Val" 0 DISPLAY_IDENTIFIER CDD_MotCtrlMgr.SenderPorts.MotAg0ParFltCnt.Val /end MEASUREMENT
/begin MEASUREMENT CDD_MotCtrlMgr.MotAg0VltgFltCnt.Val "MICROSAR RTE" UWORD NO_COMPU_METHOD 0 0 0 65535 ECU_ADDRESS 0 SYMBOL_LINK "Rte_CDD_MotCtrlMgr_MotAg0VltgFltCnt_Val" 0 DISPLAY_IDENTIFIER CDD_MotCtrlMgr.SenderPorts.MotAg0VltgFltCnt.Val /end MEASUREMENT
/begin MEASUREMENT CDD_MotCtrlMgr.MotAg1ErrReg.Val "MICROSAR RTE" ULONG NO_COMPU_METHOD 0 0 0 67108863 ECU_ADDRESS 0 SYMBOL_LINK "Rte_CDD_MotCtrlMgr_MotAg1ErrReg_Val" 0 DISPLAY_IDENTIFIER CDD_MotCtrlMgr.SenderPorts.MotAg1ErrReg.Val /end MEASUREMENT
/begin MEASUREMENT CDD_MotCtrlMgr.MotAg1Mecl.Val "MICROSAR RTE" UWORD RTE_CM_Ag5 0 0 0 0.9999847412 ECU_ADDRESS 0 SYMBOL_LINK "Rte_CDD_MotCtrlMgr_MotAg1Mecl_Val" 0 DISPLAY_IDENTIFIER CDD_MotCtrlMgr.SenderPorts.MotAg1Mecl.Val /end MEASUREMENT
/begin MEASUREMENT CDD_MotCtrlMgr.MotAg1MeclQlfr.Val "MICROSAR RTE" UBYTE RTE_CM_ENUM_SigQlfr1 0 0 0 255 ECU_ADDRESS 0 SYMBOL_LINK "Rte_CDD_MotAg1Meas_MotAg1MeclQlfr_Val" 0 DISPLAY_IDENTIFIER CDD_MotCtrlMgr.ReceiverPorts.MotAg1MeclQlfr.Val /end MEASUREMENT
/begin MEASUREMENT CDD_MotCtrlMgr.MotAg1MeclRollgCntr.Val "MICROSAR RTE" UBYTE NO_COMPU_METHOD 0 0 0 255 ECU_ADDRESS 0 SYMBOL_LINK "Rte_CDD_MotCtrlMgr_MotAg1MeclRollgCntr_Val" 0 DISPLAY_IDENTIFIER CDD_MotCtrlMgr.SenderPorts.MotAg1MeclRollgCntr.Val /end MEASUREMENT
/begin MEASUREMENT CDD_MotCtrlMgr.MotAg1ParFltCnt.Val "MICROSAR RTE" UWORD NO_COMPU_METHOD 0 0 0 65535 ECU_ADDRESS 0 SYMBOL_LINK "Rte_CDD_MotCtrlMgr_MotAg1ParFltCnt_Val" 0 DISPLAY_IDENTIFIER CDD_MotCtrlMgr.SenderPorts.MotAg1ParFltCnt.Val /end MEASUREMENT
/begin MEASUREMENT CDD_MotCtrlMgr.MotAg1VltgFltCnt.Val "MICROSAR RTE" UWORD NO_COMPU_METHOD 0 0 0 65535 ECU_ADDRESS 0 SYMBOL_LINK "Rte_CDD_MotCtrlMgr_MotAg1VltgFltCnt_Val" 0 DISPLAY_IDENTIFIER CDD_MotCtrlMgr.SenderPorts.MotAg1VltgFltCnt.Val /end MEASUREMENT
/begin MEASUREMENT CDD_MotCtrlMgr.MotAgBuf.Ary1D "MICROSAR RTE" UWORD RTE_CM_Ag5 0 0 0 0.9999847412 MATRIX_DIM 8 1 1 ECU_ADDRESS 0 SYMBOL_LINK "Rte_CDD_MotCtrlMgr_MotAgBuf_Ary1D" 0 DISPLAY_IDENTIFIER CDD_MotCtrlMgr.SenderPorts.MotAgBuf.Ary1D /end MEASUREMENT
/begin MEASUREMENT CDD_MotCtrlMgr.MotAgBufIdx.Val "MICROSAR RTE" UBYTE NO_COMPU_METHOD 0 0 0 7 ECU_ADDRESS 0 SYMBOL_LINK "Rte_CDD_MotCtrlMgr_MotAgBufIdx_Val" 0 DISPLAY_IDENTIFIER CDD_MotCtrlMgr.SenderPorts.MotAgBufIdx.Val /end MEASUREMENT
/begin MEASUREMENT CDD_MotCtrlMgr.MotAgCumvAlgndMrfRev.Val "MICROSAR RTE" SLONG RTE_CM_Ag8 0 0 -32768 32767.9999847411 ECU_ADDRESS 0 SYMBOL_LINK "Rte_CDD_MotCtrlMgr_MotAgCumvAlgndMrfRev_Val" 0 DISPLAY_IDENTIFIER CDD_MotCtrlMgr.SenderPorts.MotAgCumvAlgndMrfRev.Val /end MEASUREMENT
/begin MEASUREMENT CDD_MotCtrlMgr.MotAgCumvInid.Logl "MICROSAR RTE" UBYTE RTE_CM_BOOLEAN 0 0 0 255 ECU_ADDRESS 0 SYMBOL_LINK "Rte_CDD_MotCtrlMgr_MotAgCumvInid_Logl" 0 DISPLAY_IDENTIFIER CDD_MotCtrlMgr.SenderPorts.MotAgCumvInid.Logl /end MEASUREMENT
/begin MEASUREMENT CDD_MotCtrlMgr.MotAgElecDly.Val "MICROSAR RTE" FLOAT32_IEEE NO_COMPU_METHOD 0 0 -1.62 1.62 ECU_ADDRESS 0 SYMBOL_LINK "Rte_MotCurrRegCfg_MotAgElecDly_Val" 0 DISPLAY_IDENTIFIER CDD_MotCtrlMgr.ReceiverPorts.MotAgElecDly.Val /end MEASUREMENT
/begin MEASUREMENT CDD_MotCtrlMgr.MotAgElecDlyRpl.Val "MICROSAR RTE" FLOAT32_IEEE NO_COMPU_METHOD 0 0 -3.402823466e+38 3.402823466e+38 ECU_ADDRESS 0 SYMBOL_LINK "Rte_MotRplCoggCfg_MotAgElecDlyRpl_Val" 0 DISPLAY_IDENTIFIER CDD_MotCtrlMgr.ReceiverPorts.MotAgElecDlyRpl.Val /end MEASUREMENT
/begin MEASUREMENT CDD_MotCtrlMgr.MotAgMecl0Polarity.Val "MICROSAR RTE" SBYTE NO_COMPU_METHOD 0 0 -1.0 1.0 ECU_ADDRESS 0 SYMBOL_LINK "Rte_PolarityCfg_MotAgMecl0Polarity_Val" 0 DISPLAY_IDENTIFIER CDD_MotCtrlMgr.ReceiverPorts.MotAgMecl0Polarity.Val /end MEASUREMENT
/begin MEASUREMENT CDD_MotCtrlMgr.MotAgMecl1Polarity.Val "MICROSAR RTE" SBYTE NO_COMPU_METHOD 0 0 -1.0 1.0 ECU_ADDRESS 0 SYMBOL_LINK "Rte_PolarityCfg_MotAgMecl1Polarity_Val" 0 DISPLAY_IDENTIFIER CDD_MotCtrlMgr.ReceiverPorts.MotAgMecl1Polarity.Val /end MEASUREMENT
/begin MEASUREMENT CDD_MotCtrlMgr.MotAgMeclCorrlnSt.Val "MICROSAR RTE" UBYTE NO_COMPU_METHOD 0 0 0 7 ECU_ADDRESS 0 SYMBOL_LINK "Rte_MotAgCorrln_MotAgMeclCorrlnSt_Val" 0 DISPLAY_IDENTIFIER CDD_MotCtrlMgr.ReceiverPorts.MotAgMeclCorrlnSt.Val /end MEASUREMENT
/begin MEASUREMENT CDD_MotCtrlMgr.MotAgTiBuf.Ary1D "MICROSAR RTE" ULONG NO_COMPU_METHOD 0 0 0 4294967295 MATRIX_DIM 8 1 1 ECU_ADDRESS 0 SYMBOL_LINK "Rte_CDD_MotCtrlMgr_MotAgTiBuf_Ary1D" 0 DISPLAY_IDENTIFIER CDD_MotCtrlMgr.SenderPorts.MotAgTiBuf.Ary1D /end MEASUREMENT
/begin MEASUREMENT CDD_MotCtrlMgr.MotBackEmfVltg.Val "MICROSAR RTE" FLOAT32_IEEE NO_COMPU_METHOD 0 0 -3.402823466e+38 3.402823466e+38 ECU_ADDRESS 0 SYMBOL_LINK "Rte_CDD_MotCtrlMgr_MotBackEmfVltg_Val" 0 DISPLAY_IDENTIFIER CDD_MotCtrlMgr.ReceiverPorts.MotBackEmfVltg.Val /end MEASUREMENT
/begin MEASUREMENT CDD_MotCtrlMgr.MotCurrAdcVlyA.Val "MICROSAR RTE" FLOAT32_IEEE NO_COMPU_METHOD 0 0 0.0 5.0 ECU_ADDRESS 0 SYMBOL_LINK "Rte_CDD_MotCtrlMgr_MotCurrAdcVlyA_Val" 0 DISPLAY_IDENTIFIER CDD_MotCtrlMgr.SenderPorts.MotCurrAdcVlyA.Val /end MEASUREMENT
/begin MEASUREMENT CDD_MotCtrlMgr.MotCurrAdcVlyAAdcFaild.Logl "MICROSAR RTE" UBYTE RTE_CM_BOOLEAN 0 0 0 255 ECU_ADDRESS 0 SYMBOL_LINK "Rte_CDD_GmT1xxMcuCfg_MotCurrAdcVlyAAdcFaild_Logl" 0 DISPLAY_IDENTIFIER CDD_MotCtrlMgr.ReceiverPorts.MotCurrAdcVlyAAdcFaild.Logl /end MEASUREMENT
/begin MEASUREMENT CDD_MotCtrlMgr.MotCurrAdcVlyB.Val "MICROSAR RTE" FLOAT32_IEEE NO_COMPU_METHOD 0 0 0.0 5.0 ECU_ADDRESS 0 SYMBOL_LINK "Rte_CDD_MotCtrlMgr_MotCurrAdcVlyB_Val" 0 DISPLAY_IDENTIFIER CDD_MotCtrlMgr.SenderPorts.MotCurrAdcVlyB.Val /end MEASUREMENT
/begin MEASUREMENT CDD_MotCtrlMgr.MotCurrAdcVlyBAdcFaild.Logl "MICROSAR RTE" UBYTE RTE_CM_BOOLEAN 0 0 0 255 ECU_ADDRESS 0 SYMBOL_LINK "Rte_CDD_GmT1xxMcuCfg_MotCurrAdcVlyBAdcFaild_Logl" 0 DISPLAY_IDENTIFIER CDD_MotCtrlMgr.ReceiverPorts.MotCurrAdcVlyBAdcFaild.Logl /end MEASUREMENT
/begin MEASUREMENT CDD_MotCtrlMgr.MotCurrAdcVlyC.Val "MICROSAR RTE" FLOAT32_IEEE NO_COMPU_METHOD 0 0 0.0 5.0 ECU_ADDRESS 0 SYMBOL_LINK "Rte_CDD_MotCtrlMgr_MotCurrAdcVlyC_Val" 0 DISPLAY_IDENTIFIER CDD_MotCtrlMgr.SenderPorts.MotCurrAdcVlyC.Val /end MEASUREMENT
/begin MEASUREMENT CDD_MotCtrlMgr.MotCurrAdcVlyCAdcFaild.Logl "MICROSAR RTE" UBYTE RTE_CM_BOOLEAN 0 0 0 255 ECU_ADDRESS 0 SYMBOL_LINK "Rte_CDD_GmT1xxMcuCfg_MotCurrAdcVlyCAdcFaild_Logl" 0 DISPLAY_IDENTIFIER CDD_MotCtrlMgr.ReceiverPorts.MotCurrAdcVlyCAdcFaild.Logl /end MEASUREMENT
/begin MEASUREMENT CDD_MotCtrlMgr.MotCurrAdcVlyD.Val "MICROSAR RTE" FLOAT32_IEEE NO_COMPU_METHOD 0 0 0.0 5.0 ECU_ADDRESS 0 SYMBOL_LINK "Rte_CDD_MotCtrlMgr_MotCurrAdcVlyD_Val" 0 DISPLAY_IDENTIFIER CDD_MotCtrlMgr.SenderPorts.MotCurrAdcVlyD.Val /end MEASUREMENT
/begin MEASUREMENT CDD_MotCtrlMgr.MotCurrAdcVlyDAdcFaild.Logl "MICROSAR RTE" UBYTE RTE_CM_BOOLEAN 0 0 0 255 ECU_ADDRESS 0 SYMBOL_LINK "Rte_CDD_GmT1xxMcuCfg_MotCurrAdcVlyDAdcFaild_Logl" 0 DISPLAY_IDENTIFIER CDD_MotCtrlMgr.ReceiverPorts.MotCurrAdcVlyDAdcFaild.Logl /end MEASUREMENT
/begin MEASUREMENT CDD_MotCtrlMgr.MotCurrAdcVlyE.Val "MICROSAR RTE" FLOAT32_IEEE NO_COMPU_METHOD 0 0 0.0 5.0 ECU_ADDRESS 0 SYMBOL_LINK "Rte_CDD_MotCtrlMgr_MotCurrAdcVlyE_Val" 0 DISPLAY_IDENTIFIER CDD_MotCtrlMgr.SenderPorts.MotCurrAdcVlyE.Val /end MEASUREMENT
/begin MEASUREMENT CDD_MotCtrlMgr.MotCurrAdcVlyEAdcFaild.Logl "MICROSAR RTE" UBYTE RTE_CM_BOOLEAN 0 0 0 255 ECU_ADDRESS 0 SYMBOL_LINK "Rte_CDD_GmT1xxMcuCfg_MotCurrAdcVlyEAdcFaild_Logl" 0 DISPLAY_IDENTIFIER CDD_MotCtrlMgr.ReceiverPorts.MotCurrAdcVlyEAdcFaild.Logl /end MEASUREMENT
/begin MEASUREMENT CDD_MotCtrlMgr.MotCurrAdcVlyF.Val "MICROSAR RTE" FLOAT32_IEEE NO_COMPU_METHOD 0 0 0.0 5.0 ECU_ADDRESS 0 SYMBOL_LINK "Rte_CDD_MotCtrlMgr_MotCurrAdcVlyF_Val" 0 DISPLAY_IDENTIFIER CDD_MotCtrlMgr.SenderPorts.MotCurrAdcVlyF.Val /end MEASUREMENT
/begin MEASUREMENT CDD_MotCtrlMgr.MotCurrAdcVlyFAdcFaild.Logl "MICROSAR RTE" UBYTE RTE_CM_BOOLEAN 0 0 0 255 ECU_ADDRESS 0 SYMBOL_LINK "Rte_CDD_GmT1xxMcuCfg_MotCurrAdcVlyFAdcFaild_Logl" 0 DISPLAY_IDENTIFIER CDD_MotCtrlMgr.ReceiverPorts.MotCurrAdcVlyFAdcFaild.Logl /end MEASUREMENT
/begin MEASUREMENT CDD_MotCtrlMgr.MotCurrCorrdA.Val "MICROSAR RTE" FLOAT32_IEEE NO_COMPU_METHOD 0 0 -145.0 145.0 ECU_ADDRESS 0 SYMBOL_LINK "Rte_CDD_MotCtrlMgr_MotCurrCorrdA_Val" 0 DISPLAY_IDENTIFIER CDD_MotCtrlMgr.SenderPorts.MotCurrCorrdA.Val /end MEASUREMENT
/begin MEASUREMENT CDD_MotCtrlMgr.MotCurrCorrdB.Val "MICROSAR RTE" FLOAT32_IEEE NO_COMPU_METHOD 0 0 -145.0 145.0 ECU_ADDRESS 0 SYMBOL_LINK "Rte_CDD_MotCtrlMgr_MotCurrCorrdB_Val" 0 DISPLAY_IDENTIFIER CDD_MotCtrlMgr.SenderPorts.MotCurrCorrdB.Val /end MEASUREMENT
/begin MEASUREMENT CDD_MotCtrlMgr.MotCurrCorrdC.Val "MICROSAR RTE" FLOAT32_IEEE NO_COMPU_METHOD 0 0 -145.0 145.0 ECU_ADDRESS 0 SYMBOL_LINK "Rte_CDD_MotCtrlMgr_MotCurrCorrdC_Val" 0 DISPLAY_IDENTIFIER CDD_MotCtrlMgr.SenderPorts.MotCurrCorrdC.Val /end MEASUREMENT
/begin MEASUREMENT CDD_MotCtrlMgr.MotCurrCorrdD.Val "MICROSAR RTE" FLOAT32_IEEE NO_COMPU_METHOD 0 0 -145.0 145.0 ECU_ADDRESS 0 SYMBOL_LINK "Rte_CDD_MotCtrlMgr_MotCurrCorrdD_Val" 0 DISPLAY_IDENTIFIER CDD_MotCtrlMgr.SenderPorts.MotCurrCorrdD.Val /end MEASUREMENT
/begin MEASUREMENT CDD_MotCtrlMgr.MotCurrCorrdE.Val "MICROSAR RTE" FLOAT32_IEEE NO_COMPU_METHOD 0 0 -145.0 145.0 ECU_ADDRESS 0 SYMBOL_LINK "Rte_CDD_MotCtrlMgr_MotCurrCorrdE_Val" 0 DISPLAY_IDENTIFIER CDD_MotCtrlMgr.SenderPorts.MotCurrCorrdE.Val /end MEASUREMENT
/begin MEASUREMENT CDD_MotCtrlMgr.MotCurrCorrdF.Val "MICROSAR RTE" FLOAT32_IEEE NO_COMPU_METHOD 0 0 -145.0 145.0 ECU_ADDRESS 0 SYMBOL_LINK "Rte_CDD_MotCtrlMgr_MotCurrCorrdF_Val" 0 DISPLAY_IDENTIFIER CDD_MotCtrlMgr.SenderPorts.MotCurrCorrdF.Val /end MEASUREMENT
/begin MEASUREMENT CDD_MotCtrlMgr.MotCurrDax.Val "MICROSAR RTE" FLOAT32_IEEE NO_COMPU_METHOD 0 0 -3.402823466e+38 3.402823466e+38 ECU_ADDRESS 0 SYMBOL_LINK "Rte_CDD_MotCtrlMgr_MotCurrDax_Val" 0 DISPLAY_IDENTIFIER CDD_MotCtrlMgr.SenderPorts.MotCurrDax.Val /end MEASUREMENT
/begin MEASUREMENT CDD_MotCtrlMgr.MotCurrDaxCmd.Val "MICROSAR RTE" FLOAT32_IEEE NO_COMPU_METHOD 0 0 0.0 200.0 ECU_ADDRESS 0 SYMBOL_LINK "Rte_MotRefMdl_MotCurrDaxCmd_Val" 0 DISPLAY_IDENTIFIER CDD_MotCtrlMgr.ReceiverPorts.MotCurrDaxCmd.Val /end MEASUREMENT
/begin MEASUREMENT CDD_MotCtrlMgr.MotCurrDaxMax.Val "MICROSAR RTE" FLOAT32_IEEE NO_COMPU_METHOD 0 0 0.0 200.0 ECU_ADDRESS 0 SYMBOL_LINK "Rte_MotRefMdl_MotCurrDaxMax_Val" 0 DISPLAY_IDENTIFIER CDD_MotCtrlMgr.ReceiverPorts.MotCurrDaxMax.Val /end MEASUREMENT
/begin MEASUREMENT CDD_MotCtrlMgr.MotCurrEolCalSt.Val "MICROSAR RTE" UBYTE RTE_CM_ENUM_MotCurrEolCalSt2 0 0 0 255 ECU_ADDRESS 0 SYMBOL_LINK "Rte_CDD_CurrMeas_MotCurrEolCalSt_Val" 0 DISPLAY_IDENTIFIER CDD_MotCtrlMgr.ReceiverPorts.MotCurrEolCalSt.Val /end MEASUREMENT
/begin MEASUREMENT CDD_MotCtrlMgr.MotCurrQax.Val "MICROSAR RTE" FLOAT32_IEEE NO_COMPU_METHOD 0 0 -3.402823466e+38 3.402823466e+38 ECU_ADDRESS 0 SYMBOL_LINK "Rte_CDD_MotCtrlMgr_MotCurrQax_Val" 0 DISPLAY_IDENTIFIER CDD_MotCtrlMgr.SenderPorts.MotCurrQax.Val /end MEASUREMENT
/begin MEASUREMENT CDD_MotCtrlMgr.MotCurrQaxCmd.Val "MICROSAR RTE" FLOAT32_IEEE NO_COMPU_METHOD 0 0 -200 200 ECU_ADDRESS 0 SYMBOL_LINK "Rte_MotRefMdl_MotCurrQaxCmd_Val" 0 DISPLAY_IDENTIFIER CDD_MotCtrlMgr.ReceiverPorts.MotCurrQaxCmd.Val /end MEASUREMENT
/begin MEASUREMENT CDD_MotCtrlMgr.MotCurrQaxToMotTqGain.Val "MICROSAR RTE" FLOAT32_IEEE NO_COMPU_METHOD 0 0 -3.402823466e+38 3.402823466e+38 ECU_ADDRESS 0 SYMBOL_LINK "Rte_MotRplCoggCfg_MotCurrQaxToMotTqGain_Val" 0 DISPLAY_IDENTIFIER CDD_MotCtrlMgr.ReceiverPorts.MotCurrQaxToMotTqGain.Val /end MEASUREMENT
/begin MEASUREMENT CDD_MotCtrlMgr.MotCurrQlfr1.Val "MICROSAR RTE" UBYTE RTE_CM_ENUM_SigQlfr1 0 0 0 255 ECU_ADDRESS 0 SYMBOL_LINK "Rte_CDD_CurrMeas_MotCurrQlfr1_Val" 0 DISPLAY_IDENTIFIER CDD_MotCtrlMgr.ReceiverPorts.MotCurrQlfr1.Val /end MEASUREMENT
/begin MEASUREMENT CDD_MotCtrlMgr.MotCurrQlfr2.Val "MICROSAR RTE" UBYTE RTE_CM_ENUM_SigQlfr1 0 0 0 255 ECU_ADDRESS 0 SYMBOL_LINK "Rte_CDD_CurrMeas_MotCurrQlfr2_Val" 0 DISPLAY_IDENTIFIER CDD_MotCtrlMgr.ReceiverPorts.MotCurrQlfr2.Val /end MEASUREMENT
/begin MEASUREMENT CDD_MotCtrlMgr.MotCurrRollgCntr1.Val "MICROSAR RTE" UBYTE NO_COMPU_METHOD 0 0 0 255 ECU_ADDRESS 0 SYMBOL_LINK "Rte_CDD_MotCtrlMgr_MotCurrRollgCntr1_Val" 0 DISPLAY_IDENTIFIER CDD_MotCtrlMgr.SenderPorts.MotCurrRollgCntr1.Val /end MEASUREMENT
/begin MEASUREMENT CDD_MotCtrlMgr.MotCurrRollgCntr2.Val "MICROSAR RTE" UBYTE NO_COMPU_METHOD 0 0 0 255 ECU_ADDRESS 0 SYMBOL_LINK "Rte_CDD_MotCtrlMgr_MotCurrRollgCntr2_Val" 0 DISPLAY_IDENTIFIER CDD_MotCtrlMgr.SenderPorts.MotCurrRollgCntr2.Val /end MEASUREMENT
/begin MEASUREMENT CDD_MotCtrlMgr.MotDampgDax.Val "MICROSAR RTE" FLOAT32_IEEE NO_COMPU_METHOD 0 0 0.0 45.0 ECU_ADDRESS 0 SYMBOL_LINK "Rte_MotCurrRegCfg_MotDampgDax_Val" 0 DISPLAY_IDENTIFIER CDD_MotCtrlMgr.ReceiverPorts.MotDampgDax.Val /end MEASUREMENT
/begin MEASUREMENT CDD_MotCtrlMgr.MotDampgQax.Val "MICROSAR RTE" FLOAT32_IEEE NO_COMPU_METHOD 0 0 0.0 45.0 ECU_ADDRESS 0 SYMBOL_LINK "Rte_MotCurrRegCfg_MotDampgQax_Val" 0 DISPLAY_IDENTIFIER CDD_MotCtrlMgr.ReceiverPorts.MotDampgQax.Val /end MEASUREMENT
/begin MEASUREMENT CDD_MotCtrlMgr.MotElecMeclPolarity.Val "MICROSAR RTE" SBYTE NO_COMPU_METHOD 0 0 -1.0 1.0 ECU_ADDRESS 0 SYMBOL_LINK "Rte_PolarityCfg_MotElecMeclPolarity_Val" 0 DISPLAY_IDENTIFIER CDD_MotCtrlMgr.ReceiverPorts.MotElecMeclPolarity.Val /end MEASUREMENT
/begin MEASUREMENT CDD_MotCtrlMgr.MotInduDaxEstimdIvs.Val "MICROSAR RTE" FLOAT32_IEEE NO_COMPU_METHOD 0 0 -3.402823466e+38 3.402823466e+38 ECU_ADDRESS 0 SYMBOL_LINK "Rte_CDD_MotCtrlMgr_MotInduDaxEstimdIvs_Val" 0 DISPLAY_IDENTIFIER CDD_MotCtrlMgr.ReceiverPorts.MotInduDaxEstimdIvs.Val /end MEASUREMENT
/begin MEASUREMENT CDD_MotCtrlMgr.MotInduQaxEstimdIvs.Val "MICROSAR RTE" FLOAT32_IEEE NO_COMPU_METHOD 0 0 -3.402823466e+38 3.402823466e+38 ECU_ADDRESS 0 SYMBOL_LINK "Rte_CDD_MotCtrlMgr_MotInduQaxEstimdIvs_Val" 0 DISPLAY_IDENTIFIER CDD_MotCtrlMgr.ReceiverPorts.MotInduQaxEstimdIvs.Val /end MEASUREMENT
/begin MEASUREMENT CDD_MotCtrlMgr.MotIntglGainDax.Val "MICROSAR RTE" FLOAT32_IEEE NO_COMPU_METHOD 0 0 0.0 3.6 ECU_ADDRESS 0 SYMBOL_LINK "Rte_MotCurrRegCfg_MotIntglGainDax_Val" 0 DISPLAY_IDENTIFIER CDD_MotCtrlMgr.ReceiverPorts.MotIntglGainDax.Val /end MEASUREMENT
/begin MEASUREMENT CDD_MotCtrlMgr.MotIntglGainQax.Val "MICROSAR RTE" FLOAT32_IEEE NO_COMPU_METHOD 0 0 0.0 3.6 ECU_ADDRESS 0 SYMBOL_LINK "Rte_MotCurrRegCfg_MotIntglGainQax_Val" 0 DISPLAY_IDENTIFIER CDD_MotCtrlMgr.ReceiverPorts.MotIntglGainQax.Val /end MEASUREMENT
/begin MEASUREMENT CDD_MotCtrlMgr.MotPropGainDax.Val "MICROSAR RTE" FLOAT32_IEEE NO_COMPU_METHOD 0 0 0.0 2.25 ECU_ADDRESS 0 SYMBOL_LINK "Rte_MotCurrRegCfg_MotPropGainDax_Val" 0 DISPLAY_IDENTIFIER CDD_MotCtrlMgr.ReceiverPorts.MotPropGainDax.Val /end MEASUREMENT
/begin MEASUREMENT CDD_MotCtrlMgr.MotPropGainQax.Val "MICROSAR RTE" FLOAT32_IEEE NO_COMPU_METHOD 0 0 0.0 2.25 ECU_ADDRESS 0 SYMBOL_LINK "Rte_MotCurrRegCfg_MotPropGainQax_Val" 0 DISPLAY_IDENTIFIER CDD_MotCtrlMgr.ReceiverPorts.MotPropGainQax.Val /end MEASUREMENT
/begin MEASUREMENT CDD_MotCtrlMgr.MotREstimd.Val "MICROSAR RTE" FLOAT32_IEEE NO_COMPU_METHOD 0 0 -3.402823466e+38 3.402823466e+38 ECU_ADDRESS 0 SYMBOL_LINK "Rte_MotCtrlPrmEstimn_MotREstimd_Val" 0 DISPLAY_IDENTIFIER CDD_MotCtrlMgr.ReceiverPorts.MotREstimd.Val /end MEASUREMENT
/begin MEASUREMENT CDD_MotCtrlMgr.MotReacncDax.Val "MICROSAR RTE" FLOAT32_IEEE NO_COMPU_METHOD 0 0 -0.5 0.5 ECU_ADDRESS 0 SYMBOL_LINK "Rte_MotRefMdl_MotReacncDax_Val" 0 DISPLAY_IDENTIFIER CDD_MotCtrlMgr.ReceiverPorts.MotReacncDax.Val /end MEASUREMENT
/begin MEASUREMENT CDD_MotCtrlMgr.MotReacncQax.Val "MICROSAR RTE" FLOAT32_IEEE NO_COMPU_METHOD 0 0 -0.5 0.5 ECU_ADDRESS 0 SYMBOL_LINK "Rte_MotRefMdl_MotReacncQax_Val" 0 DISPLAY_IDENTIFIER CDD_MotCtrlMgr.ReceiverPorts.MotReacncQax.Val /end MEASUREMENT
/begin MEASUREMENT CDD_MotCtrlMgr.MotTqRplCoggOrder1Mgn.Val "MICROSAR RTE" FLOAT32_IEEE NO_COMPU_METHOD 0 0 -3.402823466e+38 3.402823466e+38 ECU_ADDRESS 0 SYMBOL_LINK "Rte_MotRplCoggCfg_MotTqRplCoggOrder1Mgn_Val" 0 DISPLAY_IDENTIFIER CDD_MotCtrlMgr.ReceiverPorts.MotTqRplCoggOrder1Mgn.Val /end MEASUREMENT
/begin MEASUREMENT CDD_MotCtrlMgr.MotTqRplCoggOrder1Pha.Val "MICROSAR RTE" FLOAT32_IEEE NO_COMPU_METHOD 0 0 -3.402823466e+38 3.402823466e+38 ECU_ADDRESS 0 SYMBOL_LINK "Rte_MotRplCoggCfg_MotTqRplCoggOrder1Pha_Val" 0 DISPLAY_IDENTIFIER CDD_MotCtrlMgr.ReceiverPorts.MotTqRplCoggOrder1Pha.Val /end MEASUREMENT
/begin MEASUREMENT CDD_MotCtrlMgr.MotTqRplCoggOrder2Mgn.Val "MICROSAR RTE" FLOAT32_IEEE NO_COMPU_METHOD 0 0 -3.402823466e+38 3.402823466e+38 ECU_ADDRESS 0 SYMBOL_LINK "Rte_MotRplCoggCfg_MotTqRplCoggOrder2Mgn_Val" 0 DISPLAY_IDENTIFIER CDD_MotCtrlMgr.ReceiverPorts.MotTqRplCoggOrder2Mgn.Val /end MEASUREMENT
/begin MEASUREMENT CDD_MotCtrlMgr.MotTqRplCoggOrder2Pha.Val "MICROSAR RTE" FLOAT32_IEEE NO_COMPU_METHOD 0 0 -3.402823466e+38 3.402823466e+38 ECU_ADDRESS 0 SYMBOL_LINK "Rte_MotRplCoggCfg_MotTqRplCoggOrder2Pha_Val" 0 DISPLAY_IDENTIFIER CDD_MotCtrlMgr.ReceiverPorts.MotTqRplCoggOrder2Pha.Val /end MEASUREMENT
/begin MEASUREMENT CDD_MotCtrlMgr.MotTqRplCoggOrder3Mgn.Val "MICROSAR RTE" FLOAT32_IEEE NO_COMPU_METHOD 0 0 -3.402823466e+38 3.402823466e+38 ECU_ADDRESS 0 SYMBOL_LINK "Rte_MotRplCoggCfg_MotTqRplCoggOrder3Mgn_Val" 0 DISPLAY_IDENTIFIER CDD_MotCtrlMgr.ReceiverPorts.MotTqRplCoggOrder3Mgn.Val /end MEASUREMENT
/begin MEASUREMENT CDD_MotCtrlMgr.MotTqRplCoggOrder3Pha.Val "MICROSAR RTE" FLOAT32_IEEE NO_COMPU_METHOD 0 0 -3.402823466e+38 3.402823466e+38 ECU_ADDRESS 0 SYMBOL_LINK "Rte_MotRplCoggCfg_MotTqRplCoggOrder3Pha_Val" 0 DISPLAY_IDENTIFIER CDD_MotCtrlMgr.ReceiverPorts.MotTqRplCoggOrder3Pha.Val /end MEASUREMENT
/begin MEASUREMENT CDD_MotCtrlMgr.MotVelMrf.Val "MICROSAR RTE" FLOAT32_IEEE NO_COMPU_METHOD 0 0 -1350 1350.0 ECU_ADDRESS 0 SYMBOL_LINK "Rte_CDD_MotVel_MotVelMrf_Val" 0 DISPLAY_IDENTIFIER CDD_MotCtrlMgr.ReceiverPorts.MotVelMrf.Val /end MEASUREMENT
/begin MEASUREMENT CDD_MotCtrlMgr.MotVltgDaxFf.Val "MICROSAR RTE" FLOAT32_IEEE NO_COMPU_METHOD 0 0 -26.5 26.5 ECU_ADDRESS 0 SYMBOL_LINK "Rte_MotRefMdl_MotVltgDaxFf_Val" 0 DISPLAY_IDENTIFIER CDD_MotCtrlMgr.ReceiverPorts.MotVltgDaxFf.Val /end MEASUREMENT
/begin MEASUREMENT CDD_MotCtrlMgr.MotVltgQaxFf.Val "MICROSAR RTE" FLOAT32_IEEE NO_COMPU_METHOD 0 0 -26.5 26.5 ECU_ADDRESS 0 SYMBOL_LINK "Rte_MotRefMdl_MotVltgQaxFf_Val" 0 DISPLAY_IDENTIFIER CDD_MotCtrlMgr.ReceiverPorts.MotVltgQaxFf.Val /end MEASUREMENT
/begin MEASUREMENT CDD_MotCtrlMgr.Ntc5DErrCnt.Val "MICROSAR RTE" UWORD NO_COMPU_METHOD 0 0 0 65535 ECU_ADDRESS 0 SYMBOL_LINK "Rte_CDD_MotCtrlMgr_Ntc5DErrCnt_Val" 0 DISPLAY_IDENTIFIER CDD_MotCtrlMgr.SenderPorts.Ntc5DErrCnt.Val /end MEASUREMENT
/begin MEASUREMENT CDD_MotCtrlMgr.Ntc6DErrCnt.Val "MICROSAR RTE" UWORD NO_COMPU_METHOD 0 0 0 65535 ECU_ADDRESS 0 SYMBOL_LINK "Rte_CDD_MotCtrlMgr_Ntc6DErrCnt_Val" 0 DISPLAY_IDENTIFIER CDD_MotCtrlMgr.SenderPorts.Ntc6DErrCnt.Val /end MEASUREMENT
/begin MEASUREMENT CDD_MotCtrlMgr.PhaOnTiSumA.Val "MICROSAR RTE" ULONG NO_COMPU_METHOD 0 0 0 4294967295 ECU_ADDRESS 0 SYMBOL_LINK "Rte_CDD_MotCtrlMgr_PhaOnTiSumA_Val" 0 DISPLAY_IDENTIFIER CDD_MotCtrlMgr.SenderPorts.PhaOnTiSumA.Val /end MEASUREMENT
/begin MEASUREMENT CDD_MotCtrlMgr.PhaOnTiSumB.Val "MICROSAR RTE" ULONG NO_COMPU_METHOD 0 0 0 4294967295 ECU_ADDRESS 0 SYMBOL_LINK "Rte_CDD_MotCtrlMgr_PhaOnTiSumB_Val" 0 DISPLAY_IDENTIFIER CDD_MotCtrlMgr.SenderPorts.PhaOnTiSumB.Val /end MEASUREMENT
/begin MEASUREMENT CDD_MotCtrlMgr.PhaOnTiSumC.Val "MICROSAR RTE" ULONG NO_COMPU_METHOD 0 0 0 4294967295 ECU_ADDRESS 0 SYMBOL_LINK "Rte_CDD_MotCtrlMgr_PhaOnTiSumC_Val" 0 DISPLAY_IDENTIFIER CDD_MotCtrlMgr.SenderPorts.PhaOnTiSumC.Val /end MEASUREMENT
/begin MEASUREMENT CDD_MotCtrlMgr.SlowLoopCntr.Val "MICROSAR RTE" UWORD NO_COMPU_METHOD 0 0 0 65535 ECU_ADDRESS 0 SYMBOL_LINK "Rte_CDD_MotCtrlMgr_SlowLoopCntr_Val" 0 DISPLAY_IDENTIFIER CDD_MotCtrlMgr.SenderPorts.SlowLoopCntr.Val /end MEASUREMENT
/begin MEASUREMENT CDD_MotCtrlMgr.SysSt.Val "MICROSAR RTE" UBYTE RTE_CM_ENUM_SysSt1 0 0 0 255 ECU_ADDRESS 0 SYMBOL_LINK "Rte_SysStMod_SysSt_Val" 0 DISPLAY_IDENTIFIER CDD_MotCtrlMgr.ReceiverPorts.SysSt.Val /end MEASUREMENT
/begin MEASUREMENT CDD_MotCurrRegVltgLimr.AntiWdupCmdScaDax "MICROSAR RTE" FLOAT32_IEEE NO_COMPU_METHOD 0 0 0.0 1.0 ECU_ADDRESS 0 SYMBOL_LINK "Rte_CDD_MotCurrRegVltgLimr_AntiWdupCmdScaDax" 0 DISPLAY_IDENTIFIER CDD_MotCurrRegVltgLimr.PerInstanceMemories.AntiWdupCmdScaDax /end MEASUREMENT
/begin MEASUREMENT CDD_MotCurrRegVltgLimr.AntiWdupCmdScaQax "MICROSAR RTE" FLOAT32_IEEE NO_COMPU_METHOD 0 0 0.0 1.0 ECU_ADDRESS 0 SYMBOL_LINK "Rte_CDD_MotCurrRegVltgLimr_AntiWdupCmdScaQax" 0 DISPLAY_IDENTIFIER CDD_MotCurrRegVltgLimr.PerInstanceMemories.AntiWdupCmdScaQax /end MEASUREMENT
/begin MEASUREMENT CDD_MotCurrRegVltgLimr.CurrLoaScarPrev "MICROSAR RTE" FLOAT32_IEEE NO_COMPU_METHOD 0 0 0.0 1.0 ECU_ADDRESS 0 SYMBOL_LINK "Rte_CDD_MotCurrRegVltgLimr_CurrLoaScarPrev" 0 DISPLAY_IDENTIFIER CDD_MotCurrRegVltgLimr.PerInstanceMemories.CurrLoaScarPrev /end MEASUREMENT
/begin MEASUREMENT CDD_MotCurrRegVltgLimr.DualEcuLoaScarPrev "MICROSAR RTE" FLOAT32_IEEE NO_COMPU_METHOD 0 0 -3.402823466e+38 3.402823466e+38 ECU_ADDRESS 0 SYMBOL_LINK "Rte_CDD_MotCurrRegVltgLimr_DualEcuLoaScarPrev" 0 DISPLAY_IDENTIFIER CDD_MotCurrRegVltgLimr.PerInstanceMemories.DualEcuLoaScarPrev /end MEASUREMENT
/begin MEASUREMENT CDD_MotCurrRegVltgLimr.IvtrLoaScarPrev "MICROSAR RTE" FLOAT32_IEEE NO_COMPU_METHOD 0 0 0.0 1.0 ECU_ADDRESS 0 SYMBOL_LINK "Rte_CDD_MotCurrRegVltgLimr_IvtrLoaScarPrev" 0 DISPLAY_IDENTIFIER CDD_MotCurrRegVltgLimr.PerInstanceMemories.IvtrLoaScarPrev /end MEASUREMENT
/begin MEASUREMENT CDD_MotCurrRegVltgLimr.MotCtrlMotVltgDaxPrev "MICROSAR RTE" FLOAT32_IEEE NO_COMPU_METHOD 0 0 -3.402823466e+38 3.402823466e+38 ECU_ADDRESS 0 SYMBOL_LINK "Rte_CDD_MotCurrRegVltgLimr_MotCtrlMotVltgDaxPrev" 0 DISPLAY_IDENTIFIER CDD_MotCurrRegVltgLimr.PerInstanceMemories.MotCtrlMotVltgDaxPrev /end MEASUREMENT
/begin MEASUREMENT CDD_MotCurrRegVltgLimr.MotCtrlMotVltgQaxPrev "MICROSAR RTE" FLOAT32_IEEE NO_COMPU_METHOD 0 0 -3.402823466e+38 3.402823466e+38 ECU_ADDRESS 0 SYMBOL_LINK "Rte_CDD_MotCurrRegVltgLimr_MotCtrlMotVltgQaxPrev" 0 DISPLAY_IDENTIFIER CDD_MotCurrRegVltgLimr.PerInstanceMemories.MotCtrlMotVltgQaxPrev /end MEASUREMENT
/begin MEASUREMENT CDD_MotCurrRegVltgLimr.MotVltgBrdgLpFil.FilGain "MICROSAR RTE" FLOAT32_IEEE NO_COMPU_METHOD 0 0 -3.402823466e+38 3.402823466e+38 ECU_ADDRESS 0 SYMBOL_LINK "Rte_CDD_MotCurrRegVltgLimr_MotVltgBrdgLpFil.FilGain" 0 DISPLAY_IDENTIFIER CDD_MotCurrRegVltgLimr.PerInstanceMemories.MotVltgBrdgLpFil.FilGain /end MEASUREMENT
/begin MEASUREMENT CDD_MotCurrRegVltgLimr.MotVltgBrdgLpFil.FilSt "MICROSAR RTE" FLOAT32_IEEE NO_COMPU_METHOD 0 0 -3.402823466e+38 3.402823466e+38 ECU_ADDRESS 0 SYMBOL_LINK "Rte_CDD_MotCurrRegVltgLimr_MotVltgBrdgLpFil.FilSt" 0 DISPLAY_IDENTIFIER CDD_MotCurrRegVltgLimr.PerInstanceMemories.MotVltgBrdgLpFil.FilSt /end MEASUREMENT
/begin MEASUREMENT CDD_MotCurrRegVltgLimr.MotVltgIntglCmdDaxPrev "MICROSAR RTE" FLOAT32_IEEE NO_COMPU_METHOD 0 0 -1000 1000 ECU_ADDRESS 0 SYMBOL_LINK "Rte_CDD_MotCurrRegVltgLimr_MotVltgIntglCmdDaxPrev" 0 DISPLAY_IDENTIFIER CDD_MotCurrRegVltgLimr.PerInstanceMemories.MotVltgIntglCmdDaxPrev /end MEASUREMENT
/begin MEASUREMENT CDD_MotCurrRegVltgLimr.MotVltgIntglCmdQaxPrev "MICROSAR RTE" FLOAT32_IEEE NO_COMPU_METHOD 0 0 -1000 1000 ECU_ADDRESS 0 SYMBOL_LINK "Rte_CDD_MotCurrRegVltgLimr_MotVltgIntglCmdQaxPrev" 0 DISPLAY_IDENTIFIER CDD_MotCurrRegVltgLimr.PerInstanceMemories.MotVltgIntglCmdQaxPrev /end MEASUREMENT
/begin MEASUREMENT CDD_MotCurrRegVltgLimr.MotVltgQaxFfLpFil.FilGain "MICROSAR RTE" FLOAT32_IEEE NO_COMPU_METHOD 0 0 -3.402823466e+38 3.402823466e+38 ECU_ADDRESS 0 SYMBOL_LINK "Rte_CDD_MotCurrRegVltgLimr_MotVltgQaxFfLpFil.FilGain" 0 DISPLAY_IDENTIFIER CDD_MotCurrRegVltgLimr.PerInstanceMemories.MotVltgQaxFfLpFil.FilGain /end MEASUREMENT
/begin MEASUREMENT CDD_MotCurrRegVltgLimr.MotVltgQaxFfLpFil.FilSt "MICROSAR RTE" FLOAT32_IEEE NO_COMPU_METHOD 0 0 -3.402823466e+38 3.402823466e+38 ECU_ADDRESS 0 SYMBOL_LINK "Rte_CDD_MotCurrRegVltgLimr_MotVltgQaxFfLpFil.FilSt" 0 DISPLAY_IDENTIFIER CDD_MotCurrRegVltgLimr.PerInstanceMemories.MotVltgQaxFfLpFil.FilSt /end MEASUREMENT
/begin MEASUREMENT CDD_MotCurrRegVltgLimr.dMotCurrRegVltgLimrAntiWdupCmdScaDax "MICROSAR RTE" FLOAT32_IEEE NO_COMPU_METHOD 0 0 0.0 1.0 ECU_ADDRESS 0 SYMBOL_LINK "Rte_CDD_MotCurrRegVltgLimr_dMotCurrRegVltgLimrAntiWdupCmdScaDax" 0 DISPLAY_IDENTIFIER CDD_MotCurrRegVltgLimr.PerInstanceMemories.dMotCurrRegVltgLimrAntiWdupCmdScaDax /end MEASUREMENT
/begin MEASUREMENT CDD_MotCurrRegVltgLimr.dMotCurrRegVltgLimrAntiWdupCmdScaQax "MICROSAR RTE" FLOAT32_IEEE NO_COMPU_METHOD 0 0 0.0 1.0 ECU_ADDRESS 0 SYMBOL_LINK "Rte_CDD_MotCurrRegVltgLimr_dMotCurrRegVltgLimrAntiWdupCmdScaQax" 0 DISPLAY_IDENTIFIER CDD_MotCurrRegVltgLimr.PerInstanceMemories.dMotCurrRegVltgLimrAntiWdupCmdScaQax /end MEASUREMENT
/begin MEASUREMENT CDD_MotCurrRegVltgLimr.dMotCurrRegVltgLimrMotCurrCmdErr "MICROSAR RTE" FLOAT32_IEEE NO_COMPU_METHOD 0 0 -450 450 ECU_ADDRESS 0 SYMBOL_LINK "Rte_CDD_MotCurrRegVltgLimr_dMotCurrRegVltgLimrMotCurrCmdErr" 0 DISPLAY_IDENTIFIER CDD_MotCurrRegVltgLimr.PerInstanceMemories.dMotCurrRegVltgLimrMotCurrCmdErr /end MEASUREMENT
/begin MEASUREMENT CDD_MotCurrRegVltgLimr.dMotCurrRegVltgLimrMotCurrCmdErrDax "MICROSAR RTE" FLOAT32_IEEE NO_COMPU_METHOD 0 0 -450 450 ECU_ADDRESS 0 SYMBOL_LINK "Rte_CDD_MotCurrRegVltgLimr_dMotCurrRegVltgLimrMotCurrCmdErrDax" 0 DISPLAY_IDENTIFIER CDD_MotCurrRegVltgLimr.PerInstanceMemories.dMotCurrRegVltgLimrMotCurrCmdErrDax /end MEASUREMENT
/begin MEASUREMENT CDD_MotCurrRegVltgLimr.dMotCurrRegVltgLimrMotCurrCmdErrQax "MICROSAR RTE" FLOAT32_IEEE NO_COMPU_METHOD 0 0 -450 450 ECU_ADDRESS 0 SYMBOL_LINK "Rte_CDD_MotCurrRegVltgLimr_dMotCurrRegVltgLimrMotCurrCmdErrQax" 0 DISPLAY_IDENTIFIER CDD_MotCurrRegVltgLimr.PerInstanceMemories.dMotCurrRegVltgLimrMotCurrCmdErrQax /end MEASUREMENT
/begin MEASUREMENT CDD_MotCurrRegVltgLimr.dMotCurrRegVltgLimrMotCurrCmdScaDax "MICROSAR RTE" FLOAT32_IEEE NO_COMPU_METHOD 0 0 -200 200 ECU_ADDRESS 0 SYMBOL_LINK "Rte_CDD_MotCurrRegVltgLimr_dMotCurrRegVltgLimrMotCurrCmdScaDax" 0 DISPLAY_IDENTIFIER CDD_MotCurrRegVltgLimr.PerInstanceMemories.dMotCurrRegVltgLimrMotCurrCmdScaDax /end MEASUREMENT
/begin MEASUREMENT CDD_MotCurrRegVltgLimr.dMotCurrRegVltgLimrMotCurrCmdScaQax "MICROSAR RTE" FLOAT32_IEEE NO_COMPU_METHOD 0 0 -200 200 ECU_ADDRESS 0 SYMBOL_LINK "Rte_CDD_MotCurrRegVltgLimr_dMotCurrRegVltgLimrMotCurrCmdScaQax" 0 DISPLAY_IDENTIFIER CDD_MotCurrRegVltgLimr.PerInstanceMemories.dMotCurrRegVltgLimrMotCurrCmdScaQax /end MEASUREMENT
/begin MEASUREMENT CDD_MotCurrRegVltgLimr.dMotCurrRegVltgLimrMotVltgBrdgFild "MICROSAR RTE" FLOAT32_IEEE NO_COMPU_METHOD 0 0 -3.402823466e+38 3.402823466e+38 ECU_ADDRESS 0 SYMBOL_LINK "Rte_CDD_MotCurrRegVltgLimr_dMotCurrRegVltgLimrMotVltgBrdgFild" 0 DISPLAY_IDENTIFIER CDD_MotCurrRegVltgLimr.PerInstanceMemories.dMotCurrRegVltgLimrMotVltgBrdgFild /end MEASUREMENT
/begin MEASUREMENT CDD_MotCurrRegVltgLimr.dMotCurrRegVltgLimrMotVltgCmdFinal "MICROSAR RTE" FLOAT32_IEEE NO_COMPU_METHOD 0 0 -26.5 26.5 ECU_ADDRESS 0 SYMBOL_LINK "Rte_CDD_MotCurrRegVltgLimr_dMotCurrRegVltgLimrMotVltgCmdFinal" 0 DISPLAY_IDENTIFIER CDD_MotCurrRegVltgLimr.PerInstanceMemories.dMotCurrRegVltgLimrMotVltgCmdFinal /end MEASUREMENT
/begin MEASUREMENT CDD_MotCurrRegVltgLimr.dMotCurrRegVltgLimrMotVltgCmdPreLim "MICROSAR RTE" FLOAT32_IEEE NO_COMPU_METHOD 0 0 -26.5 26.5 ECU_ADDRESS 0 SYMBOL_LINK "Rte_CDD_MotCurrRegVltgLimr_dMotCurrRegVltgLimrMotVltgCmdPreLim" 0 DISPLAY_IDENTIFIER CDD_MotCurrRegVltgLimr.PerInstanceMemories.dMotCurrRegVltgLimrMotVltgCmdPreLim /end MEASUREMENT
/begin MEASUREMENT CDD_MotCurrRegVltgLimr.dMotCurrRegVltgLimrMotVltgDampgDax "MICROSAR RTE" FLOAT32_IEEE NO_COMPU_METHOD 0 0 -26.5 26.5 ECU_ADDRESS 0 SYMBOL_LINK "Rte_CDD_MotCurrRegVltgLimr_dMotCurrRegVltgLimrMotVltgDampgDax" 0 DISPLAY_IDENTIFIER CDD_MotCurrRegVltgLimr.PerInstanceMemories.dMotCurrRegVltgLimrMotVltgDampgDax /end MEASUREMENT
/begin MEASUREMENT CDD_MotCurrRegVltgLimr.dMotCurrRegVltgLimrMotVltgDampgQax "MICROSAR RTE" FLOAT32_IEEE NO_COMPU_METHOD 0 0 -26.5 26.5 ECU_ADDRESS 0 SYMBOL_LINK "Rte_CDD_MotCurrRegVltgLimr_dMotCurrRegVltgLimrMotVltgDampgQax" 0 DISPLAY_IDENTIFIER CDD_MotCurrRegVltgLimr.PerInstanceMemories.dMotCurrRegVltgLimrMotVltgDampgQax /end MEASUREMENT
/begin MEASUREMENT CDD_MotCurrRegVltgLimr.dMotCurrRegVltgLimrMotVltgDaxFb "MICROSAR RTE" FLOAT32_IEEE NO_COMPU_METHOD 0 0 -3.402823466e+38 3.402823466e+38 ECU_ADDRESS 0 SYMBOL_LINK "Rte_CDD_MotCurrRegVltgLimr_dMotCurrRegVltgLimrMotVltgDaxFb" 0 DISPLAY_IDENTIFIER CDD_MotCurrRegVltgLimr.PerInstanceMemories.dMotCurrRegVltgLimrMotVltgDaxFb /end MEASUREMENT
/begin MEASUREMENT CDD_MotCurrRegVltgLimr.dMotCurrRegVltgLimrMotVltgDaxIntglPreLim "MICROSAR RTE" FLOAT32_IEEE NO_COMPU_METHOD 0 0 -3.402823466e+38 3.402823466e+38 ECU_ADDRESS 0 SYMBOL_LINK "Rte_CDD_MotCurrRegVltgLimr_dMotCurrRegVltgLimrMotVltgDaxIntglPreLim" 0 DISPLAY_IDENTIFIER CDD_MotCurrRegVltgLimr.PerInstanceMemories.dMotCurrRegVltgLimrMotVltgDaxIntglPreLim /end MEASUREMENT
/begin MEASUREMENT CDD_MotCurrRegVltgLimr.dMotCurrRegVltgLimrMotVltgDecouplFbDax "MICROSAR RTE" FLOAT32_IEEE NO_COMPU_METHOD 0 0 -26.5 26.5 ECU_ADDRESS 0 SYMBOL_LINK "Rte_CDD_MotCurrRegVltgLimr_dMotCurrRegVltgLimrMotVltgDecouplFbDax" 0 DISPLAY_IDENTIFIER CDD_MotCurrRegVltgLimr.PerInstanceMemories.dMotCurrRegVltgLimrMotVltgDecouplFbDax /end MEASUREMENT
/begin MEASUREMENT CDD_MotCurrRegVltgLimr.dMotCurrRegVltgLimrMotVltgDecouplFbQax "MICROSAR RTE" FLOAT32_IEEE NO_COMPU_METHOD 0 0 -26.5 26.5 ECU_ADDRESS 0 SYMBOL_LINK "Rte_CDD_MotCurrRegVltgLimr_dMotCurrRegVltgLimrMotVltgDecouplFbQax" 0 DISPLAY_IDENTIFIER CDD_MotCurrRegVltgLimr.PerInstanceMemories.dMotCurrRegVltgLimrMotVltgDecouplFbQax /end MEASUREMENT
/begin MEASUREMENT CDD_MotCurrRegVltgLimr.dMotCurrRegVltgLimrMotVltgDircFbDax "MICROSAR RTE" FLOAT32_IEEE NO_COMPU_METHOD 0 0 -26.5 26.5 ECU_ADDRESS 0 SYMBOL_LINK "Rte_CDD_MotCurrRegVltgLimr_dMotCurrRegVltgLimrMotVltgDircFbDax" 0 DISPLAY_IDENTIFIER CDD_MotCurrRegVltgLimr.PerInstanceMemories.dMotCurrRegVltgLimrMotVltgDircFbDax /end MEASUREMENT
/begin MEASUREMENT CDD_MotCurrRegVltgLimr.dMotCurrRegVltgLimrMotVltgDircFbQax "MICROSAR RTE" FLOAT32_IEEE NO_COMPU_METHOD 0 0 -26.5 26.5 ECU_ADDRESS 0 SYMBOL_LINK "Rte_CDD_MotCurrRegVltgLimr_dMotCurrRegVltgLimrMotVltgDircFbQax" 0 DISPLAY_IDENTIFIER CDD_MotCurrRegVltgLimr.PerInstanceMemories.dMotCurrRegVltgLimrMotVltgDircFbQax /end MEASUREMENT
/begin MEASUREMENT CDD_MotCurrRegVltgLimr.dMotCurrRegVltgLimrMotVltgPreLimDax "MICROSAR RTE" FLOAT32_IEEE NO_COMPU_METHOD 0 0 -26.5 26.5 ECU_ADDRESS 0 SYMBOL_LINK "Rte_CDD_MotCurrRegVltgLimr_dMotCurrRegVltgLimrMotVltgPreLimDax" 0 DISPLAY_IDENTIFIER CDD_MotCurrRegVltgLimr.PerInstanceMemories.dMotCurrRegVltgLimrMotVltgPreLimDax /end MEASUREMENT
/begin MEASUREMENT CDD_MotCurrRegVltgLimr.dMotCurrRegVltgLimrMotVltgPreLimQax "MICROSAR RTE" FLOAT32_IEEE NO_COMPU_METHOD 0 0 -26.5 26.5 ECU_ADDRESS 0 SYMBOL_LINK "Rte_CDD_MotCurrRegVltgLimr_dMotCurrRegVltgLimrMotVltgPreLimQax" 0 DISPLAY_IDENTIFIER CDD_MotCurrRegVltgLimr.PerInstanceMemories.dMotCurrRegVltgLimrMotVltgPreLimQax /end MEASUREMENT
/begin MEASUREMENT CDD_MotCurrRegVltgLimr.dMotCurrRegVltgLimrMotVltgPropCmdDax "MICROSAR RTE" FLOAT32_IEEE NO_COMPU_METHOD 0 0 -26.5 26.5 ECU_ADDRESS 0 SYMBOL_LINK "Rte_CDD_MotCurrRegVltgLimr_dMotCurrRegVltgLimrMotVltgPropCmdDax" 0 DISPLAY_IDENTIFIER CDD_MotCurrRegVltgLimr.PerInstanceMemories.dMotCurrRegVltgLimrMotVltgPropCmdDax /end MEASUREMENT
/begin MEASUREMENT CDD_MotCurrRegVltgLimr.dMotCurrRegVltgLimrMotVltgPropCmdQax "MICROSAR RTE" FLOAT32_IEEE NO_COMPU_METHOD 0 0 -26.5 26.5 ECU_ADDRESS 0 SYMBOL_LINK "Rte_CDD_MotCurrRegVltgLimr_dMotCurrRegVltgLimrMotVltgPropCmdQax" 0 DISPLAY_IDENTIFIER CDD_MotCurrRegVltgLimr.PerInstanceMemories.dMotCurrRegVltgLimrMotVltgPropCmdQax /end MEASUREMENT
/begin MEASUREMENT CDD_MotCurrRegVltgLimr.dMotCurrRegVltgLimrMotVltgQaxFb "MICROSAR RTE" FLOAT32_IEEE NO_COMPU_METHOD 0 0 -3.402823466e+38 3.402823466e+38 ECU_ADDRESS 0 SYMBOL_LINK "Rte_CDD_MotCurrRegVltgLimr_dMotCurrRegVltgLimrMotVltgQaxFb" 0 DISPLAY_IDENTIFIER CDD_MotCurrRegVltgLimr.PerInstanceMemories.dMotCurrRegVltgLimrMotVltgQaxFb /end MEASUREMENT
/begin MEASUREMENT CDD_MotCurrRegVltgLimr.dMotCurrRegVltgLimrMotVltgQaxFfFild "MICROSAR RTE" FLOAT32_IEEE NO_COMPU_METHOD 0 0 -3.402823466e+38 3.402823466e+38 ECU_ADDRESS 0 SYMBOL_LINK "Rte_CDD_MotCurrRegVltgLimr_dMotCurrRegVltgLimrMotVltgQaxFfFild" 0 DISPLAY_IDENTIFIER CDD_MotCurrRegVltgLimr.PerInstanceMemories.dMotCurrRegVltgLimrMotVltgQaxFfFild /end MEASUREMENT
/begin MEASUREMENT CDD_MotCurrRegVltgLimr.dMotCurrRegVltgLimrMotVltgQaxIntglPreLim "MICROSAR RTE" FLOAT32_IEEE NO_COMPU_METHOD 0 0 -3.402823466e+38 3.402823466e+38 ECU_ADDRESS 0 SYMBOL_LINK "Rte_CDD_MotCurrRegVltgLimr_dMotCurrRegVltgLimrMotVltgQaxIntglPreLim" 0 DISPLAY_IDENTIFIER CDD_MotCurrRegVltgLimr.PerInstanceMemories.dMotCurrRegVltgLimrMotVltgQaxIntglPreLim /end MEASUREMENT
/begin MEASUREMENT CDD_MotCurrRegVltgLimr.dMotCurrRegVltgLimrMotVltgSatnIvsRat "MICROSAR RTE" FLOAT32_IEEE NO_COMPU_METHOD 0 0 0.0 1.0 ECU_ADDRESS 0 SYMBOL_LINK "Rte_CDD_MotCurrRegVltgLimr_dMotCurrRegVltgLimrMotVltgSatnIvsRat" 0 DISPLAY_IDENTIFIER CDD_MotCurrRegVltgLimr.PerInstanceMemories.dMotCurrRegVltgLimrMotVltgSatnIvsRat /end MEASUREMENT
/begin MEASUREMENT CDD_MotCurrRegVltgLimr.dMotCurrRegVltgLimrMotVltgSatnRat "MICROSAR RTE" FLOAT32_IEEE NO_COMPU_METHOD 0 0 0.0 1.0 ECU_ADDRESS 0 SYMBOL_LINK "Rte_CDD_MotCurrRegVltgLimr_dMotCurrRegVltgLimrMotVltgSatnRat" 0 DISPLAY_IDENTIFIER CDD_MotCurrRegVltgLimr.PerInstanceMemories.dMotCurrRegVltgLimrMotVltgSatnRat /end MEASUREMENT
/begin MEASUREMENT CDD_MotCurrRegVltgLimr.dMotCurrRegVltgLimrPhaAdvPreDly "MICROSAR RTE" FLOAT32_IEEE NO_COMPU_METHOD 0 0 0 6.2832 ECU_ADDRESS 0 SYMBOL_LINK "Rte_CDD_MotCurrRegVltgLimr_dMotCurrRegVltgLimrPhaAdvPreDly" 0 DISPLAY_IDENTIFIER CDD_MotCurrRegVltgLimr.PerInstanceMemories.dMotCurrRegVltgLimrPhaAdvPreDly /end MEASUREMENT
/begin MEASUREMENT CDD_MotRplCoggCmd.MotCoggCmdY "MICROSAR RTE" SWORD NO_COMPU_METHOD 0 0 -32768 32767 MATRIX_DIM 512 1 1 ECU_ADDRESS 0 SYMBOL_LINK "Rte_CDD_MotRplCoggCmd_MotCoggCmdY" 0 DISPLAY_IDENTIFIER CDD_MotRplCoggCmd.PerInstanceMemories.MotCoggCmdY /end MEASUREMENT
/begin MEASUREMENT CDD_MotRplCoggCmd.dMotRplCoggCmdCoggIdx "MICROSAR RTE" UWORD NO_COMPU_METHOD 0 0 0 65535 ECU_ADDRESS 0 SYMBOL_LINK "Rte_CDD_MotRplCoggCmd_dMotRplCoggCmdCoggIdx" 0 DISPLAY_IDENTIFIER CDD_MotRplCoggCmd.PerInstanceMemories.dMotRplCoggCmdCoggIdx /end MEASUREMENT
/begin MEASUREMENT CDD_MotRplCoggCmd.dMotRplCoggCmdMotCoggCmd "MICROSAR RTE" FLOAT32_IEEE NO_COMPU_METHOD 0 0 -3.402823466e+38 3.402823466e+38 ECU_ADDRESS 0 SYMBOL_LINK "Rte_CDD_MotRplCoggCmd_dMotRplCoggCmdMotCoggCmd" 0 DISPLAY_IDENTIFIER CDD_MotRplCoggCmd.PerInstanceMemories.dMotRplCoggCmdMotCoggCmd /end MEASUREMENT
/begin MEASUREMENT CDD_MotRplCoggCmd.dMotRplCoggCmdMotCurrQaxCoggCmdPreLim "MICROSAR RTE" FLOAT32_IEEE NO_COMPU_METHOD 0 0 -3.402823466e+38 3.402823466e+38 ECU_ADDRESS 0 SYMBOL_LINK "Rte_CDD_MotRplCoggCmd_dMotRplCoggCmdMotCurrQaxCoggCmdPreLim" 0 DISPLAY_IDENTIFIER CDD_MotRplCoggCmd.PerInstanceMemories.dMotRplCoggCmdMotCurrQaxCoggCmdPreLim /end MEASUREMENT
/begin MEASUREMENT CDD_MotRplCoggCmd.dMotRplCoggCmdMotRplCmdPreLim "MICROSAR RTE" FLOAT32_IEEE NO_COMPU_METHOD 0 0 -3.402823466e+38 3.402823466e+38 ECU_ADDRESS 0 SYMBOL_LINK "Rte_CDD_MotRplCoggCmd_dMotRplCoggCmdMotRplCmdPreLim" 0 DISPLAY_IDENTIFIER CDD_MotRplCoggCmd.PerInstanceMemories.dMotRplCoggCmdMotRplCmdPreLim /end MEASUREMENT
/begin MEASUREMENT CDD_MotVel.AssiMechPolarity.Val "MICROSAR RTE" SBYTE NO_COMPU_METHOD 0 0 -1.0 1.0 ECU_ADDRESS 0 SYMBOL_LINK "Rte_PolarityCfg_AssiMechPolarity_Val" 0 DISPLAY_IDENTIFIER CDD_MotVel.ReceiverPorts.AssiMechPolarity.Val /end MEASUREMENT
/begin MEASUREMENT CDD_MotVel.MotAgBuf.Ary1D "MICROSAR RTE" UWORD RTE_CM_Ag5 0 0 0 0.9999847412 MATRIX_DIM 8 1 1 ECU_ADDRESS 0 SYMBOL_LINK "Rte_CDD_MotCtrlMgr_MotAgBuf_Ary1D" 0 DISPLAY_IDENTIFIER CDD_MotVel.ReceiverPorts.MotAgBuf.Ary1D /end MEASUREMENT
/begin MEASUREMENT CDD_MotVel.MotAgBufIdx.Val "MICROSAR RTE" UBYTE NO_COMPU_METHOD 0 0 0 7 ECU_ADDRESS 0 SYMBOL_LINK "Rte_CDD_MotCtrlMgr_MotAgBufIdx_Val" 0 DISPLAY_IDENTIFIER CDD_MotVel.ReceiverPorts.MotAgBufIdx.Val /end MEASUREMENT
/begin MEASUREMENT CDD_MotVel.MotAgBufIdxPrev "MICROSAR RTE" UBYTE NO_COMPU_METHOD 0 0 0 255 ECU_ADDRESS 0 SYMBOL_LINK "Rte_CDD_MotVel_MotAgBufIdxPrev" 0 DISPLAY_IDENTIFIER CDD_MotVel.PerInstanceMemories.MotAgBufIdxPrev /end MEASUREMENT
/begin MEASUREMENT CDD_MotVel.MotAgBufIdxPrim "MICROSAR RTE" UBYTE NO_COMPU_METHOD 0 0 0 7 ECU_ADDRESS 0 SYMBOL_LINK "Rte_CDD_MotVel_MotAgBufIdxPrim" 0 DISPLAY_IDENTIFIER CDD_MotVel.PerInstanceMemories.MotAgBufIdxPrim /end MEASUREMENT
/begin MEASUREMENT CDD_MotVel.MotAgBufPrev "MICROSAR RTE" UWORD RTE_CM_Ag5 0 0 0 0.9999847412 MATRIX_DIM 8 1 1 ECU_ADDRESS 0 SYMBOL_LINK "Rte_CDD_MotVel_MotAgBufPrev" 0 DISPLAY_IDENTIFIER CDD_MotVel.PerInstanceMemories.MotAgBufPrev /end MEASUREMENT
/begin MEASUREMENT CDD_MotVel.MotAgMeclIdptSig.Val "MICROSAR RTE" UBYTE NO_COMPU_METHOD 0 0 0 255 ECU_ADDRESS 0 SYMBOL_LINK "Rte_MotAgCorrln_MotAgMeclIdptSig_Val" 0 DISPLAY_IDENTIFIER CDD_MotVel.ReceiverPorts.MotAgMeclIdptSig.Val /end MEASUREMENT
/begin MEASUREMENT CDD_MotVel.MotAgTiBuf.Ary1D "MICROSAR RTE" ULONG NO_COMPU_METHOD 0 0 0 4294967295 MATRIX_DIM 8 1 1 ECU_ADDRESS 0 SYMBOL_LINK "Rte_CDD_MotCtrlMgr_MotAgTiBuf_Ary1D" 0 DISPLAY_IDENTIFIER CDD_MotVel.ReceiverPorts.MotAgTiBuf.Ary1D /end MEASUREMENT
/begin MEASUREMENT CDD_MotVel.MotAgTiBufPrev "MICROSAR RTE" ULONG NO_COMPU_METHOD 0 0 0 4294967295 MATRIX_DIM 8 1 1 ECU_ADDRESS 0 SYMBOL_LINK "Rte_CDD_MotVel_MotAgTiBufPrev" 0 DISPLAY_IDENTIFIER CDD_MotVel.PerInstanceMemories.MotAgTiBufPrev /end MEASUREMENT
/begin MEASUREMENT CDD_MotVel.MotVelCrf.Val "MICROSAR RTE" FLOAT32_IEEE NO_COMPU_METHOD 0 0 -1350 1350.0 ECU_ADDRESS 0 SYMBOL_LINK "Rte_CDD_MotVel_MotVelCrf_Val" 0 DISPLAY_IDENTIFIER CDD_MotVel.SenderPorts.MotVelCrf.Val /end MEASUREMENT
/begin MEASUREMENT CDD_MotVel.MotVelIninCntr "MICROSAR RTE" UBYTE NO_COMPU_METHOD 0 0 0.0 31.0 ECU_ADDRESS 0 SYMBOL_LINK "Rte_CDD_MotVel_MotVelIninCntr" 0 DISPLAY_IDENTIFIER CDD_MotVel.PerInstanceMemories.MotVelIninCntr /end MEASUREMENT
/begin MEASUREMENT CDD_MotVel.MotVelMrf.Val "MICROSAR RTE" FLOAT32_IEEE NO_COMPU_METHOD 0 0 -1350 1350.0 ECU_ADDRESS 0 SYMBOL_LINK "Rte_CDD_MotVel_MotVelMrf_Val" 0 DISPLAY_IDENTIFIER CDD_MotVel.SenderPorts.MotVelMrf.Val /end MEASUREMENT
/begin MEASUREMENT CDD_MotVel.MotVelVld.Logl "MICROSAR RTE" UBYTE RTE_CM_BOOLEAN 0 0 0 255 ECU_ADDRESS 0 SYMBOL_LINK "Rte_CDD_MotVel_MotVelVld_Logl" 0 DISPLAY_IDENTIFIER CDD_MotVel.SenderPorts.MotVelVld.Logl /end MEASUREMENT
/begin MEASUREMENT CDD_MotVel.dMotVelAvrgTi "MICROSAR RTE" FLOAT32_IEEE NO_COMPU_METHOD 0 0 0 4295 ECU_ADDRESS 0 SYMBOL_LINK "Rte_CDD_MotVel_dMotVelAvrgTi" 0 DISPLAY_IDENTIFIER CDD_MotVel.PerInstanceMemories.dMotVelAvrgTi /end MEASUREMENT
/begin MEASUREMENT CDD_MotVel.dMotVelMotAgRef "MICROSAR RTE" UWORD NO_COMPU_METHOD 0 0 0 65535 ECU_ADDRESS 0 SYMBOL_LINK "Rte_CDD_MotVel_dMotVelMotAgRef" 0 DISPLAY_IDENTIFIER CDD_MotVel.PerInstanceMemories.dMotVelMotAgRef /end MEASUREMENT
/begin MEASUREMENT CDD_MotVel.dMotVelTiStampRef "MICROSAR RTE" FLOAT32_IEEE NO_COMPU_METHOD 0 0 0 4295 ECU_ADDRESS 0 SYMBOL_LINK "Rte_CDD_MotVel_dMotVelTiStampRef" 0 DISPLAY_IDENTIFIER CDD_MotVel.PerInstanceMemories.dMotVelTiStampRef /end MEASUREMENT
/begin MEASUREMENT CDD_NvMProxy.BlkFltTbl[0].Prm "MICROSAR RTE" UBYTE NO_COMPU_METHOD 0 0 0 255 ECU_ADDRESS 0 SYMBOL_LINK "Rte_CDD_NvMProxy_BlkFltTbl[0].Prm" 0 DISPLAY_IDENTIFIER CDD_NvMProxy.PerInstanceMemories.BlkFltTbl[0].Prm /end MEASUREMENT
/begin MEASUREMENT CDD_NvMProxy.BlkFltTbl[0].Sts "MICROSAR RTE" UBYTE RTE_CM_ENUM_NtcSts1 0 0 0 255 ECU_ADDRESS 0 SYMBOL_LINK "Rte_CDD_NvMProxy_BlkFltTbl[0].Sts" 0 DISPLAY_IDENTIFIER CDD_NvMProxy.PerInstanceMemories.BlkFltTbl[0].Sts /end MEASUREMENT
/begin MEASUREMENT CDD_NvMProxy.BlkFltTbl[1].Prm "MICROSAR RTE" UBYTE NO_COMPU_METHOD 0 0 0 255 ECU_ADDRESS 0 SYMBOL_LINK "Rte_CDD_NvMProxy_BlkFltTbl[1].Prm" 0 DISPLAY_IDENTIFIER CDD_NvMProxy.PerInstanceMemories.BlkFltTbl[1].Prm /end MEASUREMENT
/begin MEASUREMENT CDD_NvMProxy.BlkFltTbl[1].Sts "MICROSAR RTE" UBYTE RTE_CM_ENUM_NtcSts1 0 0 0 255 ECU_ADDRESS 0 SYMBOL_LINK "Rte_CDD_NvMProxy_BlkFltTbl[1].Sts" 0 DISPLAY_IDENTIFIER CDD_NvMProxy.PerInstanceMemories.BlkFltTbl[1].Sts /end MEASUREMENT
/begin MEASUREMENT CDD_NvMProxy.BlkFltTbl[2].Prm "MICROSAR RTE" UBYTE NO_COMPU_METHOD 0 0 0 255 ECU_ADDRESS 0 SYMBOL_LINK "Rte_CDD_NvMProxy_BlkFltTbl[2].Prm" 0 DISPLAY_IDENTIFIER CDD_NvMProxy.PerInstanceMemories.BlkFltTbl[2].Prm /end MEASUREMENT
/begin MEASUREMENT CDD_NvMProxy.BlkFltTbl[2].Sts "MICROSAR RTE" UBYTE RTE_CM_ENUM_NtcSts1 0 0 0 255 ECU_ADDRESS 0 SYMBOL_LINK "Rte_CDD_NvMProxy_BlkFltTbl[2].Sts" 0 DISPLAY_IDENTIFIER CDD_NvMProxy.PerInstanceMemories.BlkFltTbl[2].Sts /end MEASUREMENT
/begin MEASUREMENT CDD_NvMProxy.BlkFltTbl[3].Prm "MICROSAR RTE" UBYTE NO_COMPU_METHOD 0 0 0 255 ECU_ADDRESS 0 SYMBOL_LINK "Rte_CDD_NvMProxy_BlkFltTbl[3].Prm" 0 DISPLAY_IDENTIFIER CDD_NvMProxy.PerInstanceMemories.BlkFltTbl[3].Prm /end MEASUREMENT
/begin MEASUREMENT CDD_NvMProxy.BlkFltTbl[3].Sts "MICROSAR RTE" UBYTE RTE_CM_ENUM_NtcSts1 0 0 0 255 ECU_ADDRESS 0 SYMBOL_LINK "Rte_CDD_NvMProxy_BlkFltTbl[3].Sts" 0 DISPLAY_IDENTIFIER CDD_NvMProxy.PerInstanceMemories.BlkFltTbl[3].Sts /end MEASUREMENT
/begin MEASUREMENT CDD_NvMProxy.BlkFltTbl[4].Prm "MICROSAR RTE" UBYTE NO_COMPU_METHOD 0 0 0 255 ECU_ADDRESS 0 SYMBOL_LINK "Rte_CDD_NvMProxy_BlkFltTbl[4].Prm" 0 DISPLAY_IDENTIFIER CDD_NvMProxy.PerInstanceMemories.BlkFltTbl[4].Prm /end MEASUREMENT
/begin MEASUREMENT CDD_NvMProxy.BlkFltTbl[4].Sts "MICROSAR RTE" UBYTE RTE_CM_ENUM_NtcSts1 0 0 0 255 ECU_ADDRESS 0 SYMBOL_LINK "Rte_CDD_NvMProxy_BlkFltTbl[4].Sts" 0 DISPLAY_IDENTIFIER CDD_NvMProxy.PerInstanceMemories.BlkFltTbl[4].Sts /end MEASUREMENT
/begin MEASUREMENT CDD_NvMProxy.NvmBlkActv "MICROSAR RTE" UBYTE RTE_CM_BOOLEAN 0 0 0 255 MATRIX_DIM 65535 1 1 ECU_ADDRESS 0 SYMBOL_LINK "Rte_CDD_NvMProxy_NvmBlkActv" 0 DISPLAY_IDENTIFIER CDD_NvMProxy.PerInstanceMemories.NvmBlkActv /end MEASUREMENT
/begin MEASUREMENT CDD_NvMProxy.NvmStsCollctd "MICROSAR RTE" UBYTE RTE_CM_BOOLEAN 0 0 0 255 ECU_ADDRESS 0 SYMBOL_LINK "Rte_CDD_NvMProxy_NvmStsCollctd" 0 DISPLAY_IDENTIFIER CDD_NvMProxy.PerInstanceMemories.NvmStsCollctd /end MEASUREMENT
/begin MEASUREMENT CDD_NvMProxy.ShtdwnClsChk "MICROSAR RTE" ULONG NO_COMPU_METHOD 0 0 0 4294967295 ECU_ADDRESS 0 SYMBOL_LINK "Rte_CDD_NvMProxy_ShtdwnClsChk" 0 DISPLAY_IDENTIFIER CDD_NvMProxy.PerInstanceMemories.ShtdwnClsChk /end MEASUREMENT
/begin MEASUREMENT CDD_RamMem.LclRamEccSngBitCntr "MICROSAR RTE" UBYTE NO_COMPU_METHOD 0 0 0 255 ECU_ADDRESS 0 SYMBOL_LINK "Rte_CDD_RamMem_LclRamEccSngBitCntr" 0 DISPLAY_IDENTIFIER CDD_RamMem.PerInstanceMemories.LclRamEccSngBitCntr /end MEASUREMENT
/begin MEASUREMENT CDD_RamMem.LclRamEccSngBitCntrOutp.Val "MICROSAR RTE" UBYTE NO_COMPU_METHOD 0 0 0 255 ECU_ADDRESS 0 SYMBOL_LINK "Rte_CDD_RamMem_LclRamEccSngBitCntrOutp_Val" 0 DISPLAY_IDENTIFIER CDD_RamMem.SenderPorts.LclRamEccSngBitCntrOutp.Val /end MEASUREMENT
/begin MEASUREMENT CDD_RamMem.LclRamEccSngBitSoftFailr "MICROSAR RTE" UBYTE RTE_CM_BOOLEAN 0 0 0 255 ECU_ADDRESS 0 SYMBOL_LINK "Rte_CDD_RamMem_LclRamEccSngBitSoftFailr" 0 DISPLAY_IDENTIFIER CDD_RamMem.PerInstanceMemories.LclRamEccSngBitSoftFailr /end MEASUREMENT
/begin MEASUREMENT CDD_RamMem.LclRamFailrAdr "MICROSAR RTE" ULONG NO_COMPU_METHOD 0 0 0 4294967295 ECU_ADDRESS 0 SYMBOL_LINK "Rte_CDD_RamMem_LclRamFailrAdr" 0 DISPLAY_IDENTIFIER CDD_RamMem.PerInstanceMemories.LclRamFailrAdr /end MEASUREMENT
/begin MEASUREMENT CDD_RamMem.LclRamWordLineRead "MICROSAR RTE" ULONG NO_COMPU_METHOD 0 0 0 4294967295 ECU_ADDRESS 0 SYMBOL_LINK "Rte_CDD_RamMem_LclRamWordLineRead" 0 DISPLAY_IDENTIFIER CDD_RamMem.PerInstanceMemories.LclRamWordLineRead /end MEASUREMENT
/begin MEASUREMENT CDD_RamMem.dRamMemCanRamDblBitEccErrAdr "MICROSAR RTE" ULONG NO_COMPU_METHOD 0 0 0 4294967295 ECU_ADDRESS 0 SYMBOL_LINK "Rte_CDD_RamMem_dRamMemCanRamDblBitEccErrAdr" 0 DISPLAY_IDENTIFIER CDD_RamMem.PerInstanceMemories.dRamMemCanRamDblBitEccErrAdr /end MEASUREMENT
/begin MEASUREMENT CDD_RamMem.dRamMemCanRamSngBitEccErrAdr "MICROSAR RTE" ULONG NO_COMPU_METHOD 0 0 0 4294967295 ECU_ADDRESS 0 SYMBOL_LINK "Rte_CDD_RamMem_dRamMemCanRamSngBitEccErrAdr" 0 DISPLAY_IDENTIFIER CDD_RamMem.PerInstanceMemories.dRamMemCanRamSngBitEccErrAdr /end MEASUREMENT
/begin MEASUREMENT CDD_RamMem.dRamMemDtsRamEccErrAdr "MICROSAR RTE" ULONG NO_COMPU_METHOD 0 0 0 4294967295 ECU_ADDRESS 0 SYMBOL_LINK "Rte_CDD_RamMem_dRamMemDtsRamEccErrAdr" 0 DISPLAY_IDENTIFIER CDD_RamMem.PerInstanceMemories.dRamMemDtsRamEccErrAdr /end MEASUREMENT
/begin MEASUREMENT CDD_RamMem.dRamMemFrRamDblBitEccErrAdr "MICROSAR RTE" ULONG NO_COMPU_METHOD 0 0 0 4294967295 ECU_ADDRESS 0 SYMBOL_LINK "Rte_CDD_RamMem_dRamMemFrRamDblBitEccErrAdr" 0 DISPLAY_IDENTIFIER CDD_RamMem.PerInstanceMemories.dRamMemFrRamDblBitEccErrAdr /end MEASUREMENT
/begin MEASUREMENT CDD_RamMem.dRamMemFrRamSngBitEccErrAdr "MICROSAR RTE" ULONG NO_COMPU_METHOD 0 0 0 4294967295 ECU_ADDRESS 0 SYMBOL_LINK "Rte_CDD_RamMem_dRamMemFrRamSngBitEccErrAdr" 0 DISPLAY_IDENTIFIER CDD_RamMem.PerInstanceMemories.dRamMemFrRamSngBitEccErrAdr /end MEASUREMENT
/begin MEASUREMENT CDD_RamMem.dRamMemFrRamTmpBufADblBitEccErrAdr "MICROSAR RTE" ULONG NO_COMPU_METHOD 0 0 0 4294967295 ECU_ADDRESS 0 SYMBOL_LINK "Rte_CDD_RamMem_dRamMemFrRamTmpBufADblBitEccErrAdr" 0 DISPLAY_IDENTIFIER CDD_RamMem.PerInstanceMemories.dRamMemFrRamTmpBufADblBitEccErrAdr /end MEASUREMENT
/begin MEASUREMENT CDD_RamMem.dRamMemFrRamTmpBufBDblBitEccErrAdr "MICROSAR RTE" ULONG NO_COMPU_METHOD 0 0 0 4294967295 ECU_ADDRESS 0 SYMBOL_LINK "Rte_CDD_RamMem_dRamMemFrRamTmpBufBDblBitEccErrAdr" 0 DISPLAY_IDENTIFIER CDD_RamMem.PerInstanceMemories.dRamMemFrRamTmpBufBDblBitEccErrAdr /end MEASUREMENT
/begin MEASUREMENT CDD_RamMem.dRamMemSpi0RamEccErrAdr "MICROSAR RTE" ULONG NO_COMPU_METHOD 0 0 0 4294967295 ECU_ADDRESS 0 SYMBOL_LINK "Rte_CDD_RamMem_dRamMemSpi0RamEccErrAdr" 0 DISPLAY_IDENTIFIER CDD_RamMem.PerInstanceMemories.dRamMemSpi0RamEccErrAdr /end MEASUREMENT
/begin MEASUREMENT CDD_RamMem.dRamMemSpi1RamEccErrAdr "MICROSAR RTE" ULONG NO_COMPU_METHOD 0 0 0 4294967295 ECU_ADDRESS 0 SYMBOL_LINK "Rte_CDD_RamMem_dRamMemSpi1RamEccErrAdr" 0 DISPLAY_IDENTIFIER CDD_RamMem.PerInstanceMemories.dRamMemSpi1RamEccErrAdr /end MEASUREMENT
/begin MEASUREMENT CDD_RamMem.dRamMemSpi2RamEccErrAdr "MICROSAR RTE" ULONG NO_COMPU_METHOD 0 0 0 4294967295 ECU_ADDRESS 0 SYMBOL_LINK "Rte_CDD_RamMem_dRamMemSpi2RamEccErrAdr" 0 DISPLAY_IDENTIFIER CDD_RamMem.PerInstanceMemories.dRamMemSpi2RamEccErrAdr /end MEASUREMENT
/begin MEASUREMENT CDD_RamMem.dRamMemSpi3RamEccErrAdr "MICROSAR RTE" ULONG NO_COMPU_METHOD 0 0 0 4294967295 ECU_ADDRESS 0 SYMBOL_LINK "Rte_CDD_RamMem_dRamMemSpi3RamEccErrAdr" 0 DISPLAY_IDENTIFIER CDD_RamMem.PerInstanceMemories.dRamMemSpi3RamEccErrAdr /end MEASUREMENT
/begin MEASUREMENT CDD_RamMem.dRamMemSpiRamEccErrAdr "MICROSAR RTE" ULONG NO_COMPU_METHOD 0 0 0 4294967295 ECU_ADDRESS 0 SYMBOL_LINK "Rte_CDD_RamMem_dRamMemSpiRamEccErrAdr" 0 DISPLAY_IDENTIFIER CDD_RamMem.PerInstanceMemories.dRamMemSpiRamEccErrAdr /end MEASUREMENT
/begin MEASUREMENT CDD_SinVltgGenn.Fil1OutpPrev "MICROSAR RTE" FLOAT32_IEEE NO_COMPU_METHOD 0 0 0 71429 ECU_ADDRESS 0 SYMBOL_LINK "Rte_CDD_SinVltgGenn_Fil1OutpPrev" 0 DISPLAY_IDENTIFIER CDD_SinVltgGenn.PerInstanceMemories.Fil1OutpPrev /end MEASUREMENT
/begin MEASUREMENT CDD_SinVltgGenn.Fil2OutpPrev "MICROSAR RTE" FLOAT32_IEEE NO_COMPU_METHOD 0 0 0 71429 ECU_ADDRESS 0 SYMBOL_LINK "Rte_CDD_SinVltgGenn_Fil2OutpPrev" 0 DISPLAY_IDENTIFIER CDD_SinVltgGenn.PerInstanceMemories.Fil2OutpPrev /end MEASUREMENT
/begin MEASUREMENT CDD_SinVltgGenn.MotElecMeclPolarity.Val "MICROSAR RTE" SBYTE NO_COMPU_METHOD 0 0 -1.0 1.0 ECU_ADDRESS 0 SYMBOL_LINK "Rte_PolarityCfg_MotElecMeclPolarity_Val" 0 DISPLAY_IDENTIFIER CDD_SinVltgGenn.ReceiverPorts.MotElecMeclPolarity.Val /end MEASUREMENT
/begin MEASUREMENT CDD_SinVltgGenn.PhaDptOffsA "MICROSAR RTE" FLOAT32_IEEE NO_COMPU_METHOD 0 0 0.0 0.999 ECU_ADDRESS 0 SYMBOL_LINK "Rte_CDD_SinVltgGenn_PhaDptOffsA" 0 DISPLAY_IDENTIFIER CDD_SinVltgGenn.PerInstanceMemories.PhaDptOffsA /end MEASUREMENT
/begin MEASUREMENT CDD_SinVltgGenn.PhaDptOffsB "MICROSAR RTE" FLOAT32_IEEE NO_COMPU_METHOD 0 0 0.0 0.999 ECU_ADDRESS 0 SYMBOL_LINK "Rte_CDD_SinVltgGenn_PhaDptOffsB" 0 DISPLAY_IDENTIFIER CDD_SinVltgGenn.PerInstanceMemories.PhaDptOffsB /end MEASUREMENT
/begin MEASUREMENT CDD_SinVltgGenn.PhaDptOffsC "MICROSAR RTE" FLOAT32_IEEE NO_COMPU_METHOD 0 0 0.0 0.999 ECU_ADDRESS 0 SYMBOL_LINK "Rte_CDD_SinVltgGenn_PhaDptOffsC" 0 DISPLAY_IDENTIFIER CDD_SinVltgGenn.PerInstanceMemories.PhaDptOffsC /end MEASUREMENT
/begin MEASUREMENT CDD_SinVltgGenn.PhaOnTiSumAPrev "MICROSAR RTE" ULONG NO_COMPU_METHOD 0 0 0 4294967295 ECU_ADDRESS 0 SYMBOL_LINK "Rte_CDD_SinVltgGenn_PhaOnTiSumAPrev" 0 DISPLAY_IDENTIFIER CDD_SinVltgGenn.PerInstanceMemories.PhaOnTiSumAPrev /end MEASUREMENT
/begin MEASUREMENT CDD_SinVltgGenn.PhaOnTiSumBPrev "MICROSAR RTE" ULONG NO_COMPU_METHOD 0 0 0 4294967295 ECU_ADDRESS 0 SYMBOL_LINK "Rte_CDD_SinVltgGenn_PhaOnTiSumBPrev" 0 DISPLAY_IDENTIFIER CDD_SinVltgGenn.PerInstanceMemories.PhaOnTiSumBPrev /end MEASUREMENT
/begin GROUP CDD_McuDiagc.SlowLoopCntr.Val "MICROSAR RTE" /begin SUB_GROUP /end SUB_GROUP /begin FUNCTION_LIST /end FUNCTION_LIST /begin REF_CHARACTERISTIC /end REF_CHARACTERISTIC /begin REF_MEASUREMENT CDD_McuDiagc.SlowLoopCntr.Val /end REF_MEASUREMENT /end GROUP
/begin GROUP CDD_McuDiagc.dMcuDiagcFastLoopCntrMax "MICROSAR RTE" /begin SUB_GROUP /end SUB_GROUP /begin FUNCTION_LIST /end FUNCTION_LIST /begin REF_CHARACTERISTIC /end REF_CHARACTERISTIC /begin REF_MEASUREMENT CDD_McuDiagc.dMcuDiagcFastLoopCntrMax /end REF_MEASUREMENT /end GROUP
/begin GROUP CDD_McuDiagc.dMcuDiagcFastLoopCntrMin "MICROSAR RTE" /begin SUB_GROUP /end SUB_GROUP /begin FUNCTION_LIST /end FUNCTION_LIST /begin REF_CHARACTERISTIC /end REF_CHARACTERISTIC /begin REF_MEASUREMENT CDD_McuDiagc.dMcuDiagcFastLoopCntrMin /end REF_MEASUREMENT /end GROUP
/begin GROUP CDD_McuDiagc.dMcuDiagcLoopCntr2MilliSecMotCtrlDif "MICROSAR RTE" /begin SUB_GROUP /end SUB_GROUP /begin FUNCTION_LIST /end FUNCTION_LIST /begin REF_CHARACTERISTIC /end REF_CHARACTERISTIC /begin REF_MEASUREMENT CDD_McuDiagc.dMcuDiagcLoopCntr2MilliSecMotCtrlDif /end REF_MEASUREMENT /end GROUP
/begin GROUP CDD_MotAg0Meas "MICROSAR RTE"
 /begin SUB_GROUP CDD_MotAg0Meas.CalibrationParameters CDD_MotAg0Meas.PerInstanceMemories CDD_MotAg0Meas.ReceiverPorts CDD_MotAg0Meas.SenderPorts /end SUB_GROUP
 /begin FUNCTION_LIST /end FUNCTION_LIST
 /begin REF_CHARACTERISTIC /end REF_CHARACTERISTIC
 /begin REF_MEASUREMENT /end REF_MEASUREMENT
/end GROUP
/begin GROUP CDD_MotAg0Meas.CalibrationParameters "MICROSAR RTE" /begin SUB_GROUP CDD_MotAg0Meas.MotAg0CoeffTblDft /end SUB_GROUP /begin FUNCTION_LIST /end FUNCTION_LIST /begin REF_CHARACTERISTIC /end REF_CHARACTERISTIC /begin REF_MEASUREMENT /end REF_MEASUREMENT /end GROUP
/begin GROUP CDD_MotAg0Meas.MotAg0CoeffTbl "MICROSAR RTE" /begin SUB_GROUP /end SUB_GROUP /begin FUNCTION_LIST /end FUNCTION_LIST /begin REF_CHARACTERISTIC /end REF_CHARACTERISTIC /begin REF_MEASUREMENT CDD_MotAg0Meas.MotAg0CoeffTbl /end REF_MEASUREMENT /end GROUP
/begin GROUP CDD_MotAg0Meas.MotAg0CoeffTblDft "MICROSAR RTE" /begin SUB_GROUP /end SUB_GROUP /begin FUNCTION_LIST /end FUNCTION_LIST /begin REF_CHARACTERISTIC CDD_MotAg0Meas.MotAg0CoeffTblDft /end REF_CHARACTERISTIC /begin REF_MEASUREMENT /end REF_MEASUREMENT /end GROUP
/begin GROUP CDD_MotAg0Meas.MotAg0CorrnTbl "MICROSAR RTE" /begin SUB_GROUP /end SUB_GROUP /begin FUNCTION_LIST /end FUNCTION_LIST /begin REF_CHARACTERISTIC /end REF_CHARACTERISTIC /begin REF_MEASUREMENT CDD_MotAg0Meas.MotAg0CorrnTbl /end REF_MEASUREMENT /end GROUP
/begin GROUP CDD_MotAg0Meas.MotAg0ErrParFltCntPrev "MICROSAR RTE" /begin SUB_GROUP /end SUB_GROUP /begin FUNCTION_LIST /end FUNCTION_LIST /begin REF_CHARACTERISTIC /end REF_CHARACTERISTIC /begin REF_MEASUREMENT CDD_MotAg0Meas.MotAg0ErrParFltCntPrev /end REF_MEASUREMENT /end GROUP
/begin GROUP CDD_MotAg0Meas.MotAg0ErrParFltNtcStInfoCntPrev "MICROSAR RTE" /begin SUB_GROUP /end SUB_GROUP /begin FUNCTION_LIST /end FUNCTION_LIST /begin REF_CHARACTERISTIC /end REF_CHARACTERISTIC /begin REF_MEASUREMENT CDD_MotAg0Meas.MotAg0ErrParFltNtcStInfoCntPrev /end REF_MEASUREMENT /end GROUP
/begin GROUP CDD_MotAg0Meas.MotAg0ErrPrev "MICROSAR RTE" /begin SUB_GROUP /end SUB_GROUP /begin FUNCTION_LIST /end FUNCTION_LIST /begin REF_CHARACTERISTIC /end REF_CHARACTERISTIC /begin REF_MEASUREMENT CDD_MotAg0Meas.MotAg0ErrPrev /end REF_MEASUREMENT /end GROUP
/begin GROUP CDD_MotAg0Meas.MotAg0ErrReg.Val "MICROSAR RTE" /begin SUB_GROUP /end SUB_GROUP /begin FUNCTION_LIST /end FUNCTION_LIST /begin REF_CHARACTERISTIC /end REF_CHARACTERISTIC /begin REF_MEASUREMENT CDD_MotAg0Meas.MotAg0ErrReg.Val /end REF_MEASUREMENT /end GROUP
/begin GROUP CDD_MotAg0Meas.MotAg0MeclQlfr.Val "MICROSAR RTE" /begin SUB_GROUP /end SUB_GROUP /begin FUNCTION_LIST /end FUNCTION_LIST /begin REF_CHARACTERISTIC /end REF_CHARACTERISTIC /begin REF_MEASUREMENT CDD_MotAg0Meas.MotAg0MeclQlfr.Val /end REF_MEASUREMENT /end GROUP
/begin GROUP CDD_MotAg0Meas.MotAg0MeclRollgCntrPrev "MICROSAR RTE" /begin SUB_GROUP /end SUB_GROUP /begin FUNCTION_LIST /end FUNCTION_LIST /begin REF_CHARACTERISTIC /end REF_CHARACTERISTIC /begin REF_MEASUREMENT CDD_MotAg0Meas.MotAg0MeclRollgCntrPrev /end REF_MEASUREMENT /end GROUP
/begin GROUP CDD_MotAg0Meas.MotAg0ParFltCnt.Val "MICROSAR RTE" /begin SUB_GROUP /end SUB_GROUP /begin FUNCTION_LIST /end FUNCTION_LIST /begin REF_CHARACTERISTIC /end REF_CHARACTERISTIC /begin REF_MEASUREMENT CDD_MotAg0Meas.MotAg0ParFltCnt.Val /end REF_MEASUREMENT /end GROUP
/begin GROUP CDD_MotAg0Meas.MotAg0ParFltCntPrev "MICROSAR RTE" /begin SUB_GROUP /end SUB_GROUP /begin FUNCTION_LIST /end FUNCTION_LIST /begin REF_CHARACTERISTIC /end REF_CHARACTERISTIC /begin REF_MEASUREMENT CDD_MotAg0Meas.MotAg0ParFltCntPrev /end REF_MEASUREMENT /end GROUP
/begin GROUP CDD_MotAg0Meas.MotAg0ParFltNtcStInfoCntPrev "MICROSAR RTE" /begin SUB_GROUP /end SUB_GROUP /begin FUNCTION_LIST /end FUNCTION_LIST /begin REF_CHARACTERISTIC /end REF_CHARACTERISTIC /begin REF_MEASUREMENT CDD_MotAg0Meas.MotAg0ParFltNtcStInfoCntPrev /end REF_MEASUREMENT /end GROUP
/begin GROUP CDD_MotAg0Meas.MotAg0RawMeclPrev "MICROSAR RTE" /begin SUB_GROUP /end SUB_GROUP /begin FUNCTION_LIST /end FUNCTION_LIST /begin REF_CHARACTERISTIC /end REF_CHARACTERISTIC /begin REF_MEASUREMENT CDD_MotAg0Meas.MotAg0RawMeclPrev /end REF_MEASUREMENT /end GROUP
/begin GROUP CDD_MotAg0Meas.MotAg0VltgFltCnt.Val "MICROSAR RTE" /begin SUB_GROUP /end SUB_GROUP /begin FUNCTION_LIST /end FUNCTION_LIST /begin REF_CHARACTERISTIC /end REF_CHARACTERISTIC /begin REF_MEASUREMENT CDD_MotAg0Meas.MotAg0VltgFltCnt.Val /end REF_MEASUREMENT /end GROUP
/begin GROUP CDD_MotAg0Meas.MotAg0VltgFltCntPrev "MICROSAR RTE" /begin SUB_GROUP /end SUB_GROUP /begin FUNCTION_LIST /end FUNCTION_LIST /begin REF_CHARACTERISTIC /end REF_CHARACTERISTIC /begin REF_MEASUREMENT CDD_MotAg0Meas.MotAg0VltgFltCntPrev /end REF_MEASUREMENT /end GROUP
/begin GROUP CDD_MotAg0Meas.MotAg0VltgFltNtcStInfoCntPrev "MICROSAR RTE" /begin SUB_GROUP /end SUB_GROUP /begin FUNCTION_LIST /end FUNCTION_LIST /begin REF_CHARACTERISTIC /end REF_CHARACTERISTIC /begin REF_MEASUREMENT CDD_MotAg0Meas.MotAg0VltgFltNtcStInfoCntPrev /end REF_MEASUREMENT /end GROUP
/begin GROUP CDD_MotAg0Meas.PerInstanceMemories "MICROSAR RTE"
 /begin SUB_GROUP CDD_MotAg0Meas.MotAg0CoeffTbl CDD_MotAg0Meas.MotAg0CorrnTbl CDD_MotAg0Meas.MotAg0ErrParFltCntPrev CDD_MotAg0Meas.MotAg0ErrParFltNtcStInfoCntPrev CDD_MotAg0Meas.MotAg0ErrPrev CDD_MotAg0Meas.MotAg0MeclRollgCntrPrev CDD_MotAg0Meas.MotAg0ParFltCntPrev CDD_MotAg0Meas.MotAg0ParFltNtcStInfoCntPrev CDD_MotAg0Meas.MotAg0RawMeclPrev CDD_MotAg0Meas.MotAg0VltgFltCntPrev CDD_MotAg0Meas.MotAg0VltgFltNtcStInfoCntPrev CDD_MotAg0Meas.dMotAg0MeasMotAg0RawAgReg CDD_MotAg0Meas.dMotAg0MeasMotAg0RawErrReg CDD_MotAg0Meas.dMotAg0MeasMotAg0RawTurnCntrReg /end SUB_GROUP
 /begin FUNCTION_LIST /end FUNCTION_LIST
 /begin REF_CHARACTERISTIC /end REF_CHARACTERISTIC
 /begin REF_MEASUREMENT /end REF_MEASUREMENT
/end GROUP
/begin GROUP CDD_MotAg0Meas.ReceiverPorts "MICROSAR RTE"
 /begin SUB_GROUP CDD_MotAg0Meas.MotAg0ErrReg.Val CDD_MotAg0Meas.MotAg0ParFltCnt.Val CDD_MotAg0Meas.MotAg0VltgFltCnt.Val /end SUB_GROUP
 /begin FUNCTION_LIST /end FUNCTION_LIST
 /begin REF_CHARACTERISTIC /end REF_CHARACTERISTIC
 /begin REF_MEASUREMENT /end REF_MEASUREMENT
/end GROUP
/begin GROUP CDD_MotAg0Meas.SenderPorts "MICROSAR RTE" /begin SUB_GROUP CDD_MotAg0Meas.MotAg0MeclQlfr.Val /end SUB_GROUP /begin FUNCTION_LIST /end FUNCTION_LIST /begin REF_CHARACTERISTIC /end REF_CHARACTERISTIC /begin REF_MEASUREMENT /end REF_MEASUREMENT /end GROUP
/begin GROUP CDD_MotAg0Meas.dMotAg0MeasMotAg0RawAgReg "MICROSAR RTE" /begin SUB_GROUP /end SUB_GROUP /begin FUNCTION_LIST /end FUNCTION_LIST /begin REF_CHARACTERISTIC /end REF_CHARACTERISTIC /begin REF_MEASUREMENT CDD_MotAg0Meas.dMotAg0MeasMotAg0RawAgReg /end REF_MEASUREMENT /end GROUP
/begin GROUP CDD_MotAg0Meas.dMotAg0MeasMotAg0RawErrReg "MICROSAR RTE" /begin SUB_GROUP /end SUB_GROUP /begin FUNCTION_LIST /end FUNCTION_LIST /begin REF_CHARACTERISTIC /end REF_CHARACTERISTIC /begin REF_MEASUREMENT CDD_MotAg0Meas.dMotAg0MeasMotAg0RawErrReg /end REF_MEASUREMENT /end GROUP
/begin GROUP CDD_MotAg0Meas.dMotAg0MeasMotAg0RawTurnCntrReg "MICROSAR RTE" /begin SUB_GROUP /end SUB_GROUP /begin FUNCTION_LIST /end FUNCTION_LIST /begin REF_CHARACTERISTIC /end REF_CHARACTERISTIC /begin REF_MEASUREMENT CDD_MotAg0Meas.dMotAg0MeasMotAg0RawTurnCntrReg /end REF_MEASUREMENT /end GROUP
/begin GROUP CDD_MotAg1Meas "MICROSAR RTE"
 /begin SUB_GROUP CDD_MotAg1Meas.CalibrationParameters CDD_MotAg1Meas.PerInstanceMemories CDD_MotAg1Meas.ReceiverPorts CDD_MotAg1Meas.SenderPorts /end SUB_GROUP
 /begin FUNCTION_LIST /end FUNCTION_LIST
 /begin REF_CHARACTERISTIC /end REF_CHARACTERISTIC
 /begin REF_MEASUREMENT /end REF_MEASUREMENT
/end GROUP
/begin GROUP CDD_MotAg1Meas.CalibrationParameters "MICROSAR RTE" /begin SUB_GROUP CDD_MotAg1Meas.MotAg1CoeffTblDft /end SUB_GROUP /begin FUNCTION_LIST /end FUNCTION_LIST /begin REF_CHARACTERISTIC /end REF_CHARACTERISTIC /begin REF_MEASUREMENT /end REF_MEASUREMENT /end GROUP
/begin GROUP CDD_MotAg1Meas.MotAg1CoeffTbl "MICROSAR RTE" /begin SUB_GROUP /end SUB_GROUP /begin FUNCTION_LIST /end FUNCTION_LIST /begin REF_CHARACTERISTIC /end REF_CHARACTERISTIC /begin REF_MEASUREMENT CDD_MotAg1Meas.MotAg1CoeffTbl /end REF_MEASUREMENT /end GROUP
/begin GROUP CDD_MotAg1Meas.MotAg1CoeffTblDft "MICROSAR RTE" /begin SUB_GROUP /end SUB_GROUP /begin FUNCTION_LIST /end FUNCTION_LIST /begin REF_CHARACTERISTIC CDD_MotAg1Meas.MotAg1CoeffTblDft /end REF_CHARACTERISTIC /begin REF_MEASUREMENT /end REF_MEASUREMENT /end GROUP
/begin GROUP CDD_MotAg1Meas.MotAg1CorrnTbl "MICROSAR RTE" /begin SUB_GROUP /end SUB_GROUP /begin FUNCTION_LIST /end FUNCTION_LIST /begin REF_CHARACTERISTIC /end REF_CHARACTERISTIC /begin REF_MEASUREMENT CDD_MotAg1Meas.MotAg1CorrnTbl /end REF_MEASUREMENT /end GROUP
/begin GROUP CDD_MotAg1Meas.MotAg1ErrParFltCntPrev "MICROSAR RTE" /begin SUB_GROUP /end SUB_GROUP /begin FUNCTION_LIST /end FUNCTION_LIST /begin REF_CHARACTERISTIC /end REF_CHARACTERISTIC /begin REF_MEASUREMENT CDD_MotAg1Meas.MotAg1ErrParFltCntPrev /end REF_MEASUREMENT /end GROUP
/begin GROUP CDD_MotAg1Meas.MotAg1ErrParFltNtcStInfoCntPrev "MICROSAR RTE" /begin SUB_GROUP /end SUB_GROUP /begin FUNCTION_LIST /end FUNCTION_LIST /begin REF_CHARACTERISTIC /end REF_CHARACTERISTIC /begin REF_MEASUREMENT CDD_MotAg1Meas.MotAg1ErrParFltNtcStInfoCntPrev /end REF_MEASUREMENT /end GROUP
/begin GROUP CDD_MotAg1Meas.MotAg1ErrPrev "MICROSAR RTE" /begin SUB_GROUP /end SUB_GROUP /begin FUNCTION_LIST /end FUNCTION_LIST /begin REF_CHARACTERISTIC /end REF_CHARACTERISTIC /begin REF_MEASUREMENT CDD_MotAg1Meas.MotAg1ErrPrev /end REF_MEASUREMENT /end GROUP
/begin GROUP CDD_MotAg1Meas.MotAg1ErrReg.Val "MICROSAR RTE" /begin SUB_GROUP /end SUB_GROUP /begin FUNCTION_LIST /end FUNCTION_LIST /begin REF_CHARACTERISTIC /end REF_CHARACTERISTIC /begin REF_MEASUREMENT CDD_MotAg1Meas.MotAg1ErrReg.Val /end REF_MEASUREMENT /end GROUP
/begin GROUP CDD_MotAg1Meas.MotAg1MeclQlfr.Val "MICROSAR RTE" /begin SUB_GROUP /end SUB_GROUP /begin FUNCTION_LIST /end FUNCTION_LIST /begin REF_CHARACTERISTIC /end REF_CHARACTERISTIC /begin REF_MEASUREMENT CDD_MotAg1Meas.MotAg1MeclQlfr.Val /end REF_MEASUREMENT /end GROUP
/begin GROUP CDD_MotAg1Meas.MotAg1MeclRollgCntrPrev "MICROSAR RTE" /begin SUB_GROUP /end SUB_GROUP /begin FUNCTION_LIST /end FUNCTION_LIST /begin REF_CHARACTERISTIC /end REF_CHARACTERISTIC /begin REF_MEASUREMENT CDD_MotAg1Meas.MotAg1MeclRollgCntrPrev /end REF_MEASUREMENT /end GROUP
/begin GROUP CDD_MotAg1Meas.MotAg1ParFltCnt.Val "MICROSAR RTE" /begin SUB_GROUP /end SUB_GROUP /begin FUNCTION_LIST /end FUNCTION_LIST /begin REF_CHARACTERISTIC /end REF_CHARACTERISTIC /begin REF_MEASUREMENT CDD_MotAg1Meas.MotAg1ParFltCnt.Val /end REF_MEASUREMENT /end GROUP
/begin GROUP CDD_MotAg1Meas.MotAg1ParFltCntPrev "MICROSAR RTE" /begin SUB_GROUP /end SUB_GROUP /begin FUNCTION_LIST /end FUNCTION_LIST /begin REF_CHARACTERISTIC /end REF_CHARACTERISTIC /begin REF_MEASUREMENT CDD_MotAg1Meas.MotAg1ParFltCntPrev /end REF_MEASUREMENT /end GROUP
/begin GROUP CDD_MotAg1Meas.MotAg1ParFltNtcStInfoCntPrev "MICROSAR RTE" /begin SUB_GROUP /end SUB_GROUP /begin FUNCTION_LIST /end FUNCTION_LIST /begin REF_CHARACTERISTIC /end REF_CHARACTERISTIC /begin REF_MEASUREMENT CDD_MotAg1Meas.MotAg1ParFltNtcStInfoCntPrev /end REF_MEASUREMENT /end GROUP
/begin GROUP CDD_MotAg1Meas.MotAg1RawMeclPrev "MICROSAR RTE" /begin SUB_GROUP /end SUB_GROUP /begin FUNCTION_LIST /end FUNCTION_LIST /begin REF_CHARACTERISTIC /end REF_CHARACTERISTIC /begin REF_MEASUREMENT CDD_MotAg1Meas.MotAg1RawMeclPrev /end REF_MEASUREMENT /end GROUP
/begin GROUP CDD_MotAg1Meas.MotAg1VltgFltCnt.Val "MICROSAR RTE" /begin SUB_GROUP /end SUB_GROUP /begin FUNCTION_LIST /end FUNCTION_LIST /begin REF_CHARACTERISTIC /end REF_CHARACTERISTIC /begin REF_MEASUREMENT CDD_MotAg1Meas.MotAg1VltgFltCnt.Val /end REF_MEASUREMENT /end GROUP
/begin GROUP CDD_MotAg1Meas.MotAg1VltgFltCntPrev "MICROSAR RTE" /begin SUB_GROUP /end SUB_GROUP /begin FUNCTION_LIST /end FUNCTION_LIST /begin REF_CHARACTERISTIC /end REF_CHARACTERISTIC /begin REF_MEASUREMENT CDD_MotAg1Meas.MotAg1VltgFltCntPrev /end REF_MEASUREMENT /end GROUP
/begin GROUP CDD_MotAg1Meas.MotAg1VltgFltNtcStInfoCntPrev "MICROSAR RTE" /begin SUB_GROUP /end SUB_GROUP /begin FUNCTION_LIST /end FUNCTION_LIST /begin REF_CHARACTERISTIC /end REF_CHARACTERISTIC /begin REF_MEASUREMENT CDD_MotAg1Meas.MotAg1VltgFltNtcStInfoCntPrev /end REF_MEASUREMENT /end GROUP
/begin GROUP CDD_MotAg1Meas.PerInstanceMemories "MICROSAR RTE"
 /begin SUB_GROUP CDD_MotAg1Meas.MotAg1CoeffTbl CDD_MotAg1Meas.MotAg1CorrnTbl CDD_MotAg1Meas.MotAg1ErrParFltCntPrev CDD_MotAg1Meas.MotAg1ErrParFltNtcStInfoCntPrev CDD_MotAg1Meas.MotAg1ErrPrev CDD_MotAg1Meas.MotAg1MeclRollgCntrPrev CDD_MotAg1Meas.MotAg1ParFltCntPrev CDD_MotAg1Meas.MotAg1ParFltNtcStInfoCntPrev CDD_MotAg1Meas.MotAg1RawMeclPrev CDD_MotAg1Meas.MotAg1VltgFltCntPrev CDD_MotAg1Meas.MotAg1VltgFltNtcStInfoCntPrev CDD_MotAg1Meas.dMotAg1MeasMotAg1RawAgReg CDD_MotAg1Meas.dMotAg1MeasMotAg1RawErrReg CDD_MotAg1Meas.dMotAg1MeasMotAg1RawTurnCntrReg /end SUB_GROUP
 /begin FUNCTION_LIST /end FUNCTION_LIST
 /begin REF_CHARACTERISTIC /end REF_CHARACTERISTIC
 /begin REF_MEASUREMENT /end REF_MEASUREMENT
/end GROUP
/begin GROUP CDD_MotAg1Meas.ReceiverPorts "MICROSAR RTE"
 /begin SUB_GROUP CDD_MotAg1Meas.MotAg1ErrReg.Val CDD_MotAg1Meas.MotAg1ParFltCnt.Val CDD_MotAg1Meas.MotAg1VltgFltCnt.Val /end SUB_GROUP
 /begin FUNCTION_LIST /end FUNCTION_LIST
 /begin REF_CHARACTERISTIC /end REF_CHARACTERISTIC
 /begin REF_MEASUREMENT /end REF_MEASUREMENT
/end GROUP
/begin GROUP CDD_MotAg1Meas.SenderPorts "MICROSAR RTE" /begin SUB_GROUP CDD_MotAg1Meas.MotAg1MeclQlfr.Val /end SUB_GROUP /begin FUNCTION_LIST /end FUNCTION_LIST /begin REF_CHARACTERISTIC /end REF_CHARACTERISTIC /begin REF_MEASUREMENT /end REF_MEASUREMENT /end GROUP
/begin GROUP CDD_MotAg1Meas.dMotAg1MeasMotAg1RawAgReg "MICROSAR RTE" /begin SUB_GROUP /end SUB_GROUP /begin FUNCTION_LIST /end FUNCTION_LIST /begin REF_CHARACTERISTIC /end REF_CHARACTERISTIC /begin REF_MEASUREMENT CDD_MotAg1Meas.dMotAg1MeasMotAg1RawAgReg /end REF_MEASUREMENT /end GROUP
/begin GROUP CDD_MotAg1Meas.dMotAg1MeasMotAg1RawErrReg "MICROSAR RTE" /begin SUB_GROUP /end SUB_GROUP /begin FUNCTION_LIST /end FUNCTION_LIST /begin REF_CHARACTERISTIC /end REF_CHARACTERISTIC /begin REF_MEASUREMENT CDD_MotAg1Meas.dMotAg1MeasMotAg1RawErrReg /end REF_MEASUREMENT /end GROUP
/begin GROUP CDD_MotAg1Meas.dMotAg1MeasMotAg1RawTurnCntrReg "MICROSAR RTE" /begin SUB_GROUP /end SUB_GROUP /begin FUNCTION_LIST /end FUNCTION_LIST /begin REF_CHARACTERISTIC /end REF_CHARACTERISTIC /begin REF_MEASUREMENT CDD_MotAg1Meas.dMotAg1MeasMotAg1RawTurnCntrReg /end REF_MEASUREMENT /end GROUP
/begin GROUP CDD_MotAgArbn "MICROSAR RTE" /begin SUB_GROUP CDD_MotAgArbn.PerInstanceMemories /end SUB_GROUP /begin FUNCTION_LIST /end FUNCTION_LIST /begin REF_CHARACTERISTIC /end REF_CHARACTERISTIC /begin REF_MEASUREMENT /end REF_MEASUREMENT /end GROUP
/begin GROUP CDD_MotAgArbn.MotAgARollgCntPrev "MICROSAR RTE" /begin SUB_GROUP /end SUB_GROUP /begin FUNCTION_LIST /end FUNCTION_LIST /begin REF_CHARACTERISTIC /end REF_CHARACTERISTIC /begin REF_MEASUREMENT CDD_MotAgArbn.MotAgARollgCntPrev /end REF_MEASUREMENT /end GROUP
/begin GROUP CDD_MotAgArbn.MotAgAStallCntPrev "MICROSAR RTE" /begin SUB_GROUP /end SUB_GROUP /begin FUNCTION_LIST /end FUNCTION_LIST /begin REF_CHARACTERISTIC /end REF_CHARACTERISTIC /begin REF_MEASUREMENT CDD_MotAgArbn.MotAgAStallCntPrev /end REF_MEASUREMENT /end GROUP
/begin GROUP CDD_MotAgArbn.MotAgBRollgCntPrev "MICROSAR RTE" /begin SUB_GROUP /end SUB_GROUP /begin FUNCTION_LIST /end FUNCTION_LIST /begin REF_CHARACTERISTIC /end REF_CHARACTERISTIC /begin REF_MEASUREMENT CDD_MotAgArbn.MotAgBRollgCntPrev /end REF_MEASUREMENT /end GROUP
/begin GROUP CDD_MotAgArbn.MotAgBStallCntPrev "MICROSAR RTE" /begin SUB_GROUP /end SUB_GROUP /begin FUNCTION_LIST /end FUNCTION_LIST /begin REF_CHARACTERISTIC /end REF_CHARACTERISTIC /begin REF_MEASUREMENT CDD_MotAgArbn.MotAgBStallCntPrev /end REF_MEASUREMENT /end GROUP
/begin GROUP CDD_MotAgArbn.MotAgMeclPrev "MICROSAR RTE" /begin SUB_GROUP /end SUB_GROUP /begin FUNCTION_LIST /end FUNCTION_LIST /begin REF_CHARACTERISTIC /end REF_CHARACTERISTIC /begin REF_MEASUREMENT CDD_MotAgArbn.MotAgMeclPrev /end REF_MEASUREMENT /end GROUP
/begin GROUP CDD_MotAgArbn.PerInstanceMemories "MICROSAR RTE"
 /begin SUB_GROUP CDD_MotAgArbn.MotAgARollgCntPrev CDD_MotAgArbn.MotAgAStallCntPrev CDD_MotAgArbn.MotAgBRollgCntPrev CDD_MotAgArbn.MotAgBStallCntPrev CDD_MotAgArbn.MotAgMeclPrev /end SUB_GROUP
 /begin FUNCTION_LIST /end FUNCTION_LIST
 /begin REF_CHARACTERISTIC /end REF_CHARACTERISTIC
 /begin REF_MEASUREMENT /end REF_MEASUREMENT
/end GROUP
/begin GROUP CDD_MotAgCmp "MICROSAR RTE"
 /begin SUB_GROUP CDD_MotAgCmp.CalibrationParameters CDD_MotAgCmp.CalibrationPorts CDD_MotAgCmp.PerInstanceMemories CDD_MotAgCmp.ReceiverPorts CDD_MotAgCmp.SenderPorts /end SUB_GROUP
 /begin FUNCTION_LIST /end FUNCTION_LIST
 /begin REF_CHARACTERISTIC /end REF_CHARACTERISTIC
 /begin REF_MEASUREMENT /end REF_MEASUREMENT
/end GROUP
/begin GROUP CDD_MotAgCmp.AssiMechPolarity.Val "MICROSAR RTE" /begin SUB_GROUP /end SUB_GROUP /begin FUNCTION_LIST /end FUNCTION_LIST /begin REF_CHARACTERISTIC /end REF_CHARACTERISTIC /begin REF_MEASUREMENT CDD_MotAgCmp.AssiMechPolarity.Val /end REF_MEASUREMENT /end GROUP
/begin GROUP CDD_MotAgCmp.CalibrationParameters "MICROSAR RTE" /begin SUB_GROUP CDD_MotAgCmp.MotAgCmpMotAgBackEmfDft /end SUB_GROUP /begin FUNCTION_LIST /end FUNCTION_LIST /begin REF_CHARACTERISTIC /end REF_CHARACTERISTIC /begin REF_MEASUREMENT /end REF_MEASUREMENT /end GROUP
/begin GROUP CDD_MotAgCmp.CalibrationPorts "MICROSAR RTE"
 /begin SUB_GROUP CDD_MotAgCmp.SysGlbPrmMotPoleCnt.Val CDD_MotAgCmp.SysGlbPrmSysKineRat.Val /end SUB_GROUP
 /begin FUNCTION_LIST /end FUNCTION_LIST
 /begin REF_CHARACTERISTIC /end REF_CHARACTERISTIC
 /begin REF_MEASUREMENT /end REF_MEASUREMENT
/end GROUP
/begin GROUP CDD_MotAgCmp.CmpEnaCntr "MICROSAR RTE" /begin SUB_GROUP /end SUB_GROUP /begin FUNCTION_LIST /end FUNCTION_LIST /begin REF_CHARACTERISTIC /end REF_CHARACTERISTIC /begin REF_MEASUREMENT CDD_MotAgCmp.CmpEnaCntr /end REF_MEASUREMENT /end GROUP
/begin GROUP CDD_MotAgCmp.DigMotHwPosn "MICROSAR RTE" /begin SUB_GROUP /end SUB_GROUP /begin FUNCTION_LIST /end FUNCTION_LIST /begin REF_CHARACTERISTIC /end REF_CHARACTERISTIC /begin REF_MEASUREMENT CDD_MotAgCmp.DigMotHwPosn /end REF_MEASUREMENT /end GROUP
/begin GROUP CDD_MotAgCmp.MotAgCmpMotAgBackEmf "MICROSAR RTE" /begin SUB_GROUP /end SUB_GROUP /begin FUNCTION_LIST /end FUNCTION_LIST /begin REF_CHARACTERISTIC /end REF_CHARACTERISTIC /begin REF_MEASUREMENT CDD_MotAgCmp.MotAgCmpMotAgBackEmf /end REF_MEASUREMENT /end GROUP
/begin GROUP CDD_MotAgCmp.MotAgCmpMotAgBackEmfDft "MICROSAR RTE" /begin SUB_GROUP /end SUB_GROUP /begin FUNCTION_LIST /end FUNCTION_LIST /begin REF_CHARACTERISTIC CDD_MotAgCmp.MotAgCmpMotAgBackEmfDft /end REF_CHARACTERISTIC /begin REF_MEASUREMENT /end REF_MEASUREMENT /end GROUP
/begin GROUP CDD_MotAgCmp.MotAgCmpMotCtrlMotAgCumvAlgndMrfRevSVPrev "MICROSAR RTE" /begin SUB_GROUP /end SUB_GROUP /begin FUNCTION_LIST /end FUNCTION_LIST /begin REF_CHARACTERISTIC /end REF_CHARACTERISTIC /begin REF_MEASUREMENT CDD_MotAgCmp.MotAgCmpMotCtrlMotAgCumvAlgndMrfRevSVPrev /end REF_MEASUREMENT /end GROUP
/begin GROUP CDD_MotAgCmp.MotAgCmpMotCtrlMotAgMeclPrev "MICROSAR RTE" /begin SUB_GROUP /end SUB_GROUP /begin FUNCTION_LIST /end FUNCTION_LIST /begin REF_CHARACTERISTIC /end REF_CHARACTERISTIC /begin REF_MEASUREMENT CDD_MotAgCmp.MotAgCmpMotCtrlMotAgMeclPrev /end REF_MEASUREMENT /end GROUP
/begin GROUP CDD_MotAgCmp.MotAgCumvAlgndCrf.Val "MICROSAR RTE" /begin SUB_GROUP /end SUB_GROUP /begin FUNCTION_LIST /end FUNCTION_LIST /begin REF_CHARACTERISTIC /end REF_CHARACTERISTIC /begin REF_MEASUREMENT CDD_MotAgCmp.MotAgCumvAlgndCrf.Val /end REF_MEASUREMENT /end GROUP
/begin GROUP CDD_MotAgCmp.MotAgCumvAlgndMrf.Val "MICROSAR RTE" /begin SUB_GROUP /end SUB_GROUP /begin FUNCTION_LIST /end FUNCTION_LIST /begin REF_CHARACTERISTIC /end REF_CHARACTERISTIC /begin REF_MEASUREMENT CDD_MotAgCmp.MotAgCumvAlgndMrf.Val /end REF_MEASUREMENT /end GROUP
/begin GROUP CDD_MotAgCmp.MotAgCumvAlgndMrfRev.Val "MICROSAR RTE" /begin SUB_GROUP /end SUB_GROUP /begin FUNCTION_LIST /end FUNCTION_LIST /begin REF_CHARACTERISTIC /end REF_CHARACTERISTIC /begin REF_MEASUREMENT CDD_MotAgCmp.MotAgCumvAlgndMrfRev.Val /end REF_MEASUREMENT /end GROUP
/begin GROUP CDD_MotAgCmp.MotAgCumvAlgndVld.Logl "MICROSAR RTE" /begin SUB_GROUP /end SUB_GROUP /begin FUNCTION_LIST /end FUNCTION_LIST /begin REF_CHARACTERISTIC /end REF_CHARACTERISTIC /begin REF_MEASUREMENT CDD_MotAgCmp.MotAgCumvAlgndVld.Logl /end REF_MEASUREMENT /end GROUP
/begin GROUP CDD_MotAgCmp.MotAgCumvInid.Logl "MICROSAR RTE" /begin SUB_GROUP /end SUB_GROUP /begin FUNCTION_LIST /end FUNCTION_LIST /begin REF_CHARACTERISTIC /end REF_CHARACTERISTIC /begin REF_MEASUREMENT CDD_MotAgCmp.MotAgCumvInid.Logl /end REF_MEASUREMENT /end GROUP
/begin GROUP CDD_MotAgCmp.PerInstanceMemories "MICROSAR RTE"
 /begin SUB_GROUP CDD_MotAgCmp.CmpEnaCntr CDD_MotAgCmp.DigMotHwPosn CDD_MotAgCmp.MotAgCmpMotAgBackEmf CDD_MotAgCmp.MotAgCmpMotCtrlMotAgCumvAlgndMrfRevSVPrev CDD_MotAgCmp.MotAgCmpMotCtrlMotAgMeclPrev /end SUB_GROUP
 /begin FUNCTION_LIST /end FUNCTION_LIST
 /begin REF_CHARACTERISTIC /end REF_CHARACTERISTIC
 /begin REF_MEASUREMENT /end REF_MEASUREMENT
/end GROUP
/begin GROUP CDD_MotAgCmp.ReceiverPorts "MICROSAR RTE"
 /begin SUB_GROUP CDD_MotAgCmp.AssiMechPolarity.Val CDD_MotAgCmp.MotAgCumvAlgndMrfRev.Val CDD_MotAgCmp.MotAgCumvInid.Logl /end SUB_GROUP
 /begin FUNCTION_LIST /end FUNCTION_LIST
 /begin REF_CHARACTERISTIC /end REF_CHARACTERISTIC
 /begin REF_MEASUREMENT /end REF_MEASUREMENT
/end GROUP
/begin GROUP CDD_MotAgCmp.SenderPorts "MICROSAR RTE"
 /begin SUB_GROUP CDD_MotAgCmp.MotAgCumvAlgndCrf.Val CDD_MotAgCmp.MotAgCumvAlgndMrf.Val CDD_MotAgCmp.MotAgCumvAlgndVld.Logl /end SUB_GROUP
 /begin FUNCTION_LIST /end FUNCTION_LIST
 /begin REF_CHARACTERISTIC /end REF_CHARACTERISTIC
 /begin REF_MEASUREMENT /end REF_MEASUREMENT
/end GROUP
/begin GROUP CDD_MotAgCmp.SysGlbPrmMotPoleCnt.Val "MICROSAR RTE" /begin SUB_GROUP /end SUB_GROUP /begin FUNCTION_LIST /end FUNCTION_LIST /begin REF_CHARACTERISTIC CDD_MotAgCmp.SysGlbPrmMotPoleCnt.Val /end REF_CHARACTERISTIC /begin REF_MEASUREMENT /end REF_MEASUREMENT /end GROUP
/begin GROUP CDD_MotAgCmp.SysGlbPrmSysKineRat.Val "MICROSAR RTE" /begin SUB_GROUP /end SUB_GROUP /begin FUNCTION_LIST /end FUNCTION_LIST /begin REF_CHARACTERISTIC CDD_MotAgCmp.SysGlbPrmSysKineRat.Val /end REF_CHARACTERISTIC /begin REF_MEASUREMENT /end REF_MEASUREMENT /end GROUP
/begin GROUP CDD_MotCtrlMgr "MICROSAR RTE" /begin SUB_GROUP CDD_MotCtrlMgr.ReceiverPorts CDD_MotCtrlMgr.SenderPorts /end SUB_GROUP /begin FUNCTION_LIST /end FUNCTION_LIST /begin REF_CHARACTERISTIC /end REF_CHARACTERISTIC /begin REF_MEASUREMENT /end REF_MEASUREMENT /end GROUP
/begin GROUP CDD_MotCtrlMgr.Adc0ScanGroup2Ref0.Val "MICROSAR RTE" /begin SUB_GROUP /end SUB_GROUP /begin FUNCTION_LIST /end FUNCTION_LIST /begin REF_CHARACTERISTIC /end REF_CHARACTERISTIC /begin REF_MEASUREMENT CDD_MotCtrlMgr.Adc0ScanGroup2Ref0.Val /end REF_MEASUREMENT /end GROUP
/begin GROUP CDD_MotCtrlMgr.Adc0ScanGroup2Ref1.Val "MICROSAR RTE" /begin SUB_GROUP /end SUB_GROUP /begin FUNCTION_LIST /end FUNCTION_LIST /begin REF_CHARACTERISTIC /end REF_CHARACTERISTIC /begin REF_MEASUREMENT CDD_MotCtrlMgr.Adc0ScanGroup2Ref1.Val /end REF_MEASUREMENT /end GROUP
/begin GROUP CDD_MotCtrlMgr.Adc0ScanGroup3Ref0.Val "MICROSAR RTE" /begin SUB_GROUP /end SUB_GROUP /begin FUNCTION_LIST /end FUNCTION_LIST /begin REF_CHARACTERISTIC /end REF_CHARACTERISTIC /begin REF_MEASUREMENT CDD_MotCtrlMgr.Adc0ScanGroup3Ref0.Val /end REF_MEASUREMENT /end GROUP
/begin GROUP CDD_MotCtrlMgr.Adc0ScanGroup3Ref1.Val "MICROSAR RTE" /begin SUB_GROUP /end SUB_GROUP /begin FUNCTION_LIST /end FUNCTION_LIST /begin REF_CHARACTERISTIC /end REF_CHARACTERISTIC /begin REF_MEASUREMENT CDD_MotCtrlMgr.Adc0ScanGroup3Ref1.Val /end REF_MEASUREMENT /end GROUP
/begin GROUP CDD_MotCtrlMgr.Adc0SelfDiag0.Val "MICROSAR RTE" /begin SUB_GROUP /end SUB_GROUP /begin FUNCTION_LIST /end FUNCTION_LIST /begin REF_CHARACTERISTIC /end REF_CHARACTERISTIC /begin REF_MEASUREMENT CDD_MotCtrlMgr.Adc0SelfDiag0.Val /end REF_MEASUREMENT /end GROUP
/begin GROUP CDD_MotCtrlMgr.Adc0SelfDiag2.Val "MICROSAR RTE" /begin SUB_GROUP /end SUB_GROUP /begin FUNCTION_LIST /end FUNCTION_LIST /begin REF_CHARACTERISTIC /end REF_CHARACTERISTIC /begin REF_MEASUREMENT CDD_MotCtrlMgr.Adc0SelfDiag2.Val /end REF_MEASUREMENT /end GROUP
/begin GROUP CDD_MotCtrlMgr.Adc0SelfDiag4.Val "MICROSAR RTE" /begin SUB_GROUP /end SUB_GROUP /begin FUNCTION_LIST /end FUNCTION_LIST /begin REF_CHARACTERISTIC /end REF_CHARACTERISTIC /begin REF_MEASUREMENT CDD_MotCtrlMgr.Adc0SelfDiag4.Val /end REF_MEASUREMENT /end GROUP
/begin GROUP CDD_MotCtrlMgr.AdcDiagcEndPtrOutp.Val "MICROSAR RTE" /begin SUB_GROUP /end SUB_GROUP /begin FUNCTION_LIST /end FUNCTION_LIST /begin REF_CHARACTERISTIC /end REF_CHARACTERISTIC /begin REF_MEASUREMENT CDD_MotCtrlMgr.AdcDiagcEndPtrOutp.Val /end REF_MEASUREMENT /end GROUP
/begin GROUP CDD_MotCtrlMgr.AdcDiagcStrtPtrOutp.Val "MICROSAR RTE" /begin SUB_GROUP /end SUB_GROUP /begin FUNCTION_LIST /end FUNCTION_LIST /begin REF_CHARACTERISTIC /end REF_CHARACTERISTIC /begin REF_MEASUREMENT CDD_MotCtrlMgr.AdcDiagcStrtPtrOutp.Val /end REF_MEASUREMENT /end GROUP
/begin GROUP CDD_MotCtrlMgr.BrdgVltg.Val "MICROSAR RTE" /begin SUB_GROUP /end SUB_GROUP /begin FUNCTION_LIST /end FUNCTION_LIST /begin REF_CHARACTERISTIC /end REF_CHARACTERISTIC /begin REF_MEASUREMENT CDD_MotCtrlMgr.BrdgVltg.Val /end REF_MEASUREMENT /end GROUP
/begin GROUP CDD_MotCtrlMgr.CurrMeasCorrlnSts.Val "MICROSAR RTE" /begin SUB_GROUP /end SUB_GROUP /begin FUNCTION_LIST /end FUNCTION_LIST /begin REF_CHARACTERISTIC /end REF_CHARACTERISTIC /begin REF_MEASUREMENT CDD_MotCtrlMgr.CurrMeasCorrlnSts.Val /end REF_MEASUREMENT /end GROUP
/begin GROUP CDD_MotCtrlMgr.CurrMeasLoaMtgtnEna.Logl "MICROSAR RTE" /begin SUB_GROUP /end SUB_GROUP /begin FUNCTION_LIST /end FUNCTION_LIST /begin REF_CHARACTERISTIC /end REF_CHARACTERISTIC /begin REF_MEASUREMENT CDD_MotCtrlMgr.CurrMeasLoaMtgtnEna.Logl /end REF_MEASUREMENT /end GROUP
/begin GROUP CDD_MotCtrlMgr.CurrMeasWrmIninTestCmpl.Logl "MICROSAR RTE" /begin SUB_GROUP /end SUB_GROUP /begin FUNCTION_LIST /end FUNCTION_LIST /begin REF_CHARACTERISTIC /end REF_CHARACTERISTIC /begin REF_MEASUREMENT CDD_MotCtrlMgr.CurrMeasWrmIninTestCmpl.Logl /end REF_MEASUREMENT /end GROUP
/begin GROUP CDD_MotCtrlMgr.DiagcStsIvtr1Inactv.Logl "MICROSAR RTE" /begin SUB_GROUP /end SUB_GROUP /begin FUNCTION_LIST /end FUNCTION_LIST /begin REF_CHARACTERISTIC /end REF_CHARACTERISTIC /begin REF_MEASUREMENT CDD_MotCtrlMgr.DiagcStsIvtr1Inactv.Logl /end REF_MEASUREMENT /end GROUP
/begin GROUP CDD_MotCtrlMgr.DiagcStsIvtr2Inactv.Logl "MICROSAR RTE" /begin SUB_GROUP /end SUB_GROUP /begin FUNCTION_LIST /end FUNCTION_LIST /begin REF_CHARACTERISTIC /end REF_CHARACTERISTIC /begin REF_MEASUREMENT CDD_MotCtrlMgr.DiagcStsIvtr2Inactv.Logl /end REF_MEASUREMENT /end GROUP
/begin GROUP CDD_MotCtrlMgr.DualEcuMotCtrlMtgtnEna.Logl "MICROSAR RTE" /begin SUB_GROUP /end SUB_GROUP /begin FUNCTION_LIST /end FUNCTION_LIST /begin REF_CHARACTERISTIC /end REF_CHARACTERISTIC /begin REF_MEASUREMENT CDD_MotCtrlMgr.DualEcuMotCtrlMtgtnEna.Logl /end REF_MEASUREMENT /end GROUP
/begin GROUP CDD_MotCtrlMgr.EcuTFild.Val "MICROSAR RTE" /begin SUB_GROUP /end SUB_GROUP /begin FUNCTION_LIST /end FUNCTION_LIST /begin REF_CHARACTERISTIC /end REF_CHARACTERISTIC /begin REF_MEASUREMENT CDD_MotCtrlMgr.EcuTFild.Val /end REF_MEASUREMENT /end GROUP
/begin GROUP CDD_MotCtrlMgr.FastLoopCntr.Val "MICROSAR RTE" /begin SUB_GROUP /end SUB_GROUP /begin FUNCTION_LIST /end FUNCTION_LIST /begin REF_CHARACTERISTIC /end REF_CHARACTERISTIC /begin REF_MEASUREMENT CDD_MotCtrlMgr.FastLoopCntr.Val /end REF_MEASUREMENT /end GROUP
/begin GROUP CDD_MotCtrlMgr.IvtrLoaMtgtnEna.Logl "MICROSAR RTE" /begin SUB_GROUP /end SUB_GROUP /begin FUNCTION_LIST /end FUNCTION_LIST /begin REF_CHARACTERISTIC /end REF_CHARACTERISTIC /begin REF_MEASUREMENT CDD_MotCtrlMgr.IvtrLoaMtgtnEna.Logl /end REF_MEASUREMENT /end GROUP
/begin GROUP CDD_MotCtrlMgr.LoopCntr2MilliSec.Val "MICROSAR RTE" /begin SUB_GROUP /end SUB_GROUP /begin FUNCTION_LIST /end FUNCTION_LIST /begin REF_CHARACTERISTIC /end REF_CHARACTERISTIC /begin REF_MEASUREMENT CDD_MotCtrlMgr.LoopCntr2MilliSec.Val /end REF_MEASUREMENT /end GROUP
/begin GROUP CDD_MotCtrlMgr.MotAg0ErrReg.Val "MICROSAR RTE" /begin SUB_GROUP /end SUB_GROUP /begin FUNCTION_LIST /end FUNCTION_LIST /begin REF_CHARACTERISTIC /end REF_CHARACTERISTIC /begin REF_MEASUREMENT CDD_MotCtrlMgr.MotAg0ErrReg.Val /end REF_MEASUREMENT /end GROUP
/begin GROUP CDD_MotCtrlMgr.MotAg0Mecl.Val "MICROSAR RTE" /begin SUB_GROUP /end SUB_GROUP /begin FUNCTION_LIST /end FUNCTION_LIST /begin REF_CHARACTERISTIC /end REF_CHARACTERISTIC /begin REF_MEASUREMENT CDD_MotCtrlMgr.MotAg0Mecl.Val /end REF_MEASUREMENT /end GROUP
/begin GROUP CDD_MotCtrlMgr.MotAg0MeclQlfr.Val "MICROSAR RTE" /begin SUB_GROUP /end SUB_GROUP /begin FUNCTION_LIST /end FUNCTION_LIST /begin REF_CHARACTERISTIC /end REF_CHARACTERISTIC /begin REF_MEASUREMENT CDD_MotCtrlMgr.MotAg0MeclQlfr.Val /end REF_MEASUREMENT /end GROUP
/begin GROUP CDD_MotCtrlMgr.MotAg0MeclRollgCntr.Val "MICROSAR RTE" /begin SUB_GROUP /end SUB_GROUP /begin FUNCTION_LIST /end FUNCTION_LIST /begin REF_CHARACTERISTIC /end REF_CHARACTERISTIC /begin REF_MEASUREMENT CDD_MotCtrlMgr.MotAg0MeclRollgCntr.Val /end REF_MEASUREMENT /end GROUP
/begin GROUP CDD_MotCtrlMgr.MotAg0ParFltCnt.Val "MICROSAR RTE" /begin SUB_GROUP /end SUB_GROUP /begin FUNCTION_LIST /end FUNCTION_LIST /begin REF_CHARACTERISTIC /end REF_CHARACTERISTIC /begin REF_MEASUREMENT CDD_MotCtrlMgr.MotAg0ParFltCnt.Val /end REF_MEASUREMENT /end GROUP
/begin GROUP CDD_MotCtrlMgr.MotAg0VltgFltCnt.Val "MICROSAR RTE" /begin SUB_GROUP /end SUB_GROUP /begin FUNCTION_LIST /end FUNCTION_LIST /begin REF_CHARACTERISTIC /end REF_CHARACTERISTIC /begin REF_MEASUREMENT CDD_MotCtrlMgr.MotAg0VltgFltCnt.Val /end REF_MEASUREMENT /end GROUP
/begin GROUP CDD_MotCtrlMgr.MotAg1ErrReg.Val "MICROSAR RTE" /begin SUB_GROUP /end SUB_GROUP /begin FUNCTION_LIST /end FUNCTION_LIST /begin REF_CHARACTERISTIC /end REF_CHARACTERISTIC /begin REF_MEASUREMENT CDD_MotCtrlMgr.MotAg1ErrReg.Val /end REF_MEASUREMENT /end GROUP
/begin GROUP CDD_MotCtrlMgr.MotAg1Mecl.Val "MICROSAR RTE" /begin SUB_GROUP /end SUB_GROUP /begin FUNCTION_LIST /end FUNCTION_LIST /begin REF_CHARACTERISTIC /end REF_CHARACTERISTIC /begin REF_MEASUREMENT CDD_MotCtrlMgr.MotAg1Mecl.Val /end REF_MEASUREMENT /end GROUP
/begin GROUP CDD_MotCtrlMgr.MotAg1MeclQlfr.Val "MICROSAR RTE" /begin SUB_GROUP /end SUB_GROUP /begin FUNCTION_LIST /end FUNCTION_LIST /begin REF_CHARACTERISTIC /end REF_CHARACTERISTIC /begin REF_MEASUREMENT CDD_MotCtrlMgr.MotAg1MeclQlfr.Val /end REF_MEASUREMENT /end GROUP
/begin GROUP CDD_MotCtrlMgr.MotAg1MeclRollgCntr.Val "MICROSAR RTE" /begin SUB_GROUP /end SUB_GROUP /begin FUNCTION_LIST /end FUNCTION_LIST /begin REF_CHARACTERISTIC /end REF_CHARACTERISTIC /begin REF_MEASUREMENT CDD_MotCtrlMgr.MotAg1MeclRollgCntr.Val /end REF_MEASUREMENT /end GROUP
/begin GROUP CDD_MotCtrlMgr.MotAg1ParFltCnt.Val "MICROSAR RTE" /begin SUB_GROUP /end SUB_GROUP /begin FUNCTION_LIST /end FUNCTION_LIST /begin REF_CHARACTERISTIC /end REF_CHARACTERISTIC /begin REF_MEASUREMENT CDD_MotCtrlMgr.MotAg1ParFltCnt.Val /end REF_MEASUREMENT /end GROUP
/begin GROUP CDD_MotCtrlMgr.MotAg1VltgFltCnt.Val "MICROSAR RTE" /begin SUB_GROUP /end SUB_GROUP /begin FUNCTION_LIST /end FUNCTION_LIST /begin REF_CHARACTERISTIC /end REF_CHARACTERISTIC /begin REF_MEASUREMENT CDD_MotCtrlMgr.MotAg1VltgFltCnt.Val /end REF_MEASUREMENT /end GROUP
/begin GROUP CDD_MotCtrlMgr.MotAgBuf.Ary1D "MICROSAR RTE" /begin SUB_GROUP /end SUB_GROUP /begin FUNCTION_LIST /end FUNCTION_LIST /begin REF_CHARACTERISTIC /end REF_CHARACTERISTIC /begin REF_MEASUREMENT CDD_MotCtrlMgr.MotAgBuf.Ary1D /end REF_MEASUREMENT /end GROUP
/begin GROUP CDD_MotCtrlMgr.MotAgBufIdx.Val "MICROSAR RTE" /begin SUB_GROUP /end SUB_GROUP /begin FUNCTION_LIST /end FUNCTION_LIST /begin REF_CHARACTERISTIC /end REF_CHARACTERISTIC /begin REF_MEASUREMENT CDD_MotCtrlMgr.MotAgBufIdx.Val /end REF_MEASUREMENT /end GROUP
/begin GROUP CDD_MotCtrlMgr.MotAgCumvAlgndMrfRev.Val "MICROSAR RTE" /begin SUB_GROUP /end SUB_GROUP /begin FUNCTION_LIST /end FUNCTION_LIST /begin REF_CHARACTERISTIC /end REF_CHARACTERISTIC /begin REF_MEASUREMENT CDD_MotCtrlMgr.MotAgCumvAlgndMrfRev.Val /end REF_MEASUREMENT /end GROUP
/begin GROUP CDD_MotCtrlMgr.MotAgCumvInid.Logl "MICROSAR RTE" /begin SUB_GROUP /end SUB_GROUP /begin FUNCTION_LIST /end FUNCTION_LIST /begin REF_CHARACTERISTIC /end REF_CHARACTERISTIC /begin REF_MEASUREMENT CDD_MotCtrlMgr.MotAgCumvInid.Logl /end REF_MEASUREMENT /end GROUP
/begin GROUP CDD_MotCtrlMgr.MotAgElecDly.Val "MICROSAR RTE" /begin SUB_GROUP /end SUB_GROUP /begin FUNCTION_LIST /end FUNCTION_LIST /begin REF_CHARACTERISTIC /end REF_CHARACTERISTIC /begin REF_MEASUREMENT CDD_MotCtrlMgr.MotAgElecDly.Val /end REF_MEASUREMENT /end GROUP
/begin GROUP CDD_MotCtrlMgr.MotAgElecDlyRpl.Val "MICROSAR RTE" /begin SUB_GROUP /end SUB_GROUP /begin FUNCTION_LIST /end FUNCTION_LIST /begin REF_CHARACTERISTIC /end REF_CHARACTERISTIC /begin REF_MEASUREMENT CDD_MotCtrlMgr.MotAgElecDlyRpl.Val /end REF_MEASUREMENT /end GROUP
/begin GROUP CDD_MotCtrlMgr.MotAgMecl0Polarity.Val "MICROSAR RTE" /begin SUB_GROUP /end SUB_GROUP /begin FUNCTION_LIST /end FUNCTION_LIST /begin REF_CHARACTERISTIC /end REF_CHARACTERISTIC /begin REF_MEASUREMENT CDD_MotCtrlMgr.MotAgMecl0Polarity.Val /end REF_MEASUREMENT /end GROUP
/begin GROUP CDD_MotCtrlMgr.MotAgMecl1Polarity.Val "MICROSAR RTE" /begin SUB_GROUP /end SUB_GROUP /begin FUNCTION_LIST /end FUNCTION_LIST /begin REF_CHARACTERISTIC /end REF_CHARACTERISTIC /begin REF_MEASUREMENT CDD_MotCtrlMgr.MotAgMecl1Polarity.Val /end REF_MEASUREMENT /end GROUP
/begin GROUP CDD_MotCtrlMgr.MotAgMeclCorrlnSt.Val "MICROSAR RTE" /begin SUB_GROUP /end SUB_GROUP /begin FUNCTION_LIST /end FUNCTION_LIST /begin REF_CHARACTERISTIC /end REF_CHARACTERISTIC /begin REF_MEASUREMENT CDD_MotCtrlMgr.MotAgMeclCorrlnSt.Val /end REF_MEASUREMENT /end GROUP
/begin GROUP CDD_MotCtrlMgr.MotAgTiBuf.Ary1D "MICROSAR RTE" /begin SUB_GROUP /end SUB_GROUP /begin FUNCTION_LIST /end FUNCTION_LIST /begin REF_CHARACTERISTIC /end REF_CHARACTERISTIC /begin REF_MEASUREMENT CDD_MotCtrlMgr.MotAgTiBuf.Ary1D /end REF_MEASUREMENT /end GROUP
/begin GROUP CDD_MotCtrlMgr.MotBackEmfVltg.Val "MICROSAR RTE" /begin SUB_GROUP /end SUB_GROUP /begin FUNCTION_LIST /end FUNCTION_LIST /begin REF_CHARACTERISTIC /end REF_CHARACTERISTIC /begin REF_MEASUREMENT CDD_MotCtrlMgr.MotBackEmfVltg.Val /end REF_MEASUREMENT /end GROUP
/begin GROUP CDD_MotCtrlMgr.MotCurrAdcVlyA.Val "MICROSAR RTE" /begin SUB_GROUP /end SUB_GROUP /begin FUNCTION_LIST /end FUNCTION_LIST /begin REF_CHARACTERISTIC /end REF_CHARACTERISTIC /begin REF_MEASUREMENT CDD_MotCtrlMgr.MotCurrAdcVlyA.Val /end REF_MEASUREMENT /end GROUP
/begin GROUP CDD_MotCtrlMgr.MotCurrAdcVlyAAdcFaild.Logl "MICROSAR RTE" /begin SUB_GROUP /end SUB_GROUP /begin FUNCTION_LIST /end FUNCTION_LIST /begin REF_CHARACTERISTIC /end REF_CHARACTERISTIC /begin REF_MEASUREMENT CDD_MotCtrlMgr.MotCurrAdcVlyAAdcFaild.Logl /end REF_MEASUREMENT /end GROUP
/begin GROUP CDD_MotCtrlMgr.MotCurrAdcVlyB.Val "MICROSAR RTE" /begin SUB_GROUP /end SUB_GROUP /begin FUNCTION_LIST /end FUNCTION_LIST /begin REF_CHARACTERISTIC /end REF_CHARACTERISTIC /begin REF_MEASUREMENT CDD_MotCtrlMgr.MotCurrAdcVlyB.Val /end REF_MEASUREMENT /end GROUP
/begin GROUP CDD_MotCtrlMgr.MotCurrAdcVlyBAdcFaild.Logl "MICROSAR RTE" /begin SUB_GROUP /end SUB_GROUP /begin FUNCTION_LIST /end FUNCTION_LIST /begin REF_CHARACTERISTIC /end REF_CHARACTERISTIC /begin REF_MEASUREMENT CDD_MotCtrlMgr.MotCurrAdcVlyBAdcFaild.Logl /end REF_MEASUREMENT /end GROUP
/begin GROUP CDD_MotCtrlMgr.MotCurrAdcVlyC.Val "MICROSAR RTE" /begin SUB_GROUP /end SUB_GROUP /begin FUNCTION_LIST /end FUNCTION_LIST /begin REF_CHARACTERISTIC /end REF_CHARACTERISTIC /begin REF_MEASUREMENT CDD_MotCtrlMgr.MotCurrAdcVlyC.Val /end REF_MEASUREMENT /end GROUP
/begin GROUP CDD_MotCtrlMgr.MotCurrAdcVlyCAdcFaild.Logl "MICROSAR RTE" /begin SUB_GROUP /end SUB_GROUP /begin FUNCTION_LIST /end FUNCTION_LIST /begin REF_CHARACTERISTIC /end REF_CHARACTERISTIC /begin REF_MEASUREMENT CDD_MotCtrlMgr.MotCurrAdcVlyCAdcFaild.Logl /end REF_MEASUREMENT /end GROUP
/begin GROUP CDD_MotCtrlMgr.MotCurrAdcVlyD.Val "MICROSAR RTE" /begin SUB_GROUP /end SUB_GROUP /begin FUNCTION_LIST /end FUNCTION_LIST /begin REF_CHARACTERISTIC /end REF_CHARACTERISTIC /begin REF_MEASUREMENT CDD_MotCtrlMgr.MotCurrAdcVlyD.Val /end REF_MEASUREMENT /end GROUP
/begin GROUP CDD_MotCtrlMgr.MotCurrAdcVlyDAdcFaild.Logl "MICROSAR RTE" /begin SUB_GROUP /end SUB_GROUP /begin FUNCTION_LIST /end FUNCTION_LIST /begin REF_CHARACTERISTIC /end REF_CHARACTERISTIC /begin REF_MEASUREMENT CDD_MotCtrlMgr.MotCurrAdcVlyDAdcFaild.Logl /end REF_MEASUREMENT /end GROUP
/begin GROUP CDD_MotCtrlMgr.MotCurrAdcVlyE.Val "MICROSAR RTE" /begin SUB_GROUP /end SUB_GROUP /begin FUNCTION_LIST /end FUNCTION_LIST /begin REF_CHARACTERISTIC /end REF_CHARACTERISTIC /begin REF_MEASUREMENT CDD_MotCtrlMgr.MotCurrAdcVlyE.Val /end REF_MEASUREMENT /end GROUP
/begin GROUP CDD_MotCtrlMgr.MotCurrAdcVlyEAdcFaild.Logl "MICROSAR RTE" /begin SUB_GROUP /end SUB_GROUP /begin FUNCTION_LIST /end FUNCTION_LIST /begin REF_CHARACTERISTIC /end REF_CHARACTERISTIC /begin REF_MEASUREMENT CDD_MotCtrlMgr.MotCurrAdcVlyEAdcFaild.Logl /end REF_MEASUREMENT /end GROUP
/begin GROUP CDD_MotCtrlMgr.MotCurrAdcVlyF.Val "MICROSAR RTE" /begin SUB_GROUP /end SUB_GROUP /begin FUNCTION_LIST /end FUNCTION_LIST /begin REF_CHARACTERISTIC /end REF_CHARACTERISTIC /begin REF_MEASUREMENT CDD_MotCtrlMgr.MotCurrAdcVlyF.Val /end REF_MEASUREMENT /end GROUP
/begin GROUP CDD_MotCtrlMgr.MotCurrAdcVlyFAdcFaild.Logl "MICROSAR RTE" /begin SUB_GROUP /end SUB_GROUP /begin FUNCTION_LIST /end FUNCTION_LIST /begin REF_CHARACTERISTIC /end REF_CHARACTERISTIC /begin REF_MEASUREMENT CDD_MotCtrlMgr.MotCurrAdcVlyFAdcFaild.Logl /end REF_MEASUREMENT /end GROUP
/begin GROUP CDD_MotCtrlMgr.MotCurrCorrdA.Val "MICROSAR RTE" /begin SUB_GROUP /end SUB_GROUP /begin FUNCTION_LIST /end FUNCTION_LIST /begin REF_CHARACTERISTIC /end REF_CHARACTERISTIC /begin REF_MEASUREMENT CDD_MotCtrlMgr.MotCurrCorrdA.Val /end REF_MEASUREMENT /end GROUP
/begin GROUP CDD_MotCtrlMgr.MotCurrCorrdB.Val "MICROSAR RTE" /begin SUB_GROUP /end SUB_GROUP /begin FUNCTION_LIST /end FUNCTION_LIST /begin REF_CHARACTERISTIC /end REF_CHARACTERISTIC /begin REF_MEASUREMENT CDD_MotCtrlMgr.MotCurrCorrdB.Val /end REF_MEASUREMENT /end GROUP
/begin GROUP CDD_MotCtrlMgr.MotCurrCorrdC.Val "MICROSAR RTE" /begin SUB_GROUP /end SUB_GROUP /begin FUNCTION_LIST /end FUNCTION_LIST /begin REF_CHARACTERISTIC /end REF_CHARACTERISTIC /begin REF_MEASUREMENT CDD_MotCtrlMgr.MotCurrCorrdC.Val /end REF_MEASUREMENT /end GROUP
/begin GROUP CDD_MotCtrlMgr.MotCurrCorrdD.Val "MICROSAR RTE" /begin SUB_GROUP /end SUB_GROUP /begin FUNCTION_LIST /end FUNCTION_LIST /begin REF_CHARACTERISTIC /end REF_CHARACTERISTIC /begin REF_MEASUREMENT CDD_MotCtrlMgr.MotCurrCorrdD.Val /end REF_MEASUREMENT /end GROUP
/begin GROUP CDD_MotCtrlMgr.MotCurrCorrdE.Val "MICROSAR RTE" /begin SUB_GROUP /end SUB_GROUP /begin FUNCTION_LIST /end FUNCTION_LIST /begin REF_CHARACTERISTIC /end REF_CHARACTERISTIC /begin REF_MEASUREMENT CDD_MotCtrlMgr.MotCurrCorrdE.Val /end REF_MEASUREMENT /end GROUP
/begin GROUP CDD_MotCtrlMgr.MotCurrCorrdF.Val "MICROSAR RTE" /begin SUB_GROUP /end SUB_GROUP /begin FUNCTION_LIST /end FUNCTION_LIST /begin REF_CHARACTERISTIC /end REF_CHARACTERISTIC /begin REF_MEASUREMENT CDD_MotCtrlMgr.MotCurrCorrdF.Val /end REF_MEASUREMENT /end GROUP
/begin GROUP CDD_MotCtrlMgr.MotCurrDax.Val "MICROSAR RTE" /begin SUB_GROUP /end SUB_GROUP /begin FUNCTION_LIST /end FUNCTION_LIST /begin REF_CHARACTERISTIC /end REF_CHARACTERISTIC /begin REF_MEASUREMENT CDD_MotCtrlMgr.MotCurrDax.Val /end REF_MEASUREMENT /end GROUP
/begin GROUP CDD_MotCtrlMgr.MotCurrDaxCmd.Val "MICROSAR RTE" /begin SUB_GROUP /end SUB_GROUP /begin FUNCTION_LIST /end FUNCTION_LIST /begin REF_CHARACTERISTIC /end REF_CHARACTERISTIC /begin REF_MEASUREMENT CDD_MotCtrlMgr.MotCurrDaxCmd.Val /end REF_MEASUREMENT /end GROUP
/begin GROUP CDD_MotCtrlMgr.MotCurrDaxMax.Val "MICROSAR RTE" /begin SUB_GROUP /end SUB_GROUP /begin FUNCTION_LIST /end FUNCTION_LIST /begin REF_CHARACTERISTIC /end REF_CHARACTERISTIC /begin REF_MEASUREMENT CDD_MotCtrlMgr.MotCurrDaxMax.Val /end REF_MEASUREMENT /end GROUP
/begin GROUP CDD_MotCtrlMgr.MotCurrEolCalSt.Val "MICROSAR RTE" /begin SUB_GROUP /end SUB_GROUP /begin FUNCTION_LIST /end FUNCTION_LIST /begin REF_CHARACTERISTIC /end REF_CHARACTERISTIC /begin REF_MEASUREMENT CDD_MotCtrlMgr.MotCurrEolCalSt.Val /end REF_MEASUREMENT /end GROUP
/begin GROUP CDD_MotCtrlMgr.MotCurrQax.Val "MICROSAR RTE" /begin SUB_GROUP /end SUB_GROUP /begin FUNCTION_LIST /end FUNCTION_LIST /begin REF_CHARACTERISTIC /end REF_CHARACTERISTIC /begin REF_MEASUREMENT CDD_MotCtrlMgr.MotCurrQax.Val /end REF_MEASUREMENT /end GROUP
/begin GROUP CDD_MotCtrlMgr.MotCurrQaxCmd.Val "MICROSAR RTE" /begin SUB_GROUP /end SUB_GROUP /begin FUNCTION_LIST /end FUNCTION_LIST /begin REF_CHARACTERISTIC /end REF_CHARACTERISTIC /begin REF_MEASUREMENT CDD_MotCtrlMgr.MotCurrQaxCmd.Val /end REF_MEASUREMENT /end GROUP
/begin GROUP CDD_MotCtrlMgr.MotCurrQaxToMotTqGain.Val "MICROSAR RTE" /begin SUB_GROUP /end SUB_GROUP /begin FUNCTION_LIST /end FUNCTION_LIST /begin REF_CHARACTERISTIC /end REF_CHARACTERISTIC /begin REF_MEASUREMENT CDD_MotCtrlMgr.MotCurrQaxToMotTqGain.Val /end REF_MEASUREMENT /end GROUP
/begin GROUP CDD_MotCtrlMgr.MotCurrQlfr1.Val "MICROSAR RTE" /begin SUB_GROUP /end SUB_GROUP /begin FUNCTION_LIST /end FUNCTION_LIST /begin REF_CHARACTERISTIC /end REF_CHARACTERISTIC /begin REF_MEASUREMENT CDD_MotCtrlMgr.MotCurrQlfr1.Val /end REF_MEASUREMENT /end GROUP
/begin GROUP CDD_MotCtrlMgr.MotCurrQlfr2.Val "MICROSAR RTE" /begin SUB_GROUP /end SUB_GROUP /begin FUNCTION_LIST /end FUNCTION_LIST /begin REF_CHARACTERISTIC /end REF_CHARACTERISTIC /begin REF_MEASUREMENT CDD_MotCtrlMgr.MotCurrQlfr2.Val /end REF_MEASUREMENT /end GROUP
/begin GROUP CDD_MotCtrlMgr.MotCurrRollgCntr1.Val "MICROSAR RTE" /begin SUB_GROUP /end SUB_GROUP /begin FUNCTION_LIST /end FUNCTION_LIST /begin REF_CHARACTERISTIC /end REF_CHARACTERISTIC /begin REF_MEASUREMENT CDD_MotCtrlMgr.MotCurrRollgCntr1.Val /end REF_MEASUREMENT /end GROUP
/begin GROUP CDD_MotCtrlMgr.MotCurrRollgCntr2.Val "MICROSAR RTE" /begin SUB_GROUP /end SUB_GROUP /begin FUNCTION_LIST /end FUNCTION_LIST /begin REF_CHARACTERISTIC /end REF_CHARACTERISTIC /begin REF_MEASUREMENT CDD_MotCtrlMgr.MotCurrRollgCntr2.Val /end REF_MEASUREMENT /end GROUP
/begin GROUP CDD_MotCtrlMgr.MotDampgDax.Val "MICROSAR RTE" /begin SUB_GROUP /end SUB_GROUP /begin FUNCTION_LIST /end FUNCTION_LIST /begin REF_CHARACTERISTIC /end REF_CHARACTERISTIC /begin REF_MEASUREMENT CDD_MotCtrlMgr.MotDampgDax.Val /end REF_MEASUREMENT /end GROUP
/begin GROUP CDD_MotCtrlMgr.MotDampgQax.Val "MICROSAR RTE" /begin SUB_GROUP /end SUB_GROUP /begin FUNCTION_LIST /end FUNCTION_LIST /begin REF_CHARACTERISTIC /end REF_CHARACTERISTIC /begin REF_MEASUREMENT CDD_MotCtrlMgr.MotDampgQax.Val /end REF_MEASUREMENT /end GROUP
/begin GROUP CDD_MotCtrlMgr.MotElecMeclPolarity.Val "MICROSAR RTE" /begin SUB_GROUP /end SUB_GROUP /begin FUNCTION_LIST /end FUNCTION_LIST /begin REF_CHARACTERISTIC /end REF_CHARACTERISTIC /begin REF_MEASUREMENT CDD_MotCtrlMgr.MotElecMeclPolarity.Val /end REF_MEASUREMENT /end GROUP
/begin GROUP CDD_MotCtrlMgr.MotInduDaxEstimdIvs.Val "MICROSAR RTE" /begin SUB_GROUP /end SUB_GROUP /begin FUNCTION_LIST /end FUNCTION_LIST /begin REF_CHARACTERISTIC /end REF_CHARACTERISTIC /begin REF_MEASUREMENT CDD_MotCtrlMgr.MotInduDaxEstimdIvs.Val /end REF_MEASUREMENT /end GROUP
/begin GROUP CDD_MotCtrlMgr.MotInduQaxEstimdIvs.Val "MICROSAR RTE" /begin SUB_GROUP /end SUB_GROUP /begin FUNCTION_LIST /end FUNCTION_LIST /begin REF_CHARACTERISTIC /end REF_CHARACTERISTIC /begin REF_MEASUREMENT CDD_MotCtrlMgr.MotInduQaxEstimdIvs.Val /end REF_MEASUREMENT /end GROUP
/begin GROUP CDD_MotCtrlMgr.MotIntglGainDax.Val "MICROSAR RTE" /begin SUB_GROUP /end SUB_GROUP /begin FUNCTION_LIST /end FUNCTION_LIST /begin REF_CHARACTERISTIC /end REF_CHARACTERISTIC /begin REF_MEASUREMENT CDD_MotCtrlMgr.MotIntglGainDax.Val /end REF_MEASUREMENT /end GROUP
/begin GROUP CDD_MotCtrlMgr.MotIntglGainQax.Val "MICROSAR RTE" /begin SUB_GROUP /end SUB_GROUP /begin FUNCTION_LIST /end FUNCTION_LIST /begin REF_CHARACTERISTIC /end REF_CHARACTERISTIC /begin REF_MEASUREMENT CDD_MotCtrlMgr.MotIntglGainQax.Val /end REF_MEASUREMENT /end GROUP
/begin GROUP CDD_MotCtrlMgr.MotPropGainDax.Val "MICROSAR RTE" /begin SUB_GROUP /end SUB_GROUP /begin FUNCTION_LIST /end FUNCTION_LIST /begin REF_CHARACTERISTIC /end REF_CHARACTERISTIC /begin REF_MEASUREMENT CDD_MotCtrlMgr.MotPropGainDax.Val /end REF_MEASUREMENT /end GROUP
/begin GROUP CDD_MotCtrlMgr.MotPropGainQax.Val "MICROSAR RTE" /begin SUB_GROUP /end SUB_GROUP /begin FUNCTION_LIST /end FUNCTION_LIST /begin REF_CHARACTERISTIC /end REF_CHARACTERISTIC /begin REF_MEASUREMENT CDD_MotCtrlMgr.MotPropGainQax.Val /end REF_MEASUREMENT /end GROUP
/begin GROUP CDD_MotCtrlMgr.MotREstimd.Val "MICROSAR RTE" /begin SUB_GROUP /end SUB_GROUP /begin FUNCTION_LIST /end FUNCTION_LIST /begin REF_CHARACTERISTIC /end REF_CHARACTERISTIC /begin REF_MEASUREMENT CDD_MotCtrlMgr.MotREstimd.Val /end REF_MEASUREMENT /end GROUP
/begin GROUP CDD_MotCtrlMgr.MotReacncDax.Val "MICROSAR RTE" /begin SUB_GROUP /end SUB_GROUP /begin FUNCTION_LIST /end FUNCTION_LIST /begin REF_CHARACTERISTIC /end REF_CHARACTERISTIC /begin REF_MEASUREMENT CDD_MotCtrlMgr.MotReacncDax.Val /end REF_MEASUREMENT /end GROUP
/begin GROUP CDD_MotCtrlMgr.MotReacncQax.Val "MICROSAR RTE" /begin SUB_GROUP /end SUB_GROUP /begin FUNCTION_LIST /end FUNCTION_LIST /begin REF_CHARACTERISTIC /end REF_CHARACTERISTIC /begin REF_MEASUREMENT CDD_MotCtrlMgr.MotReacncQax.Val /end REF_MEASUREMENT /end GROUP
/begin GROUP CDD_MotCtrlMgr.MotTqRplCoggOrder1Mgn.Val "MICROSAR RTE" /begin SUB_GROUP /end SUB_GROUP /begin FUNCTION_LIST /end FUNCTION_LIST /begin REF_CHARACTERISTIC /end REF_CHARACTERISTIC /begin REF_MEASUREMENT CDD_MotCtrlMgr.MotTqRplCoggOrder1Mgn.Val /end REF_MEASUREMENT /end GROUP
/begin GROUP CDD_MotCtrlMgr.MotTqRplCoggOrder1Pha.Val "MICROSAR RTE" /begin SUB_GROUP /end SUB_GROUP /begin FUNCTION_LIST /end FUNCTION_LIST /begin REF_CHARACTERISTIC /end REF_CHARACTERISTIC /begin REF_MEASUREMENT CDD_MotCtrlMgr.MotTqRplCoggOrder1Pha.Val /end REF_MEASUREMENT /end GROUP
/begin GROUP CDD_MotCtrlMgr.MotTqRplCoggOrder2Mgn.Val "MICROSAR RTE" /begin SUB_GROUP /end SUB_GROUP /begin FUNCTION_LIST /end FUNCTION_LIST /begin REF_CHARACTERISTIC /end REF_CHARACTERISTIC /begin REF_MEASUREMENT CDD_MotCtrlMgr.MotTqRplCoggOrder2Mgn.Val /end REF_MEASUREMENT /end GROUP
/begin GROUP CDD_MotCtrlMgr.MotTqRplCoggOrder2Pha.Val "MICROSAR RTE" /begin SUB_GROUP /end SUB_GROUP /begin FUNCTION_LIST /end FUNCTION_LIST /begin REF_CHARACTERISTIC /end REF_CHARACTERISTIC /begin REF_MEASUREMENT CDD_MotCtrlMgr.MotTqRplCoggOrder2Pha.Val /end REF_MEASUREMENT /end GROUP
/begin GROUP CDD_MotCtrlMgr.MotTqRplCoggOrder3Mgn.Val "MICROSAR RTE" /begin SUB_GROUP /end SUB_GROUP /begin FUNCTION_LIST /end FUNCTION_LIST /begin REF_CHARACTERISTIC /end REF_CHARACTERISTIC /begin REF_MEASUREMENT CDD_MotCtrlMgr.MotTqRplCoggOrder3Mgn.Val /end REF_MEASUREMENT /end GROUP
/begin GROUP CDD_MotCtrlMgr.MotTqRplCoggOrder3Pha.Val "MICROSAR RTE" /begin SUB_GROUP /end SUB_GROUP /begin FUNCTION_LIST /end FUNCTION_LIST /begin REF_CHARACTERISTIC /end REF_CHARACTERISTIC /begin REF_MEASUREMENT CDD_MotCtrlMgr.MotTqRplCoggOrder3Pha.Val /end REF_MEASUREMENT /end GROUP
/begin GROUP CDD_MotCtrlMgr.MotVelMrf.Val "MICROSAR RTE" /begin SUB_GROUP /end SUB_GROUP /begin FUNCTION_LIST /end FUNCTION_LIST /begin REF_CHARACTERISTIC /end REF_CHARACTERISTIC /begin REF_MEASUREMENT CDD_MotCtrlMgr.MotVelMrf.Val /end REF_MEASUREMENT /end GROUP
/begin GROUP CDD_MotCtrlMgr.MotVltgDaxFf.Val "MICROSAR RTE" /begin SUB_GROUP /end SUB_GROUP /begin FUNCTION_LIST /end FUNCTION_LIST /begin REF_CHARACTERISTIC /end REF_CHARACTERISTIC /begin REF_MEASUREMENT CDD_MotCtrlMgr.MotVltgDaxFf.Val /end REF_MEASUREMENT /end GROUP
/begin GROUP CDD_MotCtrlMgr.MotVltgQaxFf.Val "MICROSAR RTE" /begin SUB_GROUP /end SUB_GROUP /begin FUNCTION_LIST /end FUNCTION_LIST /begin REF_CHARACTERISTIC /end REF_CHARACTERISTIC /begin REF_MEASUREMENT CDD_MotCtrlMgr.MotVltgQaxFf.Val /end REF_MEASUREMENT /end GROUP
/begin GROUP CDD_MotCtrlMgr.Ntc5DErrCnt.Val "MICROSAR RTE" /begin SUB_GROUP /end SUB_GROUP /begin FUNCTION_LIST /end FUNCTION_LIST /begin REF_CHARACTERISTIC /end REF_CHARACTERISTIC /begin REF_MEASUREMENT CDD_MotCtrlMgr.Ntc5DErrCnt.Val /end REF_MEASUREMENT /end GROUP
/begin GROUP CDD_MotCtrlMgr.Ntc6DErrCnt.Val "MICROSAR RTE" /begin SUB_GROUP /end SUB_GROUP /begin FUNCTION_LIST /end FUNCTION_LIST /begin REF_CHARACTERISTIC /end REF_CHARACTERISTIC /begin REF_MEASUREMENT CDD_MotCtrlMgr.Ntc6DErrCnt.Val /end REF_MEASUREMENT /end GROUP
/begin GROUP CDD_MotCtrlMgr.PhaOnTiSumA.Val "MICROSAR RTE" /begin SUB_GROUP /end SUB_GROUP /begin FUNCTION_LIST /end FUNCTION_LIST /begin REF_CHARACTERISTIC /end REF_CHARACTERISTIC /begin REF_MEASUREMENT CDD_MotCtrlMgr.PhaOnTiSumA.Val /end REF_MEASUREMENT /end GROUP
/begin GROUP CDD_MotCtrlMgr.PhaOnTiSumB.Val "MICROSAR RTE" /begin SUB_GROUP /end SUB_GROUP /begin FUNCTION_LIST /end FUNCTION_LIST /begin REF_CHARACTERISTIC /end REF_CHARACTERISTIC /begin REF_MEASUREMENT CDD_MotCtrlMgr.PhaOnTiSumB.Val /end REF_MEASUREMENT /end GROUP
/begin GROUP CDD_MotCtrlMgr.PhaOnTiSumC.Val "MICROSAR RTE" /begin SUB_GROUP /end SUB_GROUP /begin FUNCTION_LIST /end FUNCTION_LIST /begin REF_CHARACTERISTIC /end REF_CHARACTERISTIC /begin REF_MEASUREMENT CDD_MotCtrlMgr.PhaOnTiSumC.Val /end REF_MEASUREMENT /end GROUP
/begin GROUP CDD_MotCtrlMgr.ReceiverPorts "MICROSAR RTE"
 /begin SUB_GROUP CDD_MotCtrlMgr.AdcDiagcEndPtrOutp.Val CDD_MotCtrlMgr.AdcDiagcStrtPtrOutp.Val CDD_MotCtrlMgr.BrdgVltg.Val CDD_MotCtrlMgr.CurrMeasCorrlnSts.Val CDD_MotCtrlMgr.CurrMeasLoaMtgtnEna.Logl CDD_MotCtrlMgr.CurrMeasWrmIninTestCmpl.Logl CDD_MotCtrlMgr.DiagcStsIvtr1Inactv.Logl CDD_MotCtrlMgr.DiagcStsIvtr2Inactv.Logl CDD_MotCtrlMgr.DualEcuMotCtrlMtgtnEna.Logl CDD_MotCtrlMgr.EcuTFild.Val CDD_MotCtrlMgr.IvtrLoaMtgtnEna.Logl CDD_MotCtrlMgr.LoopCntr2MilliSec.Val CDD_MotCtrlMgr.MotAg0MeclQlfr.Val CDD_MotCtrlMgr.MotAg1MeclQlfr.Val CDD_MotCtrlMgr.MotAgElecDly.Val CDD_MotCtrlMgr.MotAgElecDlyRpl.Val CDD_MotCtrlMgr.MotAgMecl0Polarity.Val CDD_MotCtrlMgr.MotAgMecl1Polarity.Val CDD_MotCtrlMgr.MotAgMeclCorrlnSt.Val CDD_MotCtrlMgr.MotBackEmfVltg.Val CDD_MotCtrlMgr.MotCurrAdcVlyAAdcFaild.Logl CDD_MotCtrlMgr.MotCurrAdcVlyBAdcFaild.Logl CDD_MotCtrlMgr.MotCurrAdcVlyCAdcFaild.Logl CDD_MotCtrlMgr.MotCurrAdcVlyDAdcFaild.Logl CDD_MotCtrlMgr.MotCurrAdcVlyEAdcFaild.Logl CDD_MotCtrlMgr.MotCurrAdcVlyFAdcFaild.Logl CDD_MotCtrlMgr.MotCurrDaxCmd.Val CDD_MotCtrlMgr.MotCurrDaxMax.Val CDD_MotCtrlMgr.MotCurrEolCalSt.Val CDD_MotCtrlMgr.MotCurrQaxCmd.Val CDD_MotCtrlMgr.MotCurrQaxToMotTqGain.Val CDD_MotCtrlMgr.MotCurrQlfr1.Val CDD_MotCtrlMgr.MotCurrQlfr2.Val CDD_MotCtrlMgr.MotDampgDax.Val CDD_MotCtrlMgr.MotDampgQax.Val CDD_MotCtrlMgr.MotElecMeclPolarity.Val CDD_MotCtrlMgr.MotInduDaxEstimdIvs.Val CDD_MotCtrlMgr.MotInduQaxEstimdIvs.Val CDD_MotCtrlMgr.MotIntglGainDax.Val CDD_MotCtrlMgr.MotIntglGainQax.Val CDD_MotCtrlMgr.MotPropGainDax.Val CDD_MotCtrlMgr.MotPropGainQax.Val CDD_MotCtrlMgr.MotREstimd.Val CDD_MotCtrlMgr.MotReacncDax.Val CDD_MotCtrlMgr.MotReacncQax.Val CDD_MotCtrlMgr.MotTqRplCoggOrder1Mgn.Val CDD_MotCtrlMgr.MotTqRplCoggOrder1Pha.Val CDD_MotCtrlMgr.MotTqRplCoggOrder2Mgn.Val CDD_MotCtrlMgr.MotTqRplCoggOrder2Pha.Val CDD_MotCtrlMgr.MotTqRplCoggOrder3Mgn.Val CDD_MotCtrlMgr.MotTqRplCoggOrder3Pha.Val CDD_MotCtrlMgr.MotVelMrf.Val CDD_MotCtrlMgr.MotVltgDaxFf.Val CDD_MotCtrlMgr.MotVltgQaxFf.Val CDD_MotCtrlMgr.SysSt.Val /end SUB_GROUP
 /begin FUNCTION_LIST /end FUNCTION_LIST
 /begin REF_CHARACTERISTIC /end REF_CHARACTERISTIC
 /begin REF_MEASUREMENT /end REF_MEASUREMENT
/end GROUP
/begin GROUP CDD_MotCtrlMgr.SenderPorts "MICROSAR RTE"
 /begin SUB_GROUP CDD_MotCtrlMgr.Adc0ScanGroup2Ref0.Val CDD_MotCtrlMgr.Adc0ScanGroup2Ref1.Val CDD_MotCtrlMgr.Adc0ScanGroup3Ref0.Val CDD_MotCtrlMgr.Adc0ScanGroup3Ref1.Val CDD_MotCtrlMgr.Adc0SelfDiag0.Val CDD_MotCtrlMgr.Adc0SelfDiag2.Val CDD_MotCtrlMgr.Adc0SelfDiag4.Val CDD_MotCtrlMgr.FastLoopCntr.Val CDD_MotCtrlMgr.MotAg0ErrReg.Val CDD_MotCtrlMgr.MotAg0Mecl.Val CDD_MotCtrlMgr.MotAg0MeclRollgCntr.Val CDD_MotCtrlMgr.MotAg0ParFltCnt.Val CDD_MotCtrlMgr.MotAg0VltgFltCnt.Val CDD_MotCtrlMgr.MotAg1ErrReg.Val CDD_MotCtrlMgr.MotAg1Mecl.Val CDD_MotCtrlMgr.MotAg1MeclRollgCntr.Val CDD_MotCtrlMgr.MotAg1ParFltCnt.Val CDD_MotCtrlMgr.MotAg1VltgFltCnt.Val CDD_MotCtrlMgr.MotAgBuf.Ary1D CDD_MotCtrlMgr.MotAgBufIdx.Val CDD_MotCtrlMgr.MotAgCumvAlgndMrfRev.Val CDD_MotCtrlMgr.MotAgCumvInid.Logl CDD_MotCtrlMgr.MotAgTiBuf.Ary1D CDD_MotCtrlMgr.MotCurrAdcVlyA.Val CDD_MotCtrlMgr.MotCurrAdcVlyB.Val CDD_MotCtrlMgr.MotCurrAdcVlyC.Val CDD_MotCtrlMgr.MotCurrAdcVlyD.Val CDD_MotCtrlMgr.MotCurrAdcVlyE.Val CDD_MotCtrlMgr.MotCurrAdcVlyF.Val CDD_MotCtrlMgr.MotCurrCorrdA.Val CDD_MotCtrlMgr.MotCurrCorrdB.Val CDD_MotCtrlMgr.MotCurrCorrdC.Val CDD_MotCtrlMgr.MotCurrCorrdD.Val CDD_MotCtrlMgr.MotCurrCorrdE.Val CDD_MotCtrlMgr.MotCurrCorrdF.Val CDD_MotCtrlMgr.MotCurrDax.Val CDD_MotCtrlMgr.MotCurrQax.Val CDD_MotCtrlMgr.MotCurrRollgCntr1.Val CDD_MotCtrlMgr.MotCurrRollgCntr2.Val CDD_MotCtrlMgr.Ntc5DErrCnt.Val CDD_MotCtrlMgr.Ntc6DErrCnt.Val CDD_MotCtrlMgr.PhaOnTiSumA.Val CDD_MotCtrlMgr.PhaOnTiSumB.Val CDD_MotCtrlMgr.PhaOnTiSumC.Val CDD_MotCtrlMgr.SlowLoopCntr.Val /end SUB_GROUP
 /begin FUNCTION_LIST /end FUNCTION_LIST
 /begin REF_CHARACTERISTIC /end REF_CHARACTERISTIC
 /begin REF_MEASUREMENT /end REF_MEASUREMENT
/end GROUP
/begin GROUP CDD_MotCtrlMgr.SlowLoopCntr.Val "MICROSAR RTE" /begin SUB_GROUP /end SUB_GROUP /begin FUNCTION_LIST /end FUNCTION_LIST /begin REF_CHARACTERISTIC /end REF_CHARACTERISTIC /begin REF_MEASUREMENT CDD_MotCtrlMgr.SlowLoopCntr.Val /end REF_MEASUREMENT /end GROUP
/begin GROUP CDD_MotCtrlMgr.SysSt.Val "MICROSAR RTE" /begin SUB_GROUP /end SUB_GROUP /begin FUNCTION_LIST /end FUNCTION_LIST /begin REF_CHARACTERISTIC /end REF_CHARACTERISTIC /begin REF_MEASUREMENT CDD_MotCtrlMgr.SysSt.Val /end REF_MEASUREMENT /end GROUP
/begin GROUP CDD_MotCurrRegVltgLimr "MICROSAR RTE"
 /begin SUB_GROUP CDD_MotCurrRegVltgLimr.CalibrationPorts CDD_MotCurrRegVltgLimr.PerInstanceMemories /end SUB_GROUP
 /begin FUNCTION_LIST /end FUNCTION_LIST
 /begin REF_CHARACTERISTIC /end REF_CHARACTERISTIC
 /begin REF_MEASUREMENT /end REF_MEASUREMENT
/end GROUP
/begin GROUP CDD_MotCurrRegVltgLimr.AntiWdupCmdScaDax "MICROSAR RTE" /begin SUB_GROUP /end SUB_GROUP /begin FUNCTION_LIST /end FUNCTION_LIST /begin REF_CHARACTERISTIC /end REF_CHARACTERISTIC /begin REF_MEASUREMENT CDD_MotCurrRegVltgLimr.AntiWdupCmdScaDax /end REF_MEASUREMENT /end GROUP
/begin GROUP CDD_MotCurrRegVltgLimr.AntiWdupCmdScaQax "MICROSAR RTE" /begin SUB_GROUP /end SUB_GROUP /begin FUNCTION_LIST /end FUNCTION_LIST /begin REF_CHARACTERISTIC /end REF_CHARACTERISTIC /begin REF_MEASUREMENT CDD_MotCurrRegVltgLimr.AntiWdupCmdScaQax /end REF_MEASUREMENT /end GROUP
/begin GROUP CDD_MotCurrRegVltgLimr.CalibrationPorts "MICROSAR RTE"
 /begin SUB_GROUP CDD_MotCurrRegVltgLimr.MotCurrRegCfgCurrLoopSecOrderTrfFctEna.Logl CDD_MotCurrRegVltgLimr.MotCurrRegCfgMotRVirtDax.Val CDD_MotCurrRegVltgLimr.MotCurrRegCfgMotRVirtQax.Val CDD_MotCurrRegVltgLimr.MotCurrRegVltgLimrCurrLoaScarSlewRate.Val CDD_MotCurrRegVltgLimr.MotCurrRegVltgLimrDaxAntiWdupCoeff.Val CDD_MotCurrRegVltgLimr.MotCurrRegVltgLimrDualEcuLoaScarSlewRate.Val CDD_MotCurrRegVltgLimr.MotCurrRegVltgLimrIvtrLoaScarSlewRate.Val CDD_MotCurrRegVltgLimr.MotCurrRegVltgLimrMotCurrPredEna.Logl CDD_MotCurrRegVltgLimr.MotCurrRegVltgLimrMotCurrPredTi.Val CDD_MotCurrRegVltgLimr.MotCurrRegVltgLimrMotCurrQaxRefMdfnRplEna.Logl CDD_MotCurrRegVltgLimr.MotCurrRegVltgLimrMotVltgBrdgFilEna.Logl CDD_MotCurrRegVltgLimr.MotCurrRegVltgLimrMotVltgBrdgLpFilFrq.Val CDD_MotCurrRegVltgLimr.MotCurrRegVltgLimrMotVltgDaxIntglHiLim.Val CDD_MotCurrRegVltgLimr.MotCurrRegVltgLimrMotVltgDaxIntglLoLim.Val CDD_MotCurrRegVltgLimr.MotCurrRegVltgLimrMotVltgQaxFfFilEna.Logl CDD_MotCurrRegVltgLimr.MotCurrRegVltgLimrMotVltgQaxFfLpFilFrq.Val CDD_MotCurrRegVltgLimr.MotCurrRegVltgLimrMotVltgQaxIntglHiLim.Val CDD_MotCurrRegVltgLimr.MotCurrRegVltgLimrMotVltgQaxIntglLoLim.Val CDD_MotCurrRegVltgLimr.MotCurrRegVltgLimrQaxAntiWdupCoeff.Val CDD_MotCurrRegVltgLimr.MotCurrRegVltgLimrQaxAntiWdupScagDi.Logl CDD_MotCurrRegVltgLimr.MotRefMdlFbCtrlDi.Logl CDD_MotCurrRegVltgLimr.MotRefMdlIvtrDeadTiBrdgVltgSca.Val /end SUB_GROUP
 /begin FUNCTION_LIST /end FUNCTION_LIST
 /begin REF_CHARACTERISTIC /end REF_CHARACTERISTIC
 /begin REF_MEASUREMENT /end REF_MEASUREMENT
/end GROUP
/begin GROUP CDD_MotCurrRegVltgLimr.CurrLoaScarPrev "MICROSAR RTE" /begin SUB_GROUP /end SUB_GROUP /begin FUNCTION_LIST /end FUNCTION_LIST /begin REF_CHARACTERISTIC /end REF_CHARACTERISTIC /begin REF_MEASUREMENT CDD_MotCurrRegVltgLimr.CurrLoaScarPrev /end REF_MEASUREMENT /end GROUP
/begin GROUP CDD_MotCurrRegVltgLimr.DualEcuLoaScarPrev "MICROSAR RTE" /begin SUB_GROUP /end SUB_GROUP /begin FUNCTION_LIST /end FUNCTION_LIST /begin REF_CHARACTERISTIC /end REF_CHARACTERISTIC /begin REF_MEASUREMENT CDD_MotCurrRegVltgLimr.DualEcuLoaScarPrev /end REF_MEASUREMENT /end GROUP
/begin GROUP CDD_MotCurrRegVltgLimr.IvtrLoaScarPrev "MICROSAR RTE" /begin SUB_GROUP /end SUB_GROUP /begin FUNCTION_LIST /end FUNCTION_LIST /begin REF_CHARACTERISTIC /end REF_CHARACTERISTIC /begin REF_MEASUREMENT CDD_MotCurrRegVltgLimr.IvtrLoaScarPrev /end REF_MEASUREMENT /end GROUP
/begin GROUP CDD_MotCurrRegVltgLimr.MotCtrlMotVltgDaxPrev "MICROSAR RTE" /begin SUB_GROUP /end SUB_GROUP /begin FUNCTION_LIST /end FUNCTION_LIST /begin REF_CHARACTERISTIC /end REF_CHARACTERISTIC /begin REF_MEASUREMENT CDD_MotCurrRegVltgLimr.MotCtrlMotVltgDaxPrev /end REF_MEASUREMENT /end GROUP
/begin GROUP CDD_MotCurrRegVltgLimr.MotCtrlMotVltgQaxPrev "MICROSAR RTE" /begin SUB_GROUP /end SUB_GROUP /begin FUNCTION_LIST /end FUNCTION_LIST /begin REF_CHARACTERISTIC /end REF_CHARACTERISTIC /begin REF_MEASUREMENT CDD_MotCurrRegVltgLimr.MotCtrlMotVltgQaxPrev /end REF_MEASUREMENT /end GROUP
/begin GROUP CDD_MotCurrRegVltgLimr.MotCurrRegCfgCurrLoopSecOrderTrfFctEna.Logl "MICROSAR RTE" /begin SUB_GROUP /end SUB_GROUP /begin FUNCTION_LIST /end FUNCTION_LIST
 /begin REF_CHARACTERISTIC CDD_MotCurrRegVltgLimr.MotCurrRegCfgCurrLoopSecOrderTrfFctEna.Logl /end REF_CHARACTERISTIC
 /begin REF_MEASUREMENT /end REF_MEASUREMENT
/end GROUP
/begin GROUP CDD_MotCurrRegVltgLimr.MotCurrRegCfgMotRVirtDax.Val "MICROSAR RTE" /begin SUB_GROUP /end SUB_GROUP /begin FUNCTION_LIST /end FUNCTION_LIST /begin REF_CHARACTERISTIC CDD_MotCurrRegVltgLimr.MotCurrRegCfgMotRVirtDax.Val /end REF_CHARACTERISTIC /begin REF_MEASUREMENT /end REF_MEASUREMENT /end GROUP
/begin GROUP CDD_MotCurrRegVltgLimr.MotCurrRegCfgMotRVirtQax.Val "MICROSAR RTE" /begin SUB_GROUP /end SUB_GROUP /begin FUNCTION_LIST /end FUNCTION_LIST /begin REF_CHARACTERISTIC CDD_MotCurrRegVltgLimr.MotCurrRegCfgMotRVirtQax.Val /end REF_CHARACTERISTIC /begin REF_MEASUREMENT /end REF_MEASUREMENT /end GROUP
/begin GROUP CDD_MotCurrRegVltgLimr.MotCurrRegVltgLimrCurrLoaScarSlewRate.Val "MICROSAR RTE" /begin SUB_GROUP /end SUB_GROUP /begin FUNCTION_LIST /end FUNCTION_LIST
 /begin REF_CHARACTERISTIC CDD_MotCurrRegVltgLimr.MotCurrRegVltgLimrCurrLoaScarSlewRate.Val /end REF_CHARACTERISTIC
 /begin REF_MEASUREMENT /end REF_MEASUREMENT
/end GROUP
/begin GROUP CDD_MotCurrRegVltgLimr.MotCurrRegVltgLimrDaxAntiWdupCoeff.Val "MICROSAR RTE" /begin SUB_GROUP /end SUB_GROUP /begin FUNCTION_LIST /end FUNCTION_LIST
 /begin REF_CHARACTERISTIC CDD_MotCurrRegVltgLimr.MotCurrRegVltgLimrDaxAntiWdupCoeff.Val /end REF_CHARACTERISTIC
 /begin REF_MEASUREMENT /end REF_MEASUREMENT
/end GROUP
/begin GROUP CDD_MotCurrRegVltgLimr.MotCurrRegVltgLimrDualEcuLoaScarSlewRate.Val "MICROSAR RTE" /begin SUB_GROUP /end SUB_GROUP /begin FUNCTION_LIST /end FUNCTION_LIST
 /begin REF_CHARACTERISTIC CDD_MotCurrRegVltgLimr.MotCurrRegVltgLimrDualEcuLoaScarSlewRate.Val /end REF_CHARACTERISTIC
 /begin REF_MEASUREMENT /end REF_MEASUREMENT
/end GROUP
/begin GROUP CDD_MotCurrRegVltgLimr.MotCurrRegVltgLimrIvtrLoaScarSlewRate.Val "MICROSAR RTE" /begin SUB_GROUP /end SUB_GROUP /begin FUNCTION_LIST /end FUNCTION_LIST
 /begin REF_CHARACTERISTIC CDD_MotCurrRegVltgLimr.MotCurrRegVltgLimrIvtrLoaScarSlewRate.Val /end REF_CHARACTERISTIC
 /begin REF_MEASUREMENT /end REF_MEASUREMENT
/end GROUP
/begin GROUP CDD_MotCurrRegVltgLimr.MotCurrRegVltgLimrMotCurrPredEna.Logl "MICROSAR RTE" /begin SUB_GROUP /end SUB_GROUP /begin FUNCTION_LIST /end FUNCTION_LIST
 /begin REF_CHARACTERISTIC CDD_MotCurrRegVltgLimr.MotCurrRegVltgLimrMotCurrPredEna.Logl /end REF_CHARACTERISTIC
 /begin REF_MEASUREMENT /end REF_MEASUREMENT
/end GROUP
/begin GROUP CDD_MotCurrRegVltgLimr.MotCurrRegVltgLimrMotCurrPredTi.Val "MICROSAR RTE" /begin SUB_GROUP /end SUB_GROUP /begin FUNCTION_LIST /end FUNCTION_LIST /begin REF_CHARACTERISTIC CDD_MotCurrRegVltgLimr.MotCurrRegVltgLimrMotCurrPredTi.Val /end REF_CHARACTERISTIC /begin REF_MEASUREMENT /end REF_MEASUREMENT /end GROUP
/begin GROUP CDD_MotCurrRegVltgLimr.MotCurrRegVltgLimrMotCurrQaxRefMdfnRplEna.Logl "MICROSAR RTE" /begin SUB_GROUP /end SUB_GROUP /begin FUNCTION_LIST /end FUNCTION_LIST
 /begin REF_CHARACTERISTIC CDD_MotCurrRegVltgLimr.MotCurrRegVltgLimrMotCurrQaxRefMdfnRplEna.Logl /end REF_CHARACTERISTIC
 /begin REF_MEASUREMENT /end REF_MEASUREMENT
/end GROUP
/begin GROUP CDD_MotCurrRegVltgLimr.MotCurrRegVltgLimrMotVltgBrdgFilEna.Logl "MICROSAR RTE" /begin SUB_GROUP /end SUB_GROUP /begin FUNCTION_LIST /end FUNCTION_LIST
 /begin REF_CHARACTERISTIC CDD_MotCurrRegVltgLimr.MotCurrRegVltgLimrMotVltgBrdgFilEna.Logl /end REF_CHARACTERISTIC
 /begin REF_MEASUREMENT /end REF_MEASUREMENT
/end GROUP
/begin GROUP CDD_MotCurrRegVltgLimr.MotCurrRegVltgLimrMotVltgBrdgLpFilFrq.Val "MICROSAR RTE" /begin SUB_GROUP /end SUB_GROUP /begin FUNCTION_LIST /end FUNCTION_LIST
 /begin REF_CHARACTERISTIC CDD_MotCurrRegVltgLimr.MotCurrRegVltgLimrMotVltgBrdgLpFilFrq.Val /end REF_CHARACTERISTIC
 /begin REF_MEASUREMENT /end REF_MEASUREMENT
/end GROUP
/begin GROUP CDD_MotCurrRegVltgLimr.MotCurrRegVltgLimrMotVltgDaxIntglHiLim.Val "MICROSAR RTE" /begin SUB_GROUP /end SUB_GROUP /begin FUNCTION_LIST /end FUNCTION_LIST
 /begin REF_CHARACTERISTIC CDD_MotCurrRegVltgLimr.MotCurrRegVltgLimrMotVltgDaxIntglHiLim.Val /end REF_CHARACTERISTIC
 /begin REF_MEASUREMENT /end REF_MEASUREMENT
/end GROUP
/begin GROUP CDD_MotCurrRegVltgLimr.MotCurrRegVltgLimrMotVltgDaxIntglLoLim.Val "MICROSAR RTE" /begin SUB_GROUP /end SUB_GROUP /begin FUNCTION_LIST /end FUNCTION_LIST
 /begin REF_CHARACTERISTIC CDD_MotCurrRegVltgLimr.MotCurrRegVltgLimrMotVltgDaxIntglLoLim.Val /end REF_CHARACTERISTIC
 /begin REF_MEASUREMENT /end REF_MEASUREMENT
/end GROUP
/begin GROUP CDD_MotCurrRegVltgLimr.MotCurrRegVltgLimrMotVltgQaxFfFilEna.Logl "MICROSAR RTE" /begin SUB_GROUP /end SUB_GROUP /begin FUNCTION_LIST /end FUNCTION_LIST
 /begin REF_CHARACTERISTIC CDD_MotCurrRegVltgLimr.MotCurrRegVltgLimrMotVltgQaxFfFilEna.Logl /end REF_CHARACTERISTIC
 /begin REF_MEASUREMENT /end REF_MEASUREMENT
/end GROUP
/begin GROUP CDD_MotCurrRegVltgLimr.MotCurrRegVltgLimrMotVltgQaxFfLpFilFrq.Val "MICROSAR RTE" /begin SUB_GROUP /end SUB_GROUP /begin FUNCTION_LIST /end FUNCTION_LIST
 /begin REF_CHARACTERISTIC CDD_MotCurrRegVltgLimr.MotCurrRegVltgLimrMotVltgQaxFfLpFilFrq.Val /end REF_CHARACTERISTIC
 /begin REF_MEASUREMENT /end REF_MEASUREMENT
/end GROUP
/begin GROUP CDD_MotCurrRegVltgLimr.MotCurrRegVltgLimrMotVltgQaxIntglHiLim.Val "MICROSAR RTE" /begin SUB_GROUP /end SUB_GROUP /begin FUNCTION_LIST /end FUNCTION_LIST
 /begin REF_CHARACTERISTIC CDD_MotCurrRegVltgLimr.MotCurrRegVltgLimrMotVltgQaxIntglHiLim.Val /end REF_CHARACTERISTIC
 /begin REF_MEASUREMENT /end REF_MEASUREMENT
/end GROUP
/begin GROUP CDD_MotCurrRegVltgLimr.MotCurrRegVltgLimrMotVltgQaxIntglLoLim.Val "MICROSAR RTE" /begin SUB_GROUP /end SUB_GROUP /begin FUNCTION_LIST /end FUNCTION_LIST
 /begin REF_CHARACTERISTIC CDD_MotCurrRegVltgLimr.MotCurrRegVltgLimrMotVltgQaxIntglLoLim.Val /end REF_CHARACTERISTIC
 /begin REF_MEASUREMENT /end REF_MEASUREMENT
/end GROUP
/begin GROUP CDD_MotCurrRegVltgLimr.MotCurrRegVltgLimrQaxAntiWdupCoeff.Val "MICROSAR RTE" /begin SUB_GROUP /end SUB_GROUP /begin FUNCTION_LIST /end FUNCTION_LIST
 /begin REF_CHARACTERISTIC CDD_MotCurrRegVltgLimr.MotCurrRegVltgLimrQaxAntiWdupCoeff.Val /end REF_CHARACTERISTIC
 /begin REF_MEASUREMENT /end REF_MEASUREMENT
/end GROUP
/begin GROUP CDD_MotCurrRegVltgLimr.MotCurrRegVltgLimrQaxAntiWdupScagDi.Logl "MICROSAR RTE" /begin SUB_GROUP /end SUB_GROUP /begin FUNCTION_LIST /end FUNCTION_LIST
 /begin REF_CHARACTERISTIC CDD_MotCurrRegVltgLimr.MotCurrRegVltgLimrQaxAntiWdupScagDi.Logl /end REF_CHARACTERISTIC
 /begin REF_MEASUREMENT /end REF_MEASUREMENT
/end GROUP
/begin GROUP CDD_MotCurrRegVltgLimr.MotRefMdlFbCtrlDi.Logl "MICROSAR RTE" /begin SUB_GROUP /end SUB_GROUP /begin FUNCTION_LIST /end FUNCTION_LIST /begin REF_CHARACTERISTIC CDD_MotCurrRegVltgLimr.MotRefMdlFbCtrlDi.Logl /end REF_CHARACTERISTIC /begin REF_MEASUREMENT /end REF_MEASUREMENT /end GROUP
/begin GROUP CDD_MotCurrRegVltgLimr.MotRefMdlIvtrDeadTiBrdgVltgSca.Val "MICROSAR RTE" /begin SUB_GROUP /end SUB_GROUP /begin FUNCTION_LIST /end FUNCTION_LIST /begin REF_CHARACTERISTIC CDD_MotCurrRegVltgLimr.MotRefMdlIvtrDeadTiBrdgVltgSca.Val /end REF_CHARACTERISTIC /begin REF_MEASUREMENT /end REF_MEASUREMENT /end GROUP
/begin GROUP CDD_MotCurrRegVltgLimr.MotVltgBrdgLpFil "MICROSAR RTE" /begin SUB_GROUP /end SUB_GROUP /begin FUNCTION_LIST /end FUNCTION_LIST /begin REF_CHARACTERISTIC /end REF_CHARACTERISTIC
 /begin REF_MEASUREMENT CDD_MotCurrRegVltgLimr.MotVltgBrdgLpFil.FilGain CDD_MotCurrRegVltgLimr.MotVltgBrdgLpFil.FilSt /end REF_MEASUREMENT
/end GROUP
/begin GROUP CDD_MotCurrRegVltgLimr.MotVltgIntglCmdDaxPrev "MICROSAR RTE" /begin SUB_GROUP /end SUB_GROUP /begin FUNCTION_LIST /end FUNCTION_LIST /begin REF_CHARACTERISTIC /end REF_CHARACTERISTIC /begin REF_MEASUREMENT CDD_MotCurrRegVltgLimr.MotVltgIntglCmdDaxPrev /end REF_MEASUREMENT /end GROUP
/begin GROUP CDD_MotCurrRegVltgLimr.MotVltgIntglCmdQaxPrev "MICROSAR RTE" /begin SUB_GROUP /end SUB_GROUP /begin FUNCTION_LIST /end FUNCTION_LIST /begin REF_CHARACTERISTIC /end REF_CHARACTERISTIC /begin REF_MEASUREMENT CDD_MotCurrRegVltgLimr.MotVltgIntglCmdQaxPrev /end REF_MEASUREMENT /end GROUP
/begin GROUP CDD_MotCurrRegVltgLimr.MotVltgQaxFfLpFil "MICROSAR RTE" /begin SUB_GROUP /end SUB_GROUP /begin FUNCTION_LIST /end FUNCTION_LIST /begin REF_CHARACTERISTIC /end REF_CHARACTERISTIC
 /begin REF_MEASUREMENT CDD_MotCurrRegVltgLimr.MotVltgQaxFfLpFil.FilGain CDD_MotCurrRegVltgLimr.MotVltgQaxFfLpFil.FilSt /end REF_MEASUREMENT
/end GROUP
/begin GROUP CDD_MotCurrRegVltgLimr.PerInstanceMemories "MICROSAR RTE"
 /begin SUB_GROUP CDD_MotCurrRegVltgLimr.AntiWdupCmdScaDax CDD_MotCurrRegVltgLimr.AntiWdupCmdScaQax CDD_MotCurrRegVltgLimr.CurrLoaScarPrev CDD_MotCurrRegVltgLimr.DualEcuLoaScarPrev CDD_MotCurrRegVltgLimr.IvtrLoaScarPrev CDD_MotCurrRegVltgLimr.MotCtrlMotVltgDaxPrev CDD_MotCurrRegVltgLimr.MotCtrlMotVltgQaxPrev CDD_MotCurrRegVltgLimr.MotVltgBrdgLpFil CDD_MotCurrRegVltgLimr.MotVltgIntglCmdDaxPrev CDD_MotCurrRegVltgLimr.MotVltgIntglCmdQaxPrev CDD_MotCurrRegVltgLimr.MotVltgQaxFfLpFil CDD_MotCurrRegVltgLimr.dMotCurrRegVltgLimrAntiWdupCmdScaDax CDD_MotCurrRegVltgLimr.dMotCurrRegVltgLimrAntiWdupCmdScaQax CDD_MotCurrRegVltgLimr.dMotCurrRegVltgLimrMotCurrCmdErr CDD_MotCurrRegVltgLimr.dMotCurrRegVltgLimrMotCurrCmdErrDax CDD_MotCurrRegVltgLimr.dMotCurrRegVltgLimrMotCurrCmdErrQax CDD_MotCurrRegVltgLimr.dMotCurrRegVltgLimrMotCurrCmdScaDax CDD_MotCurrRegVltgLimr.dMotCurrRegVltgLimrMotCurrCmdScaQax CDD_MotCurrRegVltgLimr.dMotCurrRegVltgLimrMotVltgBrdgFild CDD_MotCurrRegVltgLimr.dMotCurrRegVltgLimrMotVltgCmdFinal CDD_MotCurrRegVltgLimr.dMotCurrRegVltgLimrMotVltgCmdPreLim CDD_MotCurrRegVltgLimr.dMotCurrRegVltgLimrMotVltgDampgDax CDD_MotCurrRegVltgLimr.dMotCurrRegVltgLimrMotVltgDampgQax CDD_MotCurrRegVltgLimr.dMotCurrRegVltgLimrMotVltgDaxFb CDD_MotCurrRegVltgLimr.dMotCurrRegVltgLimrMotVltgDaxIntglPreLim CDD_MotCurrRegVltgLimr.dMotCurrRegVltgLimrMotVltgDecouplFbDax CDD_MotCurrRegVltgLimr.dMotCurrRegVltgLimrMotVltgDecouplFbQax CDD_MotCurrRegVltgLimr.dMotCurrRegVltgLimrMotVltgDircFbDax CDD_MotCurrRegVltgLimr.dMotCurrRegVltgLimrMotVltgDircFbQax CDD_MotCurrRegVltgLimr.dMotCurrRegVltgLimrMotVltgPreLimDax CDD_MotCurrRegVltgLimr.dMotCurrRegVltgLimrMotVltgPreLimQax CDD_MotCurrRegVltgLimr.dMotCurrRegVltgLimrMotVltgPropCmdDax CDD_MotCurrRegVltgLimr.dMotCurrRegVltgLimrMotVltgPropCmdQax CDD_MotCurrRegVltgLimr.dMotCurrRegVltgLimrMotVltgQaxFb CDD_MotCurrRegVltgLimr.dMotCurrRegVltgLimrMotVltgQaxFfFild CDD_MotCurrRegVltgLimr.dMotCurrRegVltgLimrMotVltgQaxIntglPreLim CDD_MotCurrRegVltgLimr.dMotCurrRegVltgLimrMotVltgSatnIvsRat CDD_MotCurrRegVltgLimr.dMotCurrRegVltgLimrMotVltgSatnRat CDD_MotCurrRegVltgLimr.dMotCurrRegVltgLimrPhaAdvPreDly /end SUB_GROUP
 /begin FUNCTION_LIST /end FUNCTION_LIST
 /begin REF_CHARACTERISTIC /end REF_CHARACTERISTIC
 /begin REF_MEASUREMENT /end REF_MEASUREMENT
/end GROUP
/begin GROUP CDD_MotCurrRegVltgLimr.dMotCurrRegVltgLimrAntiWdupCmdScaDax "MICROSAR RTE" /begin SUB_GROUP /end SUB_GROUP /begin FUNCTION_LIST /end FUNCTION_LIST /begin REF_CHARACTERISTIC /end REF_CHARACTERISTIC
 /begin REF_MEASUREMENT CDD_MotCurrRegVltgLimr.dMotCurrRegVltgLimrAntiWdupCmdScaDax /end REF_MEASUREMENT
/end GROUP
/begin GROUP CDD_MotCurrRegVltgLimr.dMotCurrRegVltgLimrAntiWdupCmdScaQax "MICROSAR RTE" /begin SUB_GROUP /end SUB_GROUP /begin FUNCTION_LIST /end FUNCTION_LIST /begin REF_CHARACTERISTIC /end REF_CHARACTERISTIC
 /begin REF_MEASUREMENT CDD_MotCurrRegVltgLimr.dMotCurrRegVltgLimrAntiWdupCmdScaQax /end REF_MEASUREMENT
/end GROUP
/begin GROUP CDD_MotCurrRegVltgLimr.dMotCurrRegVltgLimrMotCurrCmdErr "MICROSAR RTE" /begin SUB_GROUP /end SUB_GROUP /begin FUNCTION_LIST /end FUNCTION_LIST /begin REF_CHARACTERISTIC /end REF_CHARACTERISTIC /begin REF_MEASUREMENT CDD_MotCurrRegVltgLimr.dMotCurrRegVltgLimrMotCurrCmdErr /end REF_MEASUREMENT /end GROUP
/begin GROUP CDD_MotCurrRegVltgLimr.dMotCurrRegVltgLimrMotCurrCmdErrDax "MICROSAR RTE" /begin SUB_GROUP /end SUB_GROUP /begin FUNCTION_LIST /end FUNCTION_LIST /begin REF_CHARACTERISTIC /end REF_CHARACTERISTIC /begin REF_MEASUREMENT CDD_MotCurrRegVltgLimr.dMotCurrRegVltgLimrMotCurrCmdErrDax /end REF_MEASUREMENT /end GROUP
/begin GROUP CDD_MotCurrRegVltgLimr.dMotCurrRegVltgLimrMotCurrCmdErrQax "MICROSAR RTE" /begin SUB_GROUP /end SUB_GROUP /begin FUNCTION_LIST /end FUNCTION_LIST /begin REF_CHARACTERISTIC /end REF_CHARACTERISTIC /begin REF_MEASUREMENT CDD_MotCurrRegVltgLimr.dMotCurrRegVltgLimrMotCurrCmdErrQax /end REF_MEASUREMENT /end GROUP
/begin GROUP CDD_MotCurrRegVltgLimr.dMotCurrRegVltgLimrMotCurrCmdScaDax "MICROSAR RTE" /begin SUB_GROUP /end SUB_GROUP /begin FUNCTION_LIST /end FUNCTION_LIST /begin REF_CHARACTERISTIC /end REF_CHARACTERISTIC /begin REF_MEASUREMENT CDD_MotCurrRegVltgLimr.dMotCurrRegVltgLimrMotCurrCmdScaDax /end REF_MEASUREMENT /end GROUP
/begin GROUP CDD_MotCurrRegVltgLimr.dMotCurrRegVltgLimrMotCurrCmdScaQax "MICROSAR RTE" /begin SUB_GROUP /end SUB_GROUP /begin FUNCTION_LIST /end FUNCTION_LIST /begin REF_CHARACTERISTIC /end REF_CHARACTERISTIC /begin REF_MEASUREMENT CDD_MotCurrRegVltgLimr.dMotCurrRegVltgLimrMotCurrCmdScaQax /end REF_MEASUREMENT /end GROUP
/begin GROUP CDD_MotCurrRegVltgLimr.dMotCurrRegVltgLimrMotVltgBrdgFild "MICROSAR RTE" /begin SUB_GROUP /end SUB_GROUP /begin FUNCTION_LIST /end FUNCTION_LIST /begin REF_CHARACTERISTIC /end REF_CHARACTERISTIC /begin REF_MEASUREMENT CDD_MotCurrRegVltgLimr.dMotCurrRegVltgLimrMotVltgBrdgFild /end REF_MEASUREMENT /end GROUP
/begin GROUP CDD_MotCurrRegVltgLimr.dMotCurrRegVltgLimrMotVltgCmdFinal "MICROSAR RTE" /begin SUB_GROUP /end SUB_GROUP /begin FUNCTION_LIST /end FUNCTION_LIST /begin REF_CHARACTERISTIC /end REF_CHARACTERISTIC /begin REF_MEASUREMENT CDD_MotCurrRegVltgLimr.dMotCurrRegVltgLimrMotVltgCmdFinal /end REF_MEASUREMENT /end GROUP
/begin GROUP CDD_MotCurrRegVltgLimr.dMotCurrRegVltgLimrMotVltgCmdPreLim "MICROSAR RTE" /begin SUB_GROUP /end SUB_GROUP /begin FUNCTION_LIST /end FUNCTION_LIST /begin REF_CHARACTERISTIC /end REF_CHARACTERISTIC /begin REF_MEASUREMENT CDD_MotCurrRegVltgLimr.dMotCurrRegVltgLimrMotVltgCmdPreLim /end REF_MEASUREMENT /end GROUP
/begin GROUP CDD_MotCurrRegVltgLimr.dMotCurrRegVltgLimrMotVltgDampgDax "MICROSAR RTE" /begin SUB_GROUP /end SUB_GROUP /begin FUNCTION_LIST /end FUNCTION_LIST /begin REF_CHARACTERISTIC /end REF_CHARACTERISTIC /begin REF_MEASUREMENT CDD_MotCurrRegVltgLimr.dMotCurrRegVltgLimrMotVltgDampgDax /end REF_MEASUREMENT /end GROUP
/begin GROUP CDD_MotCurrRegVltgLimr.dMotCurrRegVltgLimrMotVltgDampgQax "MICROSAR RTE" /begin SUB_GROUP /end SUB_GROUP /begin FUNCTION_LIST /end FUNCTION_LIST /begin REF_CHARACTERISTIC /end REF_CHARACTERISTIC /begin REF_MEASUREMENT CDD_MotCurrRegVltgLimr.dMotCurrRegVltgLimrMotVltgDampgQax /end REF_MEASUREMENT /end GROUP
/begin GROUP CDD_MotCurrRegVltgLimr.dMotCurrRegVltgLimrMotVltgDaxFb "MICROSAR RTE" /begin SUB_GROUP /end SUB_GROUP /begin FUNCTION_LIST /end FUNCTION_LIST /begin REF_CHARACTERISTIC /end REF_CHARACTERISTIC /begin REF_MEASUREMENT CDD_MotCurrRegVltgLimr.dMotCurrRegVltgLimrMotVltgDaxFb /end REF_MEASUREMENT /end GROUP
/begin GROUP CDD_MotCurrRegVltgLimr.dMotCurrRegVltgLimrMotVltgDaxIntglPreLim "MICROSAR RTE" /begin SUB_GROUP /end SUB_GROUP /begin FUNCTION_LIST /end FUNCTION_LIST /begin REF_CHARACTERISTIC /end REF_CHARACTERISTIC
 /begin REF_MEASUREMENT CDD_MotCurrRegVltgLimr.dMotCurrRegVltgLimrMotVltgDaxIntglPreLim /end REF_MEASUREMENT
/end GROUP
/begin GROUP CDD_MotCurrRegVltgLimr.dMotCurrRegVltgLimrMotVltgDecouplFbDax "MICROSAR RTE" /begin SUB_GROUP /end SUB_GROUP /begin FUNCTION_LIST /end FUNCTION_LIST /begin REF_CHARACTERISTIC /end REF_CHARACTERISTIC
 /begin REF_MEASUREMENT CDD_MotCurrRegVltgLimr.dMotCurrRegVltgLimrMotVltgDecouplFbDax /end REF_MEASUREMENT
/end GROUP
/begin GROUP CDD_MotCurrRegVltgLimr.dMotCurrRegVltgLimrMotVltgDecouplFbQax "MICROSAR RTE" /begin SUB_GROUP /end SUB_GROUP /begin FUNCTION_LIST /end FUNCTION_LIST /begin REF_CHARACTERISTIC /end REF_CHARACTERISTIC
 /begin REF_MEASUREMENT CDD_MotCurrRegVltgLimr.dMotCurrRegVltgLimrMotVltgDecouplFbQax /end REF_MEASUREMENT
/end GROUP
/begin GROUP CDD_MotCurrRegVltgLimr.dMotCurrRegVltgLimrMotVltgDircFbDax "MICROSAR RTE" /begin SUB_GROUP /end SUB_GROUP /begin FUNCTION_LIST /end FUNCTION_LIST /begin REF_CHARACTERISTIC /end REF_CHARACTERISTIC /begin REF_MEASUREMENT CDD_MotCurrRegVltgLimr.dMotCurrRegVltgLimrMotVltgDircFbDax /end REF_MEASUREMENT /end GROUP
/begin GROUP CDD_MotCurrRegVltgLimr.dMotCurrRegVltgLimrMotVltgDircFbQax "MICROSAR RTE" /begin SUB_GROUP /end SUB_GROUP /begin FUNCTION_LIST /end FUNCTION_LIST /begin REF_CHARACTERISTIC /end REF_CHARACTERISTIC /begin REF_MEASUREMENT CDD_MotCurrRegVltgLimr.dMotCurrRegVltgLimrMotVltgDircFbQax /end REF_MEASUREMENT /end GROUP
/begin GROUP CDD_MotCurrRegVltgLimr.dMotCurrRegVltgLimrMotVltgPreLimDax "MICROSAR RTE" /begin SUB_GROUP /end SUB_GROUP /begin FUNCTION_LIST /end FUNCTION_LIST /begin REF_CHARACTERISTIC /end REF_CHARACTERISTIC /begin REF_MEASUREMENT CDD_MotCurrRegVltgLimr.dMotCurrRegVltgLimrMotVltgPreLimDax /end REF_MEASUREMENT /end GROUP
/begin GROUP CDD_MotCurrRegVltgLimr.dMotCurrRegVltgLimrMotVltgPreLimQax "MICROSAR RTE" /begin SUB_GROUP /end SUB_GROUP /begin FUNCTION_LIST /end FUNCTION_LIST /begin REF_CHARACTERISTIC /end REF_CHARACTERISTIC /begin REF_MEASUREMENT CDD_MotCurrRegVltgLimr.dMotCurrRegVltgLimrMotVltgPreLimQax /end REF_MEASUREMENT /end GROUP
/begin GROUP CDD_MotCurrRegVltgLimr.dMotCurrRegVltgLimrMotVltgPropCmdDax "MICROSAR RTE" /begin SUB_GROUP /end SUB_GROUP /begin FUNCTION_LIST /end FUNCTION_LIST /begin REF_CHARACTERISTIC /end REF_CHARACTERISTIC
 /begin REF_MEASUREMENT CDD_MotCurrRegVltgLimr.dMotCurrRegVltgLimrMotVltgPropCmdDax /end REF_MEASUREMENT
/end GROUP
/begin GROUP CDD_MotCurrRegVltgLimr.dMotCurrRegVltgLimrMotVltgPropCmdQax "MICROSAR RTE" /begin SUB_GROUP /end SUB_GROUP /begin FUNCTION_LIST /end FUNCTION_LIST /begin REF_CHARACTERISTIC /end REF_CHARACTERISTIC
 /begin REF_MEASUREMENT CDD_MotCurrRegVltgLimr.dMotCurrRegVltgLimrMotVltgPropCmdQax /end REF_MEASUREMENT
/end GROUP
/begin GROUP CDD_MotCurrRegVltgLimr.dMotCurrRegVltgLimrMotVltgQaxFb "MICROSAR RTE" /begin SUB_GROUP /end SUB_GROUP /begin FUNCTION_LIST /end FUNCTION_LIST /begin REF_CHARACTERISTIC /end REF_CHARACTERISTIC /begin REF_MEASUREMENT CDD_MotCurrRegVltgLimr.dMotCurrRegVltgLimrMotVltgQaxFb /end REF_MEASUREMENT /end GROUP
/begin GROUP CDD_MotCurrRegVltgLimr.dMotCurrRegVltgLimrMotVltgQaxFfFild "MICROSAR RTE" /begin SUB_GROUP /end SUB_GROUP /begin FUNCTION_LIST /end FUNCTION_LIST /begin REF_CHARACTERISTIC /end REF_CHARACTERISTIC /begin REF_MEASUREMENT CDD_MotCurrRegVltgLimr.dMotCurrRegVltgLimrMotVltgQaxFfFild /end REF_MEASUREMENT /end GROUP
/begin GROUP CDD_MotCurrRegVltgLimr.dMotCurrRegVltgLimrMotVltgQaxIntglPreLim "MICROSAR RTE" /begin SUB_GROUP /end SUB_GROUP /begin FUNCTION_LIST /end FUNCTION_LIST /begin REF_CHARACTERISTIC /end REF_CHARACTERISTIC
 /begin REF_MEASUREMENT CDD_MotCurrRegVltgLimr.dMotCurrRegVltgLimrMotVltgQaxIntglPreLim /end REF_MEASUREMENT
/end GROUP
/begin GROUP CDD_MotCurrRegVltgLimr.dMotCurrRegVltgLimrMotVltgSatnIvsRat "MICROSAR RTE" /begin SUB_GROUP /end SUB_GROUP /begin FUNCTION_LIST /end FUNCTION_LIST /begin REF_CHARACTERISTIC /end REF_CHARACTERISTIC
 /begin REF_MEASUREMENT CDD_MotCurrRegVltgLimr.dMotCurrRegVltgLimrMotVltgSatnIvsRat /end REF_MEASUREMENT
/end GROUP
/begin GROUP CDD_MotCurrRegVltgLimr.dMotCurrRegVltgLimrMotVltgSatnRat "MICROSAR RTE" /begin SUB_GROUP /end SUB_GROUP /begin FUNCTION_LIST /end FUNCTION_LIST /begin REF_CHARACTERISTIC /end REF_CHARACTERISTIC /begin REF_MEASUREMENT CDD_MotCurrRegVltgLimr.dMotCurrRegVltgLimrMotVltgSatnRat /end REF_MEASUREMENT /end GROUP
/begin GROUP CDD_MotCurrRegVltgLimr.dMotCurrRegVltgLimrPhaAdvPreDly "MICROSAR RTE" /begin SUB_GROUP /end SUB_GROUP /begin FUNCTION_LIST /end FUNCTION_LIST /begin REF_CHARACTERISTIC /end REF_CHARACTERISTIC /begin REF_MEASUREMENT CDD_MotCurrRegVltgLimr.dMotCurrRegVltgLimrPhaAdvPreDly /end REF_MEASUREMENT /end GROUP
/begin GROUP CDD_MotRplCoggCmd "MICROSAR RTE"
 /begin SUB_GROUP CDD_MotRplCoggCmd.CalibrationPorts CDD_MotRplCoggCmd.PerInstanceMemories /end SUB_GROUP
 /begin FUNCTION_LIST /end FUNCTION_LIST
 /begin REF_CHARACTERISTIC /end REF_CHARACTERISTIC
 /begin REF_MEASUREMENT /end REF_MEASUREMENT
/end GROUP
/begin GROUP CDD_MotRplCoggCmd.CalibrationPorts "MICROSAR RTE"
 /begin SUB_GROUP CDD_MotRplCoggCmd.MotRplCoggCmdHrmncOrder1Elec.Val CDD_MotRplCoggCmd.MotRplCoggCmdHrmncOrder2Elec.Val CDD_MotRplCoggCmd.MotRplCoggCmdHrmncOrder3Elec.Val /end SUB_GROUP
 /begin FUNCTION_LIST /end FUNCTION_LIST
 /begin REF_CHARACTERISTIC /end REF_CHARACTERISTIC
 /begin REF_MEASUREMENT /end REF_MEASUREMENT
/end GROUP
/begin GROUP CDD_MotRplCoggCmd.MotCoggCmdY "MICROSAR RTE" /begin SUB_GROUP /end SUB_GROUP /begin FUNCTION_LIST /end FUNCTION_LIST /begin REF_CHARACTERISTIC /end REF_CHARACTERISTIC /begin REF_MEASUREMENT CDD_MotRplCoggCmd.MotCoggCmdY /end REF_MEASUREMENT /end GROUP
/begin GROUP CDD_MotRplCoggCmd.MotRplCoggCmdHrmncOrder1Elec.Val "MICROSAR RTE" /begin SUB_GROUP /end SUB_GROUP /begin FUNCTION_LIST /end FUNCTION_LIST /begin REF_CHARACTERISTIC CDD_MotRplCoggCmd.MotRplCoggCmdHrmncOrder1Elec.Val /end REF_CHARACTERISTIC /begin REF_MEASUREMENT /end REF_MEASUREMENT /end GROUP
/begin GROUP CDD_MotRplCoggCmd.MotRplCoggCmdHrmncOrder2Elec.Val "MICROSAR RTE" /begin SUB_GROUP /end SUB_GROUP /begin FUNCTION_LIST /end FUNCTION_LIST /begin REF_CHARACTERISTIC CDD_MotRplCoggCmd.MotRplCoggCmdHrmncOrder2Elec.Val /end REF_CHARACTERISTIC /begin REF_MEASUREMENT /end REF_MEASUREMENT /end GROUP
/begin GROUP CDD_MotRplCoggCmd.MotRplCoggCmdHrmncOrder3Elec.Val "MICROSAR RTE" /begin SUB_GROUP /end SUB_GROUP /begin FUNCTION_LIST /end FUNCTION_LIST /begin REF_CHARACTERISTIC CDD_MotRplCoggCmd.MotRplCoggCmdHrmncOrder3Elec.Val /end REF_CHARACTERISTIC /begin REF_MEASUREMENT /end REF_MEASUREMENT /end GROUP
/begin GROUP CDD_MotRplCoggCmd.PerInstanceMemories "MICROSAR RTE"
 /begin SUB_GROUP CDD_MotRplCoggCmd.MotCoggCmdY CDD_MotRplCoggCmd.dMotRplCoggCmdCoggIdx CDD_MotRplCoggCmd.dMotRplCoggCmdMotCoggCmd CDD_MotRplCoggCmd.dMotRplCoggCmdMotCurrQaxCoggCmdPreLim CDD_MotRplCoggCmd.dMotRplCoggCmdMotRplCmdPreLim /end SUB_GROUP
 /begin FUNCTION_LIST /end FUNCTION_LIST
 /begin REF_CHARACTERISTIC /end REF_CHARACTERISTIC
 /begin REF_MEASUREMENT /end REF_MEASUREMENT
/end GROUP
/begin GROUP CDD_MotRplCoggCmd.dMotRplCoggCmdCoggIdx "MICROSAR RTE" /begin SUB_GROUP /end SUB_GROUP /begin FUNCTION_LIST /end FUNCTION_LIST /begin REF_CHARACTERISTIC /end REF_CHARACTERISTIC /begin REF_MEASUREMENT CDD_MotRplCoggCmd.dMotRplCoggCmdCoggIdx /end REF_MEASUREMENT /end GROUP
/begin GROUP CDD_MotRplCoggCmd.dMotRplCoggCmdMotCoggCmd "MICROSAR RTE" /begin SUB_GROUP /end SUB_GROUP /begin FUNCTION_LIST /end FUNCTION_LIST /begin REF_CHARACTERISTIC /end REF_CHARACTERISTIC /begin REF_MEASUREMENT CDD_MotRplCoggCmd.dMotRplCoggCmdMotCoggCmd /end REF_MEASUREMENT /end GROUP
/begin GROUP CDD_MotRplCoggCmd.dMotRplCoggCmdMotCurrQaxCoggCmdPreLim "MICROSAR RTE" /begin SUB_GROUP /end SUB_GROUP /begin FUNCTION_LIST /end FUNCTION_LIST /begin REF_CHARACTERISTIC /end REF_CHARACTERISTIC /begin REF_MEASUREMENT CDD_MotRplCoggCmd.dMotRplCoggCmdMotCurrQaxCoggCmdPreLim /end REF_MEASUREMENT /end GROUP
/begin GROUP CDD_MotRplCoggCmd.dMotRplCoggCmdMotRplCmdPreLim "MICROSAR RTE" /begin SUB_GROUP /end SUB_GROUP /begin FUNCTION_LIST /end FUNCTION_LIST /begin REF_CHARACTERISTIC /end REF_CHARACTERISTIC /begin REF_MEASUREMENT CDD_MotRplCoggCmd.dMotRplCoggCmdMotRplCmdPreLim /end REF_MEASUREMENT /end GROUP
/begin GROUP CDD_MotVel "MICROSAR RTE"
 /begin SUB_GROUP CDD_MotVel.PerInstanceMemories CDD_MotVel.ReceiverPorts CDD_MotVel.SenderPorts /end SUB_GROUP
 /begin FUNCTION_LIST /end FUNCTION_LIST
 /begin REF_CHARACTERISTIC /end REF_CHARACTERISTIC
 /begin REF_MEASUREMENT /end REF_MEASUREMENT
/end GROUP
/begin GROUP CDD_MotVel.AssiMechPolarity.Val "MICROSAR RTE" /begin SUB_GROUP /end SUB_GROUP /begin FUNCTION_LIST /end FUNCTION_LIST /begin REF_CHARACTERISTIC /end REF_CHARACTERISTIC /begin REF_MEASUREMENT CDD_MotVel.AssiMechPolarity.Val /end REF_MEASUREMENT /end GROUP
/begin GROUP CDD_MotVel.MotAgBuf.Ary1D "MICROSAR RTE" /begin SUB_GROUP /end SUB_GROUP /begin FUNCTION_LIST /end FUNCTION_LIST /begin REF_CHARACTERISTIC /end REF_CHARACTERISTIC /begin REF_MEASUREMENT CDD_MotVel.MotAgBuf.Ary1D /end REF_MEASUREMENT /end GROUP
/begin GROUP CDD_MotVel.MotAgBufIdx.Val "MICROSAR RTE" /begin SUB_GROUP /end SUB_GROUP /begin FUNCTION_LIST /end FUNCTION_LIST /begin REF_CHARACTERISTIC /end REF_CHARACTERISTIC /begin REF_MEASUREMENT CDD_MotVel.MotAgBufIdx.Val /end REF_MEASUREMENT /end GROUP
/begin GROUP CDD_MotVel.MotAgBufIdxPrev "MICROSAR RTE" /begin SUB_GROUP /end SUB_GROUP /begin FUNCTION_LIST /end FUNCTION_LIST /begin REF_CHARACTERISTIC /end REF_CHARACTERISTIC /begin REF_MEASUREMENT CDD_MotVel.MotAgBufIdxPrev /end REF_MEASUREMENT /end GROUP
/begin GROUP CDD_MotVel.MotAgBufIdxPrim "MICROSAR RTE" /begin SUB_GROUP /end SUB_GROUP /begin FUNCTION_LIST /end FUNCTION_LIST /begin REF_CHARACTERISTIC /end REF_CHARACTERISTIC /begin REF_MEASUREMENT CDD_MotVel.MotAgBufIdxPrim /end REF_MEASUREMENT /end GROUP
/begin GROUP CDD_MotVel.MotAgBufPrev "MICROSAR RTE" /begin SUB_GROUP /end SUB_GROUP /begin FUNCTION_LIST /end FUNCTION_LIST /begin REF_CHARACTERISTIC /end REF_CHARACTERISTIC /begin REF_MEASUREMENT CDD_MotVel.MotAgBufPrev /end REF_MEASUREMENT /end GROUP
/begin GROUP CDD_MotVel.MotAgMeclIdptSig.Val "MICROSAR RTE" /begin SUB_GROUP /end SUB_GROUP /begin FUNCTION_LIST /end FUNCTION_LIST /begin REF_CHARACTERISTIC /end REF_CHARACTERISTIC /begin REF_MEASUREMENT CDD_MotVel.MotAgMeclIdptSig.Val /end REF_MEASUREMENT /end GROUP
/begin GROUP CDD_MotVel.MotAgTiBuf.Ary1D "MICROSAR RTE" /begin SUB_GROUP /end SUB_GROUP /begin FUNCTION_LIST /end FUNCTION_LIST /begin REF_CHARACTERISTIC /end REF_CHARACTERISTIC /begin REF_MEASUREMENT CDD_MotVel.MotAgTiBuf.Ary1D /end REF_MEASUREMENT /end GROUP
/begin GROUP CDD_MotVel.MotAgTiBufPrev "MICROSAR RTE" /begin SUB_GROUP /end SUB_GROUP /begin FUNCTION_LIST /end FUNCTION_LIST /begin REF_CHARACTERISTIC /end REF_CHARACTERISTIC /begin REF_MEASUREMENT CDD_MotVel.MotAgTiBufPrev /end REF_MEASUREMENT /end GROUP
/begin GROUP CDD_MotVel.MotVelCrf.Val "MICROSAR RTE" /begin SUB_GROUP /end SUB_GROUP /begin FUNCTION_LIST /end FUNCTION_LIST /begin REF_CHARACTERISTIC /end REF_CHARACTERISTIC /begin REF_MEASUREMENT CDD_MotVel.MotVelCrf.Val /end REF_MEASUREMENT /end GROUP
/begin GROUP CDD_MotVel.MotVelIninCntr "MICROSAR RTE" /begin SUB_GROUP /end SUB_GROUP /begin FUNCTION_LIST /end FUNCTION_LIST /begin REF_CHARACTERISTIC /end REF_CHARACTERISTIC /begin REF_MEASUREMENT CDD_MotVel.MotVelIninCntr /end REF_MEASUREMENT /end GROUP
/begin GROUP CDD_MotVel.MotVelMrf.Val "MICROSAR RTE" /begin SUB_GROUP /end SUB_GROUP /begin FUNCTION_LIST /end FUNCTION_LIST /begin REF_CHARACTERISTIC /end REF_CHARACTERISTIC /begin REF_MEASUREMENT CDD_MotVel.MotVelMrf.Val /end REF_MEASUREMENT /end GROUP
/begin GROUP CDD_MotVel.MotVelVld.Logl "MICROSAR RTE" /begin SUB_GROUP /end SUB_GROUP /begin FUNCTION_LIST /end FUNCTION_LIST /begin REF_CHARACTERISTIC /end REF_CHARACTERISTIC /begin REF_MEASUREMENT CDD_MotVel.MotVelVld.Logl /end REF_MEASUREMENT /end GROUP
/begin GROUP CDD_MotVel.PerInstanceMemories "MICROSAR RTE"
 /begin SUB_GROUP CDD_MotVel.MotAgBufIdxPrev CDD_MotVel.MotAgBufIdxPrim CDD_MotVel.MotAgBufPrev CDD_MotVel.MotAgTiBufPrev CDD_MotVel.MotVelIninCntr CDD_MotVel.dMotVelAvrgTi CDD_MotVel.dMotVelMotAgRef CDD_MotVel.dMotVelTiStampRef /end SUB_GROUP
 /begin FUNCTION_LIST /end FUNCTION_LIST
 /begin REF_CHARACTERISTIC /end REF_CHARACTERISTIC
 /begin REF_MEASUREMENT /end REF_MEASUREMENT
/end GROUP
/begin GROUP CDD_MotVel.ReceiverPorts "MICROSAR RTE"
 /begin SUB_GROUP CDD_MotVel.AssiMechPolarity.Val CDD_MotVel.MotAgBuf.Ary1D CDD_MotVel.MotAgBufIdx.Val CDD_MotVel.MotAgMeclIdptSig.Val CDD_MotVel.MotAgTiBuf.Ary1D /end SUB_GROUP
 /begin FUNCTION_LIST /end FUNCTION_LIST
 /begin REF_CHARACTERISTIC /end REF_CHARACTERISTIC
 /begin REF_MEASUREMENT /end REF_MEASUREMENT
/end GROUP
/begin GROUP CDD_MotVel.SenderPorts "MICROSAR RTE"
 /begin SUB_GROUP CDD_MotVel.MotVelCrf.Val CDD_MotVel.MotVelMrf.Val CDD_MotVel.MotVelVld.Logl /end SUB_GROUP
 /begin FUNCTION_LIST /end FUNCTION_LIST
 /begin REF_CHARACTERISTIC /end REF_CHARACTERISTIC
 /begin REF_MEASUREMENT /end REF_MEASUREMENT
/end GROUP
/begin GROUP CDD_MotVel.dMotVelAvrgTi "MICROSAR RTE" /begin SUB_GROUP /end SUB_GROUP /begin FUNCTION_LIST /end FUNCTION_LIST /begin REF_CHARACTERISTIC /end REF_CHARACTERISTIC /begin REF_MEASUREMENT CDD_MotVel.dMotVelAvrgTi /end REF_MEASUREMENT /end GROUP
/begin GROUP CDD_MotVel.dMotVelMotAgRef "MICROSAR RTE" /begin SUB_GROUP /end SUB_GROUP /begin FUNCTION_LIST /end FUNCTION_LIST /begin REF_CHARACTERISTIC /end REF_CHARACTERISTIC /begin REF_MEASUREMENT CDD_MotVel.dMotVelMotAgRef /end REF_MEASUREMENT /end GROUP
/begin GROUP CDD_MotVel.dMotVelTiStampRef "MICROSAR RTE" /begin SUB_GROUP /end SUB_GROUP /begin FUNCTION_LIST /end FUNCTION_LIST /begin REF_CHARACTERISTIC /end REF_CHARACTERISTIC /begin REF_MEASUREMENT CDD_MotVel.dMotVelTiStampRef /end REF_MEASUREMENT /end GROUP
/begin GROUP CDD_NvMProxy "MICROSAR RTE" /begin SUB_GROUP CDD_NvMProxy.PerInstanceMemories /end SUB_GROUP /begin FUNCTION_LIST /end FUNCTION_LIST /begin REF_CHARACTERISTIC /end REF_CHARACTERISTIC /begin REF_MEASUREMENT /end REF_MEASUREMENT /end GROUP
/begin GROUP CDD_NvMProxy.BlkFltTbl "MICROSAR RTE" /begin SUB_GROUP /end SUB_GROUP /begin FUNCTION_LIST /end FUNCTION_LIST /begin REF_CHARACTERISTIC /end REF_CHARACTERISTIC
 /begin REF_MEASUREMENT CDD_NvMProxy.BlkFltTbl[0].Prm CDD_NvMProxy.BlkFltTbl[0].Sts CDD_NvMProxy.BlkFltTbl[1].Prm CDD_NvMProxy.BlkFltTbl[1].Sts CDD_NvMProxy.BlkFltTbl[2].Prm CDD_NvMProxy.BlkFltTbl[2].Sts CDD_NvMProxy.BlkFltTbl[3].Prm CDD_NvMProxy.BlkFltTbl[3].Sts CDD_NvMProxy.BlkFltTbl[4].Prm CDD_NvMProxy.BlkFltTbl[4].Sts /end REF_MEASUREMENT
/end GROUP
/begin GROUP CDD_NvMProxy.NvmBlkActv "MICROSAR RTE" /begin SUB_GROUP /end SUB_GROUP /begin FUNCTION_LIST /end FUNCTION_LIST /begin REF_CHARACTERISTIC /end REF_CHARACTERISTIC /begin REF_MEASUREMENT CDD_NvMProxy.NvmBlkActv /end REF_MEASUREMENT /end GROUP
/begin GROUP CDD_NvMProxy.NvmStsCollctd "MICROSAR RTE" /begin SUB_GROUP /end SUB_GROUP /begin FUNCTION_LIST /end FUNCTION_LIST /begin REF_CHARACTERISTIC /end REF_CHARACTERISTIC /begin REF_MEASUREMENT CDD_NvMProxy.NvmStsCollctd /end REF_MEASUREMENT /end GROUP
/begin GROUP CDD_NvMProxy.PerInstanceMemories "MICROSAR RTE"
 /begin SUB_GROUP CDD_NvMProxy.BlkFltTbl CDD_NvMProxy.NvmBlkActv CDD_NvMProxy.NvmStsCollctd CDD_NvMProxy.ShtdwnClsChk /end SUB_GROUP
 /begin FUNCTION_LIST /end FUNCTION_LIST
 /begin REF_CHARACTERISTIC /end REF_CHARACTERISTIC
 /begin REF_MEASUREMENT /end REF_MEASUREMENT
/end GROUP
/begin GROUP CDD_NvMProxy.ShtdwnClsChk "MICROSAR RTE" /begin SUB_GROUP /end SUB_GROUP /begin FUNCTION_LIST /end FUNCTION_LIST /begin REF_CHARACTERISTIC /end REF_CHARACTERISTIC /begin REF_MEASUREMENT CDD_NvMProxy.ShtdwnClsChk /end REF_MEASUREMENT /end GROUP
/begin GROUP CDD_RamMem "MICROSAR RTE" /begin SUB_GROUP CDD_RamMem.PerInstanceMemories CDD_RamMem.SenderPorts /end SUB_GROUP /begin FUNCTION_LIST /end FUNCTION_LIST /begin REF_CHARACTERISTIC /end REF_CHARACTERISTIC /begin REF_MEASUREMENT /end REF_MEASUREMENT /end GROUP
/begin GROUP CDD_RamMem.LclRamEccSngBitCntr "MICROSAR RTE" /begin SUB_GROUP /end SUB_GROUP /begin FUNCTION_LIST /end FUNCTION_LIST /begin REF_CHARACTERISTIC /end REF_CHARACTERISTIC /begin REF_MEASUREMENT CDD_RamMem.LclRamEccSngBitCntr /end REF_MEASUREMENT /end GROUP
/begin GROUP CDD_RamMem.LclRamEccSngBitCntrOutp.Val "MICROSAR RTE" /begin SUB_GROUP /end SUB_GROUP /begin FUNCTION_LIST /end FUNCTION_LIST /begin REF_CHARACTERISTIC /end REF_CHARACTERISTIC /begin REF_MEASUREMENT CDD_RamMem.LclRamEccSngBitCntrOutp.Val /end REF_MEASUREMENT /end GROUP
/begin GROUP CDD_RamMem.LclRamEccSngBitSoftFailr "MICROSAR RTE" /begin SUB_GROUP /end SUB_GROUP /begin FUNCTION_LIST /end FUNCTION_LIST /begin REF_CHARACTERISTIC /end REF_CHARACTERISTIC /begin REF_MEASUREMENT CDD_RamMem.LclRamEccSngBitSoftFailr /end REF_MEASUREMENT /end GROUP
/begin GROUP CDD_RamMem.LclRamFailrAdr "MICROSAR RTE" /begin SUB_GROUP /end SUB_GROUP /begin FUNCTION_LIST /end FUNCTION_LIST /begin REF_CHARACTERISTIC /end REF_CHARACTERISTIC /begin REF_MEASUREMENT CDD_RamMem.LclRamFailrAdr /end REF_MEASUREMENT /end GROUP
/begin GROUP CDD_RamMem.LclRamWordLineRead "MICROSAR RTE" /begin SUB_GROUP /end SUB_GROUP /begin FUNCTION_LIST /end FUNCTION_LIST /begin REF_CHARACTERISTIC /end REF_CHARACTERISTIC /begin REF_MEASUREMENT CDD_RamMem.LclRamWordLineRead /end REF_MEASUREMENT /end GROUP
/begin GROUP CDD_RamMem.PerInstanceMemories "MICROSAR RTE"
 /begin SUB_GROUP CDD_RamMem.LclRamEccSngBitCntr CDD_RamMem.LclRamEccSngBitSoftFailr CDD_RamMem.LclRamFailrAdr CDD_RamMem.LclRamWordLineRead CDD_RamMem.dRamMemCanRamDblBitEccErrAdr CDD_RamMem.dRamMemCanRamSngBitEccErrAdr CDD_RamMem.dRamMemDtsRamEccErrAdr CDD_RamMem.dRamMemFrRamDblBitEccErrAdr CDD_RamMem.dRamMemFrRamSngBitEccErrAdr CDD_RamMem.dRamMemFrRamTmpBufADblBitEccErrAdr CDD_RamMem.dRamMemFrRamTmpBufBDblBitEccErrAdr CDD_RamMem.dRamMemSpi0RamEccErrAdr CDD_RamMem.dRamMemSpi1RamEccErrAdr CDD_RamMem.dRamMemSpi2RamEccErrAdr CDD_RamMem.dRamMemSpi3RamEccErrAdr CDD_RamMem.dRamMemSpiRamEccErrAdr /end SUB_GROUP
 /begin FUNCTION_LIST /end FUNCTION_LIST
 /begin REF_CHARACTERISTIC /end REF_CHARACTERISTIC
 /begin REF_MEASUREMENT /end REF_MEASUREMENT
/end GROUP
/begin GROUP CDD_RamMem.SenderPorts "MICROSAR RTE" /begin SUB_GROUP CDD_RamMem.LclRamEccSngBitCntrOutp.Val /end SUB_GROUP /begin FUNCTION_LIST /end FUNCTION_LIST /begin REF_CHARACTERISTIC /end REF_CHARACTERISTIC /begin REF_MEASUREMENT /end REF_MEASUREMENT /end GROUP
/begin GROUP CDD_RamMem.dRamMemCanRamDblBitEccErrAdr "MICROSAR RTE" /begin SUB_GROUP /end SUB_GROUP /begin FUNCTION_LIST /end FUNCTION_LIST /begin REF_CHARACTERISTIC /end REF_CHARACTERISTIC /begin REF_MEASUREMENT CDD_RamMem.dRamMemCanRamDblBitEccErrAdr /end REF_MEASUREMENT /end GROUP
/begin GROUP CDD_RamMem.dRamMemCanRamSngBitEccErrAdr "MICROSAR RTE" /begin SUB_GROUP /end SUB_GROUP /begin FUNCTION_LIST /end FUNCTION_LIST /begin REF_CHARACTERISTIC /end REF_CHARACTERISTIC /begin REF_MEASUREMENT CDD_RamMem.dRamMemCanRamSngBitEccErrAdr /end REF_MEASUREMENT /end GROUP
/begin GROUP CDD_RamMem.dRamMemDtsRamEccErrAdr "MICROSAR RTE" /begin SUB_GROUP /end SUB_GROUP /begin FUNCTION_LIST /end FUNCTION_LIST /begin REF_CHARACTERISTIC /end REF_CHARACTERISTIC /begin REF_MEASUREMENT CDD_RamMem.dRamMemDtsRamEccErrAdr /end REF_MEASUREMENT /end GROUP
/begin GROUP CDD_RamMem.dRamMemFrRamDblBitEccErrAdr "MICROSAR RTE" /begin SUB_GROUP /end SUB_GROUP /begin FUNCTION_LIST /end FUNCTION_LIST /begin REF_CHARACTERISTIC /end REF_CHARACTERISTIC /begin REF_MEASUREMENT CDD_RamMem.dRamMemFrRamDblBitEccErrAdr /end REF_MEASUREMENT /end GROUP
/begin GROUP CDD_RamMem.dRamMemFrRamSngBitEccErrAdr "MICROSAR RTE" /begin SUB_GROUP /end SUB_GROUP /begin FUNCTION_LIST /end FUNCTION_LIST /begin REF_CHARACTERISTIC /end REF_CHARACTERISTIC /begin REF_MEASUREMENT CDD_RamMem.dRamMemFrRamSngBitEccErrAdr /end REF_MEASUREMENT /end GROUP
/begin GROUP CDD_RamMem.dRamMemFrRamTmpBufADblBitEccErrAdr "MICROSAR RTE" /begin SUB_GROUP /end SUB_GROUP /begin FUNCTION_LIST /end FUNCTION_LIST /begin REF_CHARACTERISTIC /end REF_CHARACTERISTIC /begin REF_MEASUREMENT CDD_RamMem.dRamMemFrRamTmpBufADblBitEccErrAdr /end REF_MEASUREMENT /end GROUP
/begin GROUP CDD_RamMem.dRamMemFrRamTmpBufBDblBitEccErrAdr "MICROSAR RTE" /begin SUB_GROUP /end SUB_GROUP /begin FUNCTION_LIST /end FUNCTION_LIST /begin REF_CHARACTERISTIC /end REF_CHARACTERISTIC /begin REF_MEASUREMENT CDD_RamMem.dRamMemFrRamTmpBufBDblBitEccErrAdr /end REF_MEASUREMENT /end GROUP
/begin GROUP CDD_RamMem.dRamMemSpi0RamEccErrAdr "MICROSAR RTE" /begin SUB_GROUP /end SUB_GROUP /begin FUNCTION_LIST /end FUNCTION_LIST /begin REF_CHARACTERISTIC /end REF_CHARACTERISTIC /begin REF_MEASUREMENT CDD_RamMem.dRamMemSpi0RamEccErrAdr /end REF_MEASUREMENT /end GROUP
/begin GROUP CDD_RamMem.dRamMemSpi1RamEccErrAdr "MICROSAR RTE" /begin SUB_GROUP /end SUB_GROUP /begin FUNCTION_LIST /end FUNCTION_LIST /begin REF_CHARACTERISTIC /end REF_CHARACTERISTIC /begin REF_MEASUREMENT CDD_RamMem.dRamMemSpi1RamEccErrAdr /end REF_MEASUREMENT /end GROUP
/begin GROUP CDD_RamMem.dRamMemSpi2RamEccErrAdr "MICROSAR RTE" /begin SUB_GROUP /end SUB_GROUP /begin FUNCTION_LIST /end FUNCTION_LIST /begin REF_CHARACTERISTIC /end REF_CHARACTERISTIC /begin REF_MEASUREMENT CDD_RamMem.dRamMemSpi2RamEccErrAdr /end REF_MEASUREMENT /end GROUP
/begin GROUP CDD_RamMem.dRamMemSpi3RamEccErrAdr "MICROSAR RTE" /begin SUB_GROUP /end SUB_GROUP /begin FUNCTION_LIST /end FUNCTION_LIST /begin REF_CHARACTERISTIC /end REF_CHARACTERISTIC /begin REF_MEASUREMENT CDD_RamMem.dRamMemSpi3RamEccErrAdr /end REF_MEASUREMENT /end GROUP
/begin GROUP CDD_RamMem.dRamMemSpiRamEccErrAdr "MICROSAR RTE" /begin SUB_GROUP /end SUB_GROUP /begin FUNCTION_LIST /end FUNCTION_LIST /begin REF_CHARACTERISTIC /end REF_CHARACTERISTIC /begin REF_MEASUREMENT CDD_RamMem.dRamMemSpiRamEccErrAdr /end REF_MEASUREMENT /end GROUP
/begin GROUP CDD_SinVltgGenn "MICROSAR RTE"
 /begin SUB_GROUP CDD_SinVltgGenn.CalibrationPorts CDD_SinVltgGenn.PerInstanceMemories CDD_SinVltgGenn.ReceiverPorts /end SUB_GROUP
 /begin FUNCTION_LIST /end FUNCTION_LIST
 /begin REF_CHARACTERISTIC /end REF_CHARACTERISTIC
 /begin REF_MEASUREMENT /end REF_MEASUREMENT
/end GROUP
/begin GROUP CDD_SinVltgGenn.CalibrationPorts "MICROSAR RTE" /begin SUB_GROUP CDD_SinVltgGenn.SinVltgGennDthrLpFilCoeff.Val /end SUB_GROUP /begin FUNCTION_LIST /end FUNCTION_LIST /begin REF_CHARACTERISTIC /end REF_CHARACTERISTIC /begin REF_MEASUREMENT /end REF_MEASUREMENT /end GROUP
/begin GROUP CDD_SinVltgGenn.Fil1OutpPrev "MICROSAR RTE" /begin SUB_GROUP /end SUB_GROUP /begin FUNCTION_LIST /end FUNCTION_LIST /begin REF_CHARACTERISTIC /end REF_CHARACTERISTIC /begin REF_MEASUREMENT CDD_SinVltgGenn.Fil1OutpPrev /end REF_MEASUREMENT /end GROUP
/begin GROUP CDD_SinVltgGenn.Fil2OutpPrev "MICROSAR RTE" /begin SUB_GROUP /end SUB_GROUP /begin FUNCTION_LIST /end FUNCTION_LIST /begin REF_CHARACTERISTIC /end REF_CHARACTERISTIC /begin REF_MEASUREMENT CDD_SinVltgGenn.Fil2OutpPrev /end REF_MEASUREMENT /end GROUP
/begin GROUP CDD_SinVltgGenn.MotElecMeclPolarity.Val "MICROSAR RTE" /begin SUB_GROUP /end SUB_GROUP /begin FUNCTION_LIST /end FUNCTION_LIST /begin REF_CHARACTERISTIC /end REF_CHARACTERISTIC /begin REF_MEASUREMENT CDD_SinVltgGenn.MotElecMeclPolarity.Val /end REF_MEASUREMENT /end GROUP
/begin GROUP CDD_SinVltgGenn.PerInstanceMemories "MICROSAR RTE"
 /begin SUB_GROUP CDD_SinVltgGenn.Fil1OutpPrev CDD_SinVltgGenn.Fil2OutpPrev CDD_SinVltgGenn.PhaDptOffsA CDD_SinVltgGenn.PhaDptOffsB CDD_SinVltgGenn.PhaDptOffsC CDD_SinVltgGenn.PhaOnTiSumAPrev CDD_SinVltgGenn.PhaOnTiSumBPrev CDD_SinVltgGenn.PhaOnTiSumCPrev CDD_SinVltgGenn.PwmPerdRng CDD_SinVltgGenn.RndNrPrev /end SUB_GROUP
 /begin FUNCTION_LIST /end FUNCTION_LIST
 /begin REF_CHARACTERISTIC /end REF_CHARACTERISTIC
 /begin REF_MEASUREMENT /end REF_MEASUREMENT
/end GROUP
/begin GROUP CDD_SinVltgGenn.PhaDptOffsA "MICROSAR RTE" /begin SUB_GROUP /end SUB_GROUP /begin FUNCTION_LIST /end FUNCTION_LIST /begin REF_CHARACTERISTIC /end REF_CHARACTERISTIC /begin REF_MEASUREMENT CDD_SinVltgGenn.PhaDptOffsA /end REF_MEASUREMENT /end GROUP
/begin GROUP CDD_SinVltgGenn.PhaDptOffsB "MICROSAR RTE" /begin SUB_GROUP /end SUB_GROUP /begin FUNCTION_LIST /end FUNCTION_LIST /begin REF_CHARACTERISTIC /end REF_CHARACTERISTIC /begin REF_MEASUREMENT CDD_SinVltgGenn.PhaDptOffsB /end REF_MEASUREMENT /end GROUP
/begin GROUP CDD_SinVltgGenn.PhaDptOffsC "MICROSAR RTE" /begin SUB_GROUP /end SUB_GROUP /begin FUNCTION_LIST /end FUNCTION_LIST /begin REF_CHARACTERISTIC /end REF_CHARACTERISTIC /begin REF_MEASUREMENT CDD_SinVltgGenn.PhaDptOffsC /end REF_MEASUREMENT /end GROUP
/begin GROUP CDD_SinVltgGenn.PhaOnTiSumAPrev "MICROSAR RTE" /begin SUB_GROUP /end SUB_GROUP /begin FUNCTION_LIST /end FUNCTION_LIST /begin REF_CHARACTERISTIC /end REF_CHARACTERISTIC /begin REF_MEASUREMENT CDD_SinVltgGenn.PhaOnTiSumAPrev /end REF_MEASUREMENT /end GROUP
/begin GROUP CDD_SinVltgGenn.PhaOnTiSumBPrev "MICROSAR RTE" /begin SUB_GROUP /end SUB_GROUP /begin FUNCTION_LIST /end FUNCTION_LIST /begin REF_CHARACTERISTIC /end REF_CHARACTERISTIC /begin REF_MEASUREMENT CDD_SinVltgGenn.PhaOnTiSumBPrev /end REF_MEASUREMENT /end GROUP
/**********************************************************************************************************************
* RECORD_LAYOUT
*********************************************************************************************************************/
/begin RECORD_LAYOUT RTE_RL_UBYTE FNC_VALUES 1 UBYTE ROW_DIR DIRECT /end RECORD_LAYOUT
/begin RECORD_LAYOUT RTE_RL_UWORD FNC_VALUES 1 UWORD ROW_DIR DIRECT /end RECORD_LAYOUT
/begin RECORD_LAYOUT RTE_RL_FLOAT32_IEEE FNC_VALUES 1 FLOAT32_IEEE ROW_DIR DIRECT /end RECORD_LAYOUT
/begin RECORD_LAYOUT RTE_RL_BOOLEAN FNC_VALUES 1 UBYTE ROW_DIR DIRECT /end RECORD_LAYOUT
/**********************************************************************************************************************
* COMPU_METHOD / COMPU_VTAB_RANGE
*********************************************************************************************************************/
/begin COMPU_METHOD RTE_CM_BOOLEAN "" TAB_VERB "%3.1" "" COMPU_TAB_REF RTE_CM_BOOLEAN /end COMPU_METHOD
/begin COMPU_VTAB_RANGE RTE_CM_BOOLEAN "" 2 0 0 "false" 1 255 "true" /end COMPU_VTAB_RANGE
/begin COMPU_METHOD RTE_CM_ENUM_SysSt1 "" TAB_VERB "%.1" "" COMPU_TAB_REF RTE_CM_ENUM_SysSt1 /end COMPU_METHOD
/begin COMPU_VTAB_RANGE RTE_CM_ENUM_SysSt1 "" 4 0 0 "SYSST_DI" 1 1 "SYSST_OFF" 2 2 "SYSST_ENA" 3 3 "SYSST_WRMININ" /end COMPU_VTAB_RANGE
/begin COMPU_METHOD RTE_CM_ENUM_SigQlfr1 "" TAB_VERB "%.1" "" COMPU_TAB_REF RTE_CM_ENUM_SigQlfr1 /end COMPU_METHOD
/begin COMPU_VTAB_RANGE RTE_CM_ENUM_SigQlfr1 "" 3 0 0 "SIGQLFR_NORES" 1 1 "SIGQLFR_PASSD" 2 2 "SIGQLFR_FAILD" /end COMPU_VTAB_RANGE
/begin COMPU_METHOD RTE_CM_ENUM_MotCurrEolCalSt2 "" TAB_VERB "%.1" "" COMPU_TAB_REF RTE_CM_ENUM_MotCurrEolCalSt2 /end COMPU_METHOD
/begin COMPU_VTAB_RANGE RTE_CM_ENUM_MotCurrEolCalSt2 "" 9 0 0 "MCECS_OFFSCMDSTRT" 1 1 "MCECS_OFFSCMDHI" 2 2 "MCECS_OFFSCMDLO" 3 3 "MCECS_OFFSCMDZERO" 4 4 "MCECS_OFFSCMDEND" 5 5 "MCECS_GAINCMDAD" 6 6 "MCECS_GAINCMDBE" 7 7 "MCECS_GAINCMDCF" 8 8 "MCECS_CMDSAFEST" /end COMPU_VTAB_RANGE
/begin COMPU_METHOD RTE_CM_Ag5 "" RAT_FUNC "%.1" "MotRev" COEFFS 0 65536 0 0 0 1 /end COMPU_METHOD
/begin COMPU_METHOD RTE_CM_Ag9 "" RAT_FUNC "%.1" "MotRevElec" COEFFS 0 65536 0 0 0 1 /end COMPU_METHOD
/begin COMPU_METHOD RTE_CM_Ag8 "" RAT_FUNC "%.1" "MotRev" COEFFS 0 65536 0 0 0 1 /end COMPU_METHOD
/begin COMPU_METHOD RTE_CM_Ag7 "" RAT_FUNC "%.1" "MotDeg" COEFFS 0 8192 0 0 0 1 /end COMPU_METHOD
/begin COMPU_METHOD RTE_CM_ENUM_NtcSts1 "" TAB_VERB "%.1" "" COMPU_TAB_REF RTE_CM_ENUM_NtcSts1 /end COMPU_METHOD
/begin COMPU_VTAB_RANGE RTE_CM_ENUM_NtcSts1 "" 4 0 0 "NTCSTS_PASSD" 1 1 "NTCSTS_FAILD" 2 2 "NTCSTS_PREPASSD" 3 3 "NTCSTS_PREFAILD" /end COMPU_VTAB_RANGE
