/begin CHARACTERISTIC GmMsg337BusChassisExp.GmMsg337BusChassisExpInvldDiagcTiOut.Val "MICROSAR RTE" VALUE 0x0 RTE_RL_UWORD 0 NO_COMPU_METHOD 0 65535 SYMBOL_LINK "Rte_CalprmRom_CalRegn01Cmn_DEFAULT_RTE_CALPRM_GROUP.GmMsg337BusChassisExpInvldDiagcTiOut_Val" 0 DISPLAY_IDENTIFIER GmMsg337BusChassisExp.CalibrationPorts.GmMsg337BusChassisExpInvldDiagcTiOut.Val /end CHARACTERISTIC
/begin CHARACTERISTIC GmMsg337BusChassisExp.GmMsg337BusChassisExpInvldProtnValTiOut.Val "MICROSAR RTE" VALUE 0x0 RTE_RL_UWORD 0 NO_COMPU_METHOD 0 65535 SYMBOL_LINK "Rte_CalprmRom_CalRegn01Cmn_DEFAULT_RTE_CALPRM_GROUP.GmMsg337BusChassisExpInvldProtnValTiOut_Val" 0 DISPLAY_IDENTIFIER GmMsg337BusChassisExp.CalibrationPorts.GmMsg337BusChassisExpInvldProtnValTiOut.Val /end CHARACTERISTIC
/begin CHARACTERISTIC GmMsg337BusChassisExp.GmMsg337BusChassisExpInvldRollgCntrTiOut.Val "MICROSAR RTE" VALUE 0x0 RTE_RL_UWORD 0 NO_COMPU_METHOD 0 65535 SYMBOL_LINK "Rte_CalprmRom_CalRegn01Cmn_DEFAULT_RTE_CALPRM_GROUP.GmMsg337BusChassisExpInvldRollgCntrTiOut_Val" 0 DISPLAY_IDENTIFIER GmMsg337BusChassisExp.CalibrationPorts.GmMsg337BusChassisExpInvldRollgCntrTiOut.Val /end CHARACTERISTIC
/begin CHARACTERISTIC GmMsg337BusChassisExp.GmMsg337BusChassisExpMissTiOut.Val "MICROSAR RTE" VALUE 0x0 RTE_RL_UWORD 0 NO_COMPU_METHOD 0 65535 SYMBOL_LINK "Rte_CalprmRom_CalRegn01Cmn_DEFAULT_RTE_CALPRM_GROUP.GmMsg337BusChassisExpMissTiOut_Val" 0 DISPLAY_IDENTIFIER GmMsg337BusChassisExp.CalibrationPorts.GmMsg337BusChassisExpMissTiOut.Val /end CHARACTERISTIC
/begin CHARACTERISTIC GmMsg337BusChassisExp.GmMsg337BusChassisExpTarAgPolarity.Val "MICROSAR RTE" VALUE 0x0 RTE_RL_SBYTE 0 NO_COMPU_METHOD -128 127 SYMBOL_LINK "Rte_CalprmRom_CalRegn01Cmn_DEFAULT_RTE_CALPRM_GROUP.GmMsg337BusChassisExpTarAgPolarity_Val" 0 DISPLAY_IDENTIFIER GmMsg337BusChassisExp.CalibrationPorts.GmMsg337BusChassisExpTarAgPolarity.Val /end CHARACTERISTIC
/begin CHARACTERISTIC GmMsg348BusChassisExp.GmMsg348BusChassisExpInvldTiOut.Val "MICROSAR RTE" VALUE 0x0 RTE_RL_UWORD 0 NO_COMPU_METHOD 0 65535 SYMBOL_LINK "Rte_CalprmRom_CalRegn01Cmn_DEFAULT_RTE_CALPRM_GROUP.GmMsg348BusChassisExpInvldTiOut_Val" 0 DISPLAY_IDENTIFIER GmMsg348BusChassisExp.CalibrationPorts.GmMsg348BusChassisExpInvldTiOut.Val /end CHARACTERISTIC
/begin CHARACTERISTIC GmMsg348BusChassisExp.GmMsg348BusChassisExpMissTiOut.Val "MICROSAR RTE" VALUE 0x0 RTE_RL_UWORD 0 NO_COMPU_METHOD 0 65535 SYMBOL_LINK "Rte_CalprmRom_CalRegn01Cmn_DEFAULT_RTE_CALPRM_GROUP.GmMsg348BusChassisExpMissTiOut_Val" 0 DISPLAY_IDENTIFIER GmMsg348BusChassisExp.CalibrationPorts.GmMsg348BusChassisExpMissTiOut.Val /end CHARACTERISTIC
/begin CHARACTERISTIC GmMsg348BusChassisExp.GmMsg348BusChassisExpStuckTiOut.Val "MICROSAR RTE" VALUE 0x0 RTE_RL_UWORD 0 NO_COMPU_METHOD 0 65535 SYMBOL_LINK "Rte_CalprmRom_CalRegn01Cmn_DEFAULT_RTE_CALPRM_GROUP.GmMsg348BusChassisExpStuckTiOut_Val" 0 DISPLAY_IDENTIFIER GmMsg348BusChassisExp.CalibrationPorts.GmMsg348BusChassisExpStuckTiOut.Val /end CHARACTERISTIC
/begin CHARACTERISTIC GmMsg348BusHiSpd.GmMsg348BusHiSpdInvldTiOut.Val "MICROSAR RTE" VALUE 0x0 RTE_RL_UWORD 0 NO_COMPU_METHOD 0 65535 SYMBOL_LINK "Rte_CalprmRom_CalRegn01Cmn_DEFAULT_RTE_CALPRM_GROUP.GmMsg348BusHiSpdInvldTiOut_Val" 0 DISPLAY_IDENTIFIER GmMsg348BusHiSpd.CalibrationPorts.GmMsg348BusHiSpdInvldTiOut.Val /end CHARACTERISTIC
/begin CHARACTERISTIC GmMsg348BusHiSpd.GmMsg348BusHiSpdMissTiOut.Val "MICROSAR RTE" VALUE 0x0 RTE_RL_UWORD 0 NO_COMPU_METHOD 0 65535 SYMBOL_LINK "Rte_CalprmRom_CalRegn01Cmn_DEFAULT_RTE_CALPRM_GROUP.GmMsg348BusHiSpdMissTiOut_Val" 0 DISPLAY_IDENTIFIER GmMsg348BusHiSpd.CalibrationPorts.GmMsg348BusHiSpdMissTiOut.Val /end CHARACTERISTIC
/begin CHARACTERISTIC GmMsg348BusHiSpd.GmMsg348BusHiSpdStuckTiOut.Val "MICROSAR RTE" VALUE 0x0 RTE_RL_UWORD 0 NO_COMPU_METHOD 0 65535 SYMBOL_LINK "Rte_CalprmRom_CalRegn01Cmn_DEFAULT_RTE_CALPRM_GROUP.GmMsg348BusHiSpdStuckTiOut_Val" 0 DISPLAY_IDENTIFIER GmMsg348BusHiSpd.CalibrationPorts.GmMsg348BusHiSpdStuckTiOut.Val /end CHARACTERISTIC
/begin CHARACTERISTIC GmMsg34ABusChassisExp.GmMsg34ABusChassisExpInvldTiOut.Val "MICROSAR RTE" VALUE 0x0 RTE_RL_UWORD 0 NO_COMPU_METHOD 0 65535 SYMBOL_LINK "Rte_CalprmRom_CalRegn01Cmn_DEFAULT_RTE_CALPRM_GROUP.GmMsg34ABusChassisExpInvldTiOut_Val" 0 DISPLAY_IDENTIFIER GmMsg34ABusChassisExp.CalibrationPorts.GmMsg34ABusChassisExpInvldTiOut.Val /end CHARACTERISTIC
/begin CHARACTERISTIC GmMsg34ABusChassisExp.GmMsg34ABusChassisExpMissTiOut.Val "MICROSAR RTE" VALUE 0x0 RTE_RL_UWORD 0 NO_COMPU_METHOD 0 65535 SYMBOL_LINK "Rte_CalprmRom_CalRegn01Cmn_DEFAULT_RTE_CALPRM_GROUP.GmMsg34ABusChassisExpMissTiOut_Val" 0 DISPLAY_IDENTIFIER GmMsg34ABusChassisExp.CalibrationPorts.GmMsg34ABusChassisExpMissTiOut.Val /end CHARACTERISTIC
/begin CHARACTERISTIC GmMsg34ABusChassisExp.GmMsg34ABusChassisExpStuckTiOut.Val "MICROSAR RTE" VALUE 0x0 RTE_RL_UWORD 0 NO_COMPU_METHOD 0 65535 SYMBOL_LINK "Rte_CalprmRom_CalRegn01Cmn_DEFAULT_RTE_CALPRM_GROUP.GmMsg34ABusChassisExpStuckTiOut_Val" 0 DISPLAY_IDENTIFIER GmMsg34ABusChassisExp.CalibrationPorts.GmMsg34ABusChassisExpStuckTiOut.Val /end CHARACTERISTIC
/begin CHARACTERISTIC GmMsg34ABusHiSpd.GmMsg34ABusHiSpdInvldTiOut.Val "MICROSAR RTE" VALUE 0x0 RTE_RL_UWORD 0 NO_COMPU_METHOD 0 65535 SYMBOL_LINK "Rte_CalprmRom_CalRegn01Cmn_DEFAULT_RTE_CALPRM_GROUP.GmMsg34ABusHiSpdInvldTiOut_Val" 0 DISPLAY_IDENTIFIER GmMsg34ABusHiSpd.CalibrationPorts.GmMsg34ABusHiSpdInvldTiOut.Val /end CHARACTERISTIC
/begin CHARACTERISTIC GmMsg34ABusHiSpd.GmMsg34ABusHiSpdMissTiOut.Val "MICROSAR RTE" VALUE 0x0 RTE_RL_UWORD 0 NO_COMPU_METHOD 0 65535 SYMBOL_LINK "Rte_CalprmRom_CalRegn01Cmn_DEFAULT_RTE_CALPRM_GROUP.GmMsg34ABusHiSpdMissTiOut_Val" 0 DISPLAY_IDENTIFIER GmMsg34ABusHiSpd.CalibrationPorts.GmMsg34ABusHiSpdMissTiOut.Val /end CHARACTERISTIC
/begin CHARACTERISTIC GmMsg34ABusHiSpd.GmMsg34ABusHiSpdStuckTiOut.Val "MICROSAR RTE" VALUE 0x0 RTE_RL_UWORD 0 NO_COMPU_METHOD 0 65535 SYMBOL_LINK "Rte_CalprmRom_CalRegn01Cmn_DEFAULT_RTE_CALPRM_GROUP.GmMsg34ABusHiSpdStuckTiOut_Val" 0 DISPLAY_IDENTIFIER GmMsg34ABusHiSpd.CalibrationPorts.GmMsg34ABusHiSpdStuckTiOut.Val /end CHARACTERISTIC
/begin CHARACTERISTIC GmMsg3F1BusHiSpd.GmMsg3F1BusHiSpdAmbTDft.Val "MICROSAR RTE" VALUE 0x0 RTE_RL_FLOAT32_IEEE 0 NO_COMPU_METHOD -3.402823466e+38 3.402823466e+38 SYMBOL_LINK "Rte_CalprmRom_CalRegn01Cmn_DEFAULT_RTE_CALPRM_GROUP.GmMsg3F1BusHiSpdAmbTDft_Val" 0 DISPLAY_IDENTIFIER GmMsg3F1BusHiSpd.CalibrationPorts.GmMsg3F1BusHiSpdAmbTDft.Val /end CHARACTERISTIC
/begin CHARACTERISTIC GmMsg3F1BusHiSpd.GmMsg3F1BusHiSpdInvldTiOut.Val "MICROSAR RTE" VALUE 0x0 RTE_RL_UWORD 0 NO_COMPU_METHOD 0 65535 SYMBOL_LINK "Rte_CalprmRom_CalRegn01Cmn_DEFAULT_RTE_CALPRM_GROUP.GmMsg3F1BusHiSpdInvldTiOut_Val" 0 DISPLAY_IDENTIFIER GmMsg3F1BusHiSpd.CalibrationPorts.GmMsg3F1BusHiSpdInvldTiOut.Val /end CHARACTERISTIC
/begin CHARACTERISTIC GmMsg3F1BusHiSpd.GmMsg3F1BusHiSpdMissTiOut.Val "MICROSAR RTE" VALUE 0x0 RTE_RL_UWORD 0 NO_COMPU_METHOD 0 65535 SYMBOL_LINK "Rte_CalprmRom_CalRegn01Cmn_DEFAULT_RTE_CALPRM_GROUP.GmMsg3F1BusHiSpdMissTiOut_Val" 0 DISPLAY_IDENTIFIER GmMsg3F1BusHiSpd.CalibrationPorts.GmMsg3F1BusHiSpdMissTiOut.Val /end CHARACTERISTIC
/begin CHARACTERISTIC GmMsg4D1BusHiSpd.GmMsg4D1BusHiSpdEngOilTDft.Val "MICROSAR RTE" VALUE 0x0 RTE_RL_FLOAT32_IEEE 0 NO_COMPU_METHOD -3.402823466e+38 3.402823466e+38 SYMBOL_LINK "Rte_CalprmRom_CalRegn01Cmn_DEFAULT_RTE_CALPRM_GROUP.GmMsg4D1BusHiSpdEngOilTDft_Val" 0 DISPLAY_IDENTIFIER GmMsg4D1BusHiSpd.CalibrationPorts.GmMsg4D1BusHiSpdEngOilTDft.Val /end CHARACTERISTIC
/begin CHARACTERISTIC GmMsg4D1BusHiSpd.GmMsg4D1BusHiSpdInvldTiOut.Val "MICROSAR RTE" VALUE 0x0 RTE_RL_UWORD 0 NO_COMPU_METHOD 0 65535 SYMBOL_LINK "Rte_CalprmRom_CalRegn01Cmn_DEFAULT_RTE_CALPRM_GROUP.GmMsg4D1BusHiSpdInvldTiOut_Val" 0 DISPLAY_IDENTIFIER GmMsg4D1BusHiSpd.CalibrationPorts.GmMsg4D1BusHiSpdInvldTiOut.Val /end CHARACTERISTIC
/begin CHARACTERISTIC GmMsg4D1BusHiSpd.GmMsg4D1BusHiSpdMissTiOut.Val "MICROSAR RTE" VALUE 0x0 RTE_RL_UWORD 0 NO_COMPU_METHOD 0 65535 SYMBOL_LINK "Rte_CalprmRom_CalRegn01Cmn_DEFAULT_RTE_CALPRM_GROUP.GmMsg4D1BusHiSpdMissTiOut_Val" 0 DISPLAY_IDENTIFIER GmMsg4D1BusHiSpd.CalibrationPorts.GmMsg4D1BusHiSpdMissTiOut.Val /end CHARACTERISTIC
/begin CHARACTERISTIC GmMsg500BusHiSpd.GmMsg500BusHiSpdMissTiOut.Val "MICROSAR RTE" VALUE 0x0 RTE_RL_UWORD 0 NO_COMPU_METHOD 0 65535 SYMBOL_LINK "Rte_CalprmRom_CalRegn01Cmn_DEFAULT_RTE_CALPRM_GROUP.GmMsg500BusHiSpdMissTiOut_Val" 0 DISPLAY_IDENTIFIER GmMsg500BusHiSpd.CalibrationPorts.GmMsg500BusHiSpdMissTiOut.Val /end CHARACTERISTIC
/begin CHARACTERISTIC GmMsg500BusHiSpd.GmMsg500BusHiSpdWhlPlsPerRevDft.Val "MICROSAR RTE" VALUE 0x0 RTE_RL_UBYTE 0 NO_COMPU_METHOD 0 255 SYMBOL_LINK "Rte_CalprmRom_CalRegn01Cmn_DEFAULT_RTE_CALPRM_GROUP.GmMsg500BusHiSpdWhlPlsPerRevDft_Val" 0 DISPLAY_IDENTIFIER GmMsg500BusHiSpd.CalibrationPorts.GmMsg500BusHiSpdWhlPlsPerRevDft.Val /end CHARACTERISTIC
/begin CHARACTERISTIC GmMsg500BusHiSpd.GmMsg500BusHiSpdWhlRotlStsTiStampReslDft.Val "MICROSAR RTE" VALUE 0x0 RTE_RL_FLOAT32_IEEE 0 NO_COMPU_METHOD -3.402823466e+38 3.402823466e+38 SYMBOL_LINK "Rte_CalprmRom_CalRegn01Cmn_DEFAULT_RTE_CALPRM_GROUP.GmMsg500BusHiSpdWhlRotlStsTiStampReslDft_Val" 0 DISPLAY_IDENTIFIER GmMsg500BusHiSpd.CalibrationPorts.GmMsg500BusHiSpdWhlRotlStsTiStampReslDft.Val /end CHARACTERISTIC
/begin CHARACTERISTIC GmOvrlStMgr.GmOvrlStMgrApaHaptcEna.Logl "MICROSAR RTE" VALUE 0x0 RTE_RL_BOOLEAN 0 RTE_CM_BOOLEAN 0 255 SYMBOL_LINK "Rte_CalprmRom_CalRegn02CmnGroupC_DEFAULT_RTE_CALPRM_GROUP.GmOvrlStMgrApaHaptcEna_Logl" 0 DISPLAY_IDENTIFIER GmOvrlStMgr.CalibrationPorts.GmOvrlStMgrApaHaptcEna.Logl /end CHARACTERISTIC
/begin CHARACTERISTIC GmOvrlStMgr.GmOvrlStMgrApaHwTqFilFrq.Val "MICROSAR RTE" VALUE 0x0 RTE_RL_FLOAT32_IEEE 0 NO_COMPU_METHOD -3.402823466e+38 3.402823466e+38 SYMBOL_LINK "Rte_CalprmRom_CalRegn02Inin00_DEFAULT_RTE_CALPRM_GROUP.GmOvrlStMgrApaHwTqFilFrq_Val" 0 DISPLAY_IDENTIFIER GmOvrlStMgr.CalibrationPorts.GmOvrlStMgrApaHwTqFilFrq.Val /end CHARACTERISTIC
/begin CHARACTERISTIC GmOvrlStMgr.GmOvrlStMgrApaHwTqThd.Val "MICROSAR RTE" VALUE 0x0 RTE_RL_FLOAT32_IEEE 0 NO_COMPU_METHOD -3.402823466e+38 3.402823466e+38 SYMBOL_LINK "Rte_CalprmRom_CalRegn02CmnGroupC_DEFAULT_RTE_CALPRM_GROUP.GmOvrlStMgrApaHwTqThd_Val" 0 DISPLAY_IDENTIFIER GmOvrlStMgr.CalibrationPorts.GmOvrlStMgrApaHwTqThd.Val /end CHARACTERISTIC
/begin CHARACTERISTIC GmOvrlStMgr.GmOvrlStMgrApaHwTqTiThd.Val "MICROSAR RTE" VALUE 0x0 RTE_RL_ULONG 0 NO_COMPU_METHOD 0 4294967295 SYMBOL_LINK "Rte_CalprmRom_CalRegn02Inin00GroupC_DEFAULT_RTE_CALPRM_GROUP.GmOvrlStMgrApaHwTqTiThd_Val" 0 DISPLAY_IDENTIFIER GmOvrlStMgr.CalibrationPorts.GmOvrlStMgrApaHwTqTiThd.Val /end CHARACTERISTIC
/begin CHARACTERISTIC GmOvrlStMgr.GmOvrlStMgrApaMfgEna.Logl "MICROSAR RTE" VALUE 0x0 RTE_RL_BOOLEAN 0 RTE_CM_BOOLEAN 0 255 SYMBOL_LINK "Rte_CalprmRom_CalRegn02CmnGroupA_DEFAULT_RTE_CALPRM_GROUP.GmOvrlStMgrApaMfgEna_Logl" 0 DISPLAY_IDENTIFIER GmOvrlStMgr.CalibrationPorts.GmOvrlStMgrApaMfgEna.Logl /end CHARACTERISTIC
/begin CHARACTERISTIC GmOvrlStMgr.GmOvrlStMgrApaVehSpdHiLim.Val "MICROSAR RTE" VALUE 0x0 RTE_RL_FLOAT32_IEEE 0 NO_COMPU_METHOD -3.402823466e+38 3.402823466e+38 SYMBOL_LINK "Rte_CalprmRom_CalRegn02CmnGroupC_DEFAULT_RTE_CALPRM_GROUP.GmOvrlStMgrApaVehSpdHiLim_Val" 0 DISPLAY_IDENTIFIER GmOvrlStMgr.CalibrationPorts.GmOvrlStMgrApaVehSpdHiLim.Val /end CHARACTERISTIC
/begin CHARACTERISTIC GmOvrlStMgr.GmOvrlStMgrEscMfgEna.Logl "MICROSAR RTE" VALUE 0x0 RTE_RL_BOOLEAN 0 RTE_CM_BOOLEAN 0 255 SYMBOL_LINK "Rte_CalprmRom_CalRegn02CmnGroupA_DEFAULT_RTE_CALPRM_GROUP.GmOvrlStMgrEscMfgEna_Logl" 0 DISPLAY_IDENTIFIER GmOvrlStMgr.CalibrationPorts.GmOvrlStMgrEscMfgEna.Logl /end CHARACTERISTIC
/begin CHARACTERISTIC GmOvrlStMgr.GmOvrlStMgrEscVehSpdHiLim.Val "MICROSAR RTE" VALUE 0x0 RTE_RL_FLOAT32_IEEE 0 NO_COMPU_METHOD -3.402823466e+38 3.402823466e+38 SYMBOL_LINK "Rte_CalprmRom_CalRegn02CmnGroupC_DEFAULT_RTE_CALPRM_GROUP.GmOvrlStMgrEscVehSpdHiLim_Val" 0 DISPLAY_IDENTIFIER GmOvrlStMgr.CalibrationPorts.GmOvrlStMgrEscVehSpdHiLim.Val /end CHARACTERISTIC
/begin CHARACTERISTIC GmOvrlStMgr.GmOvrlStMgrHaptcAmp.Val "MICROSAR RTE" VALUE 0x0 RTE_RL_FLOAT32_IEEE 0 NO_COMPU_METHOD -3.402823466e+38 3.402823466e+38 SYMBOL_LINK "Rte_CalprmRom_CalRegn02CmnGroupC_DEFAULT_RTE_CALPRM_GROUP.GmOvrlStMgrHaptcAmp_Val" 0 DISPLAY_IDENTIFIER GmOvrlStMgr.CalibrationPorts.GmOvrlStMgrHaptcAmp.Val /end CHARACTERISTIC
/begin CHARACTERISTIC GmOvrlStMgr.GmOvrlStMgrHaptcDurn.Val "MICROSAR RTE" VALUE 0x0 RTE_RL_ULONG 0 NO_COMPU_METHOD 0 4294967295 SYMBOL_LINK "Rte_CalprmRom_CalRegn02CmnGroupC_DEFAULT_RTE_CALPRM_GROUP.GmOvrlStMgrHaptcDurn_Val" 0 DISPLAY_IDENTIFIER GmOvrlStMgr.CalibrationPorts.GmOvrlStMgrHaptcDurn.Val /end CHARACTERISTIC
/begin CHARACTERISTIC GmOvrlStMgr.GmOvrlStMgrHaptcFrq.Val "MICROSAR RTE" VALUE 0x0 RTE_RL_FLOAT32_IEEE 0 NO_COMPU_METHOD -3.402823466e+38 3.402823466e+38 SYMBOL_LINK "Rte_CalprmRom_CalRegn02Inin00GroupC_DEFAULT_RTE_CALPRM_GROUP.GmOvrlStMgrHaptcFrq_Val" 0 DISPLAY_IDENTIFIER GmOvrlStMgr.CalibrationPorts.GmOvrlStMgrHaptcFrq.Val /end CHARACTERISTIC
/begin CHARACTERISTIC GmOvrlStMgr.GmOvrlStMgrHaptcReactnTi.Val "MICROSAR RTE" VALUE 0x0 RTE_RL_ULONG 0 NO_COMPU_METHOD 0 4294967295 SYMBOL_LINK "Rte_CalprmRom_CalRegn02Inin00GroupC_DEFAULT_RTE_CALPRM_GROUP.GmOvrlStMgrHaptcReactnTi_Val" 0 DISPLAY_IDENTIFIER GmOvrlStMgr.CalibrationPorts.GmOvrlStMgrHaptcReactnTi.Val /end CHARACTERISTIC
/begin CHARACTERISTIC GmOvrlStMgr.GmOvrlStMgrHaptcReqTiThd.Val "MICROSAR RTE" VALUE 0x0 RTE_RL_ULONG 0 NO_COMPU_METHOD 0 4294967295 SYMBOL_LINK "Rte_CalprmRom_CalRegn02Inin00GroupC_DEFAULT_RTE_CALPRM_GROUP.GmOvrlStMgrHaptcReqTiThd_Val" 0 DISPLAY_IDENTIFIER GmOvrlStMgr.CalibrationPorts.GmOvrlStMgrHaptcReqTiThd.Val /end CHARACTERISTIC
/begin CHARACTERISTIC GmOvrlStMgr.GmOvrlStMgrHwAgTarLimr.Val "MICROSAR RTE" VALUE 0x0 RTE_RL_FLOAT32_IEEE 0 NO_COMPU_METHOD -3.402823466e+38 3.402823466e+38 SYMBOL_LINK "Rte_CalprmRom_CalRegn02Rt00GroupC_DEFAULT_RTE_CALPRM_GROUP.GmOvrlStMgrHwAgTarLimr_Val" 0 DISPLAY_IDENTIFIER GmOvrlStMgr.CalibrationPorts.GmOvrlStMgrHwAgTarLimr.Val /end CHARACTERISTIC
/begin CHARACTERISTIC GmOvrlStMgr.GmOvrlStMgrHwTqFilFrq.Val "MICROSAR RTE" VALUE 0x0 RTE_RL_FLOAT32_IEEE 0 NO_COMPU_METHOD -3.402823466e+38 3.402823466e+38 SYMBOL_LINK "Rte_CalprmRom_CalRegn02Inin00_DEFAULT_RTE_CALPRM_GROUP.GmOvrlStMgrHwTqFilFrq_Val" 0 DISPLAY_IDENTIFIER GmOvrlStMgr.CalibrationPorts.GmOvrlStMgrHwTqFilFrq.Val /end CHARACTERISTIC
/begin CHARACTERISTIC GmOvrlStMgr.GmOvrlStMgrLkaHwTqFilFrq.Val "MICROSAR RTE" VALUE 0x0 RTE_RL_FLOAT32_IEEE 0 NO_COMPU_METHOD -3.402823466e+38 3.402823466e+38 SYMBOL_LINK "Rte_CalprmRom_CalRegn02Inin00_DEFAULT_RTE_CALPRM_GROUP.GmOvrlStMgrLkaHwTqFilFrq_Val" 0 DISPLAY_IDENTIFIER GmOvrlStMgr.CalibrationPorts.GmOvrlStMgrLkaHwTqFilFrq.Val /end CHARACTERISTIC
/begin CHARACTERISTIC GmOvrlStMgr.GmOvrlStMgrLkaHwTqThd1.Val "MICROSAR RTE" VALUE 0x0 RTE_RL_FLOAT32_IEEE 0 NO_COMPU_METHOD -3.402823466e+38 3.402823466e+38 SYMBOL_LINK "Rte_CalprmRom_CalRegn02CmnGroupA_DEFAULT_RTE_CALPRM_GROUP.GmOvrlStMgrLkaHwTqThd1_Val" 0 DISPLAY_IDENTIFIER GmOvrlStMgr.CalibrationPorts.GmOvrlStMgrLkaHwTqThd1.Val /end CHARACTERISTIC
/begin CHARACTERISTIC GmOvrlStMgr.GmOvrlStMgrLkaHwTqThd2.Val "MICROSAR RTE" VALUE 0x0 RTE_RL_FLOAT32_IEEE 0 NO_COMPU_METHOD -3.402823466e+38 3.402823466e+38 SYMBOL_LINK "Rte_CalprmRom_CalRegn02CmnGroupA_DEFAULT_RTE_CALPRM_GROUP.GmOvrlStMgrLkaHwTqThd2_Val" 0 DISPLAY_IDENTIFIER GmOvrlStMgr.CalibrationPorts.GmOvrlStMgrLkaHwTqThd2.Val /end CHARACTERISTIC
/begin CHARACTERISTIC GmOvrlStMgr.GmOvrlStMgrLkaHwTqTiThd1.Val "MICROSAR RTE" VALUE 0x0 RTE_RL_ULONG 0 NO_COMPU_METHOD 0 4294967295 SYMBOL_LINK "Rte_CalprmRom_CalRegn02Inin00GroupA_DEFAULT_RTE_CALPRM_GROUP.GmOvrlStMgrLkaHwTqTiThd1_Val" 0 DISPLAY_IDENTIFIER GmOvrlStMgr.CalibrationPorts.GmOvrlStMgrLkaHwTqTiThd1.Val /end CHARACTERISTIC
/begin CHARACTERISTIC GmOvrlStMgr.GmOvrlStMgrLkaHwTqTiThd2.Val "MICROSAR RTE" VALUE 0x0 RTE_RL_ULONG 0 NO_COMPU_METHOD 0 4294967295 SYMBOL_LINK "Rte_CalprmRom_CalRegn02Inin00_DEFAULT_RTE_CALPRM_GROUP.GmOvrlStMgrLkaHwTqTiThd2_Val" 0 DISPLAY_IDENTIFIER GmOvrlStMgr.CalibrationPorts.GmOvrlStMgrLkaHwTqTiThd2.Val /end CHARACTERISTIC
/begin CHARACTERISTIC GmOvrlStMgr.GmOvrlStMgrLkaMfgEna.Logl "MICROSAR RTE" VALUE 0x0 RTE_RL_BOOLEAN 0 RTE_CM_BOOLEAN 0 255 SYMBOL_LINK "Rte_CalprmRom_CalRegn02CmnGroupA_DEFAULT_RTE_CALPRM_GROUP.GmOvrlStMgrLkaMfgEna_Logl" 0 DISPLAY_IDENTIFIER GmOvrlStMgr.CalibrationPorts.GmOvrlStMgrLkaMfgEna.Logl /end CHARACTERISTIC
/begin CHARACTERISTIC GmOvrlStMgr.GmOvrlStMgrLkaVehSpdHiLim.Val "MICROSAR RTE" VALUE 0x0 RTE_RL_FLOAT32_IEEE 0 NO_COMPU_METHOD -3.402823466e+38 3.402823466e+38 SYMBOL_LINK "Rte_CalprmRom_CalRegn02CmnGroupC_DEFAULT_RTE_CALPRM_GROUP.GmOvrlStMgrLkaVehSpdHiLim_Val" 0 DISPLAY_IDENTIFIER GmOvrlStMgr.CalibrationPorts.GmOvrlStMgrLkaVehSpdHiLim.Val /end CHARACTERISTIC
/begin CHARACTERISTIC GmOvrlStMgr.GmOvrlStMgrLkaVehSpdLoLim.Val "MICROSAR RTE" VALUE 0x0 RTE_RL_FLOAT32_IEEE 0 NO_COMPU_METHOD -3.402823466e+38 3.402823466e+38 SYMBOL_LINK "Rte_CalprmRom_CalRegn02CmnGroupC_DEFAULT_RTE_CALPRM_GROUP.GmOvrlStMgrLkaVehSpdLoLim_Val" 0 DISPLAY_IDENTIFIER GmOvrlStMgr.CalibrationPorts.GmOvrlStMgrLkaVehSpdLoLim.Val /end CHARACTERISTIC
/begin CHARACTERISTIC GmOvrlStMgr.GmOvrlStMgrLoaMtgtnHaptcFbOffTi.Val "MICROSAR RTE" VALUE 0x0 RTE_RL_ULONG 0 NO_COMPU_METHOD 0 4294967295 SYMBOL_LINK "Rte_CalprmRom_CalRegn03CmnGroupC_DEFAULT_RTE_CALPRM_GROUP.GmOvrlStMgrLoaMtgtnHaptcFbOffTi_Val" 0 DISPLAY_IDENTIFIER GmOvrlStMgr.CalibrationPorts.GmOvrlStMgrLoaMtgtnHaptcFbOffTi.Val /end CHARACTERISTIC
/begin CHARACTERISTIC GmOvrlStMgr.GmOvrlStMgrLoaMtgtnHaptcFbOnTi.Val "MICROSAR RTE" VALUE 0x0 RTE_RL_ULONG 0 NO_COMPU_METHOD 0 4294967295 SYMBOL_LINK "Rte_CalprmRom_CalRegn03CmnGroupC_DEFAULT_RTE_CALPRM_GROUP.GmOvrlStMgrLoaMtgtnHaptcFbOnTi_Val" 0 DISPLAY_IDENTIFIER GmOvrlStMgr.CalibrationPorts.GmOvrlStMgrLoaMtgtnHaptcFbOnTi.Val /end CHARACTERISTIC
/begin CHARACTERISTIC GmOvrlStMgr.GmOvrlStMgrLoaMtgtnHaptcFbStrtOnTi.Val "MICROSAR RTE" VALUE 0x0 RTE_RL_ULONG 0 NO_COMPU_METHOD 0 4294967295 SYMBOL_LINK "Rte_CalprmRom_CalRegn03Inin00_DEFAULT_RTE_CALPRM_GROUP.GmOvrlStMgrLoaMtgtnHaptcFbStrtOnTi_Val" 0 DISPLAY_IDENTIFIER GmOvrlStMgr.CalibrationPorts.GmOvrlStMgrLoaMtgtnHaptcFbStrtOnTi.Val /end CHARACTERISTIC
/begin CHARACTERISTIC GmOvrlStMgr.GmOvrlStMgrLoaMtgtnHaptcFbTqMax.Val "MICROSAR RTE" VALUE 0x0 RTE_RL_FLOAT32_IEEE 0 NO_COMPU_METHOD -3.402823466e+38 3.402823466e+38 SYMBOL_LINK "Rte_CalprmRom_CalRegn03CmnGroupC_DEFAULT_RTE_CALPRM_GROUP.GmOvrlStMgrLoaMtgtnHaptcFbTqMax_Val" 0 DISPLAY_IDENTIFIER GmOvrlStMgr.CalibrationPorts.GmOvrlStMgrLoaMtgtnHaptcFbTqMax.Val /end CHARACTERISTIC
/begin CHARACTERISTIC GmOvrlStMgr.GmOvrlStMgrLoaMtgtnHaptcFbTqMin.Val "MICROSAR RTE" VALUE 0x0 RTE_RL_FLOAT32_IEEE 0 NO_COMPU_METHOD -3.402823466e+38 3.402823466e+38 SYMBOL_LINK "Rte_CalprmRom_CalRegn03CmnGroupC_DEFAULT_RTE_CALPRM_GROUP.GmOvrlStMgrLoaMtgtnHaptcFbTqMin_Val" 0 DISPLAY_IDENTIFIER GmOvrlStMgr.CalibrationPorts.GmOvrlStMgrLoaMtgtnHaptcFbTqMin.Val /end CHARACTERISTIC
/begin CHARACTERISTIC GmOvrlStMgr.GmOvrlStMgrLoaMtgtnHaptcFbVehSpdMax.Val "MICROSAR RTE" VALUE 0x0 RTE_RL_FLOAT32_IEEE 0 NO_COMPU_METHOD -3.402823466e+38 3.402823466e+38 SYMBOL_LINK "Rte_CalprmRom_CalRegn03CmnGroupC_DEFAULT_RTE_CALPRM_GROUP.GmOvrlStMgrLoaMtgtnHaptcFbVehSpdMax_Val" 0 DISPLAY_IDENTIFIER GmOvrlStMgr.CalibrationPorts.GmOvrlStMgrLoaMtgtnHaptcFbVehSpdMax.Val /end CHARACTERISTIC
/begin CHARACTERISTIC GmOvrlStMgr.GmOvrlStMgrLoaMtgtnHaptcFbVehSpdMin.Val "MICROSAR RTE" VALUE 0x0 RTE_RL_FLOAT32_IEEE 0 NO_COMPU_METHOD -3.402823466e+38 3.402823466e+38 SYMBOL_LINK "Rte_CalprmRom_CalRegn03CmnGroupC_DEFAULT_RTE_CALPRM_GROUP.GmOvrlStMgrLoaMtgtnHaptcFbVehSpdMin_Val" 0 DISPLAY_IDENTIFIER GmOvrlStMgr.CalibrationPorts.GmOvrlStMgrLoaMtgtnHaptcFbVehSpdMin.Val /end CHARACTERISTIC
/begin CHARACTERISTIC GmOvrlStMgr.GmOvrlStMgrLoaMtgtnHaptcFrq.Val "MICROSAR RTE" VALUE 0x0 RTE_RL_FLOAT32_IEEE 0 NO_COMPU_METHOD -3.402823466e+38 3.402823466e+38 SYMBOL_LINK "Rte_CalprmRom_CalRegn03CmnGroupC_DEFAULT_RTE_CALPRM_GROUP.GmOvrlStMgrLoaMtgtnHaptcFrq_Val" 0 DISPLAY_IDENTIFIER GmOvrlStMgr.CalibrationPorts.GmOvrlStMgrLoaMtgtnHaptcFrq.Val /end CHARACTERISTIC
/begin CHARACTERISTIC GmOvrlStMgr.GmOvrlStMgrLoaMtgtnStrtHaptcAmp.Val "MICROSAR RTE" VALUE 0x0 RTE_RL_FLOAT32_IEEE 0 NO_COMPU_METHOD -3.402823466e+38 3.402823466e+38 SYMBOL_LINK "Rte_CalprmRom_CalRegn03Inin00_DEFAULT_RTE_CALPRM_GROUP.GmOvrlStMgrLoaMtgtnStrtHaptcAmp_Val" 0 DISPLAY_IDENTIFIER GmOvrlStMgr.CalibrationPorts.GmOvrlStMgrLoaMtgtnStrtHaptcAmp.Val /end CHARACTERISTIC
/begin CHARACTERISTIC GmOvrlStMgr.GmOvrlStMgrLoaMtgtnTqOscnAmpY.Ary1D "MICROSAR RTE" VAL_BLK 0x0 RTE_RL_UWORD 0 NO_COMPU_METHOD 0 65535 MATRIX_DIM 8 1 1 SYMBOL_LINK "Rte_CalprmRom_CalRegn03CmnGroupC_DEFAULT_RTE_CALPRM_GROUP.GmOvrlStMgrLoaMtgtnTqOscnAmpY_Ary1D" 0 DISPLAY_IDENTIFIER GmOvrlStMgr.CalibrationPorts.GmOvrlStMgrLoaMtgtnTqOscnAmpY.Ary1D /end CHARACTERISTIC
/begin CHARACTERISTIC GmOvrlStMgr.GmOvrlStMgrLoaMtgtnVehSpdX.Ary1D "MICROSAR RTE" VAL_BLK 0x0 RTE_RL_UWORD 0 NO_COMPU_METHOD 0 65535 MATRIX_DIM 8 1 1 SYMBOL_LINK "Rte_CalprmRom_CalRegn03CmnGroupC_DEFAULT_RTE_CALPRM_GROUP.GmOvrlStMgrLoaMtgtnVehSpdX_Ary1D" 0 DISPLAY_IDENTIFIER GmOvrlStMgr.CalibrationPorts.GmOvrlStMgrLoaMtgtnVehSpdX.Ary1D /end CHARACTERISTIC
/begin CHARACTERISTIC GmOvrlStMgr.GmOvrlStMgrLoaStIgnCntrThd.Val "MICROSAR RTE" VALUE 0x0 RTE_RL_UWORD 0 NO_COMPU_METHOD 0 65535 SYMBOL_LINK "Rte_CalprmRom_CalRegn03Inin00_DEFAULT_RTE_CALPRM_GROUP.GmOvrlStMgrLoaStIgnCntrThd_Val" 0 DISPLAY_IDENTIFIER GmOvrlStMgr.CalibrationPorts.GmOvrlStMgrLoaStIgnCntrThd.Val /end CHARACTERISTIC
/begin CHARACTERISTIC GmOvrlStMgr.GmOvrlStMgrShiftLvrTiThd.Val "MICROSAR RTE" VALUE 0x0 RTE_RL_ULONG 0 NO_COMPU_METHOD 0 4294967295 SYMBOL_LINK "Rte_CalprmRom_CalRegn02Rt00GroupC_DEFAULT_RTE_CALPRM_GROUP.GmOvrlStMgrShiftLvrTiThd_Val" 0 DISPLAY_IDENTIFIER GmOvrlStMgr.CalibrationPorts.GmOvrlStMgrShiftLvrTiThd.Val /end CHARACTERISTIC
/begin CHARACTERISTIC GmOvrlStMgr.GmOvrlStMgrStandStillThd.Val "MICROSAR RTE" VALUE 0x0 RTE_RL_FLOAT32_IEEE 0 NO_COMPU_METHOD -3.402823466e+38 3.402823466e+38 SYMBOL_LINK "Rte_CalprmRom_CalRegn02Rt00GroupC_DEFAULT_RTE_CALPRM_GROUP.GmOvrlStMgrStandStillThd_Val" 0 DISPLAY_IDENTIFIER GmOvrlStMgr.CalibrationPorts.GmOvrlStMgrStandStillThd.Val /end CHARACTERISTIC
/begin CHARACTERISTIC GmOvrlStMgr.GmOvrlStMgrStandStillTiThd.Val "MICROSAR RTE" VALUE 0x0 RTE_RL_ULONG 0 NO_COMPU_METHOD 0 4294967295 SYMBOL_LINK "Rte_CalprmRom_CalRegn02Rt00GroupC_DEFAULT_RTE_CALPRM_GROUP.GmOvrlStMgrStandStillTiThd_Val" 0 DISPLAY_IDENTIFIER GmOvrlStMgr.CalibrationPorts.GmOvrlStMgrStandStillTiThd.Val /end CHARACTERISTIC
/begin MEASUREMENT GmMsg337BusChassisExp.GmMsg337BusChassisExpAgReqRollgCntrInvldTmr "MICROSAR RTE" ULONG NO_COMPU_METHOD 0 0 0 4294967295 ECU_ADDRESS 0 SYMBOL_LINK "Rte_GmMsg337BusChassisExp_GmMsg337BusChassisExpAgReqRollgCntrInvldTmr" 0 DISPLAY_IDENTIFIER GmMsg337BusChassisExp.PerInstanceMemories.GmMsg337BusChassisExpAgReqRollgCntrInvldTmr /end MEASUREMENT
/begin MEASUREMENT GmMsg337BusChassisExp.GmMsg337BusChassisExpFbProtnValInvldTmr "MICROSAR RTE" ULONG NO_COMPU_METHOD 0 0 0 4294967295 ECU_ADDRESS 0 SYMBOL_LINK "Rte_GmMsg337BusChassisExp_GmMsg337BusChassisExpFbProtnValInvldTmr" 0 DISPLAY_IDENTIFIER GmMsg337BusChassisExp.PerInstanceMemories.GmMsg337BusChassisExpFbProtnValInvldTmr /end MEASUREMENT
/begin MEASUREMENT GmMsg337BusChassisExp.GmMsg337BusChassisExpFbRollgCntrInvldTmr "MICROSAR RTE" ULONG NO_COMPU_METHOD 0 0 0 4294967295 ECU_ADDRESS 0 SYMBOL_LINK "Rte_GmMsg337BusChassisExp_GmMsg337BusChassisExpFbRollgCntrInvldTmr" 0 DISPLAY_IDENTIFIER GmMsg337BusChassisExp.PerInstanceMemories.GmMsg337BusChassisExpFbRollgCntrInvldTmr /end MEASUREMENT
/begin MEASUREMENT GmMsg337BusChassisExp.GmMsg337BusChassisExpInvldTmr "MICROSAR RTE" ULONG NO_COMPU_METHOD 0 0 0 4294967295 ECU_ADDRESS 0 SYMBOL_LINK "Rte_GmMsg337BusChassisExp_GmMsg337BusChassisExpInvldTmr" 0 DISPLAY_IDENTIFIER GmMsg337BusChassisExp.PerInstanceMemories.GmMsg337BusChassisExpInvldTmr /end MEASUREMENT
/begin MEASUREMENT GmMsg337BusChassisExp.GmMsg337BusChassisExpPrevAgReqRollgCntVal "MICROSAR RTE" UBYTE NO_COMPU_METHOD 0 0 0 255 ECU_ADDRESS 0 SYMBOL_LINK "Rte_GmMsg337BusChassisExp_GmMsg337BusChassisExpPrevAgReqRollgCntVal" 0 DISPLAY_IDENTIFIER GmMsg337BusChassisExp.PerInstanceMemories.GmMsg337BusChassisExpPrevAgReqRollgCntVal /end MEASUREMENT
/begin MEASUREMENT GmMsg337BusChassisExp.GmMsg337BusChassisExpPrevFbReqRollgCntVal "MICROSAR RTE" UBYTE NO_COMPU_METHOD 0 0 0 255 ECU_ADDRESS 0 SYMBOL_LINK "Rte_GmMsg337BusChassisExp_GmMsg337BusChassisExpPrevFbReqRollgCntVal" 0 DISPLAY_IDENTIFIER GmMsg337BusChassisExp.PerInstanceMemories.GmMsg337BusChassisExpPrevFbReqRollgCntVal /end MEASUREMENT
/begin MEASUREMENT GmMsg337BusChassisExp.GmMsg337BusChassisExpPrevInvld "MICROSAR RTE" UBYTE RTE_CM_BOOLEAN 0 0 0 255 ECU_ADDRESS 0 SYMBOL_LINK "Rte_GmMsg337BusChassisExp_GmMsg337BusChassisExpPrevInvld" 0 DISPLAY_IDENTIFIER GmMsg337BusChassisExp.PerInstanceMemories.GmMsg337BusChassisExpPrevInvld /end MEASUREMENT
/begin MEASUREMENT GmMsg337BusChassisExp.GmMsg337BusChassisExpPrevRxnTi "MICROSAR RTE" ULONG NO_COMPU_METHOD 0 0 0 4294967295 ECU_ADDRESS 0 SYMBOL_LINK "Rte_GmMsg337BusChassisExp_GmMsg337BusChassisExpPrevRxnTi" 0 DISPLAY_IDENTIFIER GmMsg337BusChassisExp.PerInstanceMemories.GmMsg337BusChassisExpPrevRxnTi /end MEASUREMENT
/begin MEASUREMENT GmMsg337BusChassisExp.GmMsg337BusChassisExpRollgCntrRst "MICROSAR RTE" UBYTE RTE_CM_BOOLEAN 0 0 0 255 ECU_ADDRESS 0 SYMBOL_LINK "Rte_GmMsg337BusChassisExp_GmMsg337BusChassisExpRollgCntrRst" 0 DISPLAY_IDENTIFIER GmMsg337BusChassisExp.PerInstanceMemories.GmMsg337BusChassisExpRollgCntrRst /end MEASUREMENT
/begin MEASUREMENT GmMsg337BusChassisExp.InvldMsg337.Logl "MICROSAR RTE" UBYTE RTE_CM_BOOLEAN 0 0 0 255 ECU_ADDRESS 0 SYMBOL_LINK "Rte_GmMsg337BusChassisExp_InvldMsg337_Logl" 0 DISPLAY_IDENTIFIER GmMsg337BusChassisExp.SenderPorts.InvldMsg337.Logl /end MEASUREMENT
/begin MEASUREMENT GmMsg337BusChassisExp.LstRxnTiMsg337BusChassisExp.Val "MICROSAR RTE" ULONG NO_COMPU_METHOD 0 0 0 4294967295 ECU_ADDRESS 0 SYMBOL_LINK "Rte_SerlComInpProxy_LstRxnTiMsg337BusChassisExp_Val" 0 DISPLAY_IDENTIFIER GmMsg337BusChassisExp.ReceiverPorts.LstRxnTiMsg337BusChassisExp.Val /end MEASUREMENT
/begin MEASUREMENT GmMsg337BusChassisExp.MissMsg337.Logl "MICROSAR RTE" UBYTE RTE_CM_BOOLEAN 0 0 0 255 ECU_ADDRESS 0 SYMBOL_LINK "Rte_GmMsg337BusChassisExp_MissMsg337_Logl" 0 DISPLAY_IDENTIFIER GmMsg337BusChassisExp.SenderPorts.MissMsg337.Logl /end MEASUREMENT
/begin MEASUREMENT GmMsg337BusChassisExp.SteerWhlAgReqActvRaw.Val "MICROSAR RTE" UBYTE NO_COMPU_METHOD 0 0 0 255 ECU_ADDRESS 0 SYMBOL_LINK "Rte_SerlComInpProxy_SteerWhlAgReqActvRaw_Val" 0 DISPLAY_IDENTIFIER GmMsg337BusChassisExp.ReceiverPorts.SteerWhlAgReqActvRaw.Val /end MEASUREMENT
/begin MEASUREMENT GmMsg337BusChassisExp.SteerWhlAgReqActvVldRaw.Val "MICROSAR RTE" UBYTE NO_COMPU_METHOD 0 0 0 255 ECU_ADDRESS 0 SYMBOL_LINK "Rte_SerlComInpProxy_SteerWhlAgReqActvVldRaw_Val" 0 DISPLAY_IDENTIFIER GmMsg337BusChassisExp.ReceiverPorts.SteerWhlAgReqActvVldRaw.Val /end MEASUREMENT
/begin MEASUREMENT GmMsg337BusChassisExp.SteerWhlAgReqProtnValRaw.Val "MICROSAR RTE" ULONG NO_COMPU_METHOD 0 0 0 4294967295 ECU_ADDRESS 0 SYMBOL_LINK "Rte_SerlComInpProxy_SteerWhlAgReqProtnValRaw_Val" 0 DISPLAY_IDENTIFIER GmMsg337BusChassisExp.ReceiverPorts.SteerWhlAgReqProtnValRaw.Val /end MEASUREMENT
/begin MEASUREMENT GmMsg337BusChassisExp.SteerWhlAgReqRollgCntrRaw.Val "MICROSAR RTE" UBYTE NO_COMPU_METHOD 0 0 0 255 ECU_ADDRESS 0 SYMBOL_LINK "Rte_SerlComInpProxy_SteerWhlAgReqRollgCntrRaw_Val" 0 DISPLAY_IDENTIFIER GmMsg337BusChassisExp.ReceiverPorts.SteerWhlAgReqRollgCntrRaw.Val /end MEASUREMENT
/begin MEASUREMENT GmMsg337BusChassisExp.SteerWhlAgReqTarAg.Val "MICROSAR RTE" FLOAT32_IEEE NO_COMPU_METHOD 0 0 -3.402823466e+38 3.402823466e+38 ECU_ADDRESS 0 SYMBOL_LINK "Rte_GmMsg337BusChassisExp_SteerWhlAgReqTarAg_Val" 0 DISPLAY_IDENTIFIER GmMsg337BusChassisExp.SenderPorts.SteerWhlAgReqTarAg.Val /end MEASUREMENT
/begin MEASUREMENT GmMsg337BusChassisExp.SteerWhlAgReqTarAgRaw.Val "MICROSAR RTE" UWORD NO_COMPU_METHOD 0 0 0 65535 ECU_ADDRESS 0 SYMBOL_LINK "Rte_SerlComInpProxy_SteerWhlAgReqTarAgRaw_Val" 0 DISPLAY_IDENTIFIER GmMsg337BusChassisExp.ReceiverPorts.SteerWhlAgReqTarAgRaw.Val /end MEASUREMENT
/begin MEASUREMENT GmMsg337BusChassisExp.SteerWhlFbReqActvProtnValRaw.Val "MICROSAR RTE" UBYTE NO_COMPU_METHOD 0 0 0 255 ECU_ADDRESS 0 SYMBOL_LINK "Rte_SerlComInpProxy_SteerWhlFbReqActvProtnValRaw_Val" 0 DISPLAY_IDENTIFIER GmMsg337BusChassisExp.ReceiverPorts.SteerWhlFbReqActvProtnValRaw.Val /end MEASUREMENT
/begin MEASUREMENT GmMsg337BusChassisExp.SteerWhlFbReqActvRaw.Val "MICROSAR RTE" UBYTE NO_COMPU_METHOD 0 0 0 255 ECU_ADDRESS 0 SYMBOL_LINK "Rte_SerlComInpProxy_SteerWhlFbReqActvRaw_Val" 0 DISPLAY_IDENTIFIER GmMsg337BusChassisExp.ReceiverPorts.SteerWhlFbReqActvRaw.Val /end MEASUREMENT
/begin MEASUREMENT GmMsg337BusChassisExp.SteerWhlFbReqActvRollgCntrRaw.Val "MICROSAR RTE" UBYTE NO_COMPU_METHOD 0 0 0 255 ECU_ADDRESS 0 SYMBOL_LINK "Rte_SerlComInpProxy_SteerWhlFbReqActvRollgCntrRaw_Val" 0 DISPLAY_IDENTIFIER GmMsg337BusChassisExp.ReceiverPorts.SteerWhlFbReqActvRollgCntrRaw.Val /end MEASUREMENT
/begin MEASUREMENT GmMsg348BusChassisExp.GmMsg348BusChassisExpPrevWhlGndVelLeDrvn "MICROSAR RTE" UWORD NO_COMPU_METHOD 0 0 0 65535 ECU_ADDRESS 0 SYMBOL_LINK "Rte_GmMsg348BusChassisExp_GmMsg348BusChassisExpPrevWhlGndVelLeDrvn" 0 DISPLAY_IDENTIFIER GmMsg348BusChassisExp.PerInstanceMemories.GmMsg348BusChassisExpPrevWhlGndVelLeDrvn /end MEASUREMENT
/begin MEASUREMENT GmMsg348BusChassisExp.GmMsg348BusChassisExpPrevWhlGndVelRiDrvn "MICROSAR RTE" UWORD NO_COMPU_METHOD 0 0 0 65535 ECU_ADDRESS 0 SYMBOL_LINK "Rte_GmMsg348BusChassisExp_GmMsg348BusChassisExpPrevWhlGndVelRiDrvn" 0 DISPLAY_IDENTIFIER GmMsg348BusChassisExp.PerInstanceMemories.GmMsg348BusChassisExpPrevWhlGndVelRiDrvn /end MEASUREMENT
/begin MEASUREMENT GmMsg348BusChassisExp.GmMsg348BusChassisExpWhlGndVelLeDrvnInvldTi "MICROSAR RTE" ULONG NO_COMPU_METHOD 0 0 0 4294967295 ECU_ADDRESS 0 SYMBOL_LINK "Rte_GmMsg348BusChassisExp_GmMsg348BusChassisExpWhlGndVelLeDrvnInvldTi" 0 DISPLAY_IDENTIFIER GmMsg348BusChassisExp.PerInstanceMemories.GmMsg348BusChassisExpWhlGndVelLeDrvnInvldTi /end MEASUREMENT
/begin MEASUREMENT GmMsg348BusChassisExp.GmMsg348BusChassisExpWhlGndVelLeDrvnStuckTi "MICROSAR RTE" ULONG NO_COMPU_METHOD 0 0 0 4294967295 ECU_ADDRESS 0 SYMBOL_LINK "Rte_GmMsg348BusChassisExp_GmMsg348BusChassisExpWhlGndVelLeDrvnStuckTi" 0 DISPLAY_IDENTIFIER GmMsg348BusChassisExp.PerInstanceMemories.GmMsg348BusChassisExpWhlGndVelLeDrvnStuckTi /end MEASUREMENT
/begin MEASUREMENT GmMsg348BusChassisExp.GmMsg348BusChassisExpWhlGndVelRiDrvnInvldTi "MICROSAR RTE" ULONG NO_COMPU_METHOD 0 0 0 4294967295 ECU_ADDRESS 0 SYMBOL_LINK "Rte_GmMsg348BusChassisExp_GmMsg348BusChassisExpWhlGndVelRiDrvnInvldTi" 0 DISPLAY_IDENTIFIER GmMsg348BusChassisExp.PerInstanceMemories.GmMsg348BusChassisExpWhlGndVelRiDrvnInvldTi /end MEASUREMENT
/begin MEASUREMENT GmMsg348BusChassisExp.GmMsg348BusChassisExpWhlGndVelRiDrvnStuckTi "MICROSAR RTE" ULONG NO_COMPU_METHOD 0 0 0 4294967295 ECU_ADDRESS 0 SYMBOL_LINK "Rte_GmMsg348BusChassisExp_GmMsg348BusChassisExpWhlGndVelRiDrvnStuckTi" 0 DISPLAY_IDENTIFIER GmMsg348BusChassisExp.PerInstanceMemories.GmMsg348BusChassisExpWhlGndVelRiDrvnStuckTi /end MEASUREMENT
/begin MEASUREMENT GmMsg348BusChassisExp.LstRxnTiMsg348BusChassisExp.Val "MICROSAR RTE" ULONG NO_COMPU_METHOD 0 0 0 4294967295 ECU_ADDRESS 0 SYMBOL_LINK "Rte_SerlComInpProxy_LstRxnTiMsg348BusChassisExp_Val" 0 DISPLAY_IDENTIFIER GmMsg348BusChassisExp.ReceiverPorts.LstRxnTiMsg348BusChassisExp.Val /end MEASUREMENT
/begin MEASUREMENT GmMsg348BusChassisExp.WhlGndVelLeDrvnBusChassisExp.Val "MICROSAR RTE" FLOAT32_IEEE NO_COMPU_METHOD 0 0 -3.402823466e+38 3.402823466e+38 ECU_ADDRESS 0 SYMBOL_LINK "Rte_GmMsg348BusChassisExp_WhlGndVelLeDrvnBusChassisExp_Val" 0 DISPLAY_IDENTIFIER GmMsg348BusChassisExp.SenderPorts.WhlGndVelLeDrvnBusChassisExp.Val /end MEASUREMENT
/begin MEASUREMENT GmMsg348BusChassisExp.WhlGndVelLeDrvnRawBusChassisExp.Val "MICROSAR RTE" UWORD NO_COMPU_METHOD 0 0 0 65535 ECU_ADDRESS 0 SYMBOL_LINK "Rte_SerlComInpProxy_WhlGndVelLeDrvnRawBusChassisExp_Val" 0 DISPLAY_IDENTIFIER GmMsg348BusChassisExp.ReceiverPorts.WhlGndVelLeDrvnRawBusChassisExp.Val /end MEASUREMENT
/begin MEASUREMENT GmMsg348BusChassisExp.WhlGndVelLeDrvnStuckBusChassisExp.Logl "MICROSAR RTE" UBYTE RTE_CM_BOOLEAN 0 0 0 255 ECU_ADDRESS 0 SYMBOL_LINK "Rte_GmMsg348BusChassisExp_WhlGndVelLeDrvnStuckBusChassisExp_Logl" 0 DISPLAY_IDENTIFIER GmMsg348BusChassisExp.SenderPorts.WhlGndVelLeDrvnStuckBusChassisExp.Logl /end MEASUREMENT
/begin MEASUREMENT GmMsg348BusChassisExp.WhlGndVelLeDrvnVldBusChassisExp.Logl "MICROSAR RTE" UBYTE RTE_CM_BOOLEAN 0 0 0 255 ECU_ADDRESS 0 SYMBOL_LINK "Rte_GmMsg348BusChassisExp_WhlGndVelLeDrvnVldBusChassisExp_Logl" 0 DISPLAY_IDENTIFIER GmMsg348BusChassisExp.SenderPorts.WhlGndVelLeDrvnVldBusChassisExp.Logl /end MEASUREMENT
/begin MEASUREMENT GmMsg348BusChassisExp.WhlGndVelLeDrvnVldRawBusChassisExp.Val "MICROSAR RTE" UBYTE NO_COMPU_METHOD 0 0 0 255 ECU_ADDRESS 0 SYMBOL_LINK "Rte_SerlComInpProxy_WhlGndVelLeDrvnVldRawBusChassisExp_Val" 0 DISPLAY_IDENTIFIER GmMsg348BusChassisExp.ReceiverPorts.WhlGndVelLeDrvnVldRawBusChassisExp.Val /end MEASUREMENT
/begin MEASUREMENT GmMsg348BusChassisExp.WhlGndVelRiDrvnBusChassisExp.Val "MICROSAR RTE" FLOAT32_IEEE NO_COMPU_METHOD 0 0 -3.402823466e+38 3.402823466e+38 ECU_ADDRESS 0 SYMBOL_LINK "Rte_GmMsg348BusChassisExp_WhlGndVelRiDrvnBusChassisExp_Val" 0 DISPLAY_IDENTIFIER GmMsg348BusChassisExp.SenderPorts.WhlGndVelRiDrvnBusChassisExp.Val /end MEASUREMENT
/begin MEASUREMENT GmMsg348BusChassisExp.WhlGndVelRiDrvnRawBusChassisExp.Val "MICROSAR RTE" UWORD NO_COMPU_METHOD 0 0 0 65535 ECU_ADDRESS 0 SYMBOL_LINK "Rte_SerlComInpProxy_WhlGndVelRiDrvnRawBusChassisExp_Val" 0 DISPLAY_IDENTIFIER GmMsg348BusChassisExp.ReceiverPorts.WhlGndVelRiDrvnRawBusChassisExp.Val /end MEASUREMENT
/begin MEASUREMENT GmMsg348BusChassisExp.WhlGndVelRiDrvnStuckBusChassisExp.Logl "MICROSAR RTE" UBYTE RTE_CM_BOOLEAN 0 0 0 255 ECU_ADDRESS 0 SYMBOL_LINK "Rte_GmMsg348BusChassisExp_WhlGndVelRiDrvnStuckBusChassisExp_Logl" 0 DISPLAY_IDENTIFIER GmMsg348BusChassisExp.SenderPorts.WhlGndVelRiDrvnStuckBusChassisExp.Logl /end MEASUREMENT
/begin MEASUREMENT GmMsg348BusChassisExp.WhlGndVelRiDrvnVldBusChassisExp.Logl "MICROSAR RTE" UBYTE RTE_CM_BOOLEAN 0 0 0 255 ECU_ADDRESS 0 SYMBOL_LINK "Rte_GmMsg348BusChassisExp_WhlGndVelRiDrvnVldBusChassisExp_Logl" 0 DISPLAY_IDENTIFIER GmMsg348BusChassisExp.SenderPorts.WhlGndVelRiDrvnVldBusChassisExp.Logl /end MEASUREMENT
/begin MEASUREMENT GmMsg348BusChassisExp.WhlGndVelRiDrvnVldRawBusChassisExp.Val "MICROSAR RTE" UBYTE NO_COMPU_METHOD 0 0 0 255 ECU_ADDRESS 0 SYMBOL_LINK "Rte_SerlComInpProxy_WhlGndVelRiDrvnVldRawBusChassisExp_Val" 0 DISPLAY_IDENTIFIER GmMsg348BusChassisExp.ReceiverPorts.WhlGndVelRiDrvnVldRawBusChassisExp.Val /end MEASUREMENT
/begin MEASUREMENT GmMsg348BusHiSpd.GmMsg348BusHiSpdPrevWhlGndVelLeDrvn "MICROSAR RTE" UWORD NO_COMPU_METHOD 0 0 0 65535 ECU_ADDRESS 0 SYMBOL_LINK "Rte_GmMsg348BusHiSpd_GmMsg348BusHiSpdPrevWhlGndVelLeDrvn" 0 DISPLAY_IDENTIFIER GmMsg348BusHiSpd.PerInstanceMemories.GmMsg348BusHiSpdPrevWhlGndVelLeDrvn /end MEASUREMENT
/begin MEASUREMENT GmMsg348BusHiSpd.GmMsg348BusHiSpdPrevWhlGndVelRiDrvn "MICROSAR RTE" UWORD NO_COMPU_METHOD 0 0 0 65535 ECU_ADDRESS 0 SYMBOL_LINK "Rte_GmMsg348BusHiSpd_GmMsg348BusHiSpdPrevWhlGndVelRiDrvn" 0 DISPLAY_IDENTIFIER GmMsg348BusHiSpd.PerInstanceMemories.GmMsg348BusHiSpdPrevWhlGndVelRiDrvn /end MEASUREMENT
/begin MEASUREMENT GmMsg348BusHiSpd.GmMsg348BusHiSpdWhlGndVelLeDrvnInvldTi "MICROSAR RTE" ULONG NO_COMPU_METHOD 0 0 0 4294967295 ECU_ADDRESS 0 SYMBOL_LINK "Rte_GmMsg348BusHiSpd_GmMsg348BusHiSpdWhlGndVelLeDrvnInvldTi" 0 DISPLAY_IDENTIFIER GmMsg348BusHiSpd.PerInstanceMemories.GmMsg348BusHiSpdWhlGndVelLeDrvnInvldTi /end MEASUREMENT
/begin MEASUREMENT GmMsg348BusHiSpd.GmMsg348BusHiSpdWhlGndVelLeDrvnStuckTi "MICROSAR RTE" ULONG NO_COMPU_METHOD 0 0 0 4294967295 ECU_ADDRESS 0 SYMBOL_LINK "Rte_GmMsg348BusHiSpd_GmMsg348BusHiSpdWhlGndVelLeDrvnStuckTi" 0 DISPLAY_IDENTIFIER GmMsg348BusHiSpd.PerInstanceMemories.GmMsg348BusHiSpdWhlGndVelLeDrvnStuckTi /end MEASUREMENT
/begin MEASUREMENT GmMsg348BusHiSpd.GmMsg348BusHiSpdWhlGndVelRiDrvnInvldTi "MICROSAR RTE" ULONG NO_COMPU_METHOD 0 0 0 4294967295 ECU_ADDRESS 0 SYMBOL_LINK "Rte_GmMsg348BusHiSpd_GmMsg348BusHiSpdWhlGndVelRiDrvnInvldTi" 0 DISPLAY_IDENTIFIER GmMsg348BusHiSpd.PerInstanceMemories.GmMsg348BusHiSpdWhlGndVelRiDrvnInvldTi /end MEASUREMENT
/begin MEASUREMENT GmMsg348BusHiSpd.GmMsg348BusHiSpdWhlGndVelRiDrvnStuckTi "MICROSAR RTE" ULONG NO_COMPU_METHOD 0 0 0 4294967295 ECU_ADDRESS 0 SYMBOL_LINK "Rte_GmMsg348BusHiSpd_GmMsg348BusHiSpdWhlGndVelRiDrvnStuckTi" 0 DISPLAY_IDENTIFIER GmMsg348BusHiSpd.PerInstanceMemories.GmMsg348BusHiSpdWhlGndVelRiDrvnStuckTi /end MEASUREMENT
/begin MEASUREMENT GmMsg348BusHiSpd.LstRxnTiMsg348BusHiSpd.Val "MICROSAR RTE" ULONG NO_COMPU_METHOD 0 0 0 4294967295 ECU_ADDRESS 0 SYMBOL_LINK "Rte_SerlComInpProxy_LstRxnTiMsg348BusHiSpd_Val" 0 DISPLAY_IDENTIFIER GmMsg348BusHiSpd.ReceiverPorts.LstRxnTiMsg348BusHiSpd.Val /end MEASUREMENT
/begin MEASUREMENT GmMsg348BusHiSpd.WhlGndVelLeDrvnBusHiSpd.Val "MICROSAR RTE" FLOAT32_IEEE NO_COMPU_METHOD 0 0 -3.402823466e+38 3.402823466e+38 ECU_ADDRESS 0 SYMBOL_LINK "Rte_GmMsg348BusHiSpd_WhlGndVelLeDrvnBusHiSpd_Val" 0 DISPLAY_IDENTIFIER GmMsg348BusHiSpd.SenderPorts.WhlGndVelLeDrvnBusHiSpd.Val /end MEASUREMENT
/begin MEASUREMENT GmMsg348BusHiSpd.WhlGndVelLeDrvnRawBusHiSpd.Val "MICROSAR RTE" UWORD NO_COMPU_METHOD 0 0 0 65535 ECU_ADDRESS 0 SYMBOL_LINK "Rte_SerlComInpProxy_WhlGndVelLeDrvnRawBusHiSpd_Val" 0 DISPLAY_IDENTIFIER GmMsg348BusHiSpd.ReceiverPorts.WhlGndVelLeDrvnRawBusHiSpd.Val /end MEASUREMENT
/begin MEASUREMENT GmMsg348BusHiSpd.WhlGndVelLeDrvnStuckBusHiSpd.Logl "MICROSAR RTE" UBYTE RTE_CM_BOOLEAN 0 0 0 255 ECU_ADDRESS 0 SYMBOL_LINK "Rte_GmMsg348BusHiSpd_WhlGndVelLeDrvnStuckBusHiSpd_Logl" 0 DISPLAY_IDENTIFIER GmMsg348BusHiSpd.SenderPorts.WhlGndVelLeDrvnStuckBusHiSpd.Logl /end MEASUREMENT
/begin MEASUREMENT GmMsg348BusHiSpd.WhlGndVelLeDrvnVldBusHiSpd.Logl "MICROSAR RTE" UBYTE RTE_CM_BOOLEAN 0 0 0 255 ECU_ADDRESS 0 SYMBOL_LINK "Rte_GmMsg348BusHiSpd_WhlGndVelLeDrvnVldBusHiSpd_Logl" 0 DISPLAY_IDENTIFIER GmMsg348BusHiSpd.SenderPorts.WhlGndVelLeDrvnVldBusHiSpd.Logl /end MEASUREMENT
/begin MEASUREMENT GmMsg348BusHiSpd.WhlGndVelLeDrvnVldRawBusHiSpd.Val "MICROSAR RTE" UBYTE NO_COMPU_METHOD 0 0 0 255 ECU_ADDRESS 0 SYMBOL_LINK "Rte_SerlComInpProxy_WhlGndVelLeDrvnVldRawBusHiSpd_Val" 0 DISPLAY_IDENTIFIER GmMsg348BusHiSpd.ReceiverPorts.WhlGndVelLeDrvnVldRawBusHiSpd.Val /end MEASUREMENT
/begin MEASUREMENT GmMsg348BusHiSpd.WhlGndVelRiDrvnBusHiSpd.Val "MICROSAR RTE" FLOAT32_IEEE NO_COMPU_METHOD 0 0 -3.402823466e+38 3.402823466e+38 ECU_ADDRESS 0 SYMBOL_LINK "Rte_GmMsg348BusHiSpd_WhlGndVelRiDrvnBusHiSpd_Val" 0 DISPLAY_IDENTIFIER GmMsg348BusHiSpd.SenderPorts.WhlGndVelRiDrvnBusHiSpd.Val /end MEASUREMENT
/begin MEASUREMENT GmMsg348BusHiSpd.WhlGndVelRiDrvnRawBusHiSpd.Val "MICROSAR RTE" UWORD NO_COMPU_METHOD 0 0 0 65535 ECU_ADDRESS 0 SYMBOL_LINK "Rte_SerlComInpProxy_WhlGndVelRiDrvnRawBusHiSpd_Val" 0 DISPLAY_IDENTIFIER GmMsg348BusHiSpd.ReceiverPorts.WhlGndVelRiDrvnRawBusHiSpd.Val /end MEASUREMENT
/begin MEASUREMENT GmMsg348BusHiSpd.WhlGndVelRiDrvnStuckBusHiSpd.Logl "MICROSAR RTE" UBYTE RTE_CM_BOOLEAN 0 0 0 255 ECU_ADDRESS 0 SYMBOL_LINK "Rte_GmMsg348BusHiSpd_WhlGndVelRiDrvnStuckBusHiSpd_Logl" 0 DISPLAY_IDENTIFIER GmMsg348BusHiSpd.SenderPorts.WhlGndVelRiDrvnStuckBusHiSpd.Logl /end MEASUREMENT
/begin MEASUREMENT GmMsg348BusHiSpd.WhlGndVelRiDrvnVldBusHiSpd.Logl "MICROSAR RTE" UBYTE RTE_CM_BOOLEAN 0 0 0 255 ECU_ADDRESS 0 SYMBOL_LINK "Rte_GmMsg348BusHiSpd_WhlGndVelRiDrvnVldBusHiSpd_Logl" 0 DISPLAY_IDENTIFIER GmMsg348BusHiSpd.SenderPorts.WhlGndVelRiDrvnVldBusHiSpd.Logl /end MEASUREMENT
/begin MEASUREMENT GmMsg348BusHiSpd.WhlGndVelRiDrvnVldRawBusHiSpd.Val "MICROSAR RTE" UBYTE NO_COMPU_METHOD 0 0 0 255 ECU_ADDRESS 0 SYMBOL_LINK "Rte_SerlComInpProxy_WhlGndVelRiDrvnVldRawBusHiSpd_Val" 0 DISPLAY_IDENTIFIER GmMsg348BusHiSpd.ReceiverPorts.WhlGndVelRiDrvnVldRawBusHiSpd.Val /end MEASUREMENT
/begin MEASUREMENT GmMsg34ABusChassisExp.GmMsg34ABusChassisExpPrevWhlGndVelLeNonDrvn "MICROSAR RTE" UWORD NO_COMPU_METHOD 0 0 0 65535 ECU_ADDRESS 0 SYMBOL_LINK "Rte_GmMsg34ABusChassisExp_GmMsg34ABusChassisExpPrevWhlGndVelLeNonDrvn" 0 DISPLAY_IDENTIFIER GmMsg34ABusChassisExp.PerInstanceMemories.GmMsg34ABusChassisExpPrevWhlGndVelLeNonDrvn /end MEASUREMENT
/begin MEASUREMENT GmMsg34ABusChassisExp.GmMsg34ABusChassisExpPrevWhlGndVelRiNonDrvn "MICROSAR RTE" UWORD NO_COMPU_METHOD 0 0 0 65535 ECU_ADDRESS 0 SYMBOL_LINK "Rte_GmMsg34ABusChassisExp_GmMsg34ABusChassisExpPrevWhlGndVelRiNonDrvn" 0 DISPLAY_IDENTIFIER GmMsg34ABusChassisExp.PerInstanceMemories.GmMsg34ABusChassisExpPrevWhlGndVelRiNonDrvn /end MEASUREMENT
/begin MEASUREMENT GmMsg34ABusChassisExp.GmMsg34ABusChassisExpWhlGndVelLeNonDrvnInvldTi "MICROSAR RTE" ULONG NO_COMPU_METHOD 0 0 0 4294967295 ECU_ADDRESS 0 SYMBOL_LINK "Rte_GmMsg34ABusChassisExp_GmMsg34ABusChassisExpWhlGndVelLeNonDrvnInvldTi" 0 DISPLAY_IDENTIFIER GmMsg34ABusChassisExp.PerInstanceMemories.GmMsg34ABusChassisExpWhlGndVelLeNonDrvnInvldTi /end MEASUREMENT
/begin MEASUREMENT GmMsg34ABusChassisExp.GmMsg34ABusChassisExpWhlGndVelLeNonDrvnStuckTi "MICROSAR RTE" ULONG NO_COMPU_METHOD 0 0 0 4294967295 ECU_ADDRESS 0 SYMBOL_LINK "Rte_GmMsg34ABusChassisExp_GmMsg34ABusChassisExpWhlGndVelLeNonDrvnStuckTi" 0 DISPLAY_IDENTIFIER GmMsg34ABusChassisExp.PerInstanceMemories.GmMsg34ABusChassisExpWhlGndVelLeNonDrvnStuckTi /end MEASUREMENT
/begin MEASUREMENT GmMsg34ABusChassisExp.GmMsg34ABusChassisExpWhlGndVelRiNonDrvnInvldTi "MICROSAR RTE" ULONG NO_COMPU_METHOD 0 0 0 4294967295 ECU_ADDRESS 0 SYMBOL_LINK "Rte_GmMsg34ABusChassisExp_GmMsg34ABusChassisExpWhlGndVelRiNonDrvnInvldTi" 0 DISPLAY_IDENTIFIER GmMsg34ABusChassisExp.PerInstanceMemories.GmMsg34ABusChassisExpWhlGndVelRiNonDrvnInvldTi /end MEASUREMENT
/begin MEASUREMENT GmMsg34ABusChassisExp.GmMsg34ABusChassisExpWhlGndVelRiNonDrvnStuckTi "MICROSAR RTE" ULONG NO_COMPU_METHOD 0 0 0 4294967295 ECU_ADDRESS 0 SYMBOL_LINK "Rte_GmMsg34ABusChassisExp_GmMsg34ABusChassisExpWhlGndVelRiNonDrvnStuckTi" 0 DISPLAY_IDENTIFIER GmMsg34ABusChassisExp.PerInstanceMemories.GmMsg34ABusChassisExpWhlGndVelRiNonDrvnStuckTi /end MEASUREMENT
/begin MEASUREMENT GmMsg34ABusChassisExp.LstRxnTiMsg34ABusChassisExp.Val "MICROSAR RTE" ULONG NO_COMPU_METHOD 0 0 0 4294967295 ECU_ADDRESS 0 SYMBOL_LINK "Rte_SerlComInpProxy_LstRxnTiMsg34ABusChassisExp_Val" 0 DISPLAY_IDENTIFIER GmMsg34ABusChassisExp.ReceiverPorts.LstRxnTiMsg34ABusChassisExp.Val /end MEASUREMENT
/begin MEASUREMENT GmMsg34ABusChassisExp.WhlGndVelLeNonDrvnBusChassisExp.Val "MICROSAR RTE" FLOAT32_IEEE NO_COMPU_METHOD 0 0 -3.402823466e+38 3.402823466e+38 ECU_ADDRESS 0 SYMBOL_LINK "Rte_GmMsg34ABusChassisExp_WhlGndVelLeNonDrvnBusChassisExp_Val" 0 DISPLAY_IDENTIFIER GmMsg34ABusChassisExp.SenderPorts.WhlGndVelLeNonDrvnBusChassisExp.Val /end MEASUREMENT
/begin MEASUREMENT GmMsg34ABusChassisExp.WhlGndVelLeNonDrvnRawBusChassisExp.Val "MICROSAR RTE" UWORD NO_COMPU_METHOD 0 0 0 65535 ECU_ADDRESS 0 SYMBOL_LINK "Rte_SerlComInpProxy_WhlGndVelLeNonDrvnRawBusChassisExp_Val" 0 DISPLAY_IDENTIFIER GmMsg34ABusChassisExp.ReceiverPorts.WhlGndVelLeNonDrvnRawBusChassisExp.Val /end MEASUREMENT
/begin MEASUREMENT GmMsg34ABusChassisExp.WhlGndVelLeNonDrvnStuckBusChassisExp.Logl "MICROSAR RTE" UBYTE RTE_CM_BOOLEAN 0 0 0 255 ECU_ADDRESS 0 SYMBOL_LINK "Rte_GmMsg34ABusChassisExp_WhlGndVelLeNonDrvnStuckBusChassisExp_Logl" 0 DISPLAY_IDENTIFIER GmMsg34ABusChassisExp.SenderPorts.WhlGndVelLeNonDrvnStuckBusChassisExp.Logl /end MEASUREMENT
/begin MEASUREMENT GmMsg34ABusChassisExp.WhlGndVelLeNonDrvnVldBusChassisExp.Logl "MICROSAR RTE" UBYTE RTE_CM_BOOLEAN 0 0 0 255 ECU_ADDRESS 0 SYMBOL_LINK "Rte_GmMsg34ABusChassisExp_WhlGndVelLeNonDrvnVldBusChassisExp_Logl" 0 DISPLAY_IDENTIFIER GmMsg34ABusChassisExp.SenderPorts.WhlGndVelLeNonDrvnVldBusChassisExp.Logl /end MEASUREMENT
/begin MEASUREMENT GmMsg34ABusChassisExp.WhlGndVelLeNonDrvnVldRawBusChassisExp.Val "MICROSAR RTE" UBYTE NO_COMPU_METHOD 0 0 0 255 ECU_ADDRESS 0 SYMBOL_LINK "Rte_SerlComInpProxy_WhlGndVelLeNonDrvnVldRawBusChassisExp_Val" 0 DISPLAY_IDENTIFIER GmMsg34ABusChassisExp.ReceiverPorts.WhlGndVelLeNonDrvnVldRawBusChassisExp.Val /end MEASUREMENT
/begin MEASUREMENT GmMsg34ABusChassisExp.WhlGndVelRiNonDrvnBusChassisExp.Val "MICROSAR RTE" FLOAT32_IEEE NO_COMPU_METHOD 0 0 -3.402823466e+38 3.402823466e+38 ECU_ADDRESS 0 SYMBOL_LINK "Rte_GmMsg34ABusChassisExp_WhlGndVelRiNonDrvnBusChassisExp_Val" 0 DISPLAY_IDENTIFIER GmMsg34ABusChassisExp.SenderPorts.WhlGndVelRiNonDrvnBusChassisExp.Val /end MEASUREMENT
/begin MEASUREMENT GmMsg34ABusChassisExp.WhlGndVelRiNonDrvnRawBusChassisExp.Val "MICROSAR RTE" UWORD NO_COMPU_METHOD 0 0 0 65535 ECU_ADDRESS 0 SYMBOL_LINK "Rte_SerlComInpProxy_WhlGndVelRiNonDrvnRawBusChassisExp_Val" 0 DISPLAY_IDENTIFIER GmMsg34ABusChassisExp.ReceiverPorts.WhlGndVelRiNonDrvnRawBusChassisExp.Val /end MEASUREMENT
/begin MEASUREMENT GmMsg34ABusChassisExp.WhlGndVelRiNonDrvnStuckBusChassisExp.Logl "MICROSAR RTE" UBYTE RTE_CM_BOOLEAN 0 0 0 255 ECU_ADDRESS 0 SYMBOL_LINK "Rte_GmMsg34ABusChassisExp_WhlGndVelRiNonDrvnStuckBusChassisExp_Logl" 0 DISPLAY_IDENTIFIER GmMsg34ABusChassisExp.SenderPorts.WhlGndVelRiNonDrvnStuckBusChassisExp.Logl /end MEASUREMENT
/begin MEASUREMENT GmMsg34ABusChassisExp.WhlGndVelRiNonDrvnVldBusChassisExp.Logl "MICROSAR RTE" UBYTE RTE_CM_BOOLEAN 0 0 0 255 ECU_ADDRESS 0 SYMBOL_LINK "Rte_GmMsg34ABusChassisExp_WhlGndVelRiNonDrvnVldBusChassisExp_Logl" 0 DISPLAY_IDENTIFIER GmMsg34ABusChassisExp.SenderPorts.WhlGndVelRiNonDrvnVldBusChassisExp.Logl /end MEASUREMENT
/begin MEASUREMENT GmMsg34ABusChassisExp.WhlGndVelRiNonDrvnVldRawBusChassisExp.Val "MICROSAR RTE" UBYTE NO_COMPU_METHOD 0 0 0 255 ECU_ADDRESS 0 SYMBOL_LINK "Rte_SerlComInpProxy_WhlGndVelRiNonDrvnVldRawBusChassisExp_Val" 0 DISPLAY_IDENTIFIER GmMsg34ABusChassisExp.ReceiverPorts.WhlGndVelRiNonDrvnVldRawBusChassisExp.Val /end MEASUREMENT
/begin MEASUREMENT GmMsg34ABusHiSpd.GmMsg34ABusHiSpdPrevWhlGndVelLeNonDrvn "MICROSAR RTE" UWORD NO_COMPU_METHOD 0 0 0 65535 ECU_ADDRESS 0 SYMBOL_LINK "Rte_GmMsg34ABusHiSpd_GmMsg34ABusHiSpdPrevWhlGndVelLeNonDrvn" 0 DISPLAY_IDENTIFIER GmMsg34ABusHiSpd.PerInstanceMemories.GmMsg34ABusHiSpdPrevWhlGndVelLeNonDrvn /end MEASUREMENT
/begin MEASUREMENT GmMsg34ABusHiSpd.GmMsg34ABusHiSpdPrevWhlGndVelRiNonDrvn "MICROSAR RTE" UWORD NO_COMPU_METHOD 0 0 0 65535 ECU_ADDRESS 0 SYMBOL_LINK "Rte_GmMsg34ABusHiSpd_GmMsg34ABusHiSpdPrevWhlGndVelRiNonDrvn" 0 DISPLAY_IDENTIFIER GmMsg34ABusHiSpd.PerInstanceMemories.GmMsg34ABusHiSpdPrevWhlGndVelRiNonDrvn /end MEASUREMENT
/begin MEASUREMENT GmMsg34ABusHiSpd.GmMsg34ABusHiSpdWhlGndVelLeNonDrvnInvldTi "MICROSAR RTE" ULONG NO_COMPU_METHOD 0 0 0 4294967295 ECU_ADDRESS 0 SYMBOL_LINK "Rte_GmMsg34ABusHiSpd_GmMsg34ABusHiSpdWhlGndVelLeNonDrvnInvldTi" 0 DISPLAY_IDENTIFIER GmMsg34ABusHiSpd.PerInstanceMemories.GmMsg34ABusHiSpdWhlGndVelLeNonDrvnInvldTi /end MEASUREMENT
/begin MEASUREMENT GmMsg34ABusHiSpd.GmMsg34ABusHiSpdWhlGndVelLeNonDrvnStuckTi "MICROSAR RTE" ULONG NO_COMPU_METHOD 0 0 0 4294967295 ECU_ADDRESS 0 SYMBOL_LINK "Rte_GmMsg34ABusHiSpd_GmMsg34ABusHiSpdWhlGndVelLeNonDrvnStuckTi" 0 DISPLAY_IDENTIFIER GmMsg34ABusHiSpd.PerInstanceMemories.GmMsg34ABusHiSpdWhlGndVelLeNonDrvnStuckTi /end MEASUREMENT
/begin MEASUREMENT GmMsg34ABusHiSpd.GmMsg34ABusHiSpdWhlGndVelRiNonDrvnInvldTi "MICROSAR RTE" ULONG NO_COMPU_METHOD 0 0 0 4294967295 ECU_ADDRESS 0 SYMBOL_LINK "Rte_GmMsg34ABusHiSpd_GmMsg34ABusHiSpdWhlGndVelRiNonDrvnInvldTi" 0 DISPLAY_IDENTIFIER GmMsg34ABusHiSpd.PerInstanceMemories.GmMsg34ABusHiSpdWhlGndVelRiNonDrvnInvldTi /end MEASUREMENT
/begin MEASUREMENT GmMsg34ABusHiSpd.GmMsg34ABusHiSpdWhlGndVelRiNonDrvnStuckTi "MICROSAR RTE" ULONG NO_COMPU_METHOD 0 0 0 4294967295 ECU_ADDRESS 0 SYMBOL_LINK "Rte_GmMsg34ABusHiSpd_GmMsg34ABusHiSpdWhlGndVelRiNonDrvnStuckTi" 0 DISPLAY_IDENTIFIER GmMsg34ABusHiSpd.PerInstanceMemories.GmMsg34ABusHiSpdWhlGndVelRiNonDrvnStuckTi /end MEASUREMENT
/begin MEASUREMENT GmMsg34ABusHiSpd.LstRxnTiMsg34ABusHiSpd.Val "MICROSAR RTE" ULONG NO_COMPU_METHOD 0 0 0 4294967295 ECU_ADDRESS 0 SYMBOL_LINK "Rte_SerlComInpProxy_LstRxnTiMsg34ABusHiSpd_Val" 0 DISPLAY_IDENTIFIER GmMsg34ABusHiSpd.ReceiverPorts.LstRxnTiMsg34ABusHiSpd.Val /end MEASUREMENT
/begin MEASUREMENT GmMsg34ABusHiSpd.WhlGndVelLeNonDrvnBusHiSpd.Val "MICROSAR RTE" FLOAT32_IEEE NO_COMPU_METHOD 0 0 -3.402823466e+38 3.402823466e+38 ECU_ADDRESS 0 SYMBOL_LINK "Rte_GmMsg34ABusHiSpd_WhlGndVelLeNonDrvnBusHiSpd_Val" 0 DISPLAY_IDENTIFIER GmMsg34ABusHiSpd.SenderPorts.WhlGndVelLeNonDrvnBusHiSpd.Val /end MEASUREMENT
/begin MEASUREMENT GmMsg34ABusHiSpd.WhlGndVelLeNonDrvnRawBusHiSpd.Val "MICROSAR RTE" UWORD NO_COMPU_METHOD 0 0 0 65535 ECU_ADDRESS 0 SYMBOL_LINK "Rte_SerlComInpProxy_WhlGndVelLeNonDrvnRawBusHiSpd_Val" 0 DISPLAY_IDENTIFIER GmMsg34ABusHiSpd.ReceiverPorts.WhlGndVelLeNonDrvnRawBusHiSpd.Val /end MEASUREMENT
/begin MEASUREMENT GmMsg34ABusHiSpd.WhlGndVelLeNonDrvnStuckBusHiSpd.Logl "MICROSAR RTE" UBYTE RTE_CM_BOOLEAN 0 0 0 255 ECU_ADDRESS 0 SYMBOL_LINK "Rte_GmMsg34ABusHiSpd_WhlGndVelLeNonDrvnStuckBusHiSpd_Logl" 0 DISPLAY_IDENTIFIER GmMsg34ABusHiSpd.SenderPorts.WhlGndVelLeNonDrvnStuckBusHiSpd.Logl /end MEASUREMENT
/begin MEASUREMENT GmMsg34ABusHiSpd.WhlGndVelLeNonDrvnVldBusHiSpd.Logl "MICROSAR RTE" UBYTE RTE_CM_BOOLEAN 0 0 0 255 ECU_ADDRESS 0 SYMBOL_LINK "Rte_GmMsg34ABusHiSpd_WhlGndVelLeNonDrvnVldBusHiSpd_Logl" 0 DISPLAY_IDENTIFIER GmMsg34ABusHiSpd.SenderPorts.WhlGndVelLeNonDrvnVldBusHiSpd.Logl /end MEASUREMENT
/begin MEASUREMENT GmMsg34ABusHiSpd.WhlGndVelLeNonDrvnVldRawBusHiSpd.Val "MICROSAR RTE" UBYTE NO_COMPU_METHOD 0 0 0 255 ECU_ADDRESS 0 SYMBOL_LINK "Rte_SerlComInpProxy_WhlGndVelLeNonDrvnVldRawBusHiSpd_Val" 0 DISPLAY_IDENTIFIER GmMsg34ABusHiSpd.ReceiverPorts.WhlGndVelLeNonDrvnVldRawBusHiSpd.Val /end MEASUREMENT
/begin MEASUREMENT GmMsg34ABusHiSpd.WhlGndVelRiNonDrvnBusHiSpd.Val "MICROSAR RTE" FLOAT32_IEEE NO_COMPU_METHOD 0 0 -3.402823466e+38 3.402823466e+38 ECU_ADDRESS 0 SYMBOL_LINK "Rte_GmMsg34ABusHiSpd_WhlGndVelRiNonDrvnBusHiSpd_Val" 0 DISPLAY_IDENTIFIER GmMsg34ABusHiSpd.SenderPorts.WhlGndVelRiNonDrvnBusHiSpd.Val /end MEASUREMENT
/begin MEASUREMENT GmMsg34ABusHiSpd.WhlGndVelRiNonDrvnRawBusHiSpd.Val "MICROSAR RTE" UWORD NO_COMPU_METHOD 0 0 0 65535 ECU_ADDRESS 0 SYMBOL_LINK "Rte_SerlComInpProxy_WhlGndVelRiNonDrvnRawBusHiSpd_Val" 0 DISPLAY_IDENTIFIER GmMsg34ABusHiSpd.ReceiverPorts.WhlGndVelRiNonDrvnRawBusHiSpd.Val /end MEASUREMENT
/begin MEASUREMENT GmMsg34ABusHiSpd.WhlGndVelRiNonDrvnStuckBusHiSpd.Logl "MICROSAR RTE" UBYTE RTE_CM_BOOLEAN 0 0 0 255 ECU_ADDRESS 0 SYMBOL_LINK "Rte_GmMsg34ABusHiSpd_WhlGndVelRiNonDrvnStuckBusHiSpd_Logl" 0 DISPLAY_IDENTIFIER GmMsg34ABusHiSpd.SenderPorts.WhlGndVelRiNonDrvnStuckBusHiSpd.Logl /end MEASUREMENT
/begin MEASUREMENT GmMsg34ABusHiSpd.WhlGndVelRiNonDrvnVldBusHiSpd.Logl "MICROSAR RTE" UBYTE RTE_CM_BOOLEAN 0 0 0 255 ECU_ADDRESS 0 SYMBOL_LINK "Rte_GmMsg34ABusHiSpd_WhlGndVelRiNonDrvnVldBusHiSpd_Logl" 0 DISPLAY_IDENTIFIER GmMsg34ABusHiSpd.SenderPorts.WhlGndVelRiNonDrvnVldBusHiSpd.Logl /end MEASUREMENT
/begin MEASUREMENT GmMsg34ABusHiSpd.WhlGndVelRiNonDrvnVldRawBusHiSpd.Val "MICROSAR RTE" UBYTE NO_COMPU_METHOD 0 0 0 255 ECU_ADDRESS 0 SYMBOL_LINK "Rte_SerlComInpProxy_WhlGndVelRiNonDrvnVldRawBusHiSpd_Val" 0 DISPLAY_IDENTIFIER GmMsg34ABusHiSpd.ReceiverPorts.WhlGndVelRiNonDrvnVldRawBusHiSpd.Val /end MEASUREMENT
/begin MEASUREMENT GmMsg3F1BusHiSpd.AmbT.Val "MICROSAR RTE" FLOAT32_IEEE NO_COMPU_METHOD 0 0 -3.402823466e+38 3.402823466e+38 ECU_ADDRESS 0 SYMBOL_LINK "Rte_GmMsg3F1BusHiSpd_AmbT_Val" 0 DISPLAY_IDENTIFIER GmMsg3F1BusHiSpd.SenderPorts.AmbT.Val /end MEASUREMENT
/begin MEASUREMENT GmMsg3F1BusHiSpd.GmMsg3F1BusHiSpdInvldMsgTmr "MICROSAR RTE" ULONG NO_COMPU_METHOD 0 0 0 4294967295 ECU_ADDRESS 0 SYMBOL_LINK "Rte_GmMsg3F1BusHiSpd_GmMsg3F1BusHiSpdInvldMsgTmr" 0 DISPLAY_IDENTIFIER GmMsg3F1BusHiSpd.PerInstanceMemories.GmMsg3F1BusHiSpdInvldMsgTmr /end MEASUREMENT
/begin MEASUREMENT GmMsg3F1BusHiSpd.LstRxnTiMsg3F1.Val "MICROSAR RTE" ULONG NO_COMPU_METHOD 0 0 0 4294967295 ECU_ADDRESS 0 SYMBOL_LINK "Rte_SerlComInpProxy_LstRxnTiMsg3F1_Val" 0 DISPLAY_IDENTIFIER GmMsg3F1BusHiSpd.ReceiverPorts.LstRxnTiMsg3F1.Val /end MEASUREMENT
/begin MEASUREMENT GmMsg3F1BusHiSpd.OutdAirTCorrdValMaskRaw.Val "MICROSAR RTE" UBYTE NO_COMPU_METHOD 0 0 0 255 ECU_ADDRESS 0 SYMBOL_LINK "Rte_SerlComInpProxy_OutdAirTCorrdValMaskRaw_Val" 0 DISPLAY_IDENTIFIER GmMsg3F1BusHiSpd.ReceiverPorts.OutdAirTCorrdValMaskRaw.Val /end MEASUREMENT
/begin MEASUREMENT GmMsg3F1BusHiSpd.OutdAirTCorrdValRaw.Val "MICROSAR RTE" UBYTE NO_COMPU_METHOD 0 0 0 255 ECU_ADDRESS 0 SYMBOL_LINK "Rte_SerlComInpProxy_OutdAirTCorrdValRaw_Val" 0 DISPLAY_IDENTIFIER GmMsg3F1BusHiSpd.ReceiverPorts.OutdAirTCorrdValRaw.Val /end MEASUREMENT
/begin MEASUREMENT GmMsg3F1BusHiSpd.OutdAirTCorrdValVldRaw.Val "MICROSAR RTE" UBYTE NO_COMPU_METHOD 0 0 0 255 ECU_ADDRESS 0 SYMBOL_LINK "Rte_SerlComInpProxy_OutdAirTCorrdValVldRaw_Val" 0 DISPLAY_IDENTIFIER GmMsg3F1BusHiSpd.ReceiverPorts.OutdAirTCorrdValVldRaw.Val /end MEASUREMENT
/begin MEASUREMENT GmMsg4D1BusHiSpd.EngOilT.Val "MICROSAR RTE" FLOAT32_IEEE NO_COMPU_METHOD 0 0 -3.402823466e+38 3.402823466e+38 ECU_ADDRESS 0 SYMBOL_LINK "Rte_GmMsg4D1BusHiSpd_EngOilT_Val" 0 DISPLAY_IDENTIFIER GmMsg4D1BusHiSpd.SenderPorts.EngOilT.Val /end MEASUREMENT
/begin MEASUREMENT GmMsg4D1BusHiSpd.EngOilTRaw.Val "MICROSAR RTE" UBYTE NO_COMPU_METHOD 0 0 0 255 ECU_ADDRESS 0 SYMBOL_LINK "Rte_SerlComInpProxy_EngOilTRaw_Val" 0 DISPLAY_IDENTIFIER GmMsg4D1BusHiSpd.ReceiverPorts.EngOilTRaw.Val /end MEASUREMENT
/begin MEASUREMENT GmMsg4D1BusHiSpd.EngOilVldRaw.Val "MICROSAR RTE" UBYTE NO_COMPU_METHOD 0 0 0 255 ECU_ADDRESS 0 SYMBOL_LINK "Rte_SerlComInpProxy_EngOilVldRaw_Val" 0 DISPLAY_IDENTIFIER GmMsg4D1BusHiSpd.ReceiverPorts.EngOilVldRaw.Val /end MEASUREMENT
/begin MEASUREMENT GmMsg4D1BusHiSpd.GmMsg4D1BusHiSpdInvldMsgTmr "MICROSAR RTE" ULONG NO_COMPU_METHOD 0 0 0 4294967295 ECU_ADDRESS 0 SYMBOL_LINK "Rte_GmMsg4D1BusHiSpd_GmMsg4D1BusHiSpdInvldMsgTmr" 0 DISPLAY_IDENTIFIER GmMsg4D1BusHiSpd.PerInstanceMemories.GmMsg4D1BusHiSpdInvldMsgTmr /end MEASUREMENT
/begin MEASUREMENT GmMsg4D1BusHiSpd.LstRxnTiMsg4D1.Val "MICROSAR RTE" ULONG NO_COMPU_METHOD 0 0 0 4294967295 ECU_ADDRESS 0 SYMBOL_LINK "Rte_SerlComInpProxy_LstRxnTiMsg4D1_Val" 0 DISPLAY_IDENTIFIER GmMsg4D1BusHiSpd.ReceiverPorts.LstRxnTiMsg4D1.Val /end MEASUREMENT
/begin MEASUREMENT GmMsg500BusHiSpd.GmMsg500BusHiSpdPrevRxnTi "MICROSAR RTE" ULONG NO_COMPU_METHOD 0 0 0 4294967295 ECU_ADDRESS 0 SYMBOL_LINK "Rte_GmMsg500BusHiSpd_GmMsg500BusHiSpdPrevRxnTi" 0 DISPLAY_IDENTIFIER GmMsg500BusHiSpd.PerInstanceMemories.GmMsg500BusHiSpdPrevRxnTi /end MEASUREMENT
/begin MEASUREMENT GmMsg500BusHiSpd.GmMsg500BusHiSpdPrevWhlPlsPerRev "MICROSAR RTE" UBYTE NO_COMPU_METHOD 0 0 0 255 ECU_ADDRESS 0 SYMBOL_LINK "Rte_GmMsg500BusHiSpd_GmMsg500BusHiSpdPrevWhlPlsPerRev" 0 DISPLAY_IDENTIFIER GmMsg500BusHiSpd.PerInstanceMemories.GmMsg500BusHiSpdPrevWhlPlsPerRev /end MEASUREMENT
/begin MEASUREMENT GmMsg500BusHiSpd.GmMsg500BusHiSpdPrevWhlRotlStsTiStampResl "MICROSAR RTE" FLOAT32_IEEE NO_COMPU_METHOD 0 0 -3.402823466e+38 3.402823466e+38 ECU_ADDRESS 0 SYMBOL_LINK "Rte_GmMsg500BusHiSpd_GmMsg500BusHiSpdPrevWhlRotlStsTiStampResl" 0 DISPLAY_IDENTIFIER GmMsg500BusHiSpd.PerInstanceMemories.GmMsg500BusHiSpdPrevWhlRotlStsTiStampResl /end MEASUREMENT
/begin MEASUREMENT GmMsg500BusHiSpd.LstRxnTiMsg500BusHiSpd.Val "MICROSAR RTE" ULONG NO_COMPU_METHOD 0 0 0 4294967295 ECU_ADDRESS 0 SYMBOL_LINK "Rte_SerlComInpProxy_LstRxnTiMsg500BusHiSpd_Val" 0 DISPLAY_IDENTIFIER GmMsg500BusHiSpd.ReceiverPorts.LstRxnTiMsg500BusHiSpd.Val /end MEASUREMENT
/begin MEASUREMENT GmMsg500BusHiSpd.WhlPlsPerRev.Val "MICROSAR RTE" UBYTE NO_COMPU_METHOD 0 0 0 255 ECU_ADDRESS 0 SYMBOL_LINK "Rte_GmMsg500BusHiSpd_WhlPlsPerRev_Val" 0 DISPLAY_IDENTIFIER GmMsg500BusHiSpd.SenderPorts.WhlPlsPerRev.Val /end MEASUREMENT
/begin MEASUREMENT GmMsg500BusHiSpd.WhlPlsPerRevRaw.Val "MICROSAR RTE" UBYTE NO_COMPU_METHOD 0 0 0 255 ECU_ADDRESS 0 SYMBOL_LINK "Rte_SerlComInpProxy_WhlPlsPerRevRaw_Val" 0 DISPLAY_IDENTIFIER GmMsg500BusHiSpd.ReceiverPorts.WhlPlsPerRevRaw.Val /end MEASUREMENT
/begin MEASUREMENT GmMsg500BusHiSpd.WhlRotlStsTiStampResl.Val "MICROSAR RTE" FLOAT32_IEEE NO_COMPU_METHOD 0 0 -3.402823466e+38 3.402823466e+38 ECU_ADDRESS 0 SYMBOL_LINK "Rte_GmMsg500BusHiSpd_WhlRotlStsTiStampResl_Val" 0 DISPLAY_IDENTIFIER GmMsg500BusHiSpd.SenderPorts.WhlRotlStsTiStampResl.Val /end MEASUREMENT
/begin MEASUREMENT GmMsg500BusHiSpd.WhlRotlStsTiStampReslRaw.Val "MICROSAR RTE" UWORD NO_COMPU_METHOD 0 0 0 65535 ECU_ADDRESS 0 SYMBOL_LINK "Rte_SerlComInpProxy_WhlRotlStsTiStampReslRaw_Val" 0 DISPLAY_IDENTIFIER GmMsg500BusHiSpd.ReceiverPorts.WhlRotlStsTiStampReslRaw.Val /end MEASUREMENT
/begin MEASUREMENT GmMsg778BusHiSpd.ActvEveId "MICROSAR RTE" UBYTE NO_COMPU_METHOD 0 0 0 255 ECU_ADDRESS 0 SYMBOL_LINK "Rte_GmMsg778BusHiSpd_ActvEveId" 0 DISPLAY_IDENTIFIER GmMsg778BusHiSpd.PerInstanceMemories.ActvEveId /end MEASUREMENT
/begin MEASUREMENT GmMsg778BusHiSpd.CodSupported.Val "MICROSAR RTE" UBYTE NO_COMPU_METHOD 0 0 0 255 ECU_ADDRESS 0 SYMBOL_LINK "Rte_GmMsg778BusHiSpd_CodSupported_Val" 0 DISPLAY_IDENTIFIER GmMsg778BusHiSpd.SenderPorts.CodSupported.Val /end MEASUREMENT
/begin MEASUREMENT GmMsg778BusHiSpd.CurrSts.Val "MICROSAR RTE" UBYTE NO_COMPU_METHOD 0 0 0 255 ECU_ADDRESS 0 SYMBOL_LINK "Rte_GmMsg778BusHiSpd_CurrSts_Val" 0 DISPLAY_IDENTIFIER GmMsg778BusHiSpd.SenderPorts.CurrSts.Val /end MEASUREMENT
/begin MEASUREMENT GmMsg778BusHiSpd.DtcFailrTyp.Val "MICROSAR RTE" UBYTE NO_COMPU_METHOD 0 0 0 255 ECU_ADDRESS 0 SYMBOL_LINK "Rte_GmMsg778BusHiSpd_DtcFailrTyp_Val" 0 DISPLAY_IDENTIFIER GmMsg778BusHiSpd.SenderPorts.DtcFailrTyp.Val /end MEASUREMENT
/begin MEASUREMENT GmMsg778BusHiSpd.DtcFltTyp.Val "MICROSAR RTE" UBYTE NO_COMPU_METHOD 0 0 0 255 ECU_ADDRESS 0 SYMBOL_LINK "Rte_GmMsg778BusHiSpd_DtcFltTyp_Val" 0 DISPLAY_IDENTIFIER GmMsg778BusHiSpd.SenderPorts.DtcFltTyp.Val /end MEASUREMENT
/begin MEASUREMENT GmMsg778BusHiSpd.DtcMap "MICROSAR RTE" ULONG NO_COMPU_METHOD 0 0 0 4294967295 MATRIX_DIM 40 1 1 ECU_ADDRESS 0 SYMBOL_LINK "Rte_GmMsg778BusHiSpd_DtcMap" 0 DISPLAY_IDENTIFIER GmMsg778BusHiSpd.PerInstanceMemories.DtcMap /end MEASUREMENT
/begin MEASUREMENT GmMsg778BusHiSpd.DtcNr.Val "MICROSAR RTE" UWORD NO_COMPU_METHOD 0 0 0 65535 ECU_ADDRESS 0 SYMBOL_LINK "Rte_GmMsg778BusHiSpd_DtcNr_Val" 0 DISPLAY_IDENTIFIER GmMsg778BusHiSpd.SenderPorts.DtcNr.Val /end MEASUREMENT
/begin MEASUREMENT GmMsg778BusHiSpd.DtcSrc.Val "MICROSAR RTE" UBYTE NO_COMPU_METHOD 0 0 0 255 ECU_ADDRESS 0 SYMBOL_LINK "Rte_GmMsg778BusHiSpd_DtcSrc_Val" 0 DISPLAY_IDENTIFIER GmMsg778BusHiSpd.SenderPorts.DtcSrc.Val /end MEASUREMENT
/begin MEASUREMENT GmMsg778BusHiSpd.DtcTrig.Val "MICROSAR RTE" UBYTE NO_COMPU_METHOD 0 0 0 255 ECU_ADDRESS 0 SYMBOL_LINK "Rte_GmMsg778BusHiSpd_DtcTrig_Val" 0 DISPLAY_IDENTIFIER GmMsg778BusHiSpd.SenderPorts.DtcTrig.Val /end MEASUREMENT
/begin MEASUREMENT GmMsg778BusHiSpd.DtcTrigStsAry "MICROSAR RTE" UBYTE NO_COMPU_METHOD 0 0 0 255 MATRIX_DIM 40 1 1 ECU_ADDRESS 0 SYMBOL_LINK "Rte_GmMsg778BusHiSpd_DtcTrigStsAry" 0 DISPLAY_IDENTIFIER GmMsg778BusHiSpd.PerInstanceMemories.DtcTrigStsAry /end MEASUREMENT
/begin MEASUREMENT GmMsg778BusHiSpd.EveCnt "MICROSAR RTE" UBYTE NO_COMPU_METHOD 0 0 0 255 ECU_ADDRESS 0 SYMBOL_LINK "Rte_GmMsg778BusHiSpd_EveCnt" 0 DISPLAY_IDENTIFIER GmMsg778BusHiSpd.PerInstanceMemories.EveCnt /end MEASUREMENT
/begin MEASUREMENT GmMsg778BusHiSpd.EveMap "MICROSAR RTE" UBYTE NO_COMPU_METHOD 0 0 0 255 MATRIX_DIM 40 1 1 ECU_ADDRESS 0 SYMBOL_LINK "Rte_GmMsg778BusHiSpd_EveMap" 0 DISPLAY_IDENTIFIER GmMsg778BusHiSpd.PerInstanceMemories.EveMap /end MEASUREMENT
/begin MEASUREMENT GmMsg778BusHiSpd.HistSts.Val "MICROSAR RTE" UBYTE NO_COMPU_METHOD 0 0 0 255 ECU_ADDRESS 0 SYMBOL_LINK "Rte_GmMsg778BusHiSpd_HistSts_Val" 0 DISPLAY_IDENTIFIER GmMsg778BusHiSpd.SenderPorts.HistSts.Val /end MEASUREMENT
/begin MEASUREMENT GmMsg778BusHiSpd.SysSt.Val "MICROSAR RTE" UBYTE RTE_CM_ENUM_SysSt1 0 0 0 255 ECU_ADDRESS 0 SYMBOL_LINK "Rte_SysStMod_SysSt_Val" 0 DISPLAY_IDENTIFIER GmMsg778BusHiSpd.ReceiverPorts.SysSt.Val /end MEASUREMENT
/begin MEASUREMENT GmMsg778BusHiSpd.TrigActv "MICROSAR RTE" UBYTE RTE_CM_BOOLEAN 0 0 0 255 ECU_ADDRESS 0 SYMBOL_LINK "Rte_GmMsg778BusHiSpd_TrigActv" 0 DISPLAY_IDENTIFIER GmMsg778BusHiSpd.PerInstanceMemories.TrigActv /end MEASUREMENT
/begin MEASUREMENT GmMsg778BusHiSpd.TrigTmr "MICROSAR RTE" ULONG NO_COMPU_METHOD 0 0 0 4294967295 ECU_ADDRESS 0 SYMBOL_LINK "Rte_GmMsg778BusHiSpd_TrigTmr" 0 DISPLAY_IDENTIFIER GmMsg778BusHiSpd.PerInstanceMemories.TrigTmr /end MEASUREMENT
/begin MEASUREMENT GmMsg778BusHiSpd.TstFaildCodClrdSts.Val "MICROSAR RTE" UBYTE NO_COMPU_METHOD 0 0 0 255 ECU_ADDRESS 0 SYMBOL_LINK "Rte_GmMsg778BusHiSpd_TstFaildCodClrdSts_Val" 0 DISPLAY_IDENTIFIER GmMsg778BusHiSpd.SenderPorts.TstFaildCodClrdSts.Val /end MEASUREMENT
/begin MEASUREMENT GmMsg778BusHiSpd.TstFaildPwrUpSts.Val "MICROSAR RTE" UBYTE NO_COMPU_METHOD 0 0 0 255 ECU_ADDRESS 0 SYMBOL_LINK "Rte_GmMsg778BusHiSpd_TstFaildPwrUpSts_Val" 0 DISPLAY_IDENTIFIER GmMsg778BusHiSpd.SenderPorts.TstFaildPwrUpSts.Val /end MEASUREMENT
/begin MEASUREMENT GmMsg778BusHiSpd.TstNotPassdCodClrdSts.Val "MICROSAR RTE" UBYTE NO_COMPU_METHOD 0 0 0 255 ECU_ADDRESS 0 SYMBOL_LINK "Rte_GmMsg778BusHiSpd_TstNotPassdCodClrdSts_Val" 0 DISPLAY_IDENTIFIER GmMsg778BusHiSpd.SenderPorts.TstNotPassdCodClrdSts.Val /end MEASUREMENT
/begin MEASUREMENT GmMsg778BusHiSpd.TstNotPassdPwrUpSts.Val "MICROSAR RTE" UBYTE NO_COMPU_METHOD 0 0 0 255 ECU_ADDRESS 0 SYMBOL_LINK "Rte_GmMsg778BusHiSpd_TstNotPassdPwrUpSts_Val" 0 DISPLAY_IDENTIFIER GmMsg778BusHiSpd.SenderPorts.TstNotPassdPwrUpSts.Val /end MEASUREMENT
/begin MEASUREMENT GmMsg778BusHiSpd.WarnIndcrReqdSts.Val "MICROSAR RTE" UBYTE NO_COMPU_METHOD 0 0 0 255 ECU_ADDRESS 0 SYMBOL_LINK "Rte_GmMsg778BusHiSpd_WarnIndcrReqdSts_Val" 0 DISPLAY_IDENTIFIER GmMsg778BusHiSpd.SenderPorts.WarnIndcrReqdSts.Val /end MEASUREMENT
/begin MEASUREMENT GmOvrlStMgr.AbsActvProtd.Logl "MICROSAR RTE" UBYTE RTE_CM_BOOLEAN 0 0 0 255 ECU_ADDRESS 0 SYMBOL_LINK "Rte_GmMsg214BusHiSpd_AbsProtd_Logl" 0 DISPLAY_IDENTIFIER GmOvrlStMgr.ReceiverPorts.AbsActvProtd.Logl /end MEASUREMENT
/begin MEASUREMENT GmOvrlStMgr.ApaDrvrIntvDetd.Logl "MICROSAR RTE" UBYTE RTE_CM_BOOLEAN 0 0 0 255 ECU_ADDRESS 0 SYMBOL_LINK "Rte_GmOvrlStMgr_ApaDrvrIntvDetd_Logl" 0 DISPLAY_IDENTIFIER GmOvrlStMgr.SenderPorts.ApaDrvrIntvDetd.Logl /end MEASUREMENT
/begin MEASUREMENT GmOvrlStMgr.ApaEna.Logl "MICROSAR RTE" UBYTE RTE_CM_BOOLEAN 0 0 0 255 ECU_ADDRESS 0 SYMBOL_LINK "Rte_GmFctDiArbn_ApaEnaArbn_Logl" 0 DISPLAY_IDENTIFIER GmOvrlStMgr.ReceiverPorts.ApaEna.Logl /end MEASUREMENT
/begin MEASUREMENT GmOvrlStMgr.ApaSt.Val "MICROSAR RTE" UBYTE NO_COMPU_METHOD 0 0 0 255 ECU_ADDRESS 0 SYMBOL_LINK "Rte_GmOvrlStMgr_ApaSt_Val" 0 DISPLAY_IDENTIFIER GmOvrlStMgr.SenderPorts.ApaSt.Val /end MEASUREMENT
/begin MEASUREMENT GmOvrlStMgr.EscEna.Logl "MICROSAR RTE" UBYTE RTE_CM_BOOLEAN 0 0 0 255 ECU_ADDRESS 0 SYMBOL_LINK "Rte_GmFctDiArbn_EscEnaArbn_Logl" 0 DISPLAY_IDENTIFIER GmOvrlStMgr.ReceiverPorts.EscEna.Logl /end MEASUREMENT
/begin MEASUREMENT GmOvrlStMgr.EscLimdActv.Logl "MICROSAR RTE" UBYTE RTE_CM_BOOLEAN 0 0 0 255 ECU_ADDRESS 0 SYMBOL_LINK "Rte_GmTqArbn_EscLimdActv_Logl" 0 DISPLAY_IDENTIFIER GmOvrlStMgr.ReceiverPorts.EscLimdActv.Logl /end MEASUREMENT
/begin MEASUREMENT GmOvrlStMgr.EscSt.Val "MICROSAR RTE" UBYTE NO_COMPU_METHOD 0 0 0 255 ECU_ADDRESS 0 SYMBOL_LINK "Rte_GmOvrlStMgr_EscSt_Val" 0 DISPLAY_IDENTIFIER GmOvrlStMgr.SenderPorts.EscSt.Val /end MEASUREMENT
/begin MEASUREMENT GmOvrlStMgr.GmLoaIgnCntr "MICROSAR RTE" UWORD NO_COMPU_METHOD 0 0 0 65535 ECU_ADDRESS 0 SYMBOL_LINK "Rte_GmOvrlStMgr_GmLoaIgnCntr" 0 DISPLAY_IDENTIFIER GmOvrlStMgr.PerInstanceMemories.GmLoaIgnCntr /end MEASUREMENT
/begin MEASUREMENT GmOvrlStMgr.HaptcStTranActvToWaitRefTi "MICROSAR RTE" ULONG NO_COMPU_METHOD 0 0 0 4294967295 ECU_ADDRESS 0 SYMBOL_LINK "Rte_GmOvrlStMgr_HaptcStTranActvToWaitRefTi" 0 DISPLAY_IDENTIFIER GmOvrlStMgr.PerInstanceMemories.HaptcStTranActvToWaitRefTi /end MEASUREMENT
/begin MEASUREMENT GmOvrlStMgr.HapticActvRefTmr "MICROSAR RTE" ULONG NO_COMPU_METHOD 0 0 0 4294967295 ECU_ADDRESS 0 SYMBOL_LINK "Rte_GmOvrlStMgr_HapticActvRefTmr" 0 DISPLAY_IDENTIFIER GmOvrlStMgr.PerInstanceMemories.HapticActvRefTmr /end MEASUREMENT
/begin MEASUREMENT GmOvrlStMgr.HapticWaitRefTmr "MICROSAR RTE" ULONG NO_COMPU_METHOD 0 0 0 4294967295 ECU_ADDRESS 0 SYMBOL_LINK "Rte_GmOvrlStMgr_HapticWaitRefTmr" 0 DISPLAY_IDENTIFIER GmOvrlStMgr.PerInstanceMemories.HapticWaitRefTmr /end MEASUREMENT
/begin MEASUREMENT GmOvrlStMgr.HwAgEotCcw.Val "MICROSAR RTE" FLOAT32_IEEE NO_COMPU_METHOD 0 0 -3.402823466e+38 3.402823466e+38 ECU_ADDRESS 0 SYMBOL_LINK "Rte_EotLrng_HwAgEotCcw_Val" 0 DISPLAY_IDENTIFIER GmOvrlStMgr.ReceiverPorts.HwAgEotCcw.Val /end MEASUREMENT
/begin MEASUREMENT GmOvrlStMgr.HwAgEotCw.Val "MICROSAR RTE" FLOAT32_IEEE NO_COMPU_METHOD 0 0 -3.402823466e+38 3.402823466e+38 ECU_ADDRESS 0 SYMBOL_LINK "Rte_EotLrng_HwAgEotCw_Val" 0 DISPLAY_IDENTIFIER GmOvrlStMgr.ReceiverPorts.HwAgEotCw.Val /end MEASUREMENT
/begin MEASUREMENT GmOvrlStMgr.HwAgServoCmd.Val "MICROSAR RTE" FLOAT32_IEEE NO_COMPU_METHOD 0 0 -3.402823466e+38 3.402823466e+38 ECU_ADDRESS 0 SYMBOL_LINK "Rte_GmOvrlStMgr_HwAgServoCmd_Val" 0 DISPLAY_IDENTIFIER GmOvrlStMgr.SenderPorts.HwAgServoCmd.Val /end MEASUREMENT
/begin MEASUREMENT GmOvrlStMgr.HwAgServoEna.Logl "MICROSAR RTE" UBYTE RTE_CM_BOOLEAN 0 0 0 255 ECU_ADDRESS 0 SYMBOL_LINK "Rte_GmOvrlStMgr_HwAgServoEna_Logl" 0 DISPLAY_IDENTIFIER GmOvrlStMgr.SenderPorts.HwAgServoEna.Logl /end MEASUREMENT
/begin MEASUREMENT GmOvrlStMgr.HwAgTar.Val "MICROSAR RTE" FLOAT32_IEEE NO_COMPU_METHOD 0 0 -3.402823466e+38 3.402823466e+38 ECU_ADDRESS 0 SYMBOL_LINK "Rte_GmMsg337BusChassisExp_SteerWhlAgReqTarAg_Val" 0 DISPLAY_IDENTIFIER GmOvrlStMgr.ReceiverPorts.HwAgTar.Val /end MEASUREMENT
/begin MEASUREMENT GmOvrlStMgr.HwAgTraj.Val "MICROSAR RTE" FLOAT32_IEEE NO_COMPU_METHOD 0 0 -3.402823466e+38 3.402823466e+38 ECU_ADDRESS 0 SYMBOL_LINK "Rte_HwAgTrajGenn_HwAgTrakgServoCmd_Val" 0 DISPLAY_IDENTIFIER GmOvrlStMgr.ReceiverPorts.HwAgTraj.Val /end MEASUREMENT
/begin MEASUREMENT GmOvrlStMgr.HwAgTrajEna.Logl "MICROSAR RTE" UBYTE RTE_CM_BOOLEAN 0 0 0 255 ECU_ADDRESS 0 SYMBOL_LINK "Rte_GmOvrlStMgr_HwAgTrajEna_Logl" 0 DISPLAY_IDENTIFIER GmOvrlStMgr.ReceiverPorts.HwAgTrajEna.Logl /end MEASUREMENT
/begin MEASUREMENT GmOvrlStMgr.HwHaptcEna.Logl "MICROSAR RTE" UBYTE RTE_CM_BOOLEAN 0 0 0 255 ECU_ADDRESS 0 SYMBOL_LINK "Rte_GmMsg337BusChassisExp_FbReqActv_Logl" 0 DISPLAY_IDENTIFIER GmOvrlStMgr.ReceiverPorts.HwHaptcEna.Logl /end MEASUREMENT
/begin MEASUREMENT GmOvrlStMgr.HwOscnEna.Logl "MICROSAR RTE" UBYTE RTE_CM_BOOLEAN 0 0 0 255 ECU_ADDRESS 0 SYMBOL_LINK "Rte_GmOvrlStMgr_HwOscnEna_Logl" 0 DISPLAY_IDENTIFIER GmOvrlStMgr.SenderPorts.HwOscnEna.Logl /end MEASUREMENT
/begin MEASUREMENT GmOvrlStMgr.HwOscnFrq.Val "MICROSAR RTE" FLOAT32_IEEE NO_COMPU_METHOD 0 0 -3.402823466e+38 3.402823466e+38 ECU_ADDRESS 0 SYMBOL_LINK "Rte_GmOvrlStMgr_HwOscnFrq_Val" 0 DISPLAY_IDENTIFIER GmOvrlStMgr.SenderPorts.HwOscnFrq.Val /end MEASUREMENT
/begin MEASUREMENT GmOvrlStMgr.HwOscnMotAmp.Val "MICROSAR RTE" FLOAT32_IEEE NO_COMPU_METHOD 0 0 -3.402823466e+38 3.402823466e+38 ECU_ADDRESS 0 SYMBOL_LINK "Rte_GmOvrlStMgr_HwOscnMotAmp_Val" 0 DISPLAY_IDENTIFIER GmOvrlStMgr.SenderPorts.HwOscnMotAmp.Val /end MEASUREMENT
/begin MEASUREMENT GmOvrlStMgr.HwTq.Val "MICROSAR RTE" FLOAT32_IEEE NO_COMPU_METHOD 0 0 -3.402823466e+38 3.402823466e+38 ECU_ADDRESS 0 SYMBOL_LINK "Rte_Swp_HwTqSwp_Val" 0 DISPLAY_IDENTIFIER GmOvrlStMgr.ReceiverPorts.HwTq.Val /end MEASUREMENT
/begin MEASUREMENT GmOvrlStMgr.HwTqLkaLpFil.FilGain "MICROSAR RTE" FLOAT32_IEEE NO_COMPU_METHOD 0 0 -3.402823466e+38 3.402823466e+38 ECU_ADDRESS 0 SYMBOL_LINK "Rte_GmOvrlStMgr_HwTqLkaLpFil.FilGain" 0 DISPLAY_IDENTIFIER GmOvrlStMgr.PerInstanceMemories.HwTqLkaLpFil.FilGain /end MEASUREMENT
/begin MEASUREMENT GmOvrlStMgr.HwTqLkaLpFil.FilSt "MICROSAR RTE" FLOAT32_IEEE NO_COMPU_METHOD 0 0 -3.402823466e+38 3.402823466e+38 ECU_ADDRESS 0 SYMBOL_LINK "Rte_GmOvrlStMgr_HwTqLkaLpFil.FilSt" 0 DISPLAY_IDENTIFIER GmOvrlStMgr.PerInstanceMemories.HwTqLkaLpFil.FilSt /end MEASUREMENT
/begin MEASUREMENT GmOvrlStMgr.HwTqLpFil.FilGain "MICROSAR RTE" FLOAT32_IEEE NO_COMPU_METHOD 0 0 -3.402823466e+38 3.402823466e+38 ECU_ADDRESS 0 SYMBOL_LINK "Rte_GmOvrlStMgr_HwTqLpFil.FilGain" 0 DISPLAY_IDENTIFIER GmOvrlStMgr.PerInstanceMemories.HwTqLpFil.FilGain /end MEASUREMENT
/begin MEASUREMENT GmOvrlStMgr.HwTqLpFil.FilSt "MICROSAR RTE" FLOAT32_IEEE NO_COMPU_METHOD 0 0 -3.402823466e+38 3.402823466e+38 ECU_ADDRESS 0 SYMBOL_LINK "Rte_GmOvrlStMgr_HwTqLpFil.FilSt" 0 DISPLAY_IDENTIFIER GmOvrlStMgr.PerInstanceMemories.HwTqLpFil.FilSt /end MEASUREMENT
/begin MEASUREMENT GmOvrlStMgr.HwTqOscSt.Val "MICROSAR RTE" UBYTE NO_COMPU_METHOD 0 0 0 255 ECU_ADDRESS 0 SYMBOL_LINK "Rte_GmOvrlStMgr_HwTqOscSt_Val" 0 DISPLAY_IDENTIFIER GmOvrlStMgr.SenderPorts.HwTqOscSt.Val /end MEASUREMENT
/begin MEASUREMENT GmOvrlStMgr.HwTqOscnLpFil.FilGain "MICROSAR RTE" FLOAT32_IEEE NO_COMPU_METHOD 0 0 -3.402823466e+38 3.402823466e+38 ECU_ADDRESS 0 SYMBOL_LINK "Rte_GmOvrlStMgr_HwTqOscnLpFil.FilGain" 0 DISPLAY_IDENTIFIER GmOvrlStMgr.PerInstanceMemories.HwTqOscnLpFil.FilGain /end MEASUREMENT
/begin MEASUREMENT GmOvrlStMgr.HwTqOscnLpFil.FilSt "MICROSAR RTE" FLOAT32_IEEE NO_COMPU_METHOD 0 0 -3.402823466e+38 3.402823466e+38 ECU_ADDRESS 0 SYMBOL_LINK "Rte_GmOvrlStMgr_HwTqOscnLpFil.FilSt" 0 DISPLAY_IDENTIFIER GmOvrlStMgr.PerInstanceMemories.HwTqOscnLpFil.FilSt /end MEASUREMENT
/begin MEASUREMENT GmOvrlStMgr.IgnCntrUpd "MICROSAR RTE" UBYTE RTE_CM_BOOLEAN 0 0 0 255 ECU_ADDRESS 0 SYMBOL_LINK "Rte_GmOvrlStMgr_IgnCntrUpd" 0 DISPLAY_IDENTIFIER GmOvrlStMgr.PerInstanceMemories.IgnCntrUpd /end MEASUREMENT
/begin MEASUREMENT GmOvrlStMgr.LkaEna.Logl "MICROSAR RTE" UBYTE RTE_CM_BOOLEAN 0 0 0 255 ECU_ADDRESS 0 SYMBOL_LINK "Rte_GmFctDiArbn_LkaEnaArbn_Logl" 0 DISPLAY_IDENTIFIER GmOvrlStMgr.ReceiverPorts.LkaEna.Logl /end MEASUREMENT
/begin MEASUREMENT GmOvrlStMgr.LkaFltCntr "MICROSAR RTE" UBYTE NO_COMPU_METHOD 0 0 0 255 ECU_ADDRESS 0 SYMBOL_LINK "Rte_GmOvrlStMgr_LkaFltCntr" 0 DISPLAY_IDENTIFIER GmOvrlStMgr.PerInstanceMemories.LkaFltCntr /end MEASUREMENT
/begin MEASUREMENT GmOvrlStMgr.LkaFltPrev "MICROSAR RTE" UBYTE RTE_CM_BOOLEAN 0 0 0 255 ECU_ADDRESS 0 SYMBOL_LINK "Rte_GmOvrlStMgr_LkaFltPrev" 0 DISPLAY_IDENTIFIER GmOvrlStMgr.PerInstanceMemories.LkaFltPrev /end MEASUREMENT
/begin MEASUREMENT GmOvrlStMgr.LkaFltRefTmr "MICROSAR RTE" ULONG NO_COMPU_METHOD 0 0 0 4294967295 ECU_ADDRESS 0 SYMBOL_LINK "Rte_GmOvrlStMgr_LkaFltRefTmr" 0 DISPLAY_IDENTIFIER GmOvrlStMgr.PerInstanceMemories.LkaFltRefTmr /end MEASUREMENT
/begin MEASUREMENT GmOvrlStMgr.LkaIntvPrev "MICROSAR RTE" UBYTE RTE_CM_BOOLEAN 0 0 0 255 ECU_ADDRESS 0 SYMBOL_LINK "Rte_GmOvrlStMgr_LkaIntvPrev" 0 DISPLAY_IDENTIFIER GmOvrlStMgr.PerInstanceMemories.LkaIntvPrev /end MEASUREMENT
/begin MEASUREMENT GmOvrlStMgr.LkaIntvRefTi1 "MICROSAR RTE" ULONG NO_COMPU_METHOD 0 0 0 4294967295 ECU_ADDRESS 0 SYMBOL_LINK "Rte_GmOvrlStMgr_LkaIntvRefTi1" 0 DISPLAY_IDENTIFIER GmOvrlStMgr.PerInstanceMemories.LkaIntvRefTi1 /end MEASUREMENT
/begin MEASUREMENT GmOvrlStMgr.LkaIntvRefTi2 "MICROSAR RTE" ULONG NO_COMPU_METHOD 0 0 0 4294967295 ECU_ADDRESS 0 SYMBOL_LINK "Rte_GmOvrlStMgr_LkaIntvRefTi2" 0 DISPLAY_IDENTIFIER GmOvrlStMgr.PerInstanceMemories.LkaIntvRefTi2 /end MEASUREMENT
/begin MEASUREMENT GmOvrlStMgr.LkaSt.Val "MICROSAR RTE" UBYTE NO_COMPU_METHOD 0 0 0 255 ECU_ADDRESS 0 SYMBOL_LINK "Rte_GmOvrlStMgr_LkaSt_Val" 0 DISPLAY_IDENTIFIER GmOvrlStMgr.SenderPorts.LkaSt.Val /end MEASUREMENT
/begin MEASUREMENT GmOvrlStMgr.LkaTqCmdCdnd.Val "MICROSAR RTE" FLOAT32_IEEE NO_COMPU_METHOD 0 0 -3.402823466e+38 3.402823466e+38 ECU_ADDRESS 0 SYMBOL_LINK "Rte_GmTqArbn_LkaTqCmdCdnd_Val" 0 DISPLAY_IDENTIFIER GmOvrlStMgr.ReceiverPorts.LkaTqCmdCdnd.Val /end MEASUREMENT
/begin MEASUREMENT GmOvrlStMgr.LoaMtgtnHaptcFbStrtOnRefTi "MICROSAR RTE" ULONG NO_COMPU_METHOD 0 0 0 4294967295 ECU_ADDRESS 0 SYMBOL_LINK "Rte_GmOvrlStMgr_LoaMtgtnHaptcFbStrtOnRefTi" 0 DISPLAY_IDENTIFIER GmOvrlStMgr.PerInstanceMemories.LoaMtgtnHaptcFbStrtOnRefTi /end MEASUREMENT
/begin MEASUREMENT GmOvrlStMgr.LoaSt.Val "MICROSAR RTE" UBYTE RTE_CM_ENUM_LoaSt1 0 0 0 255 ECU_ADDRESS 0 SYMBOL_LINK "Rte_LoaMgr_LoaSt_Val" 0 DISPLAY_IDENTIFIER GmOvrlStMgr.ReceiverPorts.LoaSt.Val /end MEASUREMENT
/begin MEASUREMENT GmOvrlStMgr.LoaStChk "MICROSAR RTE" UBYTE RTE_CM_BOOLEAN 0 0 0 255 ECU_ADDRESS 0 SYMBOL_LINK "Rte_GmOvrlStMgr_LoaStChk" 0 DISPLAY_IDENTIFIER GmOvrlStMgr.PerInstanceMemories.LoaStChk /end MEASUREMENT
/begin MEASUREMENT GmOvrlStMgr.MfgOvrlDi.Logl "MICROSAR RTE" UBYTE RTE_CM_BOOLEAN 0 0 0 255 ECU_ADDRESS 0 SYMBOL_LINK "Rte_CustDiagc_MfgOvrlDi_Logl" 0 DISPLAY_IDENTIFIER GmOvrlStMgr.ReceiverPorts.MfgOvrlDi.Logl /end MEASUREMENT
/begin MEASUREMENT GmOvrlStMgr.Msg17DBusHiSpdInvld.Logl "MICROSAR RTE" UBYTE RTE_CM_BOOLEAN 0 0 0 255 ECU_ADDRESS 0 SYMBOL_LINK "Rte_GmMsg17DBusHiSpd_InvldMsg17D_Logl" 0 DISPLAY_IDENTIFIER GmOvrlStMgr.ReceiverPorts.Msg17DBusHiSpdInvld.Logl /end MEASUREMENT
/begin MEASUREMENT GmOvrlStMgr.Msg17DBusHiSpdMiss.Logl "MICROSAR RTE" UBYTE RTE_CM_BOOLEAN 0 0 0 255 ECU_ADDRESS 0 SYMBOL_LINK "Rte_GmMsg17DBusHiSpd_MissMsg17D_Logl" 0 DISPLAY_IDENTIFIER GmOvrlStMgr.ReceiverPorts.Msg17DBusHiSpdMiss.Logl /end MEASUREMENT
/begin MEASUREMENT GmOvrlStMgr.Msg180BusChassisExpInvld.Logl "MICROSAR RTE" UBYTE RTE_CM_BOOLEAN 0 0 0 255 ECU_ADDRESS 0 SYMBOL_LINK "Rte_GmMsg180BusChassisExp_InvldMsg180BusChassisExp_Logl" 0 DISPLAY_IDENTIFIER GmOvrlStMgr.ReceiverPorts.Msg180BusChassisExpInvld.Logl /end MEASUREMENT
/begin MEASUREMENT GmOvrlStMgr.Msg180BusChassisExpMiss.Logl "MICROSAR RTE" UBYTE RTE_CM_BOOLEAN 0 0 0 255 ECU_ADDRESS 0 SYMBOL_LINK "Rte_GmMsg180BusChassisExp_MissMsg180BusChassisExp_Logl" 0 DISPLAY_IDENTIFIER GmOvrlStMgr.ReceiverPorts.Msg180BusChassisExpMiss.Logl /end MEASUREMENT
/begin MEASUREMENT GmOvrlStMgr.Msg180BusHiSpdInvld.Logl "MICROSAR RTE" UBYTE RTE_CM_BOOLEAN 0 0 0 255 ECU_ADDRESS 0 SYMBOL_LINK "Rte_GmMsg180BusHiSpd_InvldMsg180BusHiSpd_Logl" 0 DISPLAY_IDENTIFIER GmOvrlStMgr.ReceiverPorts.Msg180BusHiSpdInvld.Logl /end MEASUREMENT
/begin MEASUREMENT GmOvrlStMgr.Msg180BusHiSpdMiss.Logl "MICROSAR RTE" UBYTE RTE_CM_BOOLEAN 0 0 0 255 ECU_ADDRESS 0 SYMBOL_LINK "Rte_GmMsg180BusHiSpd_MissMsg180BusHiSpd_Logl" 0 DISPLAY_IDENTIFIER GmOvrlStMgr.ReceiverPorts.Msg180BusHiSpdMiss.Logl /end MEASUREMENT
/begin MEASUREMENT GmOvrlStMgr.Msg1E9BusHiSpdInvld.Logl "MICROSAR RTE" UBYTE RTE_CM_BOOLEAN 0 0 0 255 ECU_ADDRESS 0 SYMBOL_LINK "Rte_GmMsg1E9BusHiSpd_InvldMsg1E9_Logl" 0 DISPLAY_IDENTIFIER GmOvrlStMgr.ReceiverPorts.Msg1E9BusHiSpdInvld.Logl /end MEASUREMENT
/begin MEASUREMENT GmOvrlStMgr.Msg1E9BusHiSpdMiss.Logl "MICROSAR RTE" UBYTE RTE_CM_BOOLEAN 0 0 0 255 ECU_ADDRESS 0 SYMBOL_LINK "Rte_GmMsg1E9BusHiSpd_MissMsg1E9_Logl" 0 DISPLAY_IDENTIFIER GmOvrlStMgr.ReceiverPorts.Msg1E9BusHiSpdMiss.Logl /end MEASUREMENT
/begin MEASUREMENT GmOvrlStMgr.Msg1F5BusHiSpdInvld.Logl "MICROSAR RTE" UBYTE RTE_CM_BOOLEAN 0 0 0 255 ECU_ADDRESS 0 SYMBOL_LINK "Rte_GmMsg1F5BusHiSpd_InvldMsg1F5_Logl" 0 DISPLAY_IDENTIFIER GmOvrlStMgr.ReceiverPorts.Msg1F5BusHiSpdInvld.Logl /end MEASUREMENT
/begin MEASUREMENT GmOvrlStMgr.Msg214BusHiSpdInvld.Logl "MICROSAR RTE" UBYTE RTE_CM_BOOLEAN 0 0 0 255 ECU_ADDRESS 0 SYMBOL_LINK "Rte_GmMsg214BusHiSpd_VehStabyEnhmtInvld_Logl" 0 DISPLAY_IDENTIFIER GmOvrlStMgr.ReceiverPorts.Msg214BusHiSpdInvld.Logl /end MEASUREMENT
/begin MEASUREMENT GmOvrlStMgr.Msg214BusHiSpdMiss.Logl "MICROSAR RTE" UBYTE RTE_CM_BOOLEAN 0 0 0 255 ECU_ADDRESS 0 SYMBOL_LINK "Rte_GmMsg214BusHiSpd_MissMsg214_Logl" 0 DISPLAY_IDENTIFIER GmOvrlStMgr.ReceiverPorts.Msg214BusHiSpdMiss.Logl /end MEASUREMENT
/begin MEASUREMENT GmOvrlStMgr.Msg337BusChassisExpInvld.Logl "MICROSAR RTE" UBYTE RTE_CM_BOOLEAN 0 0 0 255 ECU_ADDRESS 0 SYMBOL_LINK "Rte_GmMsg337BusChassisExp_InvldMsg337_Logl" 0 DISPLAY_IDENTIFIER GmOvrlStMgr.ReceiverPorts.Msg337BusChassisExpInvld.Logl /end MEASUREMENT
/begin MEASUREMENT GmOvrlStMgr.Msg337BusChassisExpMiss.Logl "MICROSAR RTE" UBYTE RTE_CM_BOOLEAN 0 0 0 255 ECU_ADDRESS 0 SYMBOL_LINK "Rte_GmMsg337BusChassisExp_MissMsg337_Logl" 0 DISPLAY_IDENTIFIER GmOvrlStMgr.ReceiverPorts.Msg337BusChassisExpMiss.Logl /end MEASUREMENT
/begin MEASUREMENT GmOvrlStMgr.PrevApaIntvEna "MICROSAR RTE" UBYTE RTE_CM_BOOLEAN 0 0 0 255 ECU_ADDRESS 0 SYMBOL_LINK "Rte_GmOvrlStMgr_PrevApaIntvEna" 0 DISPLAY_IDENTIFIER GmOvrlStMgr.PerInstanceMemories.PrevApaIntvEna /end MEASUREMENT
/begin MEASUREMENT GmOvrlStMgr.PrevApaIntvRefTi "MICROSAR RTE" ULONG NO_COMPU_METHOD 0 0 0 4294967295 ECU_ADDRESS 0 SYMBOL_LINK "Rte_GmOvrlStMgr_PrevApaIntvRefTi" 0 DISPLAY_IDENTIFIER GmOvrlStMgr.PerInstanceMemories.PrevApaIntvRefTi /end MEASUREMENT
/begin MEASUREMENT GmOvrlStMgr.PrevApaSt "MICROSAR RTE" UBYTE NO_COMPU_METHOD 0 0 0 255 ECU_ADDRESS 0 SYMBOL_LINK "Rte_GmOvrlStMgr_PrevApaSt" 0 DISPLAY_IDENTIFIER GmOvrlStMgr.PerInstanceMemories.PrevApaSt /end MEASUREMENT
/begin MEASUREMENT GmOvrlStMgr.PrevEscSt "MICROSAR RTE" UBYTE NO_COMPU_METHOD 0 0 0 255 ECU_ADDRESS 0 SYMBOL_LINK "Rte_GmOvrlStMgr_PrevEscSt" 0 DISPLAY_IDENTIFIER GmOvrlStMgr.PerInstanceMemories.PrevEscSt /end MEASUREMENT
/begin MEASUREMENT GmOvrlStMgr.PrevHaptcReqEna "MICROSAR RTE" UBYTE RTE_CM_BOOLEAN 0 0 0 255 ECU_ADDRESS 0 SYMBOL_LINK "Rte_GmOvrlStMgr_PrevHaptcReqEna" 0 DISPLAY_IDENTIFIER GmOvrlStMgr.PerInstanceMemories.PrevHaptcReqEna /end MEASUREMENT
/begin MEASUREMENT GmOvrlStMgr.PrevHaptcReqRefTi "MICROSAR RTE" ULONG NO_COMPU_METHOD 0 0 0 4294967295 ECU_ADDRESS 0 SYMBOL_LINK "Rte_GmOvrlStMgr_PrevHaptcReqRefTi" 0 DISPLAY_IDENTIFIER GmOvrlStMgr.PerInstanceMemories.PrevHaptcReqRefTi /end MEASUREMENT
/begin MEASUREMENT GmOvrlStMgr.PrevHaptcSt "MICROSAR RTE" UBYTE NO_COMPU_METHOD 0 0 0 255 ECU_ADDRESS 0 SYMBOL_LINK "Rte_GmOvrlStMgr_PrevHaptcSt" 0 DISPLAY_IDENTIFIER GmOvrlStMgr.PerInstanceMemories.PrevHaptcSt /end MEASUREMENT
/begin MEASUREMENT GmOvrlStMgr.PrevLkaFlt "MICROSAR RTE" UBYTE RTE_CM_BOOLEAN 0 0 0 255 ECU_ADDRESS 0 SYMBOL_LINK "Rte_GmOvrlStMgr_PrevLkaFlt" 0 DISPLAY_IDENTIFIER GmOvrlStMgr.PerInstanceMemories.PrevLkaFlt /end MEASUREMENT
/begin MEASUREMENT GmOvrlStMgr.PrevLkaSt "MICROSAR RTE" UBYTE NO_COMPU_METHOD 0 0 0 255 ECU_ADDRESS 0 SYMBOL_LINK "Rte_GmOvrlStMgr_PrevLkaSt" 0 DISPLAY_IDENTIFIER GmOvrlStMgr.PerInstanceMemories.PrevLkaSt /end MEASUREMENT
/begin MEASUREMENT GmOvrlStMgr.PrevShiftLvrRvsEna "MICROSAR RTE" UBYTE RTE_CM_BOOLEAN 0 0 0 255 ECU_ADDRESS 0 SYMBOL_LINK "Rte_GmOvrlStMgr_PrevShiftLvrRvsEna" 0 DISPLAY_IDENTIFIER GmOvrlStMgr.PerInstanceMemories.PrevShiftLvrRvsEna /end MEASUREMENT
/begin MEASUREMENT GmOvrlStMgr.PrevShiftLvrRvsRefTi "MICROSAR RTE" ULONG NO_COMPU_METHOD 0 0 0 4294967295 ECU_ADDRESS 0 SYMBOL_LINK "Rte_GmOvrlStMgr_PrevShiftLvrRvsRefTi" 0 DISPLAY_IDENTIFIER GmOvrlStMgr.PerInstanceMemories.PrevShiftLvrRvsRefTi /end MEASUREMENT
/begin MEASUREMENT GmOvrlStMgr.PrevVehStandStillEna "MICROSAR RTE" UBYTE RTE_CM_BOOLEAN 0 0 0 255 ECU_ADDRESS 0 SYMBOL_LINK "Rte_GmOvrlStMgr_PrevVehStandStillEna" 0 DISPLAY_IDENTIFIER GmOvrlStMgr.PerInstanceMemories.PrevVehStandStillEna /end MEASUREMENT
/begin MEASUREMENT GmOvrlStMgr.PrevVehStandStillRefTi "MICROSAR RTE" ULONG NO_COMPU_METHOD 0 0 0 4294967295 ECU_ADDRESS 0 SYMBOL_LINK "Rte_GmOvrlStMgr_PrevVehStandStillRefTi" 0 DISPLAY_IDENTIFIER GmOvrlStMgr.PerInstanceMemories.PrevVehStandStillRefTi /end MEASUREMENT
/begin MEASUREMENT GmOvrlStMgr.ShiftLvrRvs.Logl "MICROSAR RTE" UBYTE RTE_CM_BOOLEAN 0 0 0 255 ECU_ADDRESS 0 SYMBOL_LINK "Rte_GmMsg1F5BusHiSpd_ShiftLvrInRvs_Logl" 0 DISPLAY_IDENTIFIER GmOvrlStMgr.ReceiverPorts.ShiftLvrRvs.Logl /end MEASUREMENT
/begin MEASUREMENT GmOvrlStMgr.SysSt.Val "MICROSAR RTE" UBYTE RTE_CM_ENUM_SysSt1 0 0 0 255 ECU_ADDRESS 0 SYMBOL_LINK "Rte_SysStMod_SysSt_Val" 0 DISPLAY_IDENTIFIER GmOvrlStMgr.ReceiverPorts.SysSt.Val /end MEASUREMENT
/begin MEASUREMENT GmOvrlStMgr.TqOscCycRefTi "MICROSAR RTE" ULONG NO_COMPU_METHOD 0 0 0 4294967295 ECU_ADDRESS 0 SYMBOL_LINK "Rte_GmOvrlStMgr_TqOscCycRefTi" 0 DISPLAY_IDENTIFIER GmOvrlStMgr.PerInstanceMemories.TqOscCycRefTi /end MEASUREMENT
/begin MEASUREMENT GmOvrlStMgr.TranHaptcWaitToApaStActvRefTi "MICROSAR RTE" ULONG NO_COMPU_METHOD 0 0 0 4294967295 ECU_ADDRESS 0 SYMBOL_LINK "Rte_GmOvrlStMgr_TranHaptcWaitToApaStActvRefTi" 0 DISPLAY_IDENTIFIER GmOvrlStMgr.PerInstanceMemories.TranHaptcWaitToApaStActvRefTi /end MEASUREMENT
/begin MEASUREMENT GmOvrlStMgr.VehSpd.Val "MICROSAR RTE" FLOAT32_IEEE NO_COMPU_METHOD 0 0 -3.402823466e+38 3.402823466e+38 ECU_ADDRESS 0 SYMBOL_LINK "Rte_VehSigCdng_VehSpd_Val" 0 DISPLAY_IDENTIFIER GmOvrlStMgr.ReceiverPorts.VehSpd.Val /end MEASUREMENT
/begin MEASUREMENT GmOvrlStMgr.VehSpdSecurMax.Val "MICROSAR RTE" FLOAT32_IEEE NO_COMPU_METHOD 0 0 -3.402823466e+38 3.402823466e+38 ECU_ADDRESS 0 SYMBOL_LINK "Rte_GmVehSpdArbn_VehSpdMaxSecur_Val" 0 DISPLAY_IDENTIFIER GmOvrlStMgr.ReceiverPorts.VehSpdSecurMax.Val /end MEASUREMENT
/begin GROUP GmMsg337BusChassisExp.GmMsg337BusChassisExpAgReqRollgCntrInvldTmr "MICROSAR RTE" /begin SUB_GROUP /end SUB_GROUP /begin FUNCTION_LIST /end FUNCTION_LIST /begin REF_CHARACTERISTIC /end REF_CHARACTERISTIC
 /begin REF_MEASUREMENT GmMsg337BusChassisExp.GmMsg337BusChassisExpAgReqRollgCntrInvldTmr /end REF_MEASUREMENT
/end GROUP
/begin GROUP GmMsg337BusChassisExp.GmMsg337BusChassisExpFbProtnValInvldTmr "MICROSAR RTE" /begin SUB_GROUP /end SUB_GROUP /begin FUNCTION_LIST /end FUNCTION_LIST /begin REF_CHARACTERISTIC /end REF_CHARACTERISTIC
 /begin REF_MEASUREMENT GmMsg337BusChassisExp.GmMsg337BusChassisExpFbProtnValInvldTmr /end REF_MEASUREMENT
/end GROUP
/begin GROUP GmMsg337BusChassisExp.GmMsg337BusChassisExpFbRollgCntrInvldTmr "MICROSAR RTE" /begin SUB_GROUP /end SUB_GROUP /begin FUNCTION_LIST /end FUNCTION_LIST /begin REF_CHARACTERISTIC /end REF_CHARACTERISTIC
 /begin REF_MEASUREMENT GmMsg337BusChassisExp.GmMsg337BusChassisExpFbRollgCntrInvldTmr /end REF_MEASUREMENT
/end GROUP
/begin GROUP GmMsg337BusChassisExp.GmMsg337BusChassisExpInvldDiagcTiOut.Val "MICROSAR RTE" /begin SUB_GROUP /end SUB_GROUP /begin FUNCTION_LIST /end FUNCTION_LIST
 /begin REF_CHARACTERISTIC GmMsg337BusChassisExp.GmMsg337BusChassisExpInvldDiagcTiOut.Val /end REF_CHARACTERISTIC
 /begin REF_MEASUREMENT /end REF_MEASUREMENT
/end GROUP
/begin GROUP GmMsg337BusChassisExp.GmMsg337BusChassisExpInvldProtnValTiOut.Val "MICROSAR RTE" /begin SUB_GROUP /end SUB_GROUP /begin FUNCTION_LIST /end FUNCTION_LIST
 /begin REF_CHARACTERISTIC GmMsg337BusChassisExp.GmMsg337BusChassisExpInvldProtnValTiOut.Val /end REF_CHARACTERISTIC
 /begin REF_MEASUREMENT /end REF_MEASUREMENT
/end GROUP
/begin GROUP GmMsg337BusChassisExp.GmMsg337BusChassisExpInvldRollgCntrTiOut.Val "MICROSAR RTE" /begin SUB_GROUP /end SUB_GROUP /begin FUNCTION_LIST /end FUNCTION_LIST
 /begin REF_CHARACTERISTIC GmMsg337BusChassisExp.GmMsg337BusChassisExpInvldRollgCntrTiOut.Val /end REF_CHARACTERISTIC
 /begin REF_MEASUREMENT /end REF_MEASUREMENT
/end GROUP
/begin GROUP GmMsg337BusChassisExp.GmMsg337BusChassisExpInvldTmr "MICROSAR RTE" /begin SUB_GROUP /end SUB_GROUP /begin FUNCTION_LIST /end FUNCTION_LIST /begin REF_CHARACTERISTIC /end REF_CHARACTERISTIC /begin REF_MEASUREMENT GmMsg337BusChassisExp.GmMsg337BusChassisExpInvldTmr /end REF_MEASUREMENT /end GROUP
/begin GROUP GmMsg337BusChassisExp.GmMsg337BusChassisExpMissTiOut.Val "MICROSAR RTE" /begin SUB_GROUP /end SUB_GROUP /begin FUNCTION_LIST /end FUNCTION_LIST /begin REF_CHARACTERISTIC GmMsg337BusChassisExp.GmMsg337BusChassisExpMissTiOut.Val /end REF_CHARACTERISTIC /begin REF_MEASUREMENT /end REF_MEASUREMENT /end GROUP
/begin GROUP GmMsg337BusChassisExp.GmMsg337BusChassisExpPrevAgReqRollgCntVal "MICROSAR RTE" /begin SUB_GROUP /end SUB_GROUP /begin FUNCTION_LIST /end FUNCTION_LIST /begin REF_CHARACTERISTIC /end REF_CHARACTERISTIC
 /begin REF_MEASUREMENT GmMsg337BusChassisExp.GmMsg337BusChassisExpPrevAgReqRollgCntVal /end REF_MEASUREMENT
/end GROUP
/begin GROUP GmMsg337BusChassisExp.GmMsg337BusChassisExpPrevFbReqRollgCntVal "MICROSAR RTE" /begin SUB_GROUP /end SUB_GROUP /begin FUNCTION_LIST /end FUNCTION_LIST /begin REF_CHARACTERISTIC /end REF_CHARACTERISTIC
 /begin REF_MEASUREMENT GmMsg337BusChassisExp.GmMsg337BusChassisExpPrevFbReqRollgCntVal /end REF_MEASUREMENT
/end GROUP
/begin GROUP GmMsg337BusChassisExp.GmMsg337BusChassisExpPrevInvld "MICROSAR RTE" /begin SUB_GROUP /end SUB_GROUP /begin FUNCTION_LIST /end FUNCTION_LIST /begin REF_CHARACTERISTIC /end REF_CHARACTERISTIC /begin REF_MEASUREMENT GmMsg337BusChassisExp.GmMsg337BusChassisExpPrevInvld /end REF_MEASUREMENT /end GROUP
/begin GROUP GmMsg337BusChassisExp.GmMsg337BusChassisExpPrevRxnTi "MICROSAR RTE" /begin SUB_GROUP /end SUB_GROUP /begin FUNCTION_LIST /end FUNCTION_LIST /begin REF_CHARACTERISTIC /end REF_CHARACTERISTIC /begin REF_MEASUREMENT GmMsg337BusChassisExp.GmMsg337BusChassisExpPrevRxnTi /end REF_MEASUREMENT /end GROUP
/begin GROUP GmMsg337BusChassisExp.GmMsg337BusChassisExpRollgCntrRst "MICROSAR RTE" /begin SUB_GROUP /end SUB_GROUP /begin FUNCTION_LIST /end FUNCTION_LIST /begin REF_CHARACTERISTIC /end REF_CHARACTERISTIC /begin REF_MEASUREMENT GmMsg337BusChassisExp.GmMsg337BusChassisExpRollgCntrRst /end REF_MEASUREMENT /end GROUP
/begin GROUP GmMsg337BusChassisExp.GmMsg337BusChassisExpTarAgPolarity.Val "MICROSAR RTE" /begin SUB_GROUP /end SUB_GROUP /begin FUNCTION_LIST /end FUNCTION_LIST
 /begin REF_CHARACTERISTIC GmMsg337BusChassisExp.GmMsg337BusChassisExpTarAgPolarity.Val /end REF_CHARACTERISTIC
 /begin REF_MEASUREMENT /end REF_MEASUREMENT
/end GROUP
/begin GROUP GmMsg337BusChassisExp.InvldMsg337.Logl "MICROSAR RTE" /begin SUB_GROUP /end SUB_GROUP /begin FUNCTION_LIST /end FUNCTION_LIST /begin REF_CHARACTERISTIC /end REF_CHARACTERISTIC /begin REF_MEASUREMENT GmMsg337BusChassisExp.InvldMsg337.Logl /end REF_MEASUREMENT /end GROUP
/begin GROUP GmMsg337BusChassisExp.LstRxnTiMsg337BusChassisExp.Val "MICROSAR RTE" /begin SUB_GROUP /end SUB_GROUP /begin FUNCTION_LIST /end FUNCTION_LIST /begin REF_CHARACTERISTIC /end REF_CHARACTERISTIC /begin REF_MEASUREMENT GmMsg337BusChassisExp.LstRxnTiMsg337BusChassisExp.Val /end REF_MEASUREMENT /end GROUP
/begin GROUP GmMsg337BusChassisExp.MissMsg337.Logl "MICROSAR RTE" /begin SUB_GROUP /end SUB_GROUP /begin FUNCTION_LIST /end FUNCTION_LIST /begin REF_CHARACTERISTIC /end REF_CHARACTERISTIC /begin REF_MEASUREMENT GmMsg337BusChassisExp.MissMsg337.Logl /end REF_MEASUREMENT /end GROUP
/begin GROUP GmMsg337BusChassisExp.PerInstanceMemories "MICROSAR RTE"
 /begin SUB_GROUP GmMsg337BusChassisExp.GmMsg337BusChassisExpAgReqProtnValInvldTmr GmMsg337BusChassisExp.GmMsg337BusChassisExpAgReqRollgCntrInvldTmr GmMsg337BusChassisExp.GmMsg337BusChassisExpFbProtnValInvldTmr GmMsg337BusChassisExp.GmMsg337BusChassisExpFbRollgCntrInvldTmr GmMsg337BusChassisExp.GmMsg337BusChassisExpInvldTmr GmMsg337BusChassisExp.GmMsg337BusChassisExpPrevAgReqRollgCntVal GmMsg337BusChassisExp.GmMsg337BusChassisExpPrevFbReqRollgCntVal GmMsg337BusChassisExp.GmMsg337BusChassisExpPrevInvld GmMsg337BusChassisExp.GmMsg337BusChassisExpPrevRxnTi GmMsg337BusChassisExp.GmMsg337BusChassisExpRollgCntrRst /end SUB_GROUP
 /begin FUNCTION_LIST /end FUNCTION_LIST
 /begin REF_CHARACTERISTIC /end REF_CHARACTERISTIC
 /begin REF_MEASUREMENT /end REF_MEASUREMENT
/end GROUP
/begin GROUP GmMsg337BusChassisExp.ReceiverPorts "MICROSAR RTE"
 /begin SUB_GROUP GmMsg337BusChassisExp.LstRxnTiMsg337BusChassisExp.Val GmMsg337BusChassisExp.SteerWhlAgReqActvRaw.Val GmMsg337BusChassisExp.SteerWhlAgReqActvVldRaw.Val GmMsg337BusChassisExp.SteerWhlAgReqProtnValRaw.Val GmMsg337BusChassisExp.SteerWhlAgReqRollgCntrRaw.Val GmMsg337BusChassisExp.SteerWhlAgReqTarAgRaw.Val GmMsg337BusChassisExp.SteerWhlFbReqActvProtnValRaw.Val GmMsg337BusChassisExp.SteerWhlFbReqActvRaw.Val GmMsg337BusChassisExp.SteerWhlFbReqActvRollgCntrRaw.Val /end SUB_GROUP
 /begin FUNCTION_LIST /end FUNCTION_LIST
 /begin REF_CHARACTERISTIC /end REF_CHARACTERISTIC
 /begin REF_MEASUREMENT /end REF_MEASUREMENT
/end GROUP
/begin GROUP GmMsg337BusChassisExp.SenderPorts "MICROSAR RTE"
 /begin SUB_GROUP GmMsg337BusChassisExp.ApaReqActv.Logl GmMsg337BusChassisExp.FbReqActv.Logl GmMsg337BusChassisExp.InvldMsg337.Logl GmMsg337BusChassisExp.MissMsg337.Logl GmMsg337BusChassisExp.SteerWhlAgReqTarAg.Val /end SUB_GROUP
 /begin FUNCTION_LIST /end FUNCTION_LIST
 /begin REF_CHARACTERISTIC /end REF_CHARACTERISTIC
 /begin REF_MEASUREMENT /end REF_MEASUREMENT
/end GROUP
/begin GROUP GmMsg337BusChassisExp.SteerWhlAgReqActvRaw.Val "MICROSAR RTE" /begin SUB_GROUP /end SUB_GROUP /begin FUNCTION_LIST /end FUNCTION_LIST /begin REF_CHARACTERISTIC /end REF_CHARACTERISTIC /begin REF_MEASUREMENT GmMsg337BusChassisExp.SteerWhlAgReqActvRaw.Val /end REF_MEASUREMENT /end GROUP
/begin GROUP GmMsg337BusChassisExp.SteerWhlAgReqActvVldRaw.Val "MICROSAR RTE" /begin SUB_GROUP /end SUB_GROUP /begin FUNCTION_LIST /end FUNCTION_LIST /begin REF_CHARACTERISTIC /end REF_CHARACTERISTIC /begin REF_MEASUREMENT GmMsg337BusChassisExp.SteerWhlAgReqActvVldRaw.Val /end REF_MEASUREMENT /end GROUP
/begin GROUP GmMsg337BusChassisExp.SteerWhlAgReqProtnValRaw.Val "MICROSAR RTE" /begin SUB_GROUP /end SUB_GROUP /begin FUNCTION_LIST /end FUNCTION_LIST /begin REF_CHARACTERISTIC /end REF_CHARACTERISTIC /begin REF_MEASUREMENT GmMsg337BusChassisExp.SteerWhlAgReqProtnValRaw.Val /end REF_MEASUREMENT /end GROUP
/begin GROUP GmMsg337BusChassisExp.SteerWhlAgReqRollgCntrRaw.Val "MICROSAR RTE" /begin SUB_GROUP /end SUB_GROUP /begin FUNCTION_LIST /end FUNCTION_LIST /begin REF_CHARACTERISTIC /end REF_CHARACTERISTIC /begin REF_MEASUREMENT GmMsg337BusChassisExp.SteerWhlAgReqRollgCntrRaw.Val /end REF_MEASUREMENT /end GROUP
/begin GROUP GmMsg337BusChassisExp.SteerWhlAgReqTarAg.Val "MICROSAR RTE" /begin SUB_GROUP /end SUB_GROUP /begin FUNCTION_LIST /end FUNCTION_LIST /begin REF_CHARACTERISTIC /end REF_CHARACTERISTIC /begin REF_MEASUREMENT GmMsg337BusChassisExp.SteerWhlAgReqTarAg.Val /end REF_MEASUREMENT /end GROUP
/begin GROUP GmMsg337BusChassisExp.SteerWhlAgReqTarAgRaw.Val "MICROSAR RTE" /begin SUB_GROUP /end SUB_GROUP /begin FUNCTION_LIST /end FUNCTION_LIST /begin REF_CHARACTERISTIC /end REF_CHARACTERISTIC /begin REF_MEASUREMENT GmMsg337BusChassisExp.SteerWhlAgReqTarAgRaw.Val /end REF_MEASUREMENT /end GROUP
/begin GROUP GmMsg337BusChassisExp.SteerWhlFbReqActvProtnValRaw.Val "MICROSAR RTE" /begin SUB_GROUP /end SUB_GROUP /begin FUNCTION_LIST /end FUNCTION_LIST /begin REF_CHARACTERISTIC /end REF_CHARACTERISTIC /begin REF_MEASUREMENT GmMsg337BusChassisExp.SteerWhlFbReqActvProtnValRaw.Val /end REF_MEASUREMENT /end GROUP
/begin GROUP GmMsg337BusChassisExp.SteerWhlFbReqActvRaw.Val "MICROSAR RTE" /begin SUB_GROUP /end SUB_GROUP /begin FUNCTION_LIST /end FUNCTION_LIST /begin REF_CHARACTERISTIC /end REF_CHARACTERISTIC /begin REF_MEASUREMENT GmMsg337BusChassisExp.SteerWhlFbReqActvRaw.Val /end REF_MEASUREMENT /end GROUP
/begin GROUP GmMsg337BusChassisExp.SteerWhlFbReqActvRollgCntrRaw.Val "MICROSAR RTE" /begin SUB_GROUP /end SUB_GROUP /begin FUNCTION_LIST /end FUNCTION_LIST /begin REF_CHARACTERISTIC /end REF_CHARACTERISTIC /begin REF_MEASUREMENT GmMsg337BusChassisExp.SteerWhlFbReqActvRollgCntrRaw.Val /end REF_MEASUREMENT /end GROUP
/begin GROUP GmMsg348BusChassisExp "MICROSAR RTE"
 /begin SUB_GROUP GmMsg348BusChassisExp.CalibrationPorts GmMsg348BusChassisExp.PerInstanceMemories GmMsg348BusChassisExp.ReceiverPorts GmMsg348BusChassisExp.SenderPorts /end SUB_GROUP
 /begin FUNCTION_LIST /end FUNCTION_LIST
 /begin REF_CHARACTERISTIC /end REF_CHARACTERISTIC
 /begin REF_MEASUREMENT /end REF_MEASUREMENT
/end GROUP
/begin GROUP GmMsg348BusChassisExp.CalibrationPorts "MICROSAR RTE"
 /begin SUB_GROUP GmMsg348BusChassisExp.GmMsg348BusChassisExpInvldTiOut.Val GmMsg348BusChassisExp.GmMsg348BusChassisExpMissTiOut.Val GmMsg348BusChassisExp.GmMsg348BusChassisExpStuckTiOut.Val /end SUB_GROUP
 /begin FUNCTION_LIST /end FUNCTION_LIST
 /begin REF_CHARACTERISTIC /end REF_CHARACTERISTIC
 /begin REF_MEASUREMENT /end REF_MEASUREMENT
/end GROUP
/begin GROUP GmMsg348BusChassisExp.GmMsg348BusChassisExpInvldTiOut.Val "MICROSAR RTE" /begin SUB_GROUP /end SUB_GROUP /begin FUNCTION_LIST /end FUNCTION_LIST /begin REF_CHARACTERISTIC GmMsg348BusChassisExp.GmMsg348BusChassisExpInvldTiOut.Val /end REF_CHARACTERISTIC /begin REF_MEASUREMENT /end REF_MEASUREMENT /end GROUP
/begin GROUP GmMsg348BusChassisExp.GmMsg348BusChassisExpMissTiOut.Val "MICROSAR RTE" /begin SUB_GROUP /end SUB_GROUP /begin FUNCTION_LIST /end FUNCTION_LIST /begin REF_CHARACTERISTIC GmMsg348BusChassisExp.GmMsg348BusChassisExpMissTiOut.Val /end REF_CHARACTERISTIC /begin REF_MEASUREMENT /end REF_MEASUREMENT /end GROUP
/begin GROUP GmMsg348BusChassisExp.GmMsg348BusChassisExpPrevWhlGndVelLeDrvn "MICROSAR RTE" /begin SUB_GROUP /end SUB_GROUP /begin FUNCTION_LIST /end FUNCTION_LIST /begin REF_CHARACTERISTIC /end REF_CHARACTERISTIC
 /begin REF_MEASUREMENT GmMsg348BusChassisExp.GmMsg348BusChassisExpPrevWhlGndVelLeDrvn /end REF_MEASUREMENT
/end GROUP
/begin GROUP GmMsg348BusChassisExp.GmMsg348BusChassisExpPrevWhlGndVelRiDrvn "MICROSAR RTE" /begin SUB_GROUP /end SUB_GROUP /begin FUNCTION_LIST /end FUNCTION_LIST /begin REF_CHARACTERISTIC /end REF_CHARACTERISTIC
 /begin REF_MEASUREMENT GmMsg348BusChassisExp.GmMsg348BusChassisExpPrevWhlGndVelRiDrvn /end REF_MEASUREMENT
/end GROUP
/begin GROUP GmMsg348BusChassisExp.GmMsg348BusChassisExpStuckTiOut.Val "MICROSAR RTE" /begin SUB_GROUP /end SUB_GROUP /begin FUNCTION_LIST /end FUNCTION_LIST /begin REF_CHARACTERISTIC GmMsg348BusChassisExp.GmMsg348BusChassisExpStuckTiOut.Val /end REF_CHARACTERISTIC /begin REF_MEASUREMENT /end REF_MEASUREMENT /end GROUP
/begin GROUP GmMsg348BusChassisExp.GmMsg348BusChassisExpWhlGndVelLeDrvnInvldTi "MICROSAR RTE" /begin SUB_GROUP /end SUB_GROUP /begin FUNCTION_LIST /end FUNCTION_LIST /begin REF_CHARACTERISTIC /end REF_CHARACTERISTIC
 /begin REF_MEASUREMENT GmMsg348BusChassisExp.GmMsg348BusChassisExpWhlGndVelLeDrvnInvldTi /end REF_MEASUREMENT
/end GROUP
/begin GROUP GmMsg348BusChassisExp.GmMsg348BusChassisExpWhlGndVelLeDrvnStuckTi "MICROSAR RTE" /begin SUB_GROUP /end SUB_GROUP /begin FUNCTION_LIST /end FUNCTION_LIST /begin REF_CHARACTERISTIC /end REF_CHARACTERISTIC
 /begin REF_MEASUREMENT GmMsg348BusChassisExp.GmMsg348BusChassisExpWhlGndVelLeDrvnStuckTi /end REF_MEASUREMENT
/end GROUP
/begin GROUP GmMsg348BusChassisExp.GmMsg348BusChassisExpWhlGndVelRiDrvnInvldTi "MICROSAR RTE" /begin SUB_GROUP /end SUB_GROUP /begin FUNCTION_LIST /end FUNCTION_LIST /begin REF_CHARACTERISTIC /end REF_CHARACTERISTIC
 /begin REF_MEASUREMENT GmMsg348BusChassisExp.GmMsg348BusChassisExpWhlGndVelRiDrvnInvldTi /end REF_MEASUREMENT
/end GROUP
/begin GROUP GmMsg348BusChassisExp.GmMsg348BusChassisExpWhlGndVelRiDrvnStuckTi "MICROSAR RTE" /begin SUB_GROUP /end SUB_GROUP /begin FUNCTION_LIST /end FUNCTION_LIST /begin REF_CHARACTERISTIC /end REF_CHARACTERISTIC
 /begin REF_MEASUREMENT GmMsg348BusChassisExp.GmMsg348BusChassisExpWhlGndVelRiDrvnStuckTi /end REF_MEASUREMENT
/end GROUP
/begin GROUP GmMsg348BusChassisExp.LstRxnTiMsg348BusChassisExp.Val "MICROSAR RTE" /begin SUB_GROUP /end SUB_GROUP /begin FUNCTION_LIST /end FUNCTION_LIST /begin REF_CHARACTERISTIC /end REF_CHARACTERISTIC /begin REF_MEASUREMENT GmMsg348BusChassisExp.LstRxnTiMsg348BusChassisExp.Val /end REF_MEASUREMENT /end GROUP
/begin GROUP GmMsg348BusChassisExp.PerInstanceMemories "MICROSAR RTE"
 /begin SUB_GROUP GmMsg348BusChassisExp.GmMsg348BusChassisExpPrevWhlGndVelLeDrvn GmMsg348BusChassisExp.GmMsg348BusChassisExpPrevWhlGndVelRiDrvn GmMsg348BusChassisExp.GmMsg348BusChassisExpWhlGndVelLeDrvnInvldTi GmMsg348BusChassisExp.GmMsg348BusChassisExpWhlGndVelLeDrvnStuckTi GmMsg348BusChassisExp.GmMsg348BusChassisExpWhlGndVelRiDrvnInvldTi GmMsg348BusChassisExp.GmMsg348BusChassisExpWhlGndVelRiDrvnStuckTi /end SUB_GROUP
 /begin FUNCTION_LIST /end FUNCTION_LIST
 /begin REF_CHARACTERISTIC /end REF_CHARACTERISTIC
 /begin REF_MEASUREMENT /end REF_MEASUREMENT
/end GROUP
/begin GROUP GmMsg348BusChassisExp.ReceiverPorts "MICROSAR RTE"
 /begin SUB_GROUP GmMsg348BusChassisExp.LstRxnTiMsg348BusChassisExp.Val GmMsg348BusChassisExp.WhlGndVelLeDrvnRawBusChassisExp.Val GmMsg348BusChassisExp.WhlGndVelLeDrvnVldRawBusChassisExp.Val GmMsg348BusChassisExp.WhlGndVelRiDrvnRawBusChassisExp.Val GmMsg348BusChassisExp.WhlGndVelRiDrvnVldRawBusChassisExp.Val /end SUB_GROUP
 /begin FUNCTION_LIST /end FUNCTION_LIST
 /begin REF_CHARACTERISTIC /end REF_CHARACTERISTIC
 /begin REF_MEASUREMENT /end REF_MEASUREMENT
/end GROUP
/begin GROUP GmMsg348BusChassisExp.SenderPorts "MICROSAR RTE"
 /begin SUB_GROUP GmMsg348BusChassisExp.WhlGndVelLeDrvnBusChassisExp.Val GmMsg348BusChassisExp.WhlGndVelLeDrvnStuckBusChassisExp.Logl GmMsg348BusChassisExp.WhlGndVelLeDrvnVldBusChassisExp.Logl GmMsg348BusChassisExp.WhlGndVelRiDrvnBusChassisExp.Val GmMsg348BusChassisExp.WhlGndVelRiDrvnStuckBusChassisExp.Logl GmMsg348BusChassisExp.WhlGndVelRiDrvnVldBusChassisExp.Logl /end SUB_GROUP
 /begin FUNCTION_LIST /end FUNCTION_LIST
 /begin REF_CHARACTERISTIC /end REF_CHARACTERISTIC
 /begin REF_MEASUREMENT /end REF_MEASUREMENT
/end GROUP
/begin GROUP GmMsg348BusChassisExp.WhlGndVelLeDrvnBusChassisExp.Val "MICROSAR RTE" /begin SUB_GROUP /end SUB_GROUP /begin FUNCTION_LIST /end FUNCTION_LIST /begin REF_CHARACTERISTIC /end REF_CHARACTERISTIC /begin REF_MEASUREMENT GmMsg348BusChassisExp.WhlGndVelLeDrvnBusChassisExp.Val /end REF_MEASUREMENT /end GROUP
/begin GROUP GmMsg348BusChassisExp.WhlGndVelLeDrvnRawBusChassisExp.Val "MICROSAR RTE" /begin SUB_GROUP /end SUB_GROUP /begin FUNCTION_LIST /end FUNCTION_LIST /begin REF_CHARACTERISTIC /end REF_CHARACTERISTIC /begin REF_MEASUREMENT GmMsg348BusChassisExp.WhlGndVelLeDrvnRawBusChassisExp.Val /end REF_MEASUREMENT /end GROUP
/begin GROUP GmMsg348BusChassisExp.WhlGndVelLeDrvnStuckBusChassisExp.Logl "MICROSAR RTE" /begin SUB_GROUP /end SUB_GROUP /begin FUNCTION_LIST /end FUNCTION_LIST /begin REF_CHARACTERISTIC /end REF_CHARACTERISTIC
 /begin REF_MEASUREMENT GmMsg348BusChassisExp.WhlGndVelLeDrvnStuckBusChassisExp.Logl /end REF_MEASUREMENT
/end GROUP
/begin GROUP GmMsg348BusChassisExp.WhlGndVelLeDrvnVldBusChassisExp.Logl "MICROSAR RTE" /begin SUB_GROUP /end SUB_GROUP /begin FUNCTION_LIST /end FUNCTION_LIST /begin REF_CHARACTERISTIC /end REF_CHARACTERISTIC /begin REF_MEASUREMENT GmMsg348BusChassisExp.WhlGndVelLeDrvnVldBusChassisExp.Logl /end REF_MEASUREMENT /end GROUP
/begin GROUP GmMsg348BusChassisExp.WhlGndVelLeDrvnVldRawBusChassisExp.Val "MICROSAR RTE" /begin SUB_GROUP /end SUB_GROUP /begin FUNCTION_LIST /end FUNCTION_LIST /begin REF_CHARACTERISTIC /end REF_CHARACTERISTIC
 /begin REF_MEASUREMENT GmMsg348BusChassisExp.WhlGndVelLeDrvnVldRawBusChassisExp.Val /end REF_MEASUREMENT
/end GROUP
/begin GROUP GmMsg348BusChassisExp.WhlGndVelRiDrvnBusChassisExp.Val "MICROSAR RTE" /begin SUB_GROUP /end SUB_GROUP /begin FUNCTION_LIST /end FUNCTION_LIST /begin REF_CHARACTERISTIC /end REF_CHARACTERISTIC /begin REF_MEASUREMENT GmMsg348BusChassisExp.WhlGndVelRiDrvnBusChassisExp.Val /end REF_MEASUREMENT /end GROUP
/begin GROUP GmMsg348BusChassisExp.WhlGndVelRiDrvnRawBusChassisExp.Val "MICROSAR RTE" /begin SUB_GROUP /end SUB_GROUP /begin FUNCTION_LIST /end FUNCTION_LIST /begin REF_CHARACTERISTIC /end REF_CHARACTERISTIC /begin REF_MEASUREMENT GmMsg348BusChassisExp.WhlGndVelRiDrvnRawBusChassisExp.Val /end REF_MEASUREMENT /end GROUP
/begin GROUP GmMsg348BusChassisExp.WhlGndVelRiDrvnStuckBusChassisExp.Logl "MICROSAR RTE" /begin SUB_GROUP /end SUB_GROUP /begin FUNCTION_LIST /end FUNCTION_LIST /begin REF_CHARACTERISTIC /end REF_CHARACTERISTIC
 /begin REF_MEASUREMENT GmMsg348BusChassisExp.WhlGndVelRiDrvnStuckBusChassisExp.Logl /end REF_MEASUREMENT
/end GROUP
/begin GROUP GmMsg348BusChassisExp.WhlGndVelRiDrvnVldBusChassisExp.Logl "MICROSAR RTE" /begin SUB_GROUP /end SUB_GROUP /begin FUNCTION_LIST /end FUNCTION_LIST /begin REF_CHARACTERISTIC /end REF_CHARACTERISTIC /begin REF_MEASUREMENT GmMsg348BusChassisExp.WhlGndVelRiDrvnVldBusChassisExp.Logl /end REF_MEASUREMENT /end GROUP
/begin GROUP GmMsg348BusChassisExp.WhlGndVelRiDrvnVldRawBusChassisExp.Val "MICROSAR RTE" /begin SUB_GROUP /end SUB_GROUP /begin FUNCTION_LIST /end FUNCTION_LIST /begin REF_CHARACTERISTIC /end REF_CHARACTERISTIC
 /begin REF_MEASUREMENT GmMsg348BusChassisExp.WhlGndVelRiDrvnVldRawBusChassisExp.Val /end REF_MEASUREMENT
/end GROUP
/begin GROUP GmMsg348BusHiSpd "MICROSAR RTE"
 /begin SUB_GROUP GmMsg348BusHiSpd.CalibrationPorts GmMsg348BusHiSpd.PerInstanceMemories GmMsg348BusHiSpd.ReceiverPorts GmMsg348BusHiSpd.SenderPorts /end SUB_GROUP
 /begin FUNCTION_LIST /end FUNCTION_LIST
 /begin REF_CHARACTERISTIC /end REF_CHARACTERISTIC
 /begin REF_MEASUREMENT /end REF_MEASUREMENT
/end GROUP
/begin GROUP GmMsg348BusHiSpd.CalibrationPorts "MICROSAR RTE"
 /begin SUB_GROUP GmMsg348BusHiSpd.GmMsg348BusHiSpdInvldTiOut.Val GmMsg348BusHiSpd.GmMsg348BusHiSpdMissTiOut.Val GmMsg348BusHiSpd.GmMsg348BusHiSpdStuckTiOut.Val /end SUB_GROUP
 /begin FUNCTION_LIST /end FUNCTION_LIST
 /begin REF_CHARACTERISTIC /end REF_CHARACTERISTIC
 /begin REF_MEASUREMENT /end REF_MEASUREMENT
/end GROUP
/begin GROUP GmMsg348BusHiSpd.GmMsg348BusHiSpdInvldTiOut.Val "MICROSAR RTE" /begin SUB_GROUP /end SUB_GROUP /begin FUNCTION_LIST /end FUNCTION_LIST /begin REF_CHARACTERISTIC GmMsg348BusHiSpd.GmMsg348BusHiSpdInvldTiOut.Val /end REF_CHARACTERISTIC /begin REF_MEASUREMENT /end REF_MEASUREMENT /end GROUP
/begin GROUP GmMsg348BusHiSpd.GmMsg348BusHiSpdMissTiOut.Val "MICROSAR RTE" /begin SUB_GROUP /end SUB_GROUP /begin FUNCTION_LIST /end FUNCTION_LIST /begin REF_CHARACTERISTIC GmMsg348BusHiSpd.GmMsg348BusHiSpdMissTiOut.Val /end REF_CHARACTERISTIC /begin REF_MEASUREMENT /end REF_MEASUREMENT /end GROUP
/begin GROUP GmMsg348BusHiSpd.GmMsg348BusHiSpdPrevWhlGndVelLeDrvn "MICROSAR RTE" /begin SUB_GROUP /end SUB_GROUP /begin FUNCTION_LIST /end FUNCTION_LIST /begin REF_CHARACTERISTIC /end REF_CHARACTERISTIC /begin REF_MEASUREMENT GmMsg348BusHiSpd.GmMsg348BusHiSpdPrevWhlGndVelLeDrvn /end REF_MEASUREMENT /end GROUP
/begin GROUP GmMsg348BusHiSpd.GmMsg348BusHiSpdPrevWhlGndVelRiDrvn "MICROSAR RTE" /begin SUB_GROUP /end SUB_GROUP /begin FUNCTION_LIST /end FUNCTION_LIST /begin REF_CHARACTERISTIC /end REF_CHARACTERISTIC /begin REF_MEASUREMENT GmMsg348BusHiSpd.GmMsg348BusHiSpdPrevWhlGndVelRiDrvn /end REF_MEASUREMENT /end GROUP
/begin GROUP GmMsg348BusHiSpd.GmMsg348BusHiSpdStuckTiOut.Val "MICROSAR RTE" /begin SUB_GROUP /end SUB_GROUP /begin FUNCTION_LIST /end FUNCTION_LIST /begin REF_CHARACTERISTIC GmMsg348BusHiSpd.GmMsg348BusHiSpdStuckTiOut.Val /end REF_CHARACTERISTIC /begin REF_MEASUREMENT /end REF_MEASUREMENT /end GROUP
/begin GROUP GmMsg348BusHiSpd.GmMsg348BusHiSpdWhlGndVelLeDrvnInvldTi "MICROSAR RTE" /begin SUB_GROUP /end SUB_GROUP /begin FUNCTION_LIST /end FUNCTION_LIST /begin REF_CHARACTERISTIC /end REF_CHARACTERISTIC /begin REF_MEASUREMENT GmMsg348BusHiSpd.GmMsg348BusHiSpdWhlGndVelLeDrvnInvldTi /end REF_MEASUREMENT /end GROUP
/begin GROUP GmMsg348BusHiSpd.GmMsg348BusHiSpdWhlGndVelLeDrvnStuckTi "MICROSAR RTE" /begin SUB_GROUP /end SUB_GROUP /begin FUNCTION_LIST /end FUNCTION_LIST /begin REF_CHARACTERISTIC /end REF_CHARACTERISTIC /begin REF_MEASUREMENT GmMsg348BusHiSpd.GmMsg348BusHiSpdWhlGndVelLeDrvnStuckTi /end REF_MEASUREMENT /end GROUP
/begin GROUP GmMsg348BusHiSpd.GmMsg348BusHiSpdWhlGndVelRiDrvnInvldTi "MICROSAR RTE" /begin SUB_GROUP /end SUB_GROUP /begin FUNCTION_LIST /end FUNCTION_LIST /begin REF_CHARACTERISTIC /end REF_CHARACTERISTIC /begin REF_MEASUREMENT GmMsg348BusHiSpd.GmMsg348BusHiSpdWhlGndVelRiDrvnInvldTi /end REF_MEASUREMENT /end GROUP
/begin GROUP GmMsg348BusHiSpd.GmMsg348BusHiSpdWhlGndVelRiDrvnStuckTi "MICROSAR RTE" /begin SUB_GROUP /end SUB_GROUP /begin FUNCTION_LIST /end FUNCTION_LIST /begin REF_CHARACTERISTIC /end REF_CHARACTERISTIC /begin REF_MEASUREMENT GmMsg348BusHiSpd.GmMsg348BusHiSpdWhlGndVelRiDrvnStuckTi /end REF_MEASUREMENT /end GROUP
/begin GROUP GmMsg348BusHiSpd.LstRxnTiMsg348BusHiSpd.Val "MICROSAR RTE" /begin SUB_GROUP /end SUB_GROUP /begin FUNCTION_LIST /end FUNCTION_LIST /begin REF_CHARACTERISTIC /end REF_CHARACTERISTIC /begin REF_MEASUREMENT GmMsg348BusHiSpd.LstRxnTiMsg348BusHiSpd.Val /end REF_MEASUREMENT /end GROUP
/begin GROUP GmMsg348BusHiSpd.PerInstanceMemories "MICROSAR RTE"
 /begin SUB_GROUP GmMsg348BusHiSpd.GmMsg348BusHiSpdPrevWhlGndVelLeDrvn GmMsg348BusHiSpd.GmMsg348BusHiSpdPrevWhlGndVelRiDrvn GmMsg348BusHiSpd.GmMsg348BusHiSpdWhlGndVelLeDrvnInvldTi GmMsg348BusHiSpd.GmMsg348BusHiSpdWhlGndVelLeDrvnStuckTi GmMsg348BusHiSpd.GmMsg348BusHiSpdWhlGndVelRiDrvnInvldTi GmMsg348BusHiSpd.GmMsg348BusHiSpdWhlGndVelRiDrvnStuckTi /end SUB_GROUP
 /begin FUNCTION_LIST /end FUNCTION_LIST
 /begin REF_CHARACTERISTIC /end REF_CHARACTERISTIC
 /begin REF_MEASUREMENT /end REF_MEASUREMENT
/end GROUP
/begin GROUP GmMsg348BusHiSpd.ReceiverPorts "MICROSAR RTE"
 /begin SUB_GROUP GmMsg348BusHiSpd.LstRxnTiMsg348BusHiSpd.Val GmMsg348BusHiSpd.WhlGndVelLeDrvnRawBusHiSpd.Val GmMsg348BusHiSpd.WhlGndVelLeDrvnVldRawBusHiSpd.Val GmMsg348BusHiSpd.WhlGndVelRiDrvnRawBusHiSpd.Val GmMsg348BusHiSpd.WhlGndVelRiDrvnVldRawBusHiSpd.Val /end SUB_GROUP
 /begin FUNCTION_LIST /end FUNCTION_LIST
 /begin REF_CHARACTERISTIC /end REF_CHARACTERISTIC
 /begin REF_MEASUREMENT /end REF_MEASUREMENT
/end GROUP
/begin GROUP GmMsg348BusHiSpd.SenderPorts "MICROSAR RTE"
 /begin SUB_GROUP GmMsg348BusHiSpd.WhlGndVelLeDrvnBusHiSpd.Val GmMsg348BusHiSpd.WhlGndVelLeDrvnStuckBusHiSpd.Logl GmMsg348BusHiSpd.WhlGndVelLeDrvnVldBusHiSpd.Logl GmMsg348BusHiSpd.WhlGndVelRiDrvnBusHiSpd.Val GmMsg348BusHiSpd.WhlGndVelRiDrvnStuckBusHiSpd.Logl GmMsg348BusHiSpd.WhlGndVelRiDrvnVldBusHiSpd.Logl /end SUB_GROUP
 /begin FUNCTION_LIST /end FUNCTION_LIST
 /begin REF_CHARACTERISTIC /end REF_CHARACTERISTIC
 /begin REF_MEASUREMENT /end REF_MEASUREMENT
/end GROUP
/begin GROUP GmMsg348BusHiSpd.WhlGndVelLeDrvnBusHiSpd.Val "MICROSAR RTE" /begin SUB_GROUP /end SUB_GROUP /begin FUNCTION_LIST /end FUNCTION_LIST /begin REF_CHARACTERISTIC /end REF_CHARACTERISTIC /begin REF_MEASUREMENT GmMsg348BusHiSpd.WhlGndVelLeDrvnBusHiSpd.Val /end REF_MEASUREMENT /end GROUP
/begin GROUP GmMsg348BusHiSpd.WhlGndVelLeDrvnRawBusHiSpd.Val "MICROSAR RTE" /begin SUB_GROUP /end SUB_GROUP /begin FUNCTION_LIST /end FUNCTION_LIST /begin REF_CHARACTERISTIC /end REF_CHARACTERISTIC /begin REF_MEASUREMENT GmMsg348BusHiSpd.WhlGndVelLeDrvnRawBusHiSpd.Val /end REF_MEASUREMENT /end GROUP
/begin GROUP GmMsg348BusHiSpd.WhlGndVelLeDrvnStuckBusHiSpd.Logl "MICROSAR RTE" /begin SUB_GROUP /end SUB_GROUP /begin FUNCTION_LIST /end FUNCTION_LIST /begin REF_CHARACTERISTIC /end REF_CHARACTERISTIC /begin REF_MEASUREMENT GmMsg348BusHiSpd.WhlGndVelLeDrvnStuckBusHiSpd.Logl /end REF_MEASUREMENT /end GROUP
/begin GROUP GmMsg348BusHiSpd.WhlGndVelLeDrvnVldBusHiSpd.Logl "MICROSAR RTE" /begin SUB_GROUP /end SUB_GROUP /begin FUNCTION_LIST /end FUNCTION_LIST /begin REF_CHARACTERISTIC /end REF_CHARACTERISTIC /begin REF_MEASUREMENT GmMsg348BusHiSpd.WhlGndVelLeDrvnVldBusHiSpd.Logl /end REF_MEASUREMENT /end GROUP
/begin GROUP GmMsg348BusHiSpd.WhlGndVelLeDrvnVldRawBusHiSpd.Val "MICROSAR RTE" /begin SUB_GROUP /end SUB_GROUP /begin FUNCTION_LIST /end FUNCTION_LIST /begin REF_CHARACTERISTIC /end REF_CHARACTERISTIC /begin REF_MEASUREMENT GmMsg348BusHiSpd.WhlGndVelLeDrvnVldRawBusHiSpd.Val /end REF_MEASUREMENT /end GROUP
/begin GROUP GmMsg348BusHiSpd.WhlGndVelRiDrvnBusHiSpd.Val "MICROSAR RTE" /begin SUB_GROUP /end SUB_GROUP /begin FUNCTION_LIST /end FUNCTION_LIST /begin REF_CHARACTERISTIC /end REF_CHARACTERISTIC /begin REF_MEASUREMENT GmMsg348BusHiSpd.WhlGndVelRiDrvnBusHiSpd.Val /end REF_MEASUREMENT /end GROUP
/begin GROUP GmMsg348BusHiSpd.WhlGndVelRiDrvnRawBusHiSpd.Val "MICROSAR RTE" /begin SUB_GROUP /end SUB_GROUP /begin FUNCTION_LIST /end FUNCTION_LIST /begin REF_CHARACTERISTIC /end REF_CHARACTERISTIC /begin REF_MEASUREMENT GmMsg348BusHiSpd.WhlGndVelRiDrvnRawBusHiSpd.Val /end REF_MEASUREMENT /end GROUP
/begin GROUP GmMsg348BusHiSpd.WhlGndVelRiDrvnStuckBusHiSpd.Logl "MICROSAR RTE" /begin SUB_GROUP /end SUB_GROUP /begin FUNCTION_LIST /end FUNCTION_LIST /begin REF_CHARACTERISTIC /end REF_CHARACTERISTIC /begin REF_MEASUREMENT GmMsg348BusHiSpd.WhlGndVelRiDrvnStuckBusHiSpd.Logl /end REF_MEASUREMENT /end GROUP
/begin GROUP GmMsg348BusHiSpd.WhlGndVelRiDrvnVldBusHiSpd.Logl "MICROSAR RTE" /begin SUB_GROUP /end SUB_GROUP /begin FUNCTION_LIST /end FUNCTION_LIST /begin REF_CHARACTERISTIC /end REF_CHARACTERISTIC /begin REF_MEASUREMENT GmMsg348BusHiSpd.WhlGndVelRiDrvnVldBusHiSpd.Logl /end REF_MEASUREMENT /end GROUP
/begin GROUP GmMsg348BusHiSpd.WhlGndVelRiDrvnVldRawBusHiSpd.Val "MICROSAR RTE" /begin SUB_GROUP /end SUB_GROUP /begin FUNCTION_LIST /end FUNCTION_LIST /begin REF_CHARACTERISTIC /end REF_CHARACTERISTIC /begin REF_MEASUREMENT GmMsg348BusHiSpd.WhlGndVelRiDrvnVldRawBusHiSpd.Val /end REF_MEASUREMENT /end GROUP
/begin GROUP GmMsg34ABusChassisExp "MICROSAR RTE"
 /begin SUB_GROUP GmMsg34ABusChassisExp.CalibrationPorts GmMsg34ABusChassisExp.PerInstanceMemories GmMsg34ABusChassisExp.ReceiverPorts GmMsg34ABusChassisExp.SenderPorts /end SUB_GROUP
 /begin FUNCTION_LIST /end FUNCTION_LIST
 /begin REF_CHARACTERISTIC /end REF_CHARACTERISTIC
 /begin REF_MEASUREMENT /end REF_MEASUREMENT
/end GROUP
/begin GROUP GmMsg34ABusChassisExp.CalibrationPorts "MICROSAR RTE"
 /begin SUB_GROUP GmMsg34ABusChassisExp.GmMsg34ABusChassisExpInvldTiOut.Val GmMsg34ABusChassisExp.GmMsg34ABusChassisExpMissTiOut.Val GmMsg34ABusChassisExp.GmMsg34ABusChassisExpStuckTiOut.Val /end SUB_GROUP
 /begin FUNCTION_LIST /end FUNCTION_LIST
 /begin REF_CHARACTERISTIC /end REF_CHARACTERISTIC
 /begin REF_MEASUREMENT /end REF_MEASUREMENT
/end GROUP
/begin GROUP GmMsg34ABusChassisExp.GmMsg34ABusChassisExpInvldTiOut.Val "MICROSAR RTE" /begin SUB_GROUP /end SUB_GROUP /begin FUNCTION_LIST /end FUNCTION_LIST /begin REF_CHARACTERISTIC GmMsg34ABusChassisExp.GmMsg34ABusChassisExpInvldTiOut.Val /end REF_CHARACTERISTIC /begin REF_MEASUREMENT /end REF_MEASUREMENT /end GROUP
/begin GROUP GmMsg34ABusChassisExp.GmMsg34ABusChassisExpMissTiOut.Val "MICROSAR RTE" /begin SUB_GROUP /end SUB_GROUP /begin FUNCTION_LIST /end FUNCTION_LIST /begin REF_CHARACTERISTIC GmMsg34ABusChassisExp.GmMsg34ABusChassisExpMissTiOut.Val /end REF_CHARACTERISTIC /begin REF_MEASUREMENT /end REF_MEASUREMENT /end GROUP
/begin GROUP GmMsg34ABusChassisExp.GmMsg34ABusChassisExpPrevWhlGndVelLeNonDrvn "MICROSAR RTE" /begin SUB_GROUP /end SUB_GROUP /begin FUNCTION_LIST /end FUNCTION_LIST /begin REF_CHARACTERISTIC /end REF_CHARACTERISTIC
 /begin REF_MEASUREMENT GmMsg34ABusChassisExp.GmMsg34ABusChassisExpPrevWhlGndVelLeNonDrvn /end REF_MEASUREMENT
/end GROUP
/begin GROUP GmMsg34ABusChassisExp.GmMsg34ABusChassisExpPrevWhlGndVelRiNonDrvn "MICROSAR RTE" /begin SUB_GROUP /end SUB_GROUP /begin FUNCTION_LIST /end FUNCTION_LIST /begin REF_CHARACTERISTIC /end REF_CHARACTERISTIC
 /begin REF_MEASUREMENT GmMsg34ABusChassisExp.GmMsg34ABusChassisExpPrevWhlGndVelRiNonDrvn /end REF_MEASUREMENT
/end GROUP
/begin GROUP GmMsg34ABusChassisExp.GmMsg34ABusChassisExpStuckTiOut.Val "MICROSAR RTE" /begin SUB_GROUP /end SUB_GROUP /begin FUNCTION_LIST /end FUNCTION_LIST /begin REF_CHARACTERISTIC GmMsg34ABusChassisExp.GmMsg34ABusChassisExpStuckTiOut.Val /end REF_CHARACTERISTIC /begin REF_MEASUREMENT /end REF_MEASUREMENT /end GROUP
/begin GROUP GmMsg34ABusChassisExp.GmMsg34ABusChassisExpWhlGndVelLeNonDrvnInvldTi "MICROSAR RTE" /begin SUB_GROUP /end SUB_GROUP /begin FUNCTION_LIST /end FUNCTION_LIST /begin REF_CHARACTERISTIC /end REF_CHARACTERISTIC
 /begin REF_MEASUREMENT GmMsg34ABusChassisExp.GmMsg34ABusChassisExpWhlGndVelLeNonDrvnInvldTi /end REF_MEASUREMENT
/end GROUP
/begin GROUP GmMsg34ABusChassisExp.GmMsg34ABusChassisExpWhlGndVelLeNonDrvnStuckTi "MICROSAR RTE" /begin SUB_GROUP /end SUB_GROUP /begin FUNCTION_LIST /end FUNCTION_LIST /begin REF_CHARACTERISTIC /end REF_CHARACTERISTIC
 /begin REF_MEASUREMENT GmMsg34ABusChassisExp.GmMsg34ABusChassisExpWhlGndVelLeNonDrvnStuckTi /end REF_MEASUREMENT
/end GROUP
/begin GROUP GmMsg34ABusChassisExp.GmMsg34ABusChassisExpWhlGndVelRiNonDrvnInvldTi "MICROSAR RTE" /begin SUB_GROUP /end SUB_GROUP /begin FUNCTION_LIST /end FUNCTION_LIST /begin REF_CHARACTERISTIC /end REF_CHARACTERISTIC
 /begin REF_MEASUREMENT GmMsg34ABusChassisExp.GmMsg34ABusChassisExpWhlGndVelRiNonDrvnInvldTi /end REF_MEASUREMENT
/end GROUP
/begin GROUP GmMsg34ABusChassisExp.GmMsg34ABusChassisExpWhlGndVelRiNonDrvnStuckTi "MICROSAR RTE" /begin SUB_GROUP /end SUB_GROUP /begin FUNCTION_LIST /end FUNCTION_LIST /begin REF_CHARACTERISTIC /end REF_CHARACTERISTIC
 /begin REF_MEASUREMENT GmMsg34ABusChassisExp.GmMsg34ABusChassisExpWhlGndVelRiNonDrvnStuckTi /end REF_MEASUREMENT
/end GROUP
/begin GROUP GmMsg34ABusChassisExp.LstRxnTiMsg34ABusChassisExp.Val "MICROSAR RTE" /begin SUB_GROUP /end SUB_GROUP /begin FUNCTION_LIST /end FUNCTION_LIST /begin REF_CHARACTERISTIC /end REF_CHARACTERISTIC /begin REF_MEASUREMENT GmMsg34ABusChassisExp.LstRxnTiMsg34ABusChassisExp.Val /end REF_MEASUREMENT /end GROUP
/begin GROUP GmMsg34ABusChassisExp.PerInstanceMemories "MICROSAR RTE"
 /begin SUB_GROUP GmMsg34ABusChassisExp.GmMsg34ABusChassisExpPrevWhlGndVelLeNonDrvn GmMsg34ABusChassisExp.GmMsg34ABusChassisExpPrevWhlGndVelRiNonDrvn GmMsg34ABusChassisExp.GmMsg34ABusChassisExpWhlGndVelLeNonDrvnInvldTi GmMsg34ABusChassisExp.GmMsg34ABusChassisExpWhlGndVelLeNonDrvnStuckTi GmMsg34ABusChassisExp.GmMsg34ABusChassisExpWhlGndVelRiNonDrvnInvldTi GmMsg34ABusChassisExp.GmMsg34ABusChassisExpWhlGndVelRiNonDrvnStuckTi /end SUB_GROUP
 /begin FUNCTION_LIST /end FUNCTION_LIST
 /begin REF_CHARACTERISTIC /end REF_CHARACTERISTIC
 /begin REF_MEASUREMENT /end REF_MEASUREMENT
/end GROUP
/begin GROUP GmMsg34ABusChassisExp.ReceiverPorts "MICROSAR RTE"
 /begin SUB_GROUP GmMsg34ABusChassisExp.LstRxnTiMsg34ABusChassisExp.Val GmMsg34ABusChassisExp.WhlGndVelLeNonDrvnRawBusChassisExp.Val GmMsg34ABusChassisExp.WhlGndVelLeNonDrvnVldRawBusChassisExp.Val GmMsg34ABusChassisExp.WhlGndVelRiNonDrvnRawBusChassisExp.Val GmMsg34ABusChassisExp.WhlGndVelRiNonDrvnVldRawBusChassisExp.Val /end SUB_GROUP
 /begin FUNCTION_LIST /end FUNCTION_LIST
 /begin REF_CHARACTERISTIC /end REF_CHARACTERISTIC
 /begin REF_MEASUREMENT /end REF_MEASUREMENT
/end GROUP
/begin GROUP GmMsg34ABusChassisExp.SenderPorts "MICROSAR RTE"
 /begin SUB_GROUP GmMsg34ABusChassisExp.WhlGndVelLeNonDrvnBusChassisExp.Val GmMsg34ABusChassisExp.WhlGndVelLeNonDrvnStuckBusChassisExp.Logl GmMsg34ABusChassisExp.WhlGndVelLeNonDrvnVldBusChassisExp.Logl GmMsg34ABusChassisExp.WhlGndVelRiNonDrvnBusChassisExp.Val GmMsg34ABusChassisExp.WhlGndVelRiNonDrvnStuckBusChassisExp.Logl GmMsg34ABusChassisExp.WhlGndVelRiNonDrvnVldBusChassisExp.Logl /end SUB_GROUP
 /begin FUNCTION_LIST /end FUNCTION_LIST
 /begin REF_CHARACTERISTIC /end REF_CHARACTERISTIC
 /begin REF_MEASUREMENT /end REF_MEASUREMENT
/end GROUP
/begin GROUP GmMsg34ABusChassisExp.WhlGndVelLeNonDrvnBusChassisExp.Val "MICROSAR RTE" /begin SUB_GROUP /end SUB_GROUP /begin FUNCTION_LIST /end FUNCTION_LIST /begin REF_CHARACTERISTIC /end REF_CHARACTERISTIC /begin REF_MEASUREMENT GmMsg34ABusChassisExp.WhlGndVelLeNonDrvnBusChassisExp.Val /end REF_MEASUREMENT /end GROUP
/begin GROUP GmMsg34ABusChassisExp.WhlGndVelLeNonDrvnRawBusChassisExp.Val "MICROSAR RTE" /begin SUB_GROUP /end SUB_GROUP /begin FUNCTION_LIST /end FUNCTION_LIST /begin REF_CHARACTERISTIC /end REF_CHARACTERISTIC
 /begin REF_MEASUREMENT GmMsg34ABusChassisExp.WhlGndVelLeNonDrvnRawBusChassisExp.Val /end REF_MEASUREMENT
/end GROUP
/begin GROUP GmMsg34ABusChassisExp.WhlGndVelLeNonDrvnStuckBusChassisExp.Logl "MICROSAR RTE" /begin SUB_GROUP /end SUB_GROUP /begin FUNCTION_LIST /end FUNCTION_LIST /begin REF_CHARACTERISTIC /end REF_CHARACTERISTIC
 /begin REF_MEASUREMENT GmMsg34ABusChassisExp.WhlGndVelLeNonDrvnStuckBusChassisExp.Logl /end REF_MEASUREMENT
/end GROUP
/begin GROUP GmMsg34ABusChassisExp.WhlGndVelLeNonDrvnVldBusChassisExp.Logl "MICROSAR RTE" /begin SUB_GROUP /end SUB_GROUP /begin FUNCTION_LIST /end FUNCTION_LIST /begin REF_CHARACTERISTIC /end REF_CHARACTERISTIC
 /begin REF_MEASUREMENT GmMsg34ABusChassisExp.WhlGndVelLeNonDrvnVldBusChassisExp.Logl /end REF_MEASUREMENT
/end GROUP
/begin GROUP GmMsg34ABusChassisExp.WhlGndVelLeNonDrvnVldRawBusChassisExp.Val "MICROSAR RTE" /begin SUB_GROUP /end SUB_GROUP /begin FUNCTION_LIST /end FUNCTION_LIST /begin REF_CHARACTERISTIC /end REF_CHARACTERISTIC
 /begin REF_MEASUREMENT GmMsg34ABusChassisExp.WhlGndVelLeNonDrvnVldRawBusChassisExp.Val /end REF_MEASUREMENT
/end GROUP
/begin GROUP GmMsg34ABusChassisExp.WhlGndVelRiNonDrvnBusChassisExp.Val "MICROSAR RTE" /begin SUB_GROUP /end SUB_GROUP /begin FUNCTION_LIST /end FUNCTION_LIST /begin REF_CHARACTERISTIC /end REF_CHARACTERISTIC /begin REF_MEASUREMENT GmMsg34ABusChassisExp.WhlGndVelRiNonDrvnBusChassisExp.Val /end REF_MEASUREMENT /end GROUP
/begin GROUP GmMsg34ABusChassisExp.WhlGndVelRiNonDrvnRawBusChassisExp.Val "MICROSAR RTE" /begin SUB_GROUP /end SUB_GROUP /begin FUNCTION_LIST /end FUNCTION_LIST /begin REF_CHARACTERISTIC /end REF_CHARACTERISTIC
 /begin REF_MEASUREMENT GmMsg34ABusChassisExp.WhlGndVelRiNonDrvnRawBusChassisExp.Val /end REF_MEASUREMENT
/end GROUP
/begin GROUP GmMsg34ABusChassisExp.WhlGndVelRiNonDrvnStuckBusChassisExp.Logl "MICROSAR RTE" /begin SUB_GROUP /end SUB_GROUP /begin FUNCTION_LIST /end FUNCTION_LIST /begin REF_CHARACTERISTIC /end REF_CHARACTERISTIC
 /begin REF_MEASUREMENT GmMsg34ABusChassisExp.WhlGndVelRiNonDrvnStuckBusChassisExp.Logl /end REF_MEASUREMENT
/end GROUP
/begin GROUP GmMsg34ABusChassisExp.WhlGndVelRiNonDrvnVldBusChassisExp.Logl "MICROSAR RTE" /begin SUB_GROUP /end SUB_GROUP /begin FUNCTION_LIST /end FUNCTION_LIST /begin REF_CHARACTERISTIC /end REF_CHARACTERISTIC
 /begin REF_MEASUREMENT GmMsg34ABusChassisExp.WhlGndVelRiNonDrvnVldBusChassisExp.Logl /end REF_MEASUREMENT
/end GROUP
/begin GROUP GmMsg34ABusChassisExp.WhlGndVelRiNonDrvnVldRawBusChassisExp.Val "MICROSAR RTE" /begin SUB_GROUP /end SUB_GROUP /begin FUNCTION_LIST /end FUNCTION_LIST /begin REF_CHARACTERISTIC /end REF_CHARACTERISTIC
 /begin REF_MEASUREMENT GmMsg34ABusChassisExp.WhlGndVelRiNonDrvnVldRawBusChassisExp.Val /end REF_MEASUREMENT
/end GROUP
/begin GROUP GmMsg34ABusHiSpd "MICROSAR RTE"
 /begin SUB_GROUP GmMsg34ABusHiSpd.CalibrationPorts GmMsg34ABusHiSpd.PerInstanceMemories GmMsg34ABusHiSpd.ReceiverPorts GmMsg34ABusHiSpd.SenderPorts /end SUB_GROUP
 /begin FUNCTION_LIST /end FUNCTION_LIST
 /begin REF_CHARACTERISTIC /end REF_CHARACTERISTIC
 /begin REF_MEASUREMENT /end REF_MEASUREMENT
/end GROUP
/begin GROUP GmMsg34ABusHiSpd.CalibrationPorts "MICROSAR RTE"
 /begin SUB_GROUP GmMsg34ABusHiSpd.GmMsg34ABusHiSpdInvldTiOut.Val GmMsg34ABusHiSpd.GmMsg34ABusHiSpdMissTiOut.Val GmMsg34ABusHiSpd.GmMsg34ABusHiSpdStuckTiOut.Val /end SUB_GROUP
 /begin FUNCTION_LIST /end FUNCTION_LIST
 /begin REF_CHARACTERISTIC /end REF_CHARACTERISTIC
 /begin REF_MEASUREMENT /end REF_MEASUREMENT
/end GROUP
/begin GROUP GmMsg34ABusHiSpd.GmMsg34ABusHiSpdInvldTiOut.Val "MICROSAR RTE" /begin SUB_GROUP /end SUB_GROUP /begin FUNCTION_LIST /end FUNCTION_LIST /begin REF_CHARACTERISTIC GmMsg34ABusHiSpd.GmMsg34ABusHiSpdInvldTiOut.Val /end REF_CHARACTERISTIC /begin REF_MEASUREMENT /end REF_MEASUREMENT /end GROUP
/begin GROUP GmMsg34ABusHiSpd.GmMsg34ABusHiSpdMissTiOut.Val "MICROSAR RTE" /begin SUB_GROUP /end SUB_GROUP /begin FUNCTION_LIST /end FUNCTION_LIST /begin REF_CHARACTERISTIC GmMsg34ABusHiSpd.GmMsg34ABusHiSpdMissTiOut.Val /end REF_CHARACTERISTIC /begin REF_MEASUREMENT /end REF_MEASUREMENT /end GROUP
/begin GROUP GmMsg34ABusHiSpd.GmMsg34ABusHiSpdPrevWhlGndVelLeNonDrvn "MICROSAR RTE" /begin SUB_GROUP /end SUB_GROUP /begin FUNCTION_LIST /end FUNCTION_LIST /begin REF_CHARACTERISTIC /end REF_CHARACTERISTIC /begin REF_MEASUREMENT GmMsg34ABusHiSpd.GmMsg34ABusHiSpdPrevWhlGndVelLeNonDrvn /end REF_MEASUREMENT /end GROUP
/begin GROUP GmMsg34ABusHiSpd.GmMsg34ABusHiSpdPrevWhlGndVelRiNonDrvn "MICROSAR RTE" /begin SUB_GROUP /end SUB_GROUP /begin FUNCTION_LIST /end FUNCTION_LIST /begin REF_CHARACTERISTIC /end REF_CHARACTERISTIC /begin REF_MEASUREMENT GmMsg34ABusHiSpd.GmMsg34ABusHiSpdPrevWhlGndVelRiNonDrvn /end REF_MEASUREMENT /end GROUP
/begin GROUP GmMsg34ABusHiSpd.GmMsg34ABusHiSpdStuckTiOut.Val "MICROSAR RTE" /begin SUB_GROUP /end SUB_GROUP /begin FUNCTION_LIST /end FUNCTION_LIST /begin REF_CHARACTERISTIC GmMsg34ABusHiSpd.GmMsg34ABusHiSpdStuckTiOut.Val /end REF_CHARACTERISTIC /begin REF_MEASUREMENT /end REF_MEASUREMENT /end GROUP
/begin GROUP GmMsg34ABusHiSpd.GmMsg34ABusHiSpdWhlGndVelLeNonDrvnInvldTi "MICROSAR RTE" /begin SUB_GROUP /end SUB_GROUP /begin FUNCTION_LIST /end FUNCTION_LIST /begin REF_CHARACTERISTIC /end REF_CHARACTERISTIC /begin REF_MEASUREMENT GmMsg34ABusHiSpd.GmMsg34ABusHiSpdWhlGndVelLeNonDrvnInvldTi /end REF_MEASUREMENT /end GROUP
/begin GROUP GmMsg34ABusHiSpd.GmMsg34ABusHiSpdWhlGndVelLeNonDrvnStuckTi "MICROSAR RTE" /begin SUB_GROUP /end SUB_GROUP /begin FUNCTION_LIST /end FUNCTION_LIST /begin REF_CHARACTERISTIC /end REF_CHARACTERISTIC /begin REF_MEASUREMENT GmMsg34ABusHiSpd.GmMsg34ABusHiSpdWhlGndVelLeNonDrvnStuckTi /end REF_MEASUREMENT /end GROUP
/begin GROUP GmMsg34ABusHiSpd.GmMsg34ABusHiSpdWhlGndVelRiNonDrvnInvldTi "MICROSAR RTE" /begin SUB_GROUP /end SUB_GROUP /begin FUNCTION_LIST /end FUNCTION_LIST /begin REF_CHARACTERISTIC /end REF_CHARACTERISTIC /begin REF_MEASUREMENT GmMsg34ABusHiSpd.GmMsg34ABusHiSpdWhlGndVelRiNonDrvnInvldTi /end REF_MEASUREMENT /end GROUP
/begin GROUP GmMsg34ABusHiSpd.GmMsg34ABusHiSpdWhlGndVelRiNonDrvnStuckTi "MICROSAR RTE" /begin SUB_GROUP /end SUB_GROUP /begin FUNCTION_LIST /end FUNCTION_LIST /begin REF_CHARACTERISTIC /end REF_CHARACTERISTIC /begin REF_MEASUREMENT GmMsg34ABusHiSpd.GmMsg34ABusHiSpdWhlGndVelRiNonDrvnStuckTi /end REF_MEASUREMENT /end GROUP
/begin GROUP GmMsg34ABusHiSpd.LstRxnTiMsg34ABusHiSpd.Val "MICROSAR RTE" /begin SUB_GROUP /end SUB_GROUP /begin FUNCTION_LIST /end FUNCTION_LIST /begin REF_CHARACTERISTIC /end REF_CHARACTERISTIC /begin REF_MEASUREMENT GmMsg34ABusHiSpd.LstRxnTiMsg34ABusHiSpd.Val /end REF_MEASUREMENT /end GROUP
/begin GROUP GmMsg34ABusHiSpd.PerInstanceMemories "MICROSAR RTE"
 /begin SUB_GROUP GmMsg34ABusHiSpd.GmMsg34ABusHiSpdPrevWhlGndVelLeNonDrvn GmMsg34ABusHiSpd.GmMsg34ABusHiSpdPrevWhlGndVelRiNonDrvn GmMsg34ABusHiSpd.GmMsg34ABusHiSpdWhlGndVelLeNonDrvnInvldTi GmMsg34ABusHiSpd.GmMsg34ABusHiSpdWhlGndVelLeNonDrvnStuckTi GmMsg34ABusHiSpd.GmMsg34ABusHiSpdWhlGndVelRiNonDrvnInvldTi GmMsg34ABusHiSpd.GmMsg34ABusHiSpdWhlGndVelRiNonDrvnStuckTi /end SUB_GROUP
 /begin FUNCTION_LIST /end FUNCTION_LIST
 /begin REF_CHARACTERISTIC /end REF_CHARACTERISTIC
 /begin REF_MEASUREMENT /end REF_MEASUREMENT
/end GROUP
/begin GROUP GmMsg34ABusHiSpd.ReceiverPorts "MICROSAR RTE"
 /begin SUB_GROUP GmMsg34ABusHiSpd.LstRxnTiMsg34ABusHiSpd.Val GmMsg34ABusHiSpd.WhlGndVelLeNonDrvnRawBusHiSpd.Val GmMsg34ABusHiSpd.WhlGndVelLeNonDrvnVldRawBusHiSpd.Val GmMsg34ABusHiSpd.WhlGndVelRiNonDrvnRawBusHiSpd.Val GmMsg34ABusHiSpd.WhlGndVelRiNonDrvnVldRawBusHiSpd.Val /end SUB_GROUP
 /begin FUNCTION_LIST /end FUNCTION_LIST
 /begin REF_CHARACTERISTIC /end REF_CHARACTERISTIC
 /begin REF_MEASUREMENT /end REF_MEASUREMENT
/end GROUP
/begin GROUP GmMsg34ABusHiSpd.SenderPorts "MICROSAR RTE"
 /begin SUB_GROUP GmMsg34ABusHiSpd.WhlGndVelLeNonDrvnBusHiSpd.Val GmMsg34ABusHiSpd.WhlGndVelLeNonDrvnStuckBusHiSpd.Logl GmMsg34ABusHiSpd.WhlGndVelLeNonDrvnVldBusHiSpd.Logl GmMsg34ABusHiSpd.WhlGndVelRiNonDrvnBusHiSpd.Val GmMsg34ABusHiSpd.WhlGndVelRiNonDrvnStuckBusHiSpd.Logl GmMsg34ABusHiSpd.WhlGndVelRiNonDrvnVldBusHiSpd.Logl /end SUB_GROUP
 /begin FUNCTION_LIST /end FUNCTION_LIST
 /begin REF_CHARACTERISTIC /end REF_CHARACTERISTIC
 /begin REF_MEASUREMENT /end REF_MEASUREMENT
/end GROUP
/begin GROUP GmMsg34ABusHiSpd.WhlGndVelLeNonDrvnBusHiSpd.Val "MICROSAR RTE" /begin SUB_GROUP /end SUB_GROUP /begin FUNCTION_LIST /end FUNCTION_LIST /begin REF_CHARACTERISTIC /end REF_CHARACTERISTIC /begin REF_MEASUREMENT GmMsg34ABusHiSpd.WhlGndVelLeNonDrvnBusHiSpd.Val /end REF_MEASUREMENT /end GROUP
/begin GROUP GmMsg34ABusHiSpd.WhlGndVelLeNonDrvnRawBusHiSpd.Val "MICROSAR RTE" /begin SUB_GROUP /end SUB_GROUP /begin FUNCTION_LIST /end FUNCTION_LIST /begin REF_CHARACTERISTIC /end REF_CHARACTERISTIC /begin REF_MEASUREMENT GmMsg34ABusHiSpd.WhlGndVelLeNonDrvnRawBusHiSpd.Val /end REF_MEASUREMENT /end GROUP
/begin GROUP GmMsg34ABusHiSpd.WhlGndVelLeNonDrvnStuckBusHiSpd.Logl "MICROSAR RTE" /begin SUB_GROUP /end SUB_GROUP /begin FUNCTION_LIST /end FUNCTION_LIST /begin REF_CHARACTERISTIC /end REF_CHARACTERISTIC /begin REF_MEASUREMENT GmMsg34ABusHiSpd.WhlGndVelLeNonDrvnStuckBusHiSpd.Logl /end REF_MEASUREMENT /end GROUP
/begin GROUP GmMsg34ABusHiSpd.WhlGndVelLeNonDrvnVldBusHiSpd.Logl "MICROSAR RTE" /begin SUB_GROUP /end SUB_GROUP /begin FUNCTION_LIST /end FUNCTION_LIST /begin REF_CHARACTERISTIC /end REF_CHARACTERISTIC /begin REF_MEASUREMENT GmMsg34ABusHiSpd.WhlGndVelLeNonDrvnVldBusHiSpd.Logl /end REF_MEASUREMENT /end GROUP
/begin GROUP GmMsg34ABusHiSpd.WhlGndVelLeNonDrvnVldRawBusHiSpd.Val "MICROSAR RTE" /begin SUB_GROUP /end SUB_GROUP /begin FUNCTION_LIST /end FUNCTION_LIST /begin REF_CHARACTERISTIC /end REF_CHARACTERISTIC /begin REF_MEASUREMENT GmMsg34ABusHiSpd.WhlGndVelLeNonDrvnVldRawBusHiSpd.Val /end REF_MEASUREMENT /end GROUP
/begin GROUP GmMsg34ABusHiSpd.WhlGndVelRiNonDrvnBusHiSpd.Val "MICROSAR RTE" /begin SUB_GROUP /end SUB_GROUP /begin FUNCTION_LIST /end FUNCTION_LIST /begin REF_CHARACTERISTIC /end REF_CHARACTERISTIC /begin REF_MEASUREMENT GmMsg34ABusHiSpd.WhlGndVelRiNonDrvnBusHiSpd.Val /end REF_MEASUREMENT /end GROUP
/begin GROUP GmMsg34ABusHiSpd.WhlGndVelRiNonDrvnRawBusHiSpd.Val "MICROSAR RTE" /begin SUB_GROUP /end SUB_GROUP /begin FUNCTION_LIST /end FUNCTION_LIST /begin REF_CHARACTERISTIC /end REF_CHARACTERISTIC /begin REF_MEASUREMENT GmMsg34ABusHiSpd.WhlGndVelRiNonDrvnRawBusHiSpd.Val /end REF_MEASUREMENT /end GROUP
/begin GROUP GmMsg34ABusHiSpd.WhlGndVelRiNonDrvnStuckBusHiSpd.Logl "MICROSAR RTE" /begin SUB_GROUP /end SUB_GROUP /begin FUNCTION_LIST /end FUNCTION_LIST /begin REF_CHARACTERISTIC /end REF_CHARACTERISTIC /begin REF_MEASUREMENT GmMsg34ABusHiSpd.WhlGndVelRiNonDrvnStuckBusHiSpd.Logl /end REF_MEASUREMENT /end GROUP
/begin GROUP GmMsg34ABusHiSpd.WhlGndVelRiNonDrvnVldBusHiSpd.Logl "MICROSAR RTE" /begin SUB_GROUP /end SUB_GROUP /begin FUNCTION_LIST /end FUNCTION_LIST /begin REF_CHARACTERISTIC /end REF_CHARACTERISTIC /begin REF_MEASUREMENT GmMsg34ABusHiSpd.WhlGndVelRiNonDrvnVldBusHiSpd.Logl /end REF_MEASUREMENT /end GROUP
/begin GROUP GmMsg34ABusHiSpd.WhlGndVelRiNonDrvnVldRawBusHiSpd.Val "MICROSAR RTE" /begin SUB_GROUP /end SUB_GROUP /begin FUNCTION_LIST /end FUNCTION_LIST /begin REF_CHARACTERISTIC /end REF_CHARACTERISTIC /begin REF_MEASUREMENT GmMsg34ABusHiSpd.WhlGndVelRiNonDrvnVldRawBusHiSpd.Val /end REF_MEASUREMENT /end GROUP
/begin GROUP GmMsg3F1BusHiSpd "MICROSAR RTE"
 /begin SUB_GROUP GmMsg3F1BusHiSpd.CalibrationPorts GmMsg3F1BusHiSpd.PerInstanceMemories GmMsg3F1BusHiSpd.ReceiverPorts GmMsg3F1BusHiSpd.SenderPorts /end SUB_GROUP
 /begin FUNCTION_LIST /end FUNCTION_LIST
 /begin REF_CHARACTERISTIC /end REF_CHARACTERISTIC
 /begin REF_MEASUREMENT /end REF_MEASUREMENT
/end GROUP
/begin GROUP GmMsg3F1BusHiSpd.AmbT.Val "MICROSAR RTE" /begin SUB_GROUP /end SUB_GROUP /begin FUNCTION_LIST /end FUNCTION_LIST /begin REF_CHARACTERISTIC /end REF_CHARACTERISTIC /begin REF_MEASUREMENT GmMsg3F1BusHiSpd.AmbT.Val /end REF_MEASUREMENT /end GROUP
/begin GROUP GmMsg3F1BusHiSpd.CalibrationPorts "MICROSAR RTE"
 /begin SUB_GROUP GmMsg3F1BusHiSpd.GmMsg3F1BusHiSpdAmbTDft.Val GmMsg3F1BusHiSpd.GmMsg3F1BusHiSpdInvldTiOut.Val GmMsg3F1BusHiSpd.GmMsg3F1BusHiSpdMissTiOut.Val /end SUB_GROUP
 /begin FUNCTION_LIST /end FUNCTION_LIST
 /begin REF_CHARACTERISTIC /end REF_CHARACTERISTIC
 /begin REF_MEASUREMENT /end REF_MEASUREMENT
/end GROUP
/begin GROUP GmMsg3F1BusHiSpd.GmMsg3F1BusHiSpdAmbTDft.Val "MICROSAR RTE" /begin SUB_GROUP /end SUB_GROUP /begin FUNCTION_LIST /end FUNCTION_LIST /begin REF_CHARACTERISTIC GmMsg3F1BusHiSpd.GmMsg3F1BusHiSpdAmbTDft.Val /end REF_CHARACTERISTIC /begin REF_MEASUREMENT /end REF_MEASUREMENT /end GROUP
/begin GROUP GmMsg3F1BusHiSpd.GmMsg3F1BusHiSpdInvldMsgTmr "MICROSAR RTE" /begin SUB_GROUP /end SUB_GROUP /begin FUNCTION_LIST /end FUNCTION_LIST /begin REF_CHARACTERISTIC /end REF_CHARACTERISTIC /begin REF_MEASUREMENT GmMsg3F1BusHiSpd.GmMsg3F1BusHiSpdInvldMsgTmr /end REF_MEASUREMENT /end GROUP
/begin GROUP GmMsg3F1BusHiSpd.GmMsg3F1BusHiSpdInvldTiOut.Val "MICROSAR RTE" /begin SUB_GROUP /end SUB_GROUP /begin FUNCTION_LIST /end FUNCTION_LIST /begin REF_CHARACTERISTIC GmMsg3F1BusHiSpd.GmMsg3F1BusHiSpdInvldTiOut.Val /end REF_CHARACTERISTIC /begin REF_MEASUREMENT /end REF_MEASUREMENT /end GROUP
/begin GROUP GmMsg3F1BusHiSpd.GmMsg3F1BusHiSpdMissTiOut.Val "MICROSAR RTE" /begin SUB_GROUP /end SUB_GROUP /begin FUNCTION_LIST /end FUNCTION_LIST /begin REF_CHARACTERISTIC GmMsg3F1BusHiSpd.GmMsg3F1BusHiSpdMissTiOut.Val /end REF_CHARACTERISTIC /begin REF_MEASUREMENT /end REF_MEASUREMENT /end GROUP
/begin GROUP GmMsg3F1BusHiSpd.LstRxnTiMsg3F1.Val "MICROSAR RTE" /begin SUB_GROUP /end SUB_GROUP /begin FUNCTION_LIST /end FUNCTION_LIST /begin REF_CHARACTERISTIC /end REF_CHARACTERISTIC /begin REF_MEASUREMENT GmMsg3F1BusHiSpd.LstRxnTiMsg3F1.Val /end REF_MEASUREMENT /end GROUP
/begin GROUP GmMsg3F1BusHiSpd.OutdAirTCorrdValMaskRaw.Val "MICROSAR RTE" /begin SUB_GROUP /end SUB_GROUP /begin FUNCTION_LIST /end FUNCTION_LIST /begin REF_CHARACTERISTIC /end REF_CHARACTERISTIC /begin REF_MEASUREMENT GmMsg3F1BusHiSpd.OutdAirTCorrdValMaskRaw.Val /end REF_MEASUREMENT /end GROUP
/begin GROUP GmMsg3F1BusHiSpd.OutdAirTCorrdValRaw.Val "MICROSAR RTE" /begin SUB_GROUP /end SUB_GROUP /begin FUNCTION_LIST /end FUNCTION_LIST /begin REF_CHARACTERISTIC /end REF_CHARACTERISTIC /begin REF_MEASUREMENT GmMsg3F1BusHiSpd.OutdAirTCorrdValRaw.Val /end REF_MEASUREMENT /end GROUP
/begin GROUP GmMsg3F1BusHiSpd.OutdAirTCorrdValVldRaw.Val "MICROSAR RTE" /begin SUB_GROUP /end SUB_GROUP /begin FUNCTION_LIST /end FUNCTION_LIST /begin REF_CHARACTERISTIC /end REF_CHARACTERISTIC /begin REF_MEASUREMENT GmMsg3F1BusHiSpd.OutdAirTCorrdValVldRaw.Val /end REF_MEASUREMENT /end GROUP
/begin GROUP GmMsg3F1BusHiSpd.PerInstanceMemories "MICROSAR RTE" /begin SUB_GROUP GmMsg3F1BusHiSpd.GmMsg3F1BusHiSpdInvldMsgTmr /end SUB_GROUP /begin FUNCTION_LIST /end FUNCTION_LIST /begin REF_CHARACTERISTIC /end REF_CHARACTERISTIC /begin REF_MEASUREMENT /end REF_MEASUREMENT /end GROUP
/begin GROUP GmMsg3F1BusHiSpd.ReceiverPorts "MICROSAR RTE"
 /begin SUB_GROUP GmMsg3F1BusHiSpd.LstRxnTiMsg3F1.Val GmMsg3F1BusHiSpd.OutdAirTCorrdValMaskRaw.Val GmMsg3F1BusHiSpd.OutdAirTCorrdValRaw.Val GmMsg3F1BusHiSpd.OutdAirTCorrdValVldRaw.Val /end SUB_GROUP
 /begin FUNCTION_LIST /end FUNCTION_LIST
 /begin REF_CHARACTERISTIC /end REF_CHARACTERISTIC
 /begin REF_MEASUREMENT /end REF_MEASUREMENT
/end GROUP
/begin GROUP GmMsg3F1BusHiSpd.SenderPorts "MICROSAR RTE" /begin SUB_GROUP GmMsg3F1BusHiSpd.AmbT.Val /end SUB_GROUP /begin FUNCTION_LIST /end FUNCTION_LIST /begin REF_CHARACTERISTIC /end REF_CHARACTERISTIC /begin REF_MEASUREMENT /end REF_MEASUREMENT /end GROUP
/begin GROUP GmMsg4D1BusHiSpd "MICROSAR RTE"
 /begin SUB_GROUP GmMsg4D1BusHiSpd.CalibrationPorts GmMsg4D1BusHiSpd.PerInstanceMemories GmMsg4D1BusHiSpd.ReceiverPorts GmMsg4D1BusHiSpd.SenderPorts /end SUB_GROUP
 /begin FUNCTION_LIST /end FUNCTION_LIST
 /begin REF_CHARACTERISTIC /end REF_CHARACTERISTIC
 /begin REF_MEASUREMENT /end REF_MEASUREMENT
/end GROUP
/begin GROUP GmMsg4D1BusHiSpd.CalibrationPorts "MICROSAR RTE"
 /begin SUB_GROUP GmMsg4D1BusHiSpd.GmMsg4D1BusHiSpdEngOilTDft.Val GmMsg4D1BusHiSpd.GmMsg4D1BusHiSpdInvldTiOut.Val GmMsg4D1BusHiSpd.GmMsg4D1BusHiSpdMissTiOut.Val /end SUB_GROUP
 /begin FUNCTION_LIST /end FUNCTION_LIST
 /begin REF_CHARACTERISTIC /end REF_CHARACTERISTIC
 /begin REF_MEASUREMENT /end REF_MEASUREMENT
/end GROUP
/begin GROUP GmMsg4D1BusHiSpd.EngOilT.Val "MICROSAR RTE" /begin SUB_GROUP /end SUB_GROUP /begin FUNCTION_LIST /end FUNCTION_LIST /begin REF_CHARACTERISTIC /end REF_CHARACTERISTIC /begin REF_MEASUREMENT GmMsg4D1BusHiSpd.EngOilT.Val /end REF_MEASUREMENT /end GROUP
/begin GROUP GmMsg4D1BusHiSpd.EngOilTRaw.Val "MICROSAR RTE" /begin SUB_GROUP /end SUB_GROUP /begin FUNCTION_LIST /end FUNCTION_LIST /begin REF_CHARACTERISTIC /end REF_CHARACTERISTIC /begin REF_MEASUREMENT GmMsg4D1BusHiSpd.EngOilTRaw.Val /end REF_MEASUREMENT /end GROUP
/begin GROUP GmMsg4D1BusHiSpd.EngOilVldRaw.Val "MICROSAR RTE" /begin SUB_GROUP /end SUB_GROUP /begin FUNCTION_LIST /end FUNCTION_LIST /begin REF_CHARACTERISTIC /end REF_CHARACTERISTIC /begin REF_MEASUREMENT GmMsg4D1BusHiSpd.EngOilVldRaw.Val /end REF_MEASUREMENT /end GROUP
/begin GROUP GmMsg4D1BusHiSpd.GmMsg4D1BusHiSpdEngOilTDft.Val "MICROSAR RTE" /begin SUB_GROUP /end SUB_GROUP /begin FUNCTION_LIST /end FUNCTION_LIST /begin REF_CHARACTERISTIC GmMsg4D1BusHiSpd.GmMsg4D1BusHiSpdEngOilTDft.Val /end REF_CHARACTERISTIC /begin REF_MEASUREMENT /end REF_MEASUREMENT /end GROUP
/begin GROUP GmMsg4D1BusHiSpd.GmMsg4D1BusHiSpdInvldMsgTmr "MICROSAR RTE" /begin SUB_GROUP /end SUB_GROUP /begin FUNCTION_LIST /end FUNCTION_LIST /begin REF_CHARACTERISTIC /end REF_CHARACTERISTIC /begin REF_MEASUREMENT GmMsg4D1BusHiSpd.GmMsg4D1BusHiSpdInvldMsgTmr /end REF_MEASUREMENT /end GROUP
/begin GROUP GmMsg4D1BusHiSpd.GmMsg4D1BusHiSpdInvldTiOut.Val "MICROSAR RTE" /begin SUB_GROUP /end SUB_GROUP /begin FUNCTION_LIST /end FUNCTION_LIST /begin REF_CHARACTERISTIC GmMsg4D1BusHiSpd.GmMsg4D1BusHiSpdInvldTiOut.Val /end REF_CHARACTERISTIC /begin REF_MEASUREMENT /end REF_MEASUREMENT /end GROUP
/begin GROUP GmMsg4D1BusHiSpd.GmMsg4D1BusHiSpdMissTiOut.Val "MICROSAR RTE" /begin SUB_GROUP /end SUB_GROUP /begin FUNCTION_LIST /end FUNCTION_LIST /begin REF_CHARACTERISTIC GmMsg4D1BusHiSpd.GmMsg4D1BusHiSpdMissTiOut.Val /end REF_CHARACTERISTIC /begin REF_MEASUREMENT /end REF_MEASUREMENT /end GROUP
/begin GROUP GmMsg4D1BusHiSpd.LstRxnTiMsg4D1.Val "MICROSAR RTE" /begin SUB_GROUP /end SUB_GROUP /begin FUNCTION_LIST /end FUNCTION_LIST /begin REF_CHARACTERISTIC /end REF_CHARACTERISTIC /begin REF_MEASUREMENT GmMsg4D1BusHiSpd.LstRxnTiMsg4D1.Val /end REF_MEASUREMENT /end GROUP
/begin GROUP GmMsg4D1BusHiSpd.PerInstanceMemories "MICROSAR RTE" /begin SUB_GROUP GmMsg4D1BusHiSpd.GmMsg4D1BusHiSpdInvldMsgTmr /end SUB_GROUP /begin FUNCTION_LIST /end FUNCTION_LIST /begin REF_CHARACTERISTIC /end REF_CHARACTERISTIC /begin REF_MEASUREMENT /end REF_MEASUREMENT /end GROUP
/begin GROUP GmMsg4D1BusHiSpd.ReceiverPorts "MICROSAR RTE"
 /begin SUB_GROUP GmMsg4D1BusHiSpd.EngOilTRaw.Val GmMsg4D1BusHiSpd.EngOilVldRaw.Val GmMsg4D1BusHiSpd.LstRxnTiMsg4D1.Val /end SUB_GROUP
 /begin FUNCTION_LIST /end FUNCTION_LIST
 /begin REF_CHARACTERISTIC /end REF_CHARACTERISTIC
 /begin REF_MEASUREMENT /end REF_MEASUREMENT
/end GROUP
/begin GROUP GmMsg4D1BusHiSpd.SenderPorts "MICROSAR RTE" /begin SUB_GROUP GmMsg4D1BusHiSpd.EngOilT.Val /end SUB_GROUP /begin FUNCTION_LIST /end FUNCTION_LIST /begin REF_CHARACTERISTIC /end REF_CHARACTERISTIC /begin REF_MEASUREMENT /end REF_MEASUREMENT /end GROUP
/begin GROUP GmMsg500BusHiSpd "MICROSAR RTE"
 /begin SUB_GROUP GmMsg500BusHiSpd.CalibrationPorts GmMsg500BusHiSpd.PerInstanceMemories GmMsg500BusHiSpd.ReceiverPorts GmMsg500BusHiSpd.SenderPorts /end SUB_GROUP
 /begin FUNCTION_LIST /end FUNCTION_LIST
 /begin REF_CHARACTERISTIC /end REF_CHARACTERISTIC
 /begin REF_MEASUREMENT /end REF_MEASUREMENT
/end GROUP
/begin GROUP GmMsg500BusHiSpd.CalibrationPorts "MICROSAR RTE"
 /begin SUB_GROUP GmMsg500BusHiSpd.GmMsg500BusHiSpdMissTiOut.Val GmMsg500BusHiSpd.GmMsg500BusHiSpdWhlPlsPerRevDft.Val GmMsg500BusHiSpd.GmMsg500BusHiSpdWhlRotlStsTiStampReslDft.Val /end SUB_GROUP
 /begin FUNCTION_LIST /end FUNCTION_LIST
 /begin REF_CHARACTERISTIC /end REF_CHARACTERISTIC
 /begin REF_MEASUREMENT /end REF_MEASUREMENT
/end GROUP
/begin GROUP GmMsg500BusHiSpd.GmMsg500BusHiSpdMissTiOut.Val "MICROSAR RTE" /begin SUB_GROUP /end SUB_GROUP /begin FUNCTION_LIST /end FUNCTION_LIST /begin REF_CHARACTERISTIC GmMsg500BusHiSpd.GmMsg500BusHiSpdMissTiOut.Val /end REF_CHARACTERISTIC /begin REF_MEASUREMENT /end REF_MEASUREMENT /end GROUP
/begin GROUP GmMsg500BusHiSpd.GmMsg500BusHiSpdPrevRxnTi "MICROSAR RTE" /begin SUB_GROUP /end SUB_GROUP /begin FUNCTION_LIST /end FUNCTION_LIST /begin REF_CHARACTERISTIC /end REF_CHARACTERISTIC /begin REF_MEASUREMENT GmMsg500BusHiSpd.GmMsg500BusHiSpdPrevRxnTi /end REF_MEASUREMENT /end GROUP
/begin GROUP GmMsg500BusHiSpd.GmMsg500BusHiSpdPrevWhlPlsPerRev "MICROSAR RTE" /begin SUB_GROUP /end SUB_GROUP /begin FUNCTION_LIST /end FUNCTION_LIST /begin REF_CHARACTERISTIC /end REF_CHARACTERISTIC /begin REF_MEASUREMENT GmMsg500BusHiSpd.GmMsg500BusHiSpdPrevWhlPlsPerRev /end REF_MEASUREMENT /end GROUP
/begin GROUP GmMsg500BusHiSpd.GmMsg500BusHiSpdPrevWhlRotlStsTiStampResl "MICROSAR RTE" /begin SUB_GROUP /end SUB_GROUP /begin FUNCTION_LIST /end FUNCTION_LIST /begin REF_CHARACTERISTIC /end REF_CHARACTERISTIC /begin REF_MEASUREMENT GmMsg500BusHiSpd.GmMsg500BusHiSpdPrevWhlRotlStsTiStampResl /end REF_MEASUREMENT /end GROUP
/begin GROUP GmMsg500BusHiSpd.GmMsg500BusHiSpdWhlPlsPerRevDft.Val "MICROSAR RTE" /begin SUB_GROUP /end SUB_GROUP /begin FUNCTION_LIST /end FUNCTION_LIST /begin REF_CHARACTERISTIC GmMsg500BusHiSpd.GmMsg500BusHiSpdWhlPlsPerRevDft.Val /end REF_CHARACTERISTIC /begin REF_MEASUREMENT /end REF_MEASUREMENT /end GROUP
/begin GROUP GmMsg500BusHiSpd.GmMsg500BusHiSpdWhlRotlStsTiStampReslDft.Val "MICROSAR RTE" /begin SUB_GROUP /end SUB_GROUP /begin FUNCTION_LIST /end FUNCTION_LIST
 /begin REF_CHARACTERISTIC GmMsg500BusHiSpd.GmMsg500BusHiSpdWhlRotlStsTiStampReslDft.Val /end REF_CHARACTERISTIC
 /begin REF_MEASUREMENT /end REF_MEASUREMENT
/end GROUP
/begin GROUP GmMsg500BusHiSpd.LstRxnTiMsg500BusHiSpd.Val "MICROSAR RTE" /begin SUB_GROUP /end SUB_GROUP /begin FUNCTION_LIST /end FUNCTION_LIST /begin REF_CHARACTERISTIC /end REF_CHARACTERISTIC /begin REF_MEASUREMENT GmMsg500BusHiSpd.LstRxnTiMsg500BusHiSpd.Val /end REF_MEASUREMENT /end GROUP
/begin GROUP GmMsg500BusHiSpd.PerInstanceMemories "MICROSAR RTE"
 /begin SUB_GROUP GmMsg500BusHiSpd.GmMsg500BusHiSpdPrevRxnTi GmMsg500BusHiSpd.GmMsg500BusHiSpdPrevWhlPlsPerRev GmMsg500BusHiSpd.GmMsg500BusHiSpdPrevWhlRotlStsTiStampResl /end SUB_GROUP
 /begin FUNCTION_LIST /end FUNCTION_LIST
 /begin REF_CHARACTERISTIC /end REF_CHARACTERISTIC
 /begin REF_MEASUREMENT /end REF_MEASUREMENT
/end GROUP
/begin GROUP GmMsg500BusHiSpd.ReceiverPorts "MICROSAR RTE"
 /begin SUB_GROUP GmMsg500BusHiSpd.LstRxnTiMsg500BusHiSpd.Val GmMsg500BusHiSpd.WhlPlsPerRevRaw.Val GmMsg500BusHiSpd.WhlRotlStsTiStampReslRaw.Val /end SUB_GROUP
 /begin FUNCTION_LIST /end FUNCTION_LIST
 /begin REF_CHARACTERISTIC /end REF_CHARACTERISTIC
 /begin REF_MEASUREMENT /end REF_MEASUREMENT
/end GROUP
/begin GROUP GmMsg500BusHiSpd.SenderPorts "MICROSAR RTE"
 /begin SUB_GROUP GmMsg500BusHiSpd.WhlPlsPerRev.Val GmMsg500BusHiSpd.WhlRotlStsTiStampResl.Val /end SUB_GROUP
 /begin FUNCTION_LIST /end FUNCTION_LIST
 /begin REF_CHARACTERISTIC /end REF_CHARACTERISTIC
 /begin REF_MEASUREMENT /end REF_MEASUREMENT
/end GROUP
/begin GROUP GmMsg500BusHiSpd.WhlPlsPerRev.Val "MICROSAR RTE" /begin SUB_GROUP /end SUB_GROUP /begin FUNCTION_LIST /end FUNCTION_LIST /begin REF_CHARACTERISTIC /end REF_CHARACTERISTIC /begin REF_MEASUREMENT GmMsg500BusHiSpd.WhlPlsPerRev.Val /end REF_MEASUREMENT /end GROUP
/begin GROUP GmMsg500BusHiSpd.WhlPlsPerRevRaw.Val "MICROSAR RTE" /begin SUB_GROUP /end SUB_GROUP /begin FUNCTION_LIST /end FUNCTION_LIST /begin REF_CHARACTERISTIC /end REF_CHARACTERISTIC /begin REF_MEASUREMENT GmMsg500BusHiSpd.WhlPlsPerRevRaw.Val /end REF_MEASUREMENT /end GROUP
/begin GROUP GmMsg500BusHiSpd.WhlRotlStsTiStampResl.Val "MICROSAR RTE" /begin SUB_GROUP /end SUB_GROUP /begin FUNCTION_LIST /end FUNCTION_LIST /begin REF_CHARACTERISTIC /end REF_CHARACTERISTIC /begin REF_MEASUREMENT GmMsg500BusHiSpd.WhlRotlStsTiStampResl.Val /end REF_MEASUREMENT /end GROUP
/begin GROUP GmMsg500BusHiSpd.WhlRotlStsTiStampReslRaw.Val "MICROSAR RTE" /begin SUB_GROUP /end SUB_GROUP /begin FUNCTION_LIST /end FUNCTION_LIST /begin REF_CHARACTERISTIC /end REF_CHARACTERISTIC /begin REF_MEASUREMENT GmMsg500BusHiSpd.WhlRotlStsTiStampReslRaw.Val /end REF_MEASUREMENT /end GROUP
/begin GROUP GmMsg778BusHiSpd "MICROSAR RTE"
 /begin SUB_GROUP GmMsg778BusHiSpd.PerInstanceMemories GmMsg778BusHiSpd.ReceiverPorts GmMsg778BusHiSpd.SenderPorts /end SUB_GROUP
 /begin FUNCTION_LIST /end FUNCTION_LIST
 /begin REF_CHARACTERISTIC /end REF_CHARACTERISTIC
 /begin REF_MEASUREMENT /end REF_MEASUREMENT
/end GROUP
/begin GROUP GmMsg778BusHiSpd.ActvEveId "MICROSAR RTE" /begin SUB_GROUP /end SUB_GROUP /begin FUNCTION_LIST /end FUNCTION_LIST /begin REF_CHARACTERISTIC /end REF_CHARACTERISTIC /begin REF_MEASUREMENT GmMsg778BusHiSpd.ActvEveId /end REF_MEASUREMENT /end GROUP
/begin GROUP GmMsg778BusHiSpd.CodSupported.Val "MICROSAR RTE" /begin SUB_GROUP /end SUB_GROUP /begin FUNCTION_LIST /end FUNCTION_LIST /begin REF_CHARACTERISTIC /end REF_CHARACTERISTIC /begin REF_MEASUREMENT GmMsg778BusHiSpd.CodSupported.Val /end REF_MEASUREMENT /end GROUP
/begin GROUP GmMsg778BusHiSpd.CurrSts.Val "MICROSAR RTE" /begin SUB_GROUP /end SUB_GROUP /begin FUNCTION_LIST /end FUNCTION_LIST /begin REF_CHARACTERISTIC /end REF_CHARACTERISTIC /begin REF_MEASUREMENT GmMsg778BusHiSpd.CurrSts.Val /end REF_MEASUREMENT /end GROUP
/begin GROUP GmMsg778BusHiSpd.DtcFailrTyp.Val "MICROSAR RTE" /begin SUB_GROUP /end SUB_GROUP /begin FUNCTION_LIST /end FUNCTION_LIST /begin REF_CHARACTERISTIC /end REF_CHARACTERISTIC /begin REF_MEASUREMENT GmMsg778BusHiSpd.DtcFailrTyp.Val /end REF_MEASUREMENT /end GROUP
/begin GROUP GmMsg778BusHiSpd.DtcFltTyp.Val "MICROSAR RTE" /begin SUB_GROUP /end SUB_GROUP /begin FUNCTION_LIST /end FUNCTION_LIST /begin REF_CHARACTERISTIC /end REF_CHARACTERISTIC /begin REF_MEASUREMENT GmMsg778BusHiSpd.DtcFltTyp.Val /end REF_MEASUREMENT /end GROUP
/begin GROUP GmMsg778BusHiSpd.DtcMap "MICROSAR RTE" /begin SUB_GROUP /end SUB_GROUP /begin FUNCTION_LIST /end FUNCTION_LIST /begin REF_CHARACTERISTIC /end REF_CHARACTERISTIC /begin REF_MEASUREMENT GmMsg778BusHiSpd.DtcMap /end REF_MEASUREMENT /end GROUP
/begin GROUP GmMsg778BusHiSpd.DtcNr.Val "MICROSAR RTE" /begin SUB_GROUP /end SUB_GROUP /begin FUNCTION_LIST /end FUNCTION_LIST /begin REF_CHARACTERISTIC /end REF_CHARACTERISTIC /begin REF_MEASUREMENT GmMsg778BusHiSpd.DtcNr.Val /end REF_MEASUREMENT /end GROUP
/begin GROUP GmMsg778BusHiSpd.DtcSrc.Val "MICROSAR RTE" /begin SUB_GROUP /end SUB_GROUP /begin FUNCTION_LIST /end FUNCTION_LIST /begin REF_CHARACTERISTIC /end REF_CHARACTERISTIC /begin REF_MEASUREMENT GmMsg778BusHiSpd.DtcSrc.Val /end REF_MEASUREMENT /end GROUP
/begin GROUP GmMsg778BusHiSpd.DtcTrig.Val "MICROSAR RTE" /begin SUB_GROUP /end SUB_GROUP /begin FUNCTION_LIST /end FUNCTION_LIST /begin REF_CHARACTERISTIC /end REF_CHARACTERISTIC /begin REF_MEASUREMENT GmMsg778BusHiSpd.DtcTrig.Val /end REF_MEASUREMENT /end GROUP
/begin GROUP GmMsg778BusHiSpd.DtcTrigStsAry "MICROSAR RTE" /begin SUB_GROUP /end SUB_GROUP /begin FUNCTION_LIST /end FUNCTION_LIST /begin REF_CHARACTERISTIC /end REF_CHARACTERISTIC /begin REF_MEASUREMENT GmMsg778BusHiSpd.DtcTrigStsAry /end REF_MEASUREMENT /end GROUP
/begin GROUP GmMsg778BusHiSpd.EveCnt "MICROSAR RTE" /begin SUB_GROUP /end SUB_GROUP /begin FUNCTION_LIST /end FUNCTION_LIST /begin REF_CHARACTERISTIC /end REF_CHARACTERISTIC /begin REF_MEASUREMENT GmMsg778BusHiSpd.EveCnt /end REF_MEASUREMENT /end GROUP
/begin GROUP GmMsg778BusHiSpd.EveMap "MICROSAR RTE" /begin SUB_GROUP /end SUB_GROUP /begin FUNCTION_LIST /end FUNCTION_LIST /begin REF_CHARACTERISTIC /end REF_CHARACTERISTIC /begin REF_MEASUREMENT GmMsg778BusHiSpd.EveMap /end REF_MEASUREMENT /end GROUP
/begin GROUP GmMsg778BusHiSpd.HistSts.Val "MICROSAR RTE" /begin SUB_GROUP /end SUB_GROUP /begin FUNCTION_LIST /end FUNCTION_LIST /begin REF_CHARACTERISTIC /end REF_CHARACTERISTIC /begin REF_MEASUREMENT GmMsg778BusHiSpd.HistSts.Val /end REF_MEASUREMENT /end GROUP
/begin GROUP GmMsg778BusHiSpd.PerInstanceMemories "MICROSAR RTE"
 /begin SUB_GROUP GmMsg778BusHiSpd.ActvEveId GmMsg778BusHiSpd.DtcMap GmMsg778BusHiSpd.DtcTrigStsAry GmMsg778BusHiSpd.EveCnt GmMsg778BusHiSpd.EveMap GmMsg778BusHiSpd.TrigActv GmMsg778BusHiSpd.TrigTmr /end SUB_GROUP
 /begin FUNCTION_LIST /end FUNCTION_LIST
 /begin REF_CHARACTERISTIC /end REF_CHARACTERISTIC
 /begin REF_MEASUREMENT /end REF_MEASUREMENT
/end GROUP
/begin GROUP GmMsg778BusHiSpd.ReceiverPorts "MICROSAR RTE" /begin SUB_GROUP GmMsg778BusHiSpd.SysSt.Val /end SUB_GROUP /begin FUNCTION_LIST /end FUNCTION_LIST /begin REF_CHARACTERISTIC /end REF_CHARACTERISTIC /begin REF_MEASUREMENT /end REF_MEASUREMENT /end GROUP
/begin GROUP GmMsg778BusHiSpd.SenderPorts "MICROSAR RTE"
 /begin SUB_GROUP GmMsg778BusHiSpd.CodSupported.Val GmMsg778BusHiSpd.CurrSts.Val GmMsg778BusHiSpd.DtcFailrTyp.Val GmMsg778BusHiSpd.DtcFltTyp.Val GmMsg778BusHiSpd.DtcNr.Val GmMsg778BusHiSpd.DtcSrc.Val GmMsg778BusHiSpd.DtcTrig.Val GmMsg778BusHiSpd.HistSts.Val GmMsg778BusHiSpd.TstFaildCodClrdSts.Val GmMsg778BusHiSpd.TstFaildPwrUpSts.Val GmMsg778BusHiSpd.TstNotPassdCodClrdSts.Val GmMsg778BusHiSpd.TstNotPassdPwrUpSts.Val GmMsg778BusHiSpd.WarnIndcrReqdSts.Val /end SUB_GROUP
 /begin FUNCTION_LIST /end FUNCTION_LIST
 /begin REF_CHARACTERISTIC /end REF_CHARACTERISTIC
 /begin REF_MEASUREMENT /end REF_MEASUREMENT
/end GROUP
/begin GROUP GmMsg778BusHiSpd.SysSt.Val "MICROSAR RTE" /begin SUB_GROUP /end SUB_GROUP /begin FUNCTION_LIST /end FUNCTION_LIST /begin REF_CHARACTERISTIC /end REF_CHARACTERISTIC /begin REF_MEASUREMENT GmMsg778BusHiSpd.SysSt.Val /end REF_MEASUREMENT /end GROUP
/begin GROUP GmMsg778BusHiSpd.TrigActv "MICROSAR RTE" /begin SUB_GROUP /end SUB_GROUP /begin FUNCTION_LIST /end FUNCTION_LIST /begin REF_CHARACTERISTIC /end REF_CHARACTERISTIC /begin REF_MEASUREMENT GmMsg778BusHiSpd.TrigActv /end REF_MEASUREMENT /end GROUP
/begin GROUP GmMsg778BusHiSpd.TrigTmr "MICROSAR RTE" /begin SUB_GROUP /end SUB_GROUP /begin FUNCTION_LIST /end FUNCTION_LIST /begin REF_CHARACTERISTIC /end REF_CHARACTERISTIC /begin REF_MEASUREMENT GmMsg778BusHiSpd.TrigTmr /end REF_MEASUREMENT /end GROUP
/begin GROUP GmMsg778BusHiSpd.TstFaildCodClrdSts.Val "MICROSAR RTE" /begin SUB_GROUP /end SUB_GROUP /begin FUNCTION_LIST /end FUNCTION_LIST /begin REF_CHARACTERISTIC /end REF_CHARACTERISTIC /begin REF_MEASUREMENT GmMsg778BusHiSpd.TstFaildCodClrdSts.Val /end REF_MEASUREMENT /end GROUP
/begin GROUP GmMsg778BusHiSpd.TstFaildPwrUpSts.Val "MICROSAR RTE" /begin SUB_GROUP /end SUB_GROUP /begin FUNCTION_LIST /end FUNCTION_LIST /begin REF_CHARACTERISTIC /end REF_CHARACTERISTIC /begin REF_MEASUREMENT GmMsg778BusHiSpd.TstFaildPwrUpSts.Val /end REF_MEASUREMENT /end GROUP
/begin GROUP GmMsg778BusHiSpd.TstNotPassdCodClrdSts.Val "MICROSAR RTE" /begin SUB_GROUP /end SUB_GROUP /begin FUNCTION_LIST /end FUNCTION_LIST /begin REF_CHARACTERISTIC /end REF_CHARACTERISTIC /begin REF_MEASUREMENT GmMsg778BusHiSpd.TstNotPassdCodClrdSts.Val /end REF_MEASUREMENT /end GROUP
/begin GROUP GmMsg778BusHiSpd.TstNotPassdPwrUpSts.Val "MICROSAR RTE" /begin SUB_GROUP /end SUB_GROUP /begin FUNCTION_LIST /end FUNCTION_LIST /begin REF_CHARACTERISTIC /end REF_CHARACTERISTIC /begin REF_MEASUREMENT GmMsg778BusHiSpd.TstNotPassdPwrUpSts.Val /end REF_MEASUREMENT /end GROUP
/begin GROUP GmMsg778BusHiSpd.WarnIndcrReqdSts.Val "MICROSAR RTE" /begin SUB_GROUP /end SUB_GROUP /begin FUNCTION_LIST /end FUNCTION_LIST /begin REF_CHARACTERISTIC /end REF_CHARACTERISTIC /begin REF_MEASUREMENT GmMsg778BusHiSpd.WarnIndcrReqdSts.Val /end REF_MEASUREMENT /end GROUP
/begin GROUP GmOvrlStMgr "MICROSAR RTE"
 /begin SUB_GROUP GmOvrlStMgr.CalibrationPorts GmOvrlStMgr.PerInstanceMemories GmOvrlStMgr.ReceiverPorts GmOvrlStMgr.SenderPorts /end SUB_GROUP
 /begin FUNCTION_LIST /end FUNCTION_LIST
 /begin REF_CHARACTERISTIC /end REF_CHARACTERISTIC
 /begin REF_MEASUREMENT /end REF_MEASUREMENT
/end GROUP
/begin GROUP GmOvrlStMgr.AbsActvProtd.Logl "MICROSAR RTE" /begin SUB_GROUP /end SUB_GROUP /begin FUNCTION_LIST /end FUNCTION_LIST /begin REF_CHARACTERISTIC /end REF_CHARACTERISTIC /begin REF_MEASUREMENT GmOvrlStMgr.AbsActvProtd.Logl /end REF_MEASUREMENT /end GROUP
/begin GROUP GmOvrlStMgr.ApaDrvrIntvDetd.Logl "MICROSAR RTE" /begin SUB_GROUP /end SUB_GROUP /begin FUNCTION_LIST /end FUNCTION_LIST /begin REF_CHARACTERISTIC /end REF_CHARACTERISTIC /begin REF_MEASUREMENT GmOvrlStMgr.ApaDrvrIntvDetd.Logl /end REF_MEASUREMENT /end GROUP
/begin GROUP GmOvrlStMgr.ApaEna.Logl "MICROSAR RTE" /begin SUB_GROUP /end SUB_GROUP /begin FUNCTION_LIST /end FUNCTION_LIST /begin REF_CHARACTERISTIC /end REF_CHARACTERISTIC /begin REF_MEASUREMENT GmOvrlStMgr.ApaEna.Logl /end REF_MEASUREMENT /end GROUP
/begin GROUP GmOvrlStMgr.ApaSt.Val "MICROSAR RTE" /begin SUB_GROUP /end SUB_GROUP /begin FUNCTION_LIST /end FUNCTION_LIST /begin REF_CHARACTERISTIC /end REF_CHARACTERISTIC /begin REF_MEASUREMENT GmOvrlStMgr.ApaSt.Val /end REF_MEASUREMENT /end GROUP
/begin GROUP GmOvrlStMgr.CalibrationPorts "MICROSAR RTE"
 /begin SUB_GROUP GmOvrlStMgr.GmOvrlStMgrApaHaptcEna.Logl GmOvrlStMgr.GmOvrlStMgrApaHwTqFilFrq.Val GmOvrlStMgr.GmOvrlStMgrApaHwTqThd.Val GmOvrlStMgr.GmOvrlStMgrApaHwTqTiThd.Val GmOvrlStMgr.GmOvrlStMgrApaMfgEna.Logl GmOvrlStMgr.GmOvrlStMgrApaVehSpdHiLim.Val GmOvrlStMgr.GmOvrlStMgrEscMfgEna.Logl GmOvrlStMgr.GmOvrlStMgrEscVehSpdHiLim.Val GmOvrlStMgr.GmOvrlStMgrHaptcAmp.Val GmOvrlStMgr.GmOvrlStMgrHaptcDurn.Val GmOvrlStMgr.GmOvrlStMgrHaptcFrq.Val GmOvrlStMgr.GmOvrlStMgrHaptcReactnTi.Val GmOvrlStMgr.GmOvrlStMgrHaptcReqTiThd.Val GmOvrlStMgr.GmOvrlStMgrHwAgTarLimr.Val GmOvrlStMgr.GmOvrlStMgrHwTqFilFrq.Val GmOvrlStMgr.GmOvrlStMgrLkaHwTqFilFrq.Val GmOvrlStMgr.GmOvrlStMgrLkaHwTqThd1.Val GmOvrlStMgr.GmOvrlStMgrLkaHwTqThd2.Val GmOvrlStMgr.GmOvrlStMgrLkaHwTqTiThd1.Val GmOvrlStMgr.GmOvrlStMgrLkaHwTqTiThd2.Val GmOvrlStMgr.GmOvrlStMgrLkaMfgEna.Logl GmOvrlStMgr.GmOvrlStMgrLkaVehSpdHiLim.Val GmOvrlStMgr.GmOvrlStMgrLkaVehSpdLoLim.Val GmOvrlStMgr.GmOvrlStMgrLoaMtgtnHaptcFbOffTi.Val GmOvrlStMgr.GmOvrlStMgrLoaMtgtnHaptcFbOnTi.Val GmOvrlStMgr.GmOvrlStMgrLoaMtgtnHaptcFbStrtOnTi.Val GmOvrlStMgr.GmOvrlStMgrLoaMtgtnHaptcFbTqMax.Val GmOvrlStMgr.GmOvrlStMgrLoaMtgtnHaptcFbTqMin.Val GmOvrlStMgr.GmOvrlStMgrLoaMtgtnHaptcFbVehSpdMax.Val GmOvrlStMgr.GmOvrlStMgrLoaMtgtnHaptcFbVehSpdMin.Val GmOvrlStMgr.GmOvrlStMgrLoaMtgtnHaptcFrq.Val GmOvrlStMgr.GmOvrlStMgrLoaMtgtnStrtHaptcAmp.Val GmOvrlStMgr.GmOvrlStMgrLoaMtgtnTqOscnAmpY.Ary1D GmOvrlStMgr.GmOvrlStMgrLoaMtgtnVehSpdX.Ary1D GmOvrlStMgr.GmOvrlStMgrLoaStIgnCntrThd.Val GmOvrlStMgr.GmOvrlStMgrShiftLvrTiThd.Val GmOvrlStMgr.GmOvrlStMgrStandStillThd.Val GmOvrlStMgr.GmOvrlStMgrStandStillTiThd.Val /end SUB_GROUP
 /begin FUNCTION_LIST /end FUNCTION_LIST
 /begin REF_CHARACTERISTIC /end REF_CHARACTERISTIC
 /begin REF_MEASUREMENT /end REF_MEASUREMENT
/end GROUP
/begin GROUP GmOvrlStMgr.EscEna.Logl "MICROSAR RTE" /begin SUB_GROUP /end SUB_GROUP /begin FUNCTION_LIST /end FUNCTION_LIST /begin REF_CHARACTERISTIC /end REF_CHARACTERISTIC /begin REF_MEASUREMENT GmOvrlStMgr.EscEna.Logl /end REF_MEASUREMENT /end GROUP
/begin GROUP GmOvrlStMgr.EscLimdActv.Logl "MICROSAR RTE" /begin SUB_GROUP /end SUB_GROUP /begin FUNCTION_LIST /end FUNCTION_LIST /begin REF_CHARACTERISTIC /end REF_CHARACTERISTIC /begin REF_MEASUREMENT GmOvrlStMgr.EscLimdActv.Logl /end REF_MEASUREMENT /end GROUP
/begin GROUP GmOvrlStMgr.EscSt.Val "MICROSAR RTE" /begin SUB_GROUP /end SUB_GROUP /begin FUNCTION_LIST /end FUNCTION_LIST /begin REF_CHARACTERISTIC /end REF_CHARACTERISTIC /begin REF_MEASUREMENT GmOvrlStMgr.EscSt.Val /end REF_MEASUREMENT /end GROUP
/begin GROUP GmOvrlStMgr.GmLoaIgnCntr "MICROSAR RTE" /begin SUB_GROUP /end SUB_GROUP /begin FUNCTION_LIST /end FUNCTION_LIST /begin REF_CHARACTERISTIC /end REF_CHARACTERISTIC /begin REF_MEASUREMENT GmOvrlStMgr.GmLoaIgnCntr /end REF_MEASUREMENT /end GROUP
/begin GROUP GmOvrlStMgr.GmOvrlStMgrApaHaptcEna.Logl "MICROSAR RTE" /begin SUB_GROUP /end SUB_GROUP /begin FUNCTION_LIST /end FUNCTION_LIST /begin REF_CHARACTERISTIC GmOvrlStMgr.GmOvrlStMgrApaHaptcEna.Logl /end REF_CHARACTERISTIC /begin REF_MEASUREMENT /end REF_MEASUREMENT /end GROUP
/begin GROUP GmOvrlStMgr.GmOvrlStMgrApaHwTqFilFrq.Val "MICROSAR RTE" /begin SUB_GROUP /end SUB_GROUP /begin FUNCTION_LIST /end FUNCTION_LIST /begin REF_CHARACTERISTIC GmOvrlStMgr.GmOvrlStMgrApaHwTqFilFrq.Val /end REF_CHARACTERISTIC /begin REF_MEASUREMENT /end REF_MEASUREMENT /end GROUP
/begin GROUP GmOvrlStMgr.GmOvrlStMgrApaHwTqThd.Val "MICROSAR RTE" /begin SUB_GROUP /end SUB_GROUP /begin FUNCTION_LIST /end FUNCTION_LIST /begin REF_CHARACTERISTIC GmOvrlStMgr.GmOvrlStMgrApaHwTqThd.Val /end REF_CHARACTERISTIC /begin REF_MEASUREMENT /end REF_MEASUREMENT /end GROUP
/begin GROUP GmOvrlStMgr.GmOvrlStMgrApaHwTqTiThd.Val "MICROSAR RTE" /begin SUB_GROUP /end SUB_GROUP /begin FUNCTION_LIST /end FUNCTION_LIST /begin REF_CHARACTERISTIC GmOvrlStMgr.GmOvrlStMgrApaHwTqTiThd.Val /end REF_CHARACTERISTIC /begin REF_MEASUREMENT /end REF_MEASUREMENT /end GROUP
/begin GROUP GmOvrlStMgr.GmOvrlStMgrApaMfgEna.Logl "MICROSAR RTE" /begin SUB_GROUP /end SUB_GROUP /begin FUNCTION_LIST /end FUNCTION_LIST /begin REF_CHARACTERISTIC GmOvrlStMgr.GmOvrlStMgrApaMfgEna.Logl /end REF_CHARACTERISTIC /begin REF_MEASUREMENT /end REF_MEASUREMENT /end GROUP
/begin GROUP GmOvrlStMgr.GmOvrlStMgrApaVehSpdHiLim.Val "MICROSAR RTE" /begin SUB_GROUP /end SUB_GROUP /begin FUNCTION_LIST /end FUNCTION_LIST /begin REF_CHARACTERISTIC GmOvrlStMgr.GmOvrlStMgrApaVehSpdHiLim.Val /end REF_CHARACTERISTIC /begin REF_MEASUREMENT /end REF_MEASUREMENT /end GROUP
/begin GROUP GmOvrlStMgr.GmOvrlStMgrEscMfgEna.Logl "MICROSAR RTE" /begin SUB_GROUP /end SUB_GROUP /begin FUNCTION_LIST /end FUNCTION_LIST /begin REF_CHARACTERISTIC GmOvrlStMgr.GmOvrlStMgrEscMfgEna.Logl /end REF_CHARACTERISTIC /begin REF_MEASUREMENT /end REF_MEASUREMENT /end GROUP
/begin GROUP GmOvrlStMgr.GmOvrlStMgrEscVehSpdHiLim.Val "MICROSAR RTE" /begin SUB_GROUP /end SUB_GROUP /begin FUNCTION_LIST /end FUNCTION_LIST /begin REF_CHARACTERISTIC GmOvrlStMgr.GmOvrlStMgrEscVehSpdHiLim.Val /end REF_CHARACTERISTIC /begin REF_MEASUREMENT /end REF_MEASUREMENT /end GROUP
/begin GROUP GmOvrlStMgr.GmOvrlStMgrHaptcAmp.Val "MICROSAR RTE" /begin SUB_GROUP /end SUB_GROUP /begin FUNCTION_LIST /end FUNCTION_LIST /begin REF_CHARACTERISTIC GmOvrlStMgr.GmOvrlStMgrHaptcAmp.Val /end REF_CHARACTERISTIC /begin REF_MEASUREMENT /end REF_MEASUREMENT /end GROUP
/begin GROUP GmOvrlStMgr.GmOvrlStMgrHaptcDurn.Val "MICROSAR RTE" /begin SUB_GROUP /end SUB_GROUP /begin FUNCTION_LIST /end FUNCTION_LIST /begin REF_CHARACTERISTIC GmOvrlStMgr.GmOvrlStMgrHaptcDurn.Val /end REF_CHARACTERISTIC /begin REF_MEASUREMENT /end REF_MEASUREMENT /end GROUP
/begin GROUP GmOvrlStMgr.GmOvrlStMgrHaptcFrq.Val "MICROSAR RTE" /begin SUB_GROUP /end SUB_GROUP /begin FUNCTION_LIST /end FUNCTION_LIST /begin REF_CHARACTERISTIC GmOvrlStMgr.GmOvrlStMgrHaptcFrq.Val /end REF_CHARACTERISTIC /begin REF_MEASUREMENT /end REF_MEASUREMENT /end GROUP
/begin GROUP GmOvrlStMgr.GmOvrlStMgrHaptcReactnTi.Val "MICROSAR RTE" /begin SUB_GROUP /end SUB_GROUP /begin FUNCTION_LIST /end FUNCTION_LIST /begin REF_CHARACTERISTIC GmOvrlStMgr.GmOvrlStMgrHaptcReactnTi.Val /end REF_CHARACTERISTIC /begin REF_MEASUREMENT /end REF_MEASUREMENT /end GROUP
/begin GROUP GmOvrlStMgr.GmOvrlStMgrHaptcReqTiThd.Val "MICROSAR RTE" /begin SUB_GROUP /end SUB_GROUP /begin FUNCTION_LIST /end FUNCTION_LIST /begin REF_CHARACTERISTIC GmOvrlStMgr.GmOvrlStMgrHaptcReqTiThd.Val /end REF_CHARACTERISTIC /begin REF_MEASUREMENT /end REF_MEASUREMENT /end GROUP
/begin GROUP GmOvrlStMgr.GmOvrlStMgrHwAgTarLimr.Val "MICROSAR RTE" /begin SUB_GROUP /end SUB_GROUP /begin FUNCTION_LIST /end FUNCTION_LIST /begin REF_CHARACTERISTIC GmOvrlStMgr.GmOvrlStMgrHwAgTarLimr.Val /end REF_CHARACTERISTIC /begin REF_MEASUREMENT /end REF_MEASUREMENT /end GROUP
/begin GROUP GmOvrlStMgr.GmOvrlStMgrHwTqFilFrq.Val "MICROSAR RTE" /begin SUB_GROUP /end SUB_GROUP /begin FUNCTION_LIST /end FUNCTION_LIST /begin REF_CHARACTERISTIC GmOvrlStMgr.GmOvrlStMgrHwTqFilFrq.Val /end REF_CHARACTERISTIC /begin REF_MEASUREMENT /end REF_MEASUREMENT /end GROUP
/begin GROUP GmOvrlStMgr.GmOvrlStMgrLkaHwTqFilFrq.Val "MICROSAR RTE" /begin SUB_GROUP /end SUB_GROUP /begin FUNCTION_LIST /end FUNCTION_LIST /begin REF_CHARACTERISTIC GmOvrlStMgr.GmOvrlStMgrLkaHwTqFilFrq.Val /end REF_CHARACTERISTIC /begin REF_MEASUREMENT /end REF_MEASUREMENT /end GROUP
/begin GROUP GmOvrlStMgr.GmOvrlStMgrLkaHwTqThd1.Val "MICROSAR RTE" /begin SUB_GROUP /end SUB_GROUP /begin FUNCTION_LIST /end FUNCTION_LIST /begin REF_CHARACTERISTIC GmOvrlStMgr.GmOvrlStMgrLkaHwTqThd1.Val /end REF_CHARACTERISTIC /begin REF_MEASUREMENT /end REF_MEASUREMENT /end GROUP
/begin GROUP GmOvrlStMgr.GmOvrlStMgrLkaHwTqThd2.Val "MICROSAR RTE" /begin SUB_GROUP /end SUB_GROUP /begin FUNCTION_LIST /end FUNCTION_LIST /begin REF_CHARACTERISTIC GmOvrlStMgr.GmOvrlStMgrLkaHwTqThd2.Val /end REF_CHARACTERISTIC /begin REF_MEASUREMENT /end REF_MEASUREMENT /end GROUP
/begin GROUP GmOvrlStMgr.GmOvrlStMgrLkaHwTqTiThd1.Val "MICROSAR RTE" /begin SUB_GROUP /end SUB_GROUP /begin FUNCTION_LIST /end FUNCTION_LIST /begin REF_CHARACTERISTIC GmOvrlStMgr.GmOvrlStMgrLkaHwTqTiThd1.Val /end REF_CHARACTERISTIC /begin REF_MEASUREMENT /end REF_MEASUREMENT /end GROUP
/begin GROUP GmOvrlStMgr.GmOvrlStMgrLkaHwTqTiThd2.Val "MICROSAR RTE" /begin SUB_GROUP /end SUB_GROUP /begin FUNCTION_LIST /end FUNCTION_LIST /begin REF_CHARACTERISTIC GmOvrlStMgr.GmOvrlStMgrLkaHwTqTiThd2.Val /end REF_CHARACTERISTIC /begin REF_MEASUREMENT /end REF_MEASUREMENT /end GROUP
/begin GROUP GmOvrlStMgr.GmOvrlStMgrLkaMfgEna.Logl "MICROSAR RTE" /begin SUB_GROUP /end SUB_GROUP /begin FUNCTION_LIST /end FUNCTION_LIST /begin REF_CHARACTERISTIC GmOvrlStMgr.GmOvrlStMgrLkaMfgEna.Logl /end REF_CHARACTERISTIC /begin REF_MEASUREMENT /end REF_MEASUREMENT /end GROUP
/begin GROUP GmOvrlStMgr.GmOvrlStMgrLkaVehSpdHiLim.Val "MICROSAR RTE" /begin SUB_GROUP /end SUB_GROUP /begin FUNCTION_LIST /end FUNCTION_LIST /begin REF_CHARACTERISTIC GmOvrlStMgr.GmOvrlStMgrLkaVehSpdHiLim.Val /end REF_CHARACTERISTIC /begin REF_MEASUREMENT /end REF_MEASUREMENT /end GROUP
/begin GROUP GmOvrlStMgr.GmOvrlStMgrLkaVehSpdLoLim.Val "MICROSAR RTE" /begin SUB_GROUP /end SUB_GROUP /begin FUNCTION_LIST /end FUNCTION_LIST /begin REF_CHARACTERISTIC GmOvrlStMgr.GmOvrlStMgrLkaVehSpdLoLim.Val /end REF_CHARACTERISTIC /begin REF_MEASUREMENT /end REF_MEASUREMENT /end GROUP
/begin GROUP GmOvrlStMgr.GmOvrlStMgrLoaMtgtnHaptcFbOffTi.Val "MICROSAR RTE" /begin SUB_GROUP /end SUB_GROUP /begin FUNCTION_LIST /end FUNCTION_LIST /begin REF_CHARACTERISTIC GmOvrlStMgr.GmOvrlStMgrLoaMtgtnHaptcFbOffTi.Val /end REF_CHARACTERISTIC /begin REF_MEASUREMENT /end REF_MEASUREMENT /end GROUP
/begin GROUP GmOvrlStMgr.GmOvrlStMgrLoaMtgtnHaptcFbOnTi.Val "MICROSAR RTE" /begin SUB_GROUP /end SUB_GROUP /begin FUNCTION_LIST /end FUNCTION_LIST /begin REF_CHARACTERISTIC GmOvrlStMgr.GmOvrlStMgrLoaMtgtnHaptcFbOnTi.Val /end REF_CHARACTERISTIC /begin REF_MEASUREMENT /end REF_MEASUREMENT /end GROUP
/begin GROUP GmOvrlStMgr.GmOvrlStMgrLoaMtgtnHaptcFbStrtOnTi.Val "MICROSAR RTE" /begin SUB_GROUP /end SUB_GROUP /begin FUNCTION_LIST /end FUNCTION_LIST /begin REF_CHARACTERISTIC GmOvrlStMgr.GmOvrlStMgrLoaMtgtnHaptcFbStrtOnTi.Val /end REF_CHARACTERISTIC /begin REF_MEASUREMENT /end REF_MEASUREMENT /end GROUP
/begin GROUP GmOvrlStMgr.GmOvrlStMgrLoaMtgtnHaptcFbTqMax.Val "MICROSAR RTE" /begin SUB_GROUP /end SUB_GROUP /begin FUNCTION_LIST /end FUNCTION_LIST /begin REF_CHARACTERISTIC GmOvrlStMgr.GmOvrlStMgrLoaMtgtnHaptcFbTqMax.Val /end REF_CHARACTERISTIC /begin REF_MEASUREMENT /end REF_MEASUREMENT /end GROUP
/begin GROUP GmOvrlStMgr.GmOvrlStMgrLoaMtgtnHaptcFbTqMin.Val "MICROSAR RTE" /begin SUB_GROUP /end SUB_GROUP /begin FUNCTION_LIST /end FUNCTION_LIST /begin REF_CHARACTERISTIC GmOvrlStMgr.GmOvrlStMgrLoaMtgtnHaptcFbTqMin.Val /end REF_CHARACTERISTIC /begin REF_MEASUREMENT /end REF_MEASUREMENT /end GROUP
/begin GROUP GmOvrlStMgr.GmOvrlStMgrLoaMtgtnHaptcFbVehSpdMax.Val "MICROSAR RTE" /begin SUB_GROUP /end SUB_GROUP /begin FUNCTION_LIST /end FUNCTION_LIST /begin REF_CHARACTERISTIC GmOvrlStMgr.GmOvrlStMgrLoaMtgtnHaptcFbVehSpdMax.Val /end REF_CHARACTERISTIC /begin REF_MEASUREMENT /end REF_MEASUREMENT /end GROUP
/begin GROUP GmOvrlStMgr.GmOvrlStMgrLoaMtgtnHaptcFbVehSpdMin.Val "MICROSAR RTE" /begin SUB_GROUP /end SUB_GROUP /begin FUNCTION_LIST /end FUNCTION_LIST /begin REF_CHARACTERISTIC GmOvrlStMgr.GmOvrlStMgrLoaMtgtnHaptcFbVehSpdMin.Val /end REF_CHARACTERISTIC /begin REF_MEASUREMENT /end REF_MEASUREMENT /end GROUP
/begin GROUP GmOvrlStMgr.GmOvrlStMgrLoaMtgtnHaptcFrq.Val "MICROSAR RTE" /begin SUB_GROUP /end SUB_GROUP /begin FUNCTION_LIST /end FUNCTION_LIST /begin REF_CHARACTERISTIC GmOvrlStMgr.GmOvrlStMgrLoaMtgtnHaptcFrq.Val /end REF_CHARACTERISTIC /begin REF_MEASUREMENT /end REF_MEASUREMENT /end GROUP
/begin GROUP GmOvrlStMgr.GmOvrlStMgrLoaMtgtnStrtHaptcAmp.Val "MICROSAR RTE" /begin SUB_GROUP /end SUB_GROUP /begin FUNCTION_LIST /end FUNCTION_LIST /begin REF_CHARACTERISTIC GmOvrlStMgr.GmOvrlStMgrLoaMtgtnStrtHaptcAmp.Val /end REF_CHARACTERISTIC /begin REF_MEASUREMENT /end REF_MEASUREMENT /end GROUP
/begin GROUP GmOvrlStMgr.GmOvrlStMgrLoaMtgtnTqOscnAmpY.Ary1D "MICROSAR RTE" /begin SUB_GROUP /end SUB_GROUP /begin FUNCTION_LIST /end FUNCTION_LIST /begin REF_CHARACTERISTIC GmOvrlStMgr.GmOvrlStMgrLoaMtgtnTqOscnAmpY.Ary1D /end REF_CHARACTERISTIC /begin REF_MEASUREMENT /end REF_MEASUREMENT /end GROUP
/begin GROUP GmOvrlStMgr.GmOvrlStMgrLoaMtgtnVehSpdX.Ary1D "MICROSAR RTE" /begin SUB_GROUP /end SUB_GROUP /begin FUNCTION_LIST /end FUNCTION_LIST /begin REF_CHARACTERISTIC GmOvrlStMgr.GmOvrlStMgrLoaMtgtnVehSpdX.Ary1D /end REF_CHARACTERISTIC /begin REF_MEASUREMENT /end REF_MEASUREMENT /end GROUP
/begin GROUP GmOvrlStMgr.GmOvrlStMgrLoaStIgnCntrThd.Val "MICROSAR RTE" /begin SUB_GROUP /end SUB_GROUP /begin FUNCTION_LIST /end FUNCTION_LIST /begin REF_CHARACTERISTIC GmOvrlStMgr.GmOvrlStMgrLoaStIgnCntrThd.Val /end REF_CHARACTERISTIC /begin REF_MEASUREMENT /end REF_MEASUREMENT /end GROUP
/begin GROUP GmOvrlStMgr.GmOvrlStMgrShiftLvrTiThd.Val "MICROSAR RTE" /begin SUB_GROUP /end SUB_GROUP /begin FUNCTION_LIST /end FUNCTION_LIST /begin REF_CHARACTERISTIC GmOvrlStMgr.GmOvrlStMgrShiftLvrTiThd.Val /end REF_CHARACTERISTIC /begin REF_MEASUREMENT /end REF_MEASUREMENT /end GROUP
/begin GROUP GmOvrlStMgr.GmOvrlStMgrStandStillThd.Val "MICROSAR RTE" /begin SUB_GROUP /end SUB_GROUP /begin FUNCTION_LIST /end FUNCTION_LIST /begin REF_CHARACTERISTIC GmOvrlStMgr.GmOvrlStMgrStandStillThd.Val /end REF_CHARACTERISTIC /begin REF_MEASUREMENT /end REF_MEASUREMENT /end GROUP
/begin GROUP GmOvrlStMgr.GmOvrlStMgrStandStillTiThd.Val "MICROSAR RTE" /begin SUB_GROUP /end SUB_GROUP /begin FUNCTION_LIST /end FUNCTION_LIST /begin REF_CHARACTERISTIC GmOvrlStMgr.GmOvrlStMgrStandStillTiThd.Val /end REF_CHARACTERISTIC /begin REF_MEASUREMENT /end REF_MEASUREMENT /end GROUP
/begin GROUP GmOvrlStMgr.HaptcStTranActvToWaitRefTi "MICROSAR RTE" /begin SUB_GROUP /end SUB_GROUP /begin FUNCTION_LIST /end FUNCTION_LIST /begin REF_CHARACTERISTIC /end REF_CHARACTERISTIC /begin REF_MEASUREMENT GmOvrlStMgr.HaptcStTranActvToWaitRefTi /end REF_MEASUREMENT /end GROUP
/begin GROUP GmOvrlStMgr.HapticActvRefTmr "MICROSAR RTE" /begin SUB_GROUP /end SUB_GROUP /begin FUNCTION_LIST /end FUNCTION_LIST /begin REF_CHARACTERISTIC /end REF_CHARACTERISTIC /begin REF_MEASUREMENT GmOvrlStMgr.HapticActvRefTmr /end REF_MEASUREMENT /end GROUP
/begin GROUP GmOvrlStMgr.HapticWaitRefTmr "MICROSAR RTE" /begin SUB_GROUP /end SUB_GROUP /begin FUNCTION_LIST /end FUNCTION_LIST /begin REF_CHARACTERISTIC /end REF_CHARACTERISTIC /begin REF_MEASUREMENT GmOvrlStMgr.HapticWaitRefTmr /end REF_MEASUREMENT /end GROUP
/begin GROUP GmOvrlStMgr.HwAgEotCcw.Val "MICROSAR RTE" /begin SUB_GROUP /end SUB_GROUP /begin FUNCTION_LIST /end FUNCTION_LIST /begin REF_CHARACTERISTIC /end REF_CHARACTERISTIC /begin REF_MEASUREMENT GmOvrlStMgr.HwAgEotCcw.Val /end REF_MEASUREMENT /end GROUP
/begin GROUP GmOvrlStMgr.HwAgEotCw.Val "MICROSAR RTE" /begin SUB_GROUP /end SUB_GROUP /begin FUNCTION_LIST /end FUNCTION_LIST /begin REF_CHARACTERISTIC /end REF_CHARACTERISTIC /begin REF_MEASUREMENT GmOvrlStMgr.HwAgEotCw.Val /end REF_MEASUREMENT /end GROUP
/begin GROUP GmOvrlStMgr.HwAgServoCmd.Val "MICROSAR RTE" /begin SUB_GROUP /end SUB_GROUP /begin FUNCTION_LIST /end FUNCTION_LIST /begin REF_CHARACTERISTIC /end REF_CHARACTERISTIC /begin REF_MEASUREMENT GmOvrlStMgr.HwAgServoCmd.Val /end REF_MEASUREMENT /end GROUP
/begin GROUP GmOvrlStMgr.HwAgServoEna.Logl "MICROSAR RTE" /begin SUB_GROUP /end SUB_GROUP /begin FUNCTION_LIST /end FUNCTION_LIST /begin REF_CHARACTERISTIC /end REF_CHARACTERISTIC /begin REF_MEASUREMENT GmOvrlStMgr.HwAgServoEna.Logl /end REF_MEASUREMENT /end GROUP
/begin GROUP GmOvrlStMgr.HwAgTar.Val "MICROSAR RTE" /begin SUB_GROUP /end SUB_GROUP /begin FUNCTION_LIST /end FUNCTION_LIST /begin REF_CHARACTERISTIC /end REF_CHARACTERISTIC /begin REF_MEASUREMENT GmOvrlStMgr.HwAgTar.Val /end REF_MEASUREMENT /end GROUP
/begin GROUP GmOvrlStMgr.HwAgTraj.Val "MICROSAR RTE" /begin SUB_GROUP /end SUB_GROUP /begin FUNCTION_LIST /end FUNCTION_LIST /begin REF_CHARACTERISTIC /end REF_CHARACTERISTIC /begin REF_MEASUREMENT GmOvrlStMgr.HwAgTraj.Val /end REF_MEASUREMENT /end GROUP
/begin GROUP GmOvrlStMgr.HwAgTrajEna.Logl "MICROSAR RTE" /begin SUB_GROUP /end SUB_GROUP /begin FUNCTION_LIST /end FUNCTION_LIST /begin REF_CHARACTERISTIC /end REF_CHARACTERISTIC /begin REF_MEASUREMENT GmOvrlStMgr.HwAgTrajEna.Logl /end REF_MEASUREMENT /end GROUP
/begin GROUP GmOvrlStMgr.HwHaptcEna.Logl "MICROSAR RTE" /begin SUB_GROUP /end SUB_GROUP /begin FUNCTION_LIST /end FUNCTION_LIST /begin REF_CHARACTERISTIC /end REF_CHARACTERISTIC /begin REF_MEASUREMENT GmOvrlStMgr.HwHaptcEna.Logl /end REF_MEASUREMENT /end GROUP
/begin GROUP GmOvrlStMgr.HwOscnEna.Logl "MICROSAR RTE" /begin SUB_GROUP /end SUB_GROUP /begin FUNCTION_LIST /end FUNCTION_LIST /begin REF_CHARACTERISTIC /end REF_CHARACTERISTIC /begin REF_MEASUREMENT GmOvrlStMgr.HwOscnEna.Logl /end REF_MEASUREMENT /end GROUP
/begin GROUP GmOvrlStMgr.HwOscnFrq.Val "MICROSAR RTE" /begin SUB_GROUP /end SUB_GROUP /begin FUNCTION_LIST /end FUNCTION_LIST /begin REF_CHARACTERISTIC /end REF_CHARACTERISTIC /begin REF_MEASUREMENT GmOvrlStMgr.HwOscnFrq.Val /end REF_MEASUREMENT /end GROUP
/begin GROUP GmOvrlStMgr.HwOscnMotAmp.Val "MICROSAR RTE" /begin SUB_GROUP /end SUB_GROUP /begin FUNCTION_LIST /end FUNCTION_LIST /begin REF_CHARACTERISTIC /end REF_CHARACTERISTIC /begin REF_MEASUREMENT GmOvrlStMgr.HwOscnMotAmp.Val /end REF_MEASUREMENT /end GROUP
/begin GROUP GmOvrlStMgr.HwTq.Val "MICROSAR RTE" /begin SUB_GROUP /end SUB_GROUP /begin FUNCTION_LIST /end FUNCTION_LIST /begin REF_CHARACTERISTIC /end REF_CHARACTERISTIC /begin REF_MEASUREMENT GmOvrlStMgr.HwTq.Val /end REF_MEASUREMENT /end GROUP
/begin GROUP GmOvrlStMgr.HwTqLkaLpFil "MICROSAR RTE" /begin SUB_GROUP /end SUB_GROUP /begin FUNCTION_LIST /end FUNCTION_LIST /begin REF_CHARACTERISTIC /end REF_CHARACTERISTIC
 /begin REF_MEASUREMENT GmOvrlStMgr.HwTqLkaLpFil.FilGain GmOvrlStMgr.HwTqLkaLpFil.FilSt /end REF_MEASUREMENT
/end GROUP
/begin GROUP GmOvrlStMgr.HwTqLpFil "MICROSAR RTE" /begin SUB_GROUP /end SUB_GROUP /begin FUNCTION_LIST /end FUNCTION_LIST /begin REF_CHARACTERISTIC /end REF_CHARACTERISTIC /begin REF_MEASUREMENT GmOvrlStMgr.HwTqLpFil.FilGain GmOvrlStMgr.HwTqLpFil.FilSt /end REF_MEASUREMENT /end GROUP
/begin GROUP GmOvrlStMgr.HwTqOscSt.Val "MICROSAR RTE" /begin SUB_GROUP /end SUB_GROUP /begin FUNCTION_LIST /end FUNCTION_LIST /begin REF_CHARACTERISTIC /end REF_CHARACTERISTIC /begin REF_MEASUREMENT GmOvrlStMgr.HwTqOscSt.Val /end REF_MEASUREMENT /end GROUP
/begin GROUP GmOvrlStMgr.HwTqOscnLpFil "MICROSAR RTE" /begin SUB_GROUP /end SUB_GROUP /begin FUNCTION_LIST /end FUNCTION_LIST /begin REF_CHARACTERISTIC /end REF_CHARACTERISTIC
 /begin REF_MEASUREMENT GmOvrlStMgr.HwTqOscnLpFil.FilGain GmOvrlStMgr.HwTqOscnLpFil.FilSt /end REF_MEASUREMENT
/end GROUP
/begin GROUP GmOvrlStMgr.IgnCntrUpd "MICROSAR RTE" /begin SUB_GROUP /end SUB_GROUP /begin FUNCTION_LIST /end FUNCTION_LIST /begin REF_CHARACTERISTIC /end REF_CHARACTERISTIC /begin REF_MEASUREMENT GmOvrlStMgr.IgnCntrUpd /end REF_MEASUREMENT /end GROUP
/begin GROUP GmOvrlStMgr.LkaEna.Logl "MICROSAR RTE" /begin SUB_GROUP /end SUB_GROUP /begin FUNCTION_LIST /end FUNCTION_LIST /begin REF_CHARACTERISTIC /end REF_CHARACTERISTIC /begin REF_MEASUREMENT GmOvrlStMgr.LkaEna.Logl /end REF_MEASUREMENT /end GROUP
/begin GROUP GmOvrlStMgr.LkaFltCntr "MICROSAR RTE" /begin SUB_GROUP /end SUB_GROUP /begin FUNCTION_LIST /end FUNCTION_LIST /begin REF_CHARACTERISTIC /end REF_CHARACTERISTIC /begin REF_MEASUREMENT GmOvrlStMgr.LkaFltCntr /end REF_MEASUREMENT /end GROUP
/begin GROUP GmOvrlStMgr.LkaFltPrev "MICROSAR RTE" /begin SUB_GROUP /end SUB_GROUP /begin FUNCTION_LIST /end FUNCTION_LIST /begin REF_CHARACTERISTIC /end REF_CHARACTERISTIC /begin REF_MEASUREMENT GmOvrlStMgr.LkaFltPrev /end REF_MEASUREMENT /end GROUP
/begin GROUP GmOvrlStMgr.LkaFltRefTmr "MICROSAR RTE" /begin SUB_GROUP /end SUB_GROUP /begin FUNCTION_LIST /end FUNCTION_LIST /begin REF_CHARACTERISTIC /end REF_CHARACTERISTIC /begin REF_MEASUREMENT GmOvrlStMgr.LkaFltRefTmr /end REF_MEASUREMENT /end GROUP
/begin GROUP GmOvrlStMgr.LkaIntvPrev "MICROSAR RTE" /begin SUB_GROUP /end SUB_GROUP /begin FUNCTION_LIST /end FUNCTION_LIST /begin REF_CHARACTERISTIC /end REF_CHARACTERISTIC /begin REF_MEASUREMENT GmOvrlStMgr.LkaIntvPrev /end REF_MEASUREMENT /end GROUP
/begin GROUP GmOvrlStMgr.LkaIntvRefTi1 "MICROSAR RTE" /begin SUB_GROUP /end SUB_GROUP /begin FUNCTION_LIST /end FUNCTION_LIST /begin REF_CHARACTERISTIC /end REF_CHARACTERISTIC /begin REF_MEASUREMENT GmOvrlStMgr.LkaIntvRefTi1 /end REF_MEASUREMENT /end GROUP
/begin GROUP GmOvrlStMgr.LkaIntvRefTi2 "MICROSAR RTE" /begin SUB_GROUP /end SUB_GROUP /begin FUNCTION_LIST /end FUNCTION_LIST /begin REF_CHARACTERISTIC /end REF_CHARACTERISTIC /begin REF_MEASUREMENT GmOvrlStMgr.LkaIntvRefTi2 /end REF_MEASUREMENT /end GROUP
/begin GROUP GmOvrlStMgr.LkaSt.Val "MICROSAR RTE" /begin SUB_GROUP /end SUB_GROUP /begin FUNCTION_LIST /end FUNCTION_LIST /begin REF_CHARACTERISTIC /end REF_CHARACTERISTIC /begin REF_MEASUREMENT GmOvrlStMgr.LkaSt.Val /end REF_MEASUREMENT /end GROUP
/begin GROUP GmOvrlStMgr.LkaTqCmdCdnd.Val "MICROSAR RTE" /begin SUB_GROUP /end SUB_GROUP /begin FUNCTION_LIST /end FUNCTION_LIST /begin REF_CHARACTERISTIC /end REF_CHARACTERISTIC /begin REF_MEASUREMENT GmOvrlStMgr.LkaTqCmdCdnd.Val /end REF_MEASUREMENT /end GROUP
/begin GROUP GmOvrlStMgr.LoaMtgtnHaptcFbStrtOnRefTi "MICROSAR RTE" /begin SUB_GROUP /end SUB_GROUP /begin FUNCTION_LIST /end FUNCTION_LIST /begin REF_CHARACTERISTIC /end REF_CHARACTERISTIC /begin REF_MEASUREMENT GmOvrlStMgr.LoaMtgtnHaptcFbStrtOnRefTi /end REF_MEASUREMENT /end GROUP
/begin GROUP GmOvrlStMgr.LoaSt.Val "MICROSAR RTE" /begin SUB_GROUP /end SUB_GROUP /begin FUNCTION_LIST /end FUNCTION_LIST /begin REF_CHARACTERISTIC /end REF_CHARACTERISTIC /begin REF_MEASUREMENT GmOvrlStMgr.LoaSt.Val /end REF_MEASUREMENT /end GROUP
/begin GROUP GmOvrlStMgr.LoaStChk "MICROSAR RTE" /begin SUB_GROUP /end SUB_GROUP /begin FUNCTION_LIST /end FUNCTION_LIST /begin REF_CHARACTERISTIC /end REF_CHARACTERISTIC /begin REF_MEASUREMENT GmOvrlStMgr.LoaStChk /end REF_MEASUREMENT /end GROUP
/begin GROUP GmOvrlStMgr.MfgOvrlDi.Logl "MICROSAR RTE" /begin SUB_GROUP /end SUB_GROUP /begin FUNCTION_LIST /end FUNCTION_LIST /begin REF_CHARACTERISTIC /end REF_CHARACTERISTIC /begin REF_MEASUREMENT GmOvrlStMgr.MfgOvrlDi.Logl /end REF_MEASUREMENT /end GROUP
/begin GROUP GmOvrlStMgr.Msg17DBusHiSpdInvld.Logl "MICROSAR RTE" /begin SUB_GROUP /end SUB_GROUP /begin FUNCTION_LIST /end FUNCTION_LIST /begin REF_CHARACTERISTIC /end REF_CHARACTERISTIC /begin REF_MEASUREMENT GmOvrlStMgr.Msg17DBusHiSpdInvld.Logl /end REF_MEASUREMENT /end GROUP
/begin GROUP GmOvrlStMgr.Msg17DBusHiSpdMiss.Logl "MICROSAR RTE" /begin SUB_GROUP /end SUB_GROUP /begin FUNCTION_LIST /end FUNCTION_LIST /begin REF_CHARACTERISTIC /end REF_CHARACTERISTIC /begin REF_MEASUREMENT GmOvrlStMgr.Msg17DBusHiSpdMiss.Logl /end REF_MEASUREMENT /end GROUP
/begin GROUP GmOvrlStMgr.Msg180BusChassisExpInvld.Logl "MICROSAR RTE" /begin SUB_GROUP /end SUB_GROUP /begin FUNCTION_LIST /end FUNCTION_LIST /begin REF_CHARACTERISTIC /end REF_CHARACTERISTIC /begin REF_MEASUREMENT GmOvrlStMgr.Msg180BusChassisExpInvld.Logl /end REF_MEASUREMENT /end GROUP
/begin GROUP GmOvrlStMgr.Msg180BusChassisExpMiss.Logl "MICROSAR RTE" /begin SUB_GROUP /end SUB_GROUP /begin FUNCTION_LIST /end FUNCTION_LIST /begin REF_CHARACTERISTIC /end REF_CHARACTERISTIC /begin REF_MEASUREMENT GmOvrlStMgr.Msg180BusChassisExpMiss.Logl /end REF_MEASUREMENT /end GROUP
/begin GROUP GmOvrlStMgr.Msg180BusHiSpdInvld.Logl "MICROSAR RTE" /begin SUB_GROUP /end SUB_GROUP /begin FUNCTION_LIST /end FUNCTION_LIST /begin REF_CHARACTERISTIC /end REF_CHARACTERISTIC /begin REF_MEASUREMENT GmOvrlStMgr.Msg180BusHiSpdInvld.Logl /end REF_MEASUREMENT /end GROUP
/begin GROUP GmOvrlStMgr.Msg180BusHiSpdMiss.Logl "MICROSAR RTE" /begin SUB_GROUP /end SUB_GROUP /begin FUNCTION_LIST /end FUNCTION_LIST /begin REF_CHARACTERISTIC /end REF_CHARACTERISTIC /begin REF_MEASUREMENT GmOvrlStMgr.Msg180BusHiSpdMiss.Logl /end REF_MEASUREMENT /end GROUP
/begin GROUP GmOvrlStMgr.Msg1E9BusHiSpdInvld.Logl "MICROSAR RTE" /begin SUB_GROUP /end SUB_GROUP /begin FUNCTION_LIST /end FUNCTION_LIST /begin REF_CHARACTERISTIC /end REF_CHARACTERISTIC /begin REF_MEASUREMENT GmOvrlStMgr.Msg1E9BusHiSpdInvld.Logl /end REF_MEASUREMENT /end GROUP
/begin GROUP GmOvrlStMgr.Msg1E9BusHiSpdMiss.Logl "MICROSAR RTE" /begin SUB_GROUP /end SUB_GROUP /begin FUNCTION_LIST /end FUNCTION_LIST /begin REF_CHARACTERISTIC /end REF_CHARACTERISTIC /begin REF_MEASUREMENT GmOvrlStMgr.Msg1E9BusHiSpdMiss.Logl /end REF_MEASUREMENT /end GROUP
/begin GROUP GmOvrlStMgr.Msg1F5BusHiSpdInvld.Logl "MICROSAR RTE" /begin SUB_GROUP /end SUB_GROUP /begin FUNCTION_LIST /end FUNCTION_LIST /begin REF_CHARACTERISTIC /end REF_CHARACTERISTIC /begin REF_MEASUREMENT GmOvrlStMgr.Msg1F5BusHiSpdInvld.Logl /end REF_MEASUREMENT /end GROUP
/begin GROUP GmOvrlStMgr.Msg214BusHiSpdInvld.Logl "MICROSAR RTE" /begin SUB_GROUP /end SUB_GROUP /begin FUNCTION_LIST /end FUNCTION_LIST /begin REF_CHARACTERISTIC /end REF_CHARACTERISTIC /begin REF_MEASUREMENT GmOvrlStMgr.Msg214BusHiSpdInvld.Logl /end REF_MEASUREMENT /end GROUP
/begin GROUP GmOvrlStMgr.Msg214BusHiSpdMiss.Logl "MICROSAR RTE" /begin SUB_GROUP /end SUB_GROUP /begin FUNCTION_LIST /end FUNCTION_LIST /begin REF_CHARACTERISTIC /end REF_CHARACTERISTIC /begin REF_MEASUREMENT GmOvrlStMgr.Msg214BusHiSpdMiss.Logl /end REF_MEASUREMENT /end GROUP
/begin GROUP GmOvrlStMgr.Msg337BusChassisExpInvld.Logl "MICROSAR RTE" /begin SUB_GROUP /end SUB_GROUP /begin FUNCTION_LIST /end FUNCTION_LIST /begin REF_CHARACTERISTIC /end REF_CHARACTERISTIC /begin REF_MEASUREMENT GmOvrlStMgr.Msg337BusChassisExpInvld.Logl /end REF_MEASUREMENT /end GROUP
/begin GROUP GmOvrlStMgr.Msg337BusChassisExpMiss.Logl "MICROSAR RTE" /begin SUB_GROUP /end SUB_GROUP /begin FUNCTION_LIST /end FUNCTION_LIST /begin REF_CHARACTERISTIC /end REF_CHARACTERISTIC /begin REF_MEASUREMENT GmOvrlStMgr.Msg337BusChassisExpMiss.Logl /end REF_MEASUREMENT /end GROUP
/begin GROUP GmOvrlStMgr.PerInstanceMemories "MICROSAR RTE"
 /begin SUB_GROUP GmOvrlStMgr.GmLoaIgnCntr GmOvrlStMgr.HaptcStTranActvToWaitRefTi GmOvrlStMgr.HapticActvRefTmr GmOvrlStMgr.HapticWaitRefTmr GmOvrlStMgr.HwTqLkaLpFil GmOvrlStMgr.HwTqLpFil GmOvrlStMgr.HwTqOscnLpFil GmOvrlStMgr.IgnCntrUpd GmOvrlStMgr.LkaFltCntr GmOvrlStMgr.LkaFltPrev GmOvrlStMgr.LkaFltRefTmr GmOvrlStMgr.LkaIntvPrev GmOvrlStMgr.LkaIntvRefTi1 GmOvrlStMgr.LkaIntvRefTi2 GmOvrlStMgr.LoaMtgtnHaptcFbStrtOnRefTi GmOvrlStMgr.LoaStChk GmOvrlStMgr.PrevApaIntvEna GmOvrlStMgr.PrevApaIntvRefTi GmOvrlStMgr.PrevApaSt GmOvrlStMgr.PrevEscSt GmOvrlStMgr.PrevHaptcReqEna GmOvrlStMgr.PrevHaptcReqRefTi GmOvrlStMgr.PrevHaptcSt GmOvrlStMgr.PrevLkaFlt GmOvrlStMgr.PrevLkaSt GmOvrlStMgr.PrevShiftLvrRvsEna GmOvrlStMgr.PrevShiftLvrRvsRefTi GmOvrlStMgr.PrevVehStandStillEna GmOvrlStMgr.PrevVehStandStillRefTi GmOvrlStMgr.TqOscCycRefTi GmOvrlStMgr.TranHaptcWaitToApaStActvRefTi GmOvrlStMgr.dGmOvrlStMgrApaShiftLvrRvs GmOvrlStMgr.dGmOvrlStMgrApaStandStill /end SUB_GROUP
 /begin FUNCTION_LIST /end FUNCTION_LIST
 /begin REF_CHARACTERISTIC /end REF_CHARACTERISTIC
 /begin REF_MEASUREMENT /end REF_MEASUREMENT
/end GROUP
/begin GROUP GmOvrlStMgr.PrevApaIntvEna "MICROSAR RTE" /begin SUB_GROUP /end SUB_GROUP /begin FUNCTION_LIST /end FUNCTION_LIST /begin REF_CHARACTERISTIC /end REF_CHARACTERISTIC /begin REF_MEASUREMENT GmOvrlStMgr.PrevApaIntvEna /end REF_MEASUREMENT /end GROUP
/begin GROUP GmOvrlStMgr.PrevApaIntvRefTi "MICROSAR RTE" /begin SUB_GROUP /end SUB_GROUP /begin FUNCTION_LIST /end FUNCTION_LIST /begin REF_CHARACTERISTIC /end REF_CHARACTERISTIC /begin REF_MEASUREMENT GmOvrlStMgr.PrevApaIntvRefTi /end REF_MEASUREMENT /end GROUP
/begin GROUP GmOvrlStMgr.PrevApaSt "MICROSAR RTE" /begin SUB_GROUP /end SUB_GROUP /begin FUNCTION_LIST /end FUNCTION_LIST /begin REF_CHARACTERISTIC /end REF_CHARACTERISTIC /begin REF_MEASUREMENT GmOvrlStMgr.PrevApaSt /end REF_MEASUREMENT /end GROUP
/begin GROUP GmOvrlStMgr.PrevEscSt "MICROSAR RTE" /begin SUB_GROUP /end SUB_GROUP /begin FUNCTION_LIST /end FUNCTION_LIST /begin REF_CHARACTERISTIC /end REF_CHARACTERISTIC /begin REF_MEASUREMENT GmOvrlStMgr.PrevEscSt /end REF_MEASUREMENT /end GROUP
/begin GROUP GmOvrlStMgr.PrevHaptcReqEna "MICROSAR RTE" /begin SUB_GROUP /end SUB_GROUP /begin FUNCTION_LIST /end FUNCTION_LIST /begin REF_CHARACTERISTIC /end REF_CHARACTERISTIC /begin REF_MEASUREMENT GmOvrlStMgr.PrevHaptcReqEna /end REF_MEASUREMENT /end GROUP
/begin GROUP GmOvrlStMgr.PrevHaptcReqRefTi "MICROSAR RTE" /begin SUB_GROUP /end SUB_GROUP /begin FUNCTION_LIST /end FUNCTION_LIST /begin REF_CHARACTERISTIC /end REF_CHARACTERISTIC /begin REF_MEASUREMENT GmOvrlStMgr.PrevHaptcReqRefTi /end REF_MEASUREMENT /end GROUP
/begin GROUP GmOvrlStMgr.PrevHaptcSt "MICROSAR RTE" /begin SUB_GROUP /end SUB_GROUP /begin FUNCTION_LIST /end FUNCTION_LIST /begin REF_CHARACTERISTIC /end REF_CHARACTERISTIC /begin REF_MEASUREMENT GmOvrlStMgr.PrevHaptcSt /end REF_MEASUREMENT /end GROUP
/begin GROUP GmOvrlStMgr.PrevLkaFlt "MICROSAR RTE" /begin SUB_GROUP /end SUB_GROUP /begin FUNCTION_LIST /end FUNCTION_LIST /begin REF_CHARACTERISTIC /end REF_CHARACTERISTIC /begin REF_MEASUREMENT GmOvrlStMgr.PrevLkaFlt /end REF_MEASUREMENT /end GROUP
/begin GROUP GmOvrlStMgr.PrevLkaSt "MICROSAR RTE" /begin SUB_GROUP /end SUB_GROUP /begin FUNCTION_LIST /end FUNCTION_LIST /begin REF_CHARACTERISTIC /end REF_CHARACTERISTIC /begin REF_MEASUREMENT GmOvrlStMgr.PrevLkaSt /end REF_MEASUREMENT /end GROUP
/begin GROUP GmOvrlStMgr.PrevShiftLvrRvsEna "MICROSAR RTE" /begin SUB_GROUP /end SUB_GROUP /begin FUNCTION_LIST /end FUNCTION_LIST /begin REF_CHARACTERISTIC /end REF_CHARACTERISTIC /begin REF_MEASUREMENT GmOvrlStMgr.PrevShiftLvrRvsEna /end REF_MEASUREMENT /end GROUP
/begin GROUP GmOvrlStMgr.PrevShiftLvrRvsRefTi "MICROSAR RTE" /begin SUB_GROUP /end SUB_GROUP /begin FUNCTION_LIST /end FUNCTION_LIST /begin REF_CHARACTERISTIC /end REF_CHARACTERISTIC /begin REF_MEASUREMENT GmOvrlStMgr.PrevShiftLvrRvsRefTi /end REF_MEASUREMENT /end GROUP
/begin GROUP GmOvrlStMgr.PrevVehStandStillEna "MICROSAR RTE" /begin SUB_GROUP /end SUB_GROUP /begin FUNCTION_LIST /end FUNCTION_LIST /begin REF_CHARACTERISTIC /end REF_CHARACTERISTIC /begin REF_MEASUREMENT GmOvrlStMgr.PrevVehStandStillEna /end REF_MEASUREMENT /end GROUP
/begin GROUP GmOvrlStMgr.PrevVehStandStillRefTi "MICROSAR RTE" /begin SUB_GROUP /end SUB_GROUP /begin FUNCTION_LIST /end FUNCTION_LIST /begin REF_CHARACTERISTIC /end REF_CHARACTERISTIC /begin REF_MEASUREMENT GmOvrlStMgr.PrevVehStandStillRefTi /end REF_MEASUREMENT /end GROUP
/begin GROUP GmOvrlStMgr.ReceiverPorts "MICROSAR RTE"
 /begin SUB_GROUP GmOvrlStMgr.AbsActvProtd.Logl GmOvrlStMgr.ApaEna.Logl GmOvrlStMgr.EscEna.Logl GmOvrlStMgr.EscLimdActv.Logl GmOvrlStMgr.HwAgEotCcw.Val GmOvrlStMgr.HwAgEotCw.Val GmOvrlStMgr.HwAgTar.Val GmOvrlStMgr.HwAgTraj.Val GmOvrlStMgr.HwAgTrajEna.Logl GmOvrlStMgr.HwHaptcEna.Logl GmOvrlStMgr.HwTq.Val GmOvrlStMgr.LkaEna.Logl GmOvrlStMgr.LkaTqCmdCdnd.Val GmOvrlStMgr.LoaSt.Val GmOvrlStMgr.MfgOvrlDi.Logl GmOvrlStMgr.Msg17DBusHiSpdInvld.Logl GmOvrlStMgr.Msg17DBusHiSpdMiss.Logl GmOvrlStMgr.Msg180BusChassisExpInvld.Logl GmOvrlStMgr.Msg180BusChassisExpMiss.Logl GmOvrlStMgr.Msg180BusHiSpdInvld.Logl GmOvrlStMgr.Msg180BusHiSpdMiss.Logl GmOvrlStMgr.Msg1E9BusHiSpdInvld.Logl GmOvrlStMgr.Msg1E9BusHiSpdMiss.Logl GmOvrlStMgr.Msg1F5BusHiSpdInvld.Logl GmOvrlStMgr.Msg214BusHiSpdInvld.Logl GmOvrlStMgr.Msg214BusHiSpdMiss.Logl GmOvrlStMgr.Msg337BusChassisExpInvld.Logl GmOvrlStMgr.Msg337BusChassisExpMiss.Logl GmOvrlStMgr.ShiftLvrRvs.Logl GmOvrlStMgr.SysSt.Val GmOvrlStMgr.VehSpd.Val GmOvrlStMgr.VehSpdSecurMax.Val GmOvrlStMgr.VehSpdSecurMaxVld.Logl GmOvrlStMgr.VehSpdSecurMin.Val GmOvrlStMgr.VehSpdSecurMinVld.Logl GmOvrlStMgr.VehStabyEnhmtActv.Logl /end SUB_GROUP
 /begin FUNCTION_LIST /end FUNCTION_LIST
 /begin REF_CHARACTERISTIC /end REF_CHARACTERISTIC
 /begin REF_MEASUREMENT /end REF_MEASUREMENT
/end GROUP
/begin GROUP GmOvrlStMgr.SenderPorts "MICROSAR RTE"
 /begin SUB_GROUP GmOvrlStMgr.ApaDrvrIntvDetd.Logl GmOvrlStMgr.ApaSt.Val GmOvrlStMgr.EscSt.Val GmOvrlStMgr.HwAgServoCmd.Val GmOvrlStMgr.HwAgServoEna.Logl GmOvrlStMgr.HwOscnEna.Logl GmOvrlStMgr.HwOscnFrq.Val GmOvrlStMgr.HwOscnMotAmp.Val GmOvrlStMgr.HwTqOscSt.Val GmOvrlStMgr.LkaSt.Val /end SUB_GROUP
 /begin FUNCTION_LIST /end FUNCTION_LIST
 /begin REF_CHARACTERISTIC /end REF_CHARACTERISTIC
 /begin REF_MEASUREMENT /end REF_MEASUREMENT
/end GROUP
/begin GROUP GmOvrlStMgr.ShiftLvrRvs.Logl "MICROSAR RTE" /begin SUB_GROUP /end SUB_GROUP /begin FUNCTION_LIST /end FUNCTION_LIST /begin REF_CHARACTERISTIC /end REF_CHARACTERISTIC /begin REF_MEASUREMENT GmOvrlStMgr.ShiftLvrRvs.Logl /end REF_MEASUREMENT /end GROUP
/begin GROUP GmOvrlStMgr.SysSt.Val "MICROSAR RTE" /begin SUB_GROUP /end SUB_GROUP /begin FUNCTION_LIST /end FUNCTION_LIST /begin REF_CHARACTERISTIC /end REF_CHARACTERISTIC /begin REF_MEASUREMENT GmOvrlStMgr.SysSt.Val /end REF_MEASUREMENT /end GROUP
/begin GROUP GmOvrlStMgr.TqOscCycRefTi "MICROSAR RTE" /begin SUB_GROUP /end SUB_GROUP /begin FUNCTION_LIST /end FUNCTION_LIST /begin REF_CHARACTERISTIC /end REF_CHARACTERISTIC /begin REF_MEASUREMENT GmOvrlStMgr.TqOscCycRefTi /end REF_MEASUREMENT /end GROUP
/begin GROUP GmOvrlStMgr.TranHaptcWaitToApaStActvRefTi "MICROSAR RTE" /begin SUB_GROUP /end SUB_GROUP /begin FUNCTION_LIST /end FUNCTION_LIST /begin REF_CHARACTERISTIC /end REF_CHARACTERISTIC /begin REF_MEASUREMENT GmOvrlStMgr.TranHaptcWaitToApaStActvRefTi /end REF_MEASUREMENT /end GROUP
/begin GROUP GmOvrlStMgr.VehSpd.Val "MICROSAR RTE" /begin SUB_GROUP /end SUB_GROUP /begin FUNCTION_LIST /end FUNCTION_LIST /begin REF_CHARACTERISTIC /end REF_CHARACTERISTIC /begin REF_MEASUREMENT GmOvrlStMgr.VehSpd.Val /end REF_MEASUREMENT /end GROUP
/begin GROUP GmOvrlStMgr.VehSpdSecurMax.Val "MICROSAR RTE" /begin SUB_GROUP /end SUB_GROUP /begin FUNCTION_LIST /end FUNCTION_LIST /begin REF_CHARACTERISTIC /end REF_CHARACTERISTIC /begin REF_MEASUREMENT GmOvrlStMgr.VehSpdSecurMax.Val /end REF_MEASUREMENT /end GROUP
/**********************************************************************************************************************
* RECORD_LAYOUT
*********************************************************************************************************************/
/begin RECORD_LAYOUT RTE_RL_UBYTE FNC_VALUES 1 UBYTE ROW_DIR DIRECT /end RECORD_LAYOUT
/begin RECORD_LAYOUT RTE_RL_UWORD FNC_VALUES 1 UWORD ROW_DIR DIRECT /end RECORD_LAYOUT
/begin RECORD_LAYOUT RTE_RL_ULONG FNC_VALUES 1 ULONG ROW_DIR DIRECT /end RECORD_LAYOUT
/begin RECORD_LAYOUT RTE_RL_SBYTE FNC_VALUES 1 SBYTE ROW_DIR DIRECT /end RECORD_LAYOUT
/begin RECORD_LAYOUT RTE_RL_FLOAT32_IEEE FNC_VALUES 1 FLOAT32_IEEE ROW_DIR DIRECT /end RECORD_LAYOUT
/begin RECORD_LAYOUT RTE_RL_BOOLEAN FNC_VALUES 1 UBYTE ROW_DIR DIRECT /end RECORD_LAYOUT
/**********************************************************************************************************************
* COMPU_METHOD / COMPU_VTAB_RANGE
*********************************************************************************************************************/
/begin COMPU_METHOD RTE_CM_BOOLEAN "" TAB_VERB "%3.1" "" COMPU_TAB_REF RTE_CM_BOOLEAN /end COMPU_METHOD
/begin COMPU_VTAB_RANGE RTE_CM_BOOLEAN "" 2 0 0 "false" 1 255 "true" /end COMPU_VTAB_RANGE
/begin COMPU_METHOD RTE_CM_ENUM_SysSt1 "" TAB_VERB "%.1" "" COMPU_TAB_REF RTE_CM_ENUM_SysSt1 /end COMPU_METHOD
/begin COMPU_VTAB_RANGE RTE_CM_ENUM_SysSt1 "" 4 0 0 "SYSST_DI" 1 1 "SYSST_OFF" 2 2 "SYSST_ENA" 3 3 "SYSST_WRMININ" /end COMPU_VTAB_RANGE
/begin COMPU_METHOD RTE_CM_ENUM_LoaSt1 "" TAB_VERB "%.1" "" COMPU_TAB_REF RTE_CM_ENUM_LoaSt1 /end COMPU_METHOD
/begin COMPU_VTAB_RANGE RTE_CM_ENUM_LoaSt1 "" 6 0 0 "LOAST_NORM" 1 1 "LOAST_LIMD" 2 2 "LOAST_SWBASDMTGTN" 3 3 "LOAST_FADEOUT" 4 4 "LOAST_CTRLDSHTDWNREQD" 5 5 "LOAST_IMDTSHTDWNREQD" /end COMPU_VTAB_RANGE
