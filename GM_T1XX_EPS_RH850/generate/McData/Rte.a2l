/**********************************************************************************************************************
* COPYRIGHT
* This software is copyright protected and proprietary to Vector Informatik GmbH.
* Vector Informatik GmbH grants to you only those rights as set out in the license conditions.
* All other rights remain with Vector Informatik GmbH.
* FILE DESCRIPTION
* File: Rte.a2l
* Config: EPS.dpa
* ECU-Project: EPS
* Generator: MICROSAR RTE Generator Version 4.12.0
* RTE Core Version 1.12.0
* License: Unlimited license CBD1400351 for Nexteer Automotive Corporation
* Description: MICROSAR RTE A2L file
*********************************************************************************************************************/
/**********************************************************************************************************************
* CHARACTERISTIC
*********************************************************************************************************************/
/begin CHARACTERISTIC AAACalRegn01Rt01_Dummy.TEstimnMagAmbMplr.Val "MICROSAR RTE" VALUE 0x0 RTE_RL_FLOAT32_IEEE 0 NO_COMPU_METHOD -3.402823466e+38 3.402823466e+38 SYMBOL_LINK "Rte_CalprmRom_CalRegn01Rt00_DEFAULT_RTE_CALPRM_GROUP.TEstimnMagAmbMplr_Val" 0 DISPLAY_IDENTIFIER AAACalRegn01Rt01_Dummy.CalibrationPorts.TEstimnMagAmbMplr.Val /end CHARACTERISTIC
/begin CHARACTERISTIC AAACalRegn01Rt01_Dummy.TunSelnAuthyHwTqY.Ary1D "MICROSAR RTE" VAL_BLK 0x0 RTE_RL_UWORD 0 NO_COMPU_METHOD 0 65535 MATRIX_DIM 6 1 1 SYMBOL_LINK "Rte_CalprmRom_CalRegn01Rt00_DEFAULT_RTE_CALPRM_GROUP.TunSelnAuthyHwTqY_Ary1D" 0 DISPLAY_IDENTIFIER AAACalRegn01Rt01_Dummy.CalibrationPorts.TunSelnAuthyHwTqY.Ary1D /end CHARACTERISTIC
/begin CHARACTERISTIC AAACalRegn01Rt01_Dummy.TunSelnAuthyHwVelY.Ary1D "MICROSAR RTE" VAL_BLK 0x0 RTE_RL_UWORD 0 NO_COMPU_METHOD 0 65535 MATRIX_DIM 6 1 1 SYMBOL_LINK "Rte_CalprmRom_CalRegn01Rt00_DEFAULT_RTE_CALPRM_GROUP.TunSelnAuthyHwVelY_Ary1D" 0 DISPLAY_IDENTIFIER AAACalRegn01Rt01_Dummy.CalibrationPorts.TunSelnAuthyHwVelY.Ary1D /end CHARACTERISTIC
/begin CHARACTERISTIC AAACalRegn01Rt01_Dummy_1.TEstimnMagAmbMplr.Val "MICROSAR RTE" VALUE 0x0 RTE_RL_FLOAT32_IEEE 0 NO_COMPU_METHOD -3.402823466e+38 3.402823466e+38 SYMBOL_LINK "Rte_CalprmRom_CalRegn01Rt01_DEFAULT_RTE_CALPRM_GROUP.TEstimnMagAmbMplr_Val" 0 DISPLAY_IDENTIFIER AAACalRegn01Rt01_Dummy_1.CalibrationPorts.TEstimnMagAmbMplr.Val /end CHARACTERISTIC
/begin CHARACTERISTIC AAACalRegn01Rt01_Dummy_1.TunSelnAuthyHwTqY.Ary1D "MICROSAR RTE" VAL_BLK 0x0 RTE_RL_UWORD 0 NO_COMPU_METHOD 0 65535 MATRIX_DIM 6 1 1 SYMBOL_LINK "Rte_CalprmRom_CalRegn01Rt01_DEFAULT_RTE_CALPRM_GROUP.TunSelnAuthyHwTqY_Ary1D" 0 DISPLAY_IDENTIFIER AAACalRegn01Rt01_Dummy_1.CalibrationPorts.TunSelnAuthyHwTqY.Ary1D /end CHARACTERISTIC
/begin CHARACTERISTIC AAACalRegn01Rt01_Dummy_1.TunSelnAuthyHwVelY.Ary1D "MICROSAR RTE" VAL_BLK 0x0 RTE_RL_UWORD 0 NO_COMPU_METHOD 0 65535 MATRIX_DIM 6 1 1 SYMBOL_LINK "Rte_CalprmRom_CalRegn01Rt01_DEFAULT_RTE_CALPRM_GROUP.TunSelnAuthyHwVelY_Ary1D" 0 DISPLAY_IDENTIFIER AAACalRegn01Rt01_Dummy_1.CalibrationPorts.TunSelnAuthyHwVelY.Ary1D /end CHARACTERISTIC
/begin CHARACTERISTIC AAACalRegn01Rt01_Dummy_2.TEstimnMagAmbMplr.Val "MICROSAR RTE" VALUE 0x0 RTE_RL_FLOAT32_IEEE 0 NO_COMPU_METHOD -3.402823466e+38 3.402823466e+38 SYMBOL_LINK "Rte_CalprmRom_CalRegn01Rt02_DEFAULT_RTE_CALPRM_GROUP.TEstimnMagAmbMplr_Val" 0 DISPLAY_IDENTIFIER AAACalRegn01Rt01_Dummy_2.CalibrationPorts.TEstimnMagAmbMplr.Val /end CHARACTERISTIC
/begin CHARACTERISTIC AAACalRegn01Rt01_Dummy_2.TunSelnAuthyHwTqY.Ary1D "MICROSAR RTE" VAL_BLK 0x0 RTE_RL_UWORD 0 NO_COMPU_METHOD 0 65535 MATRIX_DIM 6 1 1 SYMBOL_LINK "Rte_CalprmRom_CalRegn01Rt02_DEFAULT_RTE_CALPRM_GROUP.TunSelnAuthyHwTqY_Ary1D" 0 DISPLAY_IDENTIFIER AAACalRegn01Rt01_Dummy_2.CalibrationPorts.TunSelnAuthyHwTqY.Ary1D /end CHARACTERISTIC
/begin CHARACTERISTIC AAACalRegn01Rt01_Dummy_2.TunSelnAuthyHwVelY.Ary1D "MICROSAR RTE" VAL_BLK 0x0 RTE_RL_UWORD 0 NO_COMPU_METHOD 0 65535 MATRIX_DIM 6 1 1 SYMBOL_LINK "Rte_CalprmRom_CalRegn01Rt02_DEFAULT_RTE_CALPRM_GROUP.TunSelnAuthyHwVelY_Ary1D" 0 DISPLAY_IDENTIFIER AAACalRegn01Rt01_Dummy_2.CalibrationPorts.TunSelnAuthyHwVelY.Ary1D /end CHARACTERISTIC
/begin CHARACTERISTIC AAACalRegn01Rt01_Dummy_3.TEstimnMagAmbMplr.Val "MICROSAR RTE" VALUE 0x0 RTE_RL_FLOAT32_IEEE 0 NO_COMPU_METHOD -3.402823466e+38 3.402823466e+38 SYMBOL_LINK "Rte_CalprmRom_CalRegn01Rt03_DEFAULT_RTE_CALPRM_GROUP.TEstimnMagAmbMplr_Val" 0 DISPLAY_IDENTIFIER AAACalRegn01Rt01_Dummy_3.CalibrationPorts.TEstimnMagAmbMplr.Val /end CHARACTERISTIC
/begin CHARACTERISTIC AAACalRegn01Rt01_Dummy_3.TunSelnAuthyHwTqY.Ary1D "MICROSAR RTE" VAL_BLK 0x0 RTE_RL_UWORD 0 NO_COMPU_METHOD 0 65535 MATRIX_DIM 6 1 1 SYMBOL_LINK "Rte_CalprmRom_CalRegn01Rt03_DEFAULT_RTE_CALPRM_GROUP.TunSelnAuthyHwTqY_Ary1D" 0 DISPLAY_IDENTIFIER AAACalRegn01Rt01_Dummy_3.CalibrationPorts.TunSelnAuthyHwTqY.Ary1D /end CHARACTERISTIC
/begin CHARACTERISTIC AAACalRegn01Rt01_Dummy_3.TunSelnAuthyHwVelY.Ary1D "MICROSAR RTE" VAL_BLK 0x0 RTE_RL_UWORD 0 NO_COMPU_METHOD 0 65535 MATRIX_DIM 6 1 1 SYMBOL_LINK "Rte_CalprmRom_CalRegn01Rt03_DEFAULT_RTE_CALPRM_GROUP.TunSelnAuthyHwVelY_Ary1D" 0 DISPLAY_IDENTIFIER AAACalRegn01Rt01_Dummy_3.CalibrationPorts.TunSelnAuthyHwVelY.Ary1D /end CHARACTERISTIC
/begin CHARACTERISTIC AAACalRegn01Rt01_Dummy_4.TEstimnMagAmbMplr.Val "MICROSAR RTE" VALUE 0x0 RTE_RL_FLOAT32_IEEE 0 NO_COMPU_METHOD -3.402823466e+38 3.402823466e+38 SYMBOL_LINK "Rte_CalprmRom_CalRegn01Rt04_DEFAULT_RTE_CALPRM_GROUP.TEstimnMagAmbMplr_Val" 0 DISPLAY_IDENTIFIER AAACalRegn01Rt01_Dummy_4.CalibrationPorts.TEstimnMagAmbMplr.Val /end CHARACTERISTIC
/begin CHARACTERISTIC AAACalRegn01Rt01_Dummy_4.TunSelnAuthyHwTqY.Ary1D "MICROSAR RTE" VAL_BLK 0x0 RTE_RL_UWORD 0 NO_COMPU_METHOD 0 65535 MATRIX_DIM 6 1 1 SYMBOL_LINK "Rte_CalprmRom_CalRegn01Rt04_DEFAULT_RTE_CALPRM_GROUP.TunSelnAuthyHwTqY_Ary1D" 0 DISPLAY_IDENTIFIER AAACalRegn01Rt01_Dummy_4.CalibrationPorts.TunSelnAuthyHwTqY.Ary1D /end CHARACTERISTIC
/begin CHARACTERISTIC AAACalRegn01Rt01_Dummy_4.TunSelnAuthyHwVelY.Ary1D "MICROSAR RTE" VAL_BLK 0x0 RTE_RL_UWORD 0 NO_COMPU_METHOD 0 65535 MATRIX_DIM 6 1 1 SYMBOL_LINK "Rte_CalprmRom_CalRegn01Rt04_DEFAULT_RTE_CALPRM_GROUP.TunSelnAuthyHwVelY_Ary1D" 0 DISPLAY_IDENTIFIER AAACalRegn01Rt01_Dummy_4.CalibrationPorts.TunSelnAuthyHwVelY.Ary1D /end CHARACTERISTIC
/begin CHARACTERISTIC AAACalRegn02Rt01GroupC_Dummy.GmOvrlStMgrHwAgTarLimr.Val "MICROSAR RTE" VALUE 0x0 RTE_RL_FLOAT32_IEEE 0 NO_COMPU_METHOD -3.402823466e+38 3.402823466e+38 SYMBOL_LINK "Rte_CalprmRom_CalRegn02Rt00GroupC_DEFAULT_RTE_CALPRM_GROUP.GmOvrlStMgrHwAgTarLimr_Val" 0 DISPLAY_IDENTIFIER AAACalRegn02Rt01GroupC_Dummy.CalibrationPorts.GmOvrlStMgrHwAgTarLimr.Val /end CHARACTERISTIC
/begin CHARACTERISTIC AAACalRegn02Rt01GroupC_Dummy.GmOvrlStMgrShiftLvrTiThd.Val "MICROSAR RTE" VALUE 0x0 RTE_RL_ULONG 0 NO_COMPU_METHOD 0 4294967295 SYMBOL_LINK "Rte_CalprmRom_CalRegn02Rt00GroupC_DEFAULT_RTE_CALPRM_GROUP.GmOvrlStMgrShiftLvrTiThd_Val" 0 DISPLAY_IDENTIFIER AAACalRegn02Rt01GroupC_Dummy.CalibrationPorts.GmOvrlStMgrShiftLvrTiThd.Val /end CHARACTERISTIC
/begin CHARACTERISTIC AAACalRegn02Rt01GroupC_Dummy.GmOvrlStMgrStandStillThd.Val "MICROSAR RTE" VALUE 0x0 RTE_RL_FLOAT32_IEEE 0 NO_COMPU_METHOD -3.402823466e+38 3.402823466e+38 SYMBOL_LINK "Rte_CalprmRom_CalRegn02Rt00GroupC_DEFAULT_RTE_CALPRM_GROUP.GmOvrlStMgrStandStillThd_Val" 0 DISPLAY_IDENTIFIER AAACalRegn02Rt01GroupC_Dummy.CalibrationPorts.GmOvrlStMgrStandStillThd.Val /end CHARACTERISTIC
/begin CHARACTERISTIC AAACalRegn02Rt01GroupC_Dummy.GmOvrlStMgrStandStillTiThd.Val "MICROSAR RTE" VALUE 0x0 RTE_RL_ULONG 0 NO_COMPU_METHOD 0 4294967295 SYMBOL_LINK "Rte_CalprmRom_CalRegn02Rt00GroupC_DEFAULT_RTE_CALPRM_GROUP.GmOvrlStMgrStandStillTiThd_Val" 0 DISPLAY_IDENTIFIER AAACalRegn02Rt01GroupC_Dummy.CalibrationPorts.GmOvrlStMgrStandStillTiThd.Val /end CHARACTERISTIC
/begin CHARACTERISTIC AAACalRegn02Rt01GroupC_Dummy.GmTqArbnApaDiRateY.Ary1D "MICROSAR RTE" VAL_BLK 0x0 RTE_RL_UWORD 0 NO_COMPU_METHOD 0 65535 MATRIX_DIM 6 1 1 SYMBOL_LINK "Rte_CalprmRom_CalRegn02Rt00GroupC_DEFAULT_RTE_CALPRM_GROUP.GmTqArbnApaDiRateY_Ary1D" 0 DISPLAY_IDENTIFIER AAACalRegn02Rt01GroupC_Dummy.CalibrationPorts.GmTqArbnApaDiRateY.Ary1D /end CHARACTERISTIC
/begin CHARACTERISTIC AAACalRegn02Rt01GroupC_Dummy.GmTqArbnApaEnaRate.Val "MICROSAR RTE" VALUE 0x0 RTE_RL_FLOAT32_IEEE 0 NO_COMPU_METHOD -3.402823466e+38 3.402823466e+38 SYMBOL_LINK "Rte_CalprmRom_CalRegn02Rt00GroupC_DEFAULT_RTE_CALPRM_GROUP.GmTqArbnApaEnaRate_Val" 0 DISPLAY_IDENTIFIER AAACalRegn02Rt01GroupC_Dummy.CalibrationPorts.GmTqArbnApaEnaRate.Val /end CHARACTERISTIC
/begin CHARACTERISTIC AAACalRegn02Rt01GroupC_Dummy.GmTqArbnApaSmotngHwTqLpFilFrq.Val "MICROSAR RTE" VALUE 0x0 RTE_RL_FLOAT32_IEEE 0 NO_COMPU_METHOD -3.402823466e+38 3.402823466e+38 SYMBOL_LINK "Rte_CalprmRom_CalRegn02Rt00GroupC_DEFAULT_RTE_CALPRM_GROUP.GmTqArbnApaSmotngHwTqLpFilFrq_Val" 0 DISPLAY_IDENTIFIER AAACalRegn02Rt01GroupC_Dummy.CalibrationPorts.GmTqArbnApaSmotngHwTqLpFilFrq.Val /end CHARACTERISTIC
/begin CHARACTERISTIC AAACalRegn02Rt01GroupC_Dummy.GmTqArbnApaSmotngX.Ary1D "MICROSAR RTE" VAL_BLK 0x0 RTE_RL_UWORD 0 NO_COMPU_METHOD 0 65535 MATRIX_DIM 10 1 1 SYMBOL_LINK "Rte_CalprmRom_CalRegn02Rt00GroupC_DEFAULT_RTE_CALPRM_GROUP.GmTqArbnApaSmotngX_Ary1D" 0 DISPLAY_IDENTIFIER AAACalRegn02Rt01GroupC_Dummy.CalibrationPorts.GmTqArbnApaSmotngX.Ary1D /end CHARACTERISTIC
/begin CHARACTERISTIC AAACalRegn02Rt01GroupC_Dummy.GmTqArbnApaSmotngY.Ary1D "MICROSAR RTE" VAL_BLK 0x0 RTE_RL_UWORD 0 NO_COMPU_METHOD 0 65535 MATRIX_DIM 10 1 1 SYMBOL_LINK "Rte_CalprmRom_CalRegn02Rt00GroupC_DEFAULT_RTE_CALPRM_GROUP.GmTqArbnApaSmotngY_Ary1D" 0 DISPLAY_IDENTIFIER AAACalRegn02Rt01GroupC_Dummy.CalibrationPorts.GmTqArbnApaSmotngY.Ary1D /end CHARACTERISTIC
/begin CHARACTERISTIC AAACalRegn02Rt01GroupC_Dummy.GmTqArbnLkaOutpOvrlX.Ary2D "MICROSAR RTE" VAL_BLK 0x0 RTE_RL_UWORD 0 NO_COMPU_METHOD 0 65535 MATRIX_DIM 20 12 1 SYMBOL_LINK "Rte_CalprmRom_CalRegn02Rt00GroupC_DEFAULT_RTE_CALPRM_GROUP.GmTqArbnLkaOutpOvrlX_Ary2D" 0 DISPLAY_IDENTIFIER AAACalRegn02Rt01GroupC_Dummy.CalibrationPorts.GmTqArbnLkaOutpOvrlX.Ary2D /end CHARACTERISTIC
/begin CHARACTERISTIC AAACalRegn02Rt01GroupC_Dummy.GmTqArbnLkaOutpOvrlY.Ary2D "MICROSAR RTE" VAL_BLK 0x0 RTE_RL_UWORD 0 NO_COMPU_METHOD 0 65535 MATRIX_DIM 20 12 1 SYMBOL_LINK "Rte_CalprmRom_CalRegn02Rt00GroupC_DEFAULT_RTE_CALPRM_GROUP.GmTqArbnLkaOutpOvrlY_Ary2D" 0 DISPLAY_IDENTIFIER AAACalRegn02Rt01GroupC_Dummy.CalibrationPorts.GmTqArbnLkaOutpOvrlY.Ary2D /end CHARACTERISTIC
/begin CHARACTERISTIC AAACalRegn02Rt01GroupC_Dummy.GmTqArbnLkaSlewX.Ary1D "MICROSAR RTE" VAL_BLK 0x0 RTE_RL_UWORD 0 NO_COMPU_METHOD 0 65535 MATRIX_DIM 6 1 1 SYMBOL_LINK "Rte_CalprmRom_CalRegn02Rt00GroupC_DEFAULT_RTE_CALPRM_GROUP.GmTqArbnLkaSlewX_Ary1D" 0 DISPLAY_IDENTIFIER AAACalRegn02Rt01GroupC_Dummy.CalibrationPorts.GmTqArbnLkaSlewX.Ary1D /end CHARACTERISTIC
/begin CHARACTERISTIC AAACalRegn02Rt01GroupC_Dummy.GmTqArbnLkaSlewY.Ary1D "MICROSAR RTE" VAL_BLK 0x0 RTE_RL_UWORD 0 NO_COMPU_METHOD 0 65535 MATRIX_DIM 6 1 1 SYMBOL_LINK "Rte_CalprmRom_CalRegn02Rt00GroupC_DEFAULT_RTE_CALPRM_GROUP.GmTqArbnLkaSlewY_Ary1D" 0 DISPLAY_IDENTIFIER AAACalRegn02Rt01GroupC_Dummy.CalibrationPorts.GmTqArbnLkaSlewY.Ary1D /end CHARACTERISTIC
/begin CHARACTERISTIC AAACalRegn02Rt01GroupC_Dummy_1.GmOvrlStMgrHwAgTarLimr.Val "MICROSAR RTE" VALUE 0x0 RTE_RL_FLOAT32_IEEE 0 NO_COMPU_METHOD -3.402823466e+38 3.402823466e+38 SYMBOL_LINK "Rte_CalprmRom_CalRegn02Rt01GroupC_DEFAULT_RTE_CALPRM_GROUP.GmOvrlStMgrHwAgTarLimr_Val" 0 DISPLAY_IDENTIFIER AAACalRegn02Rt01GroupC_Dummy_1.CalibrationPorts.GmOvrlStMgrHwAgTarLimr.Val /end CHARACTERISTIC
/begin CHARACTERISTIC AAACalRegn02Rt01GroupC_Dummy_1.GmOvrlStMgrShiftLvrTiThd.Val "MICROSAR RTE" VALUE 0x0 RTE_RL_ULONG 0 NO_COMPU_METHOD 0 4294967295 SYMBOL_LINK "Rte_CalprmRom_CalRegn02Rt01GroupC_DEFAULT_RTE_CALPRM_GROUP.GmOvrlStMgrShiftLvrTiThd_Val" 0 DISPLAY_IDENTIFIER AAACalRegn02Rt01GroupC_Dummy_1.CalibrationPorts.GmOvrlStMgrShiftLvrTiThd.Val /end CHARACTERISTIC
/begin CHARACTERISTIC AAACalRegn02Rt01GroupC_Dummy_1.GmOvrlStMgrStandStillThd.Val "MICROSAR RTE" VALUE 0x0 RTE_RL_FLOAT32_IEEE 0 NO_COMPU_METHOD -3.402823466e+38 3.402823466e+38 SYMBOL_LINK "Rte_CalprmRom_CalRegn02Rt01GroupC_DEFAULT_RTE_CALPRM_GROUP.GmOvrlStMgrStandStillThd_Val" 0 DISPLAY_IDENTIFIER AAACalRegn02Rt01GroupC_Dummy_1.CalibrationPorts.GmOvrlStMgrStandStillThd.Val /end CHARACTERISTIC
/begin CHARACTERISTIC AAACalRegn02Rt01GroupC_Dummy_1.GmOvrlStMgrStandStillTiThd.Val "MICROSAR RTE" VALUE 0x0 RTE_RL_ULONG 0 NO_COMPU_METHOD 0 4294967295 SYMBOL_LINK "Rte_CalprmRom_CalRegn02Rt01GroupC_DEFAULT_RTE_CALPRM_GROUP.GmOvrlStMgrStandStillTiThd_Val" 0 DISPLAY_IDENTIFIER AAACalRegn02Rt01GroupC_Dummy_1.CalibrationPorts.GmOvrlStMgrStandStillTiThd.Val /end CHARACTERISTIC
/begin CHARACTERISTIC AAACalRegn02Rt01GroupC_Dummy_1.GmTqArbnApaDiRateY.Ary1D "MICROSAR RTE" VAL_BLK 0x0 RTE_RL_UWORD 0 NO_COMPU_METHOD 0 65535 MATRIX_DIM 6 1 1 SYMBOL_LINK "Rte_CalprmRom_CalRegn02Rt01GroupC_DEFAULT_RTE_CALPRM_GROUP.GmTqArbnApaDiRateY_Ary1D" 0 DISPLAY_IDENTIFIER AAACalRegn02Rt01GroupC_Dummy_1.CalibrationPorts.GmTqArbnApaDiRateY.Ary1D /end CHARACTERISTIC
/begin CHARACTERISTIC AAACalRegn02Rt01GroupC_Dummy_1.GmTqArbnApaEnaRate.Val "MICROSAR RTE" VALUE 0x0 RTE_RL_FLOAT32_IEEE 0 NO_COMPU_METHOD -3.402823466e+38 3.402823466e+38 SYMBOL_LINK "Rte_CalprmRom_CalRegn02Rt01GroupC_DEFAULT_RTE_CALPRM_GROUP.GmTqArbnApaEnaRate_Val" 0 DISPLAY_IDENTIFIER AAACalRegn02Rt01GroupC_Dummy_1.CalibrationPorts.GmTqArbnApaEnaRate.Val /end CHARACTERISTIC
/begin CHARACTERISTIC AAACalRegn02Rt01GroupC_Dummy_1.GmTqArbnApaSmotngHwTqLpFilFrq.Val "MICROSAR RTE" VALUE 0x0 RTE_RL_FLOAT32_IEEE 0 NO_COMPU_METHOD -3.402823466e+38 3.402823466e+38 SYMBOL_LINK "Rte_CalprmRom_CalRegn02Rt01GroupC_DEFAULT_RTE_CALPRM_GROUP.GmTqArbnApaSmotngHwTqLpFilFrq_Val" 0 DISPLAY_IDENTIFIER AAACalRegn02Rt01GroupC_Dummy_1.CalibrationPorts.GmTqArbnApaSmotngHwTqLpFilFrq.Val /end CHARACTERISTIC
/begin CHARACTERISTIC AAACalRegn02Rt01GroupC_Dummy_1.GmTqArbnApaSmotngX.Ary1D "MICROSAR RTE" VAL_BLK 0x0 RTE_RL_UWORD 0 NO_COMPU_METHOD 0 65535 MATRIX_DIM 10 1 1 SYMBOL_LINK "Rte_CalprmRom_CalRegn02Rt01GroupC_DEFAULT_RTE_CALPRM_GROUP.GmTqArbnApaSmotngX_Ary1D" 0 DISPLAY_IDENTIFIER AAACalRegn02Rt01GroupC_Dummy_1.CalibrationPorts.GmTqArbnApaSmotngX.Ary1D /end CHARACTERISTIC
/begin CHARACTERISTIC AAACalRegn02Rt01GroupC_Dummy_1.GmTqArbnApaSmotngY.Ary1D "MICROSAR RTE" VAL_BLK 0x0 RTE_RL_UWORD 0 NO_COMPU_METHOD 0 65535 MATRIX_DIM 10 1 1 SYMBOL_LINK "Rte_CalprmRom_CalRegn02Rt01GroupC_DEFAULT_RTE_CALPRM_GROUP.GmTqArbnApaSmotngY_Ary1D" 0 DISPLAY_IDENTIFIER AAACalRegn02Rt01GroupC_Dummy_1.CalibrationPorts.GmTqArbnApaSmotngY.Ary1D /end CHARACTERISTIC
/begin CHARACTERISTIC AAACalRegn02Rt01GroupC_Dummy_1.GmTqArbnLkaOutpOvrlX.Ary2D "MICROSAR RTE" VAL_BLK 0x0 RTE_RL_UWORD 0 NO_COMPU_METHOD 0 65535 MATRIX_DIM 20 12 1 SYMBOL_LINK "Rte_CalprmRom_CalRegn02Rt01GroupC_DEFAULT_RTE_CALPRM_GROUP.GmTqArbnLkaOutpOvrlX_Ary2D" 0 DISPLAY_IDENTIFIER AAACalRegn02Rt01GroupC_Dummy_1.CalibrationPorts.GmTqArbnLkaOutpOvrlX.Ary2D /end CHARACTERISTIC
/begin CHARACTERISTIC AAACalRegn02Rt01GroupC_Dummy_1.GmTqArbnLkaOutpOvrlY.Ary2D "MICROSAR RTE" VAL_BLK 0x0 RTE_RL_UWORD 0 NO_COMPU_METHOD 0 65535 MATRIX_DIM 20 12 1 SYMBOL_LINK "Rte_CalprmRom_CalRegn02Rt01GroupC_DEFAULT_RTE_CALPRM_GROUP.GmTqArbnLkaOutpOvrlY_Ary2D" 0 DISPLAY_IDENTIFIER AAACalRegn02Rt01GroupC_Dummy_1.CalibrationPorts.GmTqArbnLkaOutpOvrlY.Ary2D /end CHARACTERISTIC
/begin CHARACTERISTIC AAACalRegn02Rt01GroupC_Dummy_1.GmTqArbnLkaSlewX.Ary1D "MICROSAR RTE" VAL_BLK 0x0 RTE_RL_UWORD 0 NO_COMPU_METHOD 0 65535 MATRIX_DIM 6 1 1 SYMBOL_LINK "Rte_CalprmRom_CalRegn02Rt01GroupC_DEFAULT_RTE_CALPRM_GROUP.GmTqArbnLkaSlewX_Ary1D" 0 DISPLAY_IDENTIFIER AAACalRegn02Rt01GroupC_Dummy_1.CalibrationPorts.GmTqArbnLkaSlewX.Ary1D /end CHARACTERISTIC
/begin CHARACTERISTIC AAACalRegn02Rt01GroupC_Dummy_1.GmTqArbnLkaSlewY.Ary1D "MICROSAR RTE" VAL_BLK 0x0 RTE_RL_UWORD 0 NO_COMPU_METHOD 0 65535 MATRIX_DIM 6 1 1 SYMBOL_LINK "Rte_CalprmRom_CalRegn02Rt01GroupC_DEFAULT_RTE_CALPRM_GROUP.GmTqArbnLkaSlewY_Ary1D" 0 DISPLAY_IDENTIFIER AAACalRegn02Rt01GroupC_Dummy_1.CalibrationPorts.GmTqArbnLkaSlewY.Ary1D /end CHARACTERISTIC
/begin CHARACTERISTIC AAACalRegn02Rt01GroupC_Dummy_2.GmOvrlStMgrHwAgTarLimr.Val "MICROSAR RTE" VALUE 0x0 RTE_RL_FLOAT32_IEEE 0 NO_COMPU_METHOD -3.402823466e+38 3.402823466e+38 SYMBOL_LINK "Rte_CalprmRom_CalRegn02Rt02GroupC_DEFAULT_RTE_CALPRM_GROUP.GmOvrlStMgrHwAgTarLimr_Val" 0 DISPLAY_IDENTIFIER AAACalRegn02Rt01GroupC_Dummy_2.CalibrationPorts.GmOvrlStMgrHwAgTarLimr.Val /end CHARACTERISTIC
/begin CHARACTERISTIC AAACalRegn02Rt01GroupC_Dummy_2.GmOvrlStMgrShiftLvrTiThd.Val "MICROSAR RTE" VALUE 0x0 RTE_RL_ULONG 0 NO_COMPU_METHOD 0 4294967295 SYMBOL_LINK "Rte_CalprmRom_CalRegn02Rt02GroupC_DEFAULT_RTE_CALPRM_GROUP.GmOvrlStMgrShiftLvrTiThd_Val" 0 DISPLAY_IDENTIFIER AAACalRegn02Rt01GroupC_Dummy_2.CalibrationPorts.GmOvrlStMgrShiftLvrTiThd.Val /end CHARACTERISTIC
/begin CHARACTERISTIC AAACalRegn02Rt01GroupC_Dummy_2.GmOvrlStMgrStandStillThd.Val "MICROSAR RTE" VALUE 0x0 RTE_RL_FLOAT32_IEEE 0 NO_COMPU_METHOD -3.402823466e+38 3.402823466e+38 SYMBOL_LINK "Rte_CalprmRom_CalRegn02Rt02GroupC_DEFAULT_RTE_CALPRM_GROUP.GmOvrlStMgrStandStillThd_Val" 0 DISPLAY_IDENTIFIER AAACalRegn02Rt01GroupC_Dummy_2.CalibrationPorts.GmOvrlStMgrStandStillThd.Val /end CHARACTERISTIC
/begin CHARACTERISTIC AAACalRegn02Rt01GroupC_Dummy_2.GmOvrlStMgrStandStillTiThd.Val "MICROSAR RTE" VALUE 0x0 RTE_RL_ULONG 0 NO_COMPU_METHOD 0 4294967295 SYMBOL_LINK "Rte_CalprmRom_CalRegn02Rt02GroupC_DEFAULT_RTE_CALPRM_GROUP.GmOvrlStMgrStandStillTiThd_Val" 0 DISPLAY_IDENTIFIER AAACalRegn02Rt01GroupC_Dummy_2.CalibrationPorts.GmOvrlStMgrStandStillTiThd.Val /end CHARACTERISTIC
/begin CHARACTERISTIC AAACalRegn02Rt01GroupC_Dummy_2.GmTqArbnApaDiRateY.Ary1D "MICROSAR RTE" VAL_BLK 0x0 RTE_RL_UWORD 0 NO_COMPU_METHOD 0 65535 MATRIX_DIM 6 1 1 SYMBOL_LINK "Rte_CalprmRom_CalRegn02Rt02GroupC_DEFAULT_RTE_CALPRM_GROUP.GmTqArbnApaDiRateY_Ary1D" 0 DISPLAY_IDENTIFIER AAACalRegn02Rt01GroupC_Dummy_2.CalibrationPorts.GmTqArbnApaDiRateY.Ary1D /end CHARACTERISTIC
/begin CHARACTERISTIC AAACalRegn02Rt01GroupC_Dummy_2.GmTqArbnApaEnaRate.Val "MICROSAR RTE" VALUE 0x0 RTE_RL_FLOAT32_IEEE 0 NO_COMPU_METHOD -3.402823466e+38 3.402823466e+38 SYMBOL_LINK "Rte_CalprmRom_CalRegn02Rt02GroupC_DEFAULT_RTE_CALPRM_GROUP.GmTqArbnApaEnaRate_Val" 0 DISPLAY_IDENTIFIER AAACalRegn02Rt01GroupC_Dummy_2.CalibrationPorts.GmTqArbnApaEnaRate.Val /end CHARACTERISTIC
/begin CHARACTERISTIC AAACalRegn02Rt01GroupC_Dummy_2.GmTqArbnApaSmotngHwTqLpFilFrq.Val "MICROSAR RTE" VALUE 0x0 RTE_RL_FLOAT32_IEEE 0 NO_COMPU_METHOD -3.402823466e+38 3.402823466e+38 SYMBOL_LINK "Rte_CalprmRom_CalRegn02Rt02GroupC_DEFAULT_RTE_CALPRM_GROUP.GmTqArbnApaSmotngHwTqLpFilFrq_Val" 0 DISPLAY_IDENTIFIER AAACalRegn02Rt01GroupC_Dummy_2.CalibrationPorts.GmTqArbnApaSmotngHwTqLpFilFrq.Val /end CHARACTERISTIC
/begin CHARACTERISTIC AAACalRegn02Rt01GroupC_Dummy_2.GmTqArbnApaSmotngX.Ary1D "MICROSAR RTE" VAL_BLK 0x0 RTE_RL_UWORD 0 NO_COMPU_METHOD 0 65535 MATRIX_DIM 10 1 1 SYMBOL_LINK "Rte_CalprmRom_CalRegn02Rt02GroupC_DEFAULT_RTE_CALPRM_GROUP.GmTqArbnApaSmotngX_Ary1D" 0 DISPLAY_IDENTIFIER AAACalRegn02Rt01GroupC_Dummy_2.CalibrationPorts.GmTqArbnApaSmotngX.Ary1D /end CHARACTERISTIC
/begin CHARACTERISTIC AAACalRegn02Rt01GroupC_Dummy_2.GmTqArbnApaSmotngY.Ary1D "MICROSAR RTE" VAL_BLK 0x0 RTE_RL_UWORD 0 NO_COMPU_METHOD 0 65535 MATRIX_DIM 10 1 1 SYMBOL_LINK "Rte_CalprmRom_CalRegn02Rt02GroupC_DEFAULT_RTE_CALPRM_GROUP.GmTqArbnApaSmotngY_Ary1D" 0 DISPLAY_IDENTIFIER AAACalRegn02Rt01GroupC_Dummy_2.CalibrationPorts.GmTqArbnApaSmotngY.Ary1D /end CHARACTERISTIC
/begin CHARACTERISTIC AAACalRegn02Rt01GroupC_Dummy_2.GmTqArbnLkaOutpOvrlX.Ary2D "MICROSAR RTE" VAL_BLK 0x0 RTE_RL_UWORD 0 NO_COMPU_METHOD 0 65535 MATRIX_DIM 20 12 1 SYMBOL_LINK "Rte_CalprmRom_CalRegn02Rt02GroupC_DEFAULT_RTE_CALPRM_GROUP.GmTqArbnLkaOutpOvrlX_Ary2D" 0 DISPLAY_IDENTIFIER AAACalRegn02Rt01GroupC_Dummy_2.CalibrationPorts.GmTqArbnLkaOutpOvrlX.Ary2D /end CHARACTERISTIC
/begin CHARACTERISTIC AAACalRegn02Rt01GroupC_Dummy_2.GmTqArbnLkaOutpOvrlY.Ary2D "MICROSAR RTE" VAL_BLK 0x0 RTE_RL_UWORD 0 NO_COMPU_METHOD 0 65535 MATRIX_DIM 20 12 1 SYMBOL_LINK "Rte_CalprmRom_CalRegn02Rt02GroupC_DEFAULT_RTE_CALPRM_GROUP.GmTqArbnLkaOutpOvrlY_Ary2D" 0 DISPLAY_IDENTIFIER AAACalRegn02Rt01GroupC_Dummy_2.CalibrationPorts.GmTqArbnLkaOutpOvrlY.Ary2D /end CHARACTERISTIC
/begin CHARACTERISTIC AAACalRegn02Rt01GroupC_Dummy_2.GmTqArbnLkaSlewX.Ary1D "MICROSAR RTE" VAL_BLK 0x0 RTE_RL_UWORD 0 NO_COMPU_METHOD 0 65535 MATRIX_DIM 6 1 1 SYMBOL_LINK "Rte_CalprmRom_CalRegn02Rt02GroupC_DEFAULT_RTE_CALPRM_GROUP.GmTqArbnLkaSlewX_Ary1D" 0 DISPLAY_IDENTIFIER AAACalRegn02Rt01GroupC_Dummy_2.CalibrationPorts.GmTqArbnLkaSlewX.Ary1D /end CHARACTERISTIC
/begin CHARACTERISTIC AAACalRegn02Rt01GroupC_Dummy_2.GmTqArbnLkaSlewY.Ary1D "MICROSAR RTE" VAL_BLK 0x0 RTE_RL_UWORD 0 NO_COMPU_METHOD 0 65535 MATRIX_DIM 6 1 1 SYMBOL_LINK "Rte_CalprmRom_CalRegn02Rt02GroupC_DEFAULT_RTE_CALPRM_GROUP.GmTqArbnLkaSlewY_Ary1D" 0 DISPLAY_IDENTIFIER AAACalRegn02Rt01GroupC_Dummy_2.CalibrationPorts.GmTqArbnLkaSlewY.Ary1D /end CHARACTERISTIC
/begin CHARACTERISTIC AAACalRegn02Rt01GroupC_Dummy_3.GmOvrlStMgrHwAgTarLimr.Val "MICROSAR RTE" VALUE 0x0 RTE_RL_FLOAT32_IEEE 0 NO_COMPU_METHOD -3.402823466e+38 3.402823466e+38 SYMBOL_LINK "Rte_CalprmRom_CalRegn02Rt03GroupC_DEFAULT_RTE_CALPRM_GROUP.GmOvrlStMgrHwAgTarLimr_Val" 0 DISPLAY_IDENTIFIER AAACalRegn02Rt01GroupC_Dummy_3.CalibrationPorts.GmOvrlStMgrHwAgTarLimr.Val /end CHARACTERISTIC
/begin CHARACTERISTIC AAACalRegn02Rt01GroupC_Dummy_3.GmOvrlStMgrShiftLvrTiThd.Val "MICROSAR RTE" VALUE 0x0 RTE_RL_ULONG 0 NO_COMPU_METHOD 0 4294967295 SYMBOL_LINK "Rte_CalprmRom_CalRegn02Rt03GroupC_DEFAULT_RTE_CALPRM_GROUP.GmOvrlStMgrShiftLvrTiThd_Val" 0 DISPLAY_IDENTIFIER AAACalRegn02Rt01GroupC_Dummy_3.CalibrationPorts.GmOvrlStMgrShiftLvrTiThd.Val /end CHARACTERISTIC
/begin CHARACTERISTIC AAACalRegn02Rt01GroupC_Dummy_3.GmOvrlStMgrStandStillThd.Val "MICROSAR RTE" VALUE 0x0 RTE_RL_FLOAT32_IEEE 0 NO_COMPU_METHOD -3.402823466e+38 3.402823466e+38 SYMBOL_LINK "Rte_CalprmRom_CalRegn02Rt03GroupC_DEFAULT_RTE_CALPRM_GROUP.GmOvrlStMgrStandStillThd_Val" 0 DISPLAY_IDENTIFIER AAACalRegn02Rt01GroupC_Dummy_3.CalibrationPorts.GmOvrlStMgrStandStillThd.Val /end CHARACTERISTIC
/begin CHARACTERISTIC AAACalRegn02Rt01GroupC_Dummy_3.GmOvrlStMgrStandStillTiThd.Val "MICROSAR RTE" VALUE 0x0 RTE_RL_ULONG 0 NO_COMPU_METHOD 0 4294967295 SYMBOL_LINK "Rte_CalprmRom_CalRegn02Rt03GroupC_DEFAULT_RTE_CALPRM_GROUP.GmOvrlStMgrStandStillTiThd_Val" 0 DISPLAY_IDENTIFIER AAACalRegn02Rt01GroupC_Dummy_3.CalibrationPorts.GmOvrlStMgrStandStillTiThd.Val /end CHARACTERISTIC
/begin CHARACTERISTIC AAACalRegn02Rt01GroupC_Dummy_3.GmTqArbnApaDiRateY.Ary1D "MICROSAR RTE" VAL_BLK 0x0 RTE_RL_UWORD 0 NO_COMPU_METHOD 0 65535 MATRIX_DIM 6 1 1 SYMBOL_LINK "Rte_CalprmRom_CalRegn02Rt03GroupC_DEFAULT_RTE_CALPRM_GROUP.GmTqArbnApaDiRateY_Ary1D" 0 DISPLAY_IDENTIFIER AAACalRegn02Rt01GroupC_Dummy_3.CalibrationPorts.GmTqArbnApaDiRateY.Ary1D /end CHARACTERISTIC
/begin CHARACTERISTIC AAACalRegn02Rt01GroupC_Dummy_3.GmTqArbnApaEnaRate.Val "MICROSAR RTE" VALUE 0x0 RTE_RL_FLOAT32_IEEE 0 NO_COMPU_METHOD -3.402823466e+38 3.402823466e+38 SYMBOL_LINK "Rte_CalprmRom_CalRegn02Rt03GroupC_DEFAULT_RTE_CALPRM_GROUP.GmTqArbnApaEnaRate_Val" 0 DISPLAY_IDENTIFIER AAACalRegn02Rt01GroupC_Dummy_3.CalibrationPorts.GmTqArbnApaEnaRate.Val /end CHARACTERISTIC
/begin CHARACTERISTIC AAACalRegn02Rt01GroupC_Dummy_3.GmTqArbnApaSmotngHwTqLpFilFrq.Val "MICROSAR RTE" VALUE 0x0 RTE_RL_FLOAT32_IEEE 0 NO_COMPU_METHOD -3.402823466e+38 3.402823466e+38 SYMBOL_LINK "Rte_CalprmRom_CalRegn02Rt03GroupC_DEFAULT_RTE_CALPRM_GROUP.GmTqArbnApaSmotngHwTqLpFilFrq_Val" 0 DISPLAY_IDENTIFIER AAACalRegn02Rt01GroupC_Dummy_3.CalibrationPorts.GmTqArbnApaSmotngHwTqLpFilFrq.Val /end CHARACTERISTIC
/begin CHARACTERISTIC AAACalRegn02Rt01GroupC_Dummy_3.GmTqArbnApaSmotngX.Ary1D "MICROSAR RTE" VAL_BLK 0x0 RTE_RL_UWORD 0 NO_COMPU_METHOD 0 65535 MATRIX_DIM 10 1 1 SYMBOL_LINK "Rte_CalprmRom_CalRegn02Rt03GroupC_DEFAULT_RTE_CALPRM_GROUP.GmTqArbnApaSmotngX_Ary1D" 0 DISPLAY_IDENTIFIER AAACalRegn02Rt01GroupC_Dummy_3.CalibrationPorts.GmTqArbnApaSmotngX.Ary1D /end CHARACTERISTIC
/begin CHARACTERISTIC AAACalRegn02Rt01GroupC_Dummy_3.GmTqArbnApaSmotngY.Ary1D "MICROSAR RTE" VAL_BLK 0x0 RTE_RL_UWORD 0 NO_COMPU_METHOD 0 65535 MATRIX_DIM 10 1 1 SYMBOL_LINK "Rte_CalprmRom_CalRegn02Rt03GroupC_DEFAULT_RTE_CALPRM_GROUP.GmTqArbnApaSmotngY_Ary1D" 0 DISPLAY_IDENTIFIER AAACalRegn02Rt01GroupC_Dummy_3.CalibrationPorts.GmTqArbnApaSmotngY.Ary1D /end CHARACTERISTIC
/begin CHARACTERISTIC AAACalRegn02Rt01GroupC_Dummy_3.GmTqArbnLkaOutpOvrlX.Ary2D "MICROSAR RTE" VAL_BLK 0x0 RTE_RL_UWORD 0 NO_COMPU_METHOD 0 65535 MATRIX_DIM 20 12 1 SYMBOL_LINK "Rte_CalprmRom_CalRegn02Rt03GroupC_DEFAULT_RTE_CALPRM_GROUP.GmTqArbnLkaOutpOvrlX_Ary2D" 0 DISPLAY_IDENTIFIER AAACalRegn02Rt01GroupC_Dummy_3.CalibrationPorts.GmTqArbnLkaOutpOvrlX.Ary2D /end CHARACTERISTIC
/begin CHARACTERISTIC AAACalRegn02Rt01GroupC_Dummy_3.GmTqArbnLkaOutpOvrlY.Ary2D "MICROSAR RTE" VAL_BLK 0x0 RTE_RL_UWORD 0 NO_COMPU_METHOD 0 65535 MATRIX_DIM 20 12 1 SYMBOL_LINK "Rte_CalprmRom_CalRegn02Rt03GroupC_DEFAULT_RTE_CALPRM_GROUP.GmTqArbnLkaOutpOvrlY_Ary2D" 0 DISPLAY_IDENTIFIER AAACalRegn02Rt01GroupC_Dummy_3.CalibrationPorts.GmTqArbnLkaOutpOvrlY.Ary2D /end CHARACTERISTIC
/begin CHARACTERISTIC AAACalRegn02Rt01GroupC_Dummy_3.GmTqArbnLkaSlewX.Ary1D "MICROSAR RTE" VAL_BLK 0x0 RTE_RL_UWORD 0 NO_COMPU_METHOD 0 65535 MATRIX_DIM 6 1 1 SYMBOL_LINK "Rte_CalprmRom_CalRegn02Rt03GroupC_DEFAULT_RTE_CALPRM_GROUP.GmTqArbnLkaSlewX_Ary1D" 0 DISPLAY_IDENTIFIER AAACalRegn02Rt01GroupC_Dummy_3.CalibrationPorts.GmTqArbnLkaSlewX.Ary1D /end CHARACTERISTIC
/begin CHARACTERISTIC AAACalRegn02Rt01GroupC_Dummy_3.GmTqArbnLkaSlewY.Ary1D "MICROSAR RTE" VAL_BLK 0x0 RTE_RL_UWORD 0 NO_COMPU_METHOD 0 65535 MATRIX_DIM 6 1 1 SYMBOL_LINK "Rte_CalprmRom_CalRegn02Rt03GroupC_DEFAULT_RTE_CALPRM_GROUP.GmTqArbnLkaSlewY_Ary1D" 0 DISPLAY_IDENTIFIER AAACalRegn02Rt01GroupC_Dummy_3.CalibrationPorts.GmTqArbnLkaSlewY.Ary1D /end CHARACTERISTIC
/begin CHARACTERISTIC AAACalRegn02Rt01GroupC_Dummy_4.GmOvrlStMgrHwAgTarLimr.Val "MICROSAR RTE" VALUE 0x0 RTE_RL_FLOAT32_IEEE 0 NO_COMPU_METHOD -3.402823466e+38 3.402823466e+38 SYMBOL_LINK "Rte_CalprmRom_CalRegn02Rt04GroupC_DEFAULT_RTE_CALPRM_GROUP.GmOvrlStMgrHwAgTarLimr_Val" 0 DISPLAY_IDENTIFIER AAACalRegn02Rt01GroupC_Dummy_4.CalibrationPorts.GmOvrlStMgrHwAgTarLimr.Val /end CHARACTERISTIC
/begin CHARACTERISTIC AAACalRegn02Rt01GroupC_Dummy_4.GmOvrlStMgrShiftLvrTiThd.Val "MICROSAR RTE" VALUE 0x0 RTE_RL_ULONG 0 NO_COMPU_METHOD 0 4294967295 SYMBOL_LINK "Rte_CalprmRom_CalRegn02Rt04GroupC_DEFAULT_RTE_CALPRM_GROUP.GmOvrlStMgrShiftLvrTiThd_Val" 0 DISPLAY_IDENTIFIER AAACalRegn02Rt01GroupC_Dummy_4.CalibrationPorts.GmOvrlStMgrShiftLvrTiThd.Val /end CHARACTERISTIC
/begin CHARACTERISTIC AAACalRegn02Rt01GroupC_Dummy_4.GmOvrlStMgrStandStillThd.Val "MICROSAR RTE" VALUE 0x0 RTE_RL_FLOAT32_IEEE 0 NO_COMPU_METHOD -3.402823466e+38 3.402823466e+38 SYMBOL_LINK "Rte_CalprmRom_CalRegn02Rt04GroupC_DEFAULT_RTE_CALPRM_GROUP.GmOvrlStMgrStandStillThd_Val" 0 DISPLAY_IDENTIFIER AAACalRegn02Rt01GroupC_Dummy_4.CalibrationPorts.GmOvrlStMgrStandStillThd.Val /end CHARACTERISTIC
/begin CHARACTERISTIC AAACalRegn02Rt01GroupC_Dummy_4.GmOvrlStMgrStandStillTiThd.Val "MICROSAR RTE" VALUE 0x0 RTE_RL_ULONG 0 NO_COMPU_METHOD 0 4294967295 SYMBOL_LINK "Rte_CalprmRom_CalRegn02Rt04GroupC_DEFAULT_RTE_CALPRM_GROUP.GmOvrlStMgrStandStillTiThd_Val" 0 DISPLAY_IDENTIFIER AAACalRegn02Rt01GroupC_Dummy_4.CalibrationPorts.GmOvrlStMgrStandStillTiThd.Val /end CHARACTERISTIC
/begin CHARACTERISTIC AAACalRegn02Rt01GroupC_Dummy_4.GmTqArbnApaDiRateY.Ary1D "MICROSAR RTE" VAL_BLK 0x0 RTE_RL_UWORD 0 NO_COMPU_METHOD 0 65535 MATRIX_DIM 6 1 1 SYMBOL_LINK "Rte_CalprmRom_CalRegn02Rt04GroupC_DEFAULT_RTE_CALPRM_GROUP.GmTqArbnApaDiRateY_Ary1D" 0 DISPLAY_IDENTIFIER AAACalRegn02Rt01GroupC_Dummy_4.CalibrationPorts.GmTqArbnApaDiRateY.Ary1D /end CHARACTERISTIC
/begin CHARACTERISTIC AAACalRegn02Rt01GroupC_Dummy_4.GmTqArbnApaEnaRate.Val "MICROSAR RTE" VALUE 0x0 RTE_RL_FLOAT32_IEEE 0 NO_COMPU_METHOD -3.402823466e+38 3.402823466e+38 SYMBOL_LINK "Rte_CalprmRom_CalRegn02Rt04GroupC_DEFAULT_RTE_CALPRM_GROUP.GmTqArbnApaEnaRate_Val" 0 DISPLAY_IDENTIFIER AAACalRegn02Rt01GroupC_Dummy_4.CalibrationPorts.GmTqArbnApaEnaRate.Val /end CHARACTERISTIC
/begin CHARACTERISTIC AAACalRegn02Rt01GroupC_Dummy_4.GmTqArbnApaSmotngHwTqLpFilFrq.Val "MICROSAR RTE" VALUE 0x0 RTE_RL_FLOAT32_IEEE 0 NO_COMPU_METHOD -3.402823466e+38 3.402823466e+38 SYMBOL_LINK "Rte_CalprmRom_CalRegn02Rt04GroupC_DEFAULT_RTE_CALPRM_GROUP.GmTqArbnApaSmotngHwTqLpFilFrq_Val" 0 DISPLAY_IDENTIFIER AAACalRegn02Rt01GroupC_Dummy_4.CalibrationPorts.GmTqArbnApaSmotngHwTqLpFilFrq.Val /end CHARACTERISTIC
/begin CHARACTERISTIC AAACalRegn02Rt01GroupC_Dummy_4.GmTqArbnApaSmotngX.Ary1D "MICROSAR RTE" VAL_BLK 0x0 RTE_RL_UWORD 0 NO_COMPU_METHOD 0 65535 MATRIX_DIM 10 1 1 SYMBOL_LINK "Rte_CalprmRom_CalRegn02Rt04GroupC_DEFAULT_RTE_CALPRM_GROUP.GmTqArbnApaSmotngX_Ary1D" 0 DISPLAY_IDENTIFIER AAACalRegn02Rt01GroupC_Dummy_4.CalibrationPorts.GmTqArbnApaSmotngX.Ary1D /end CHARACTERISTIC
/begin CHARACTERISTIC AAACalRegn02Rt01GroupC_Dummy_4.GmTqArbnApaSmotngY.Ary1D "MICROSAR RTE" VAL_BLK 0x0 RTE_RL_UWORD 0 NO_COMPU_METHOD 0 65535 MATRIX_DIM 10 1 1 SYMBOL_LINK "Rte_CalprmRom_CalRegn02Rt04GroupC_DEFAULT_RTE_CALPRM_GROUP.GmTqArbnApaSmotngY_Ary1D" 0 DISPLAY_IDENTIFIER AAACalRegn02Rt01GroupC_Dummy_4.CalibrationPorts.GmTqArbnApaSmotngY.Ary1D /end CHARACTERISTIC
/begin CHARACTERISTIC AAACalRegn02Rt01GroupC_Dummy_4.GmTqArbnLkaOutpOvrlX.Ary2D "MICROSAR RTE" VAL_BLK 0x0 RTE_RL_UWORD 0 NO_COMPU_METHOD 0 65535 MATRIX_DIM 20 12 1 SYMBOL_LINK "Rte_CalprmRom_CalRegn02Rt04GroupC_DEFAULT_RTE_CALPRM_GROUP.GmTqArbnLkaOutpOvrlX_Ary2D" 0 DISPLAY_IDENTIFIER AAACalRegn02Rt01GroupC_Dummy_4.CalibrationPorts.GmTqArbnLkaOutpOvrlX.Ary2D /end CHARACTERISTIC
/begin CHARACTERISTIC AAACalRegn02Rt01GroupC_Dummy_4.GmTqArbnLkaOutpOvrlY.Ary2D "MICROSAR RTE" VAL_BLK 0x0 RTE_RL_UWORD 0 NO_COMPU_METHOD 0 65535 MATRIX_DIM 20 12 1 SYMBOL_LINK "Rte_CalprmRom_CalRegn02Rt04GroupC_DEFAULT_RTE_CALPRM_GROUP.GmTqArbnLkaOutpOvrlY_Ary2D" 0 DISPLAY_IDENTIFIER AAACalRegn02Rt01GroupC_Dummy_4.CalibrationPorts.GmTqArbnLkaOutpOvrlY.Ary2D /end CHARACTERISTIC
/begin CHARACTERISTIC AAACalRegn02Rt01GroupC_Dummy_4.GmTqArbnLkaSlewX.Ary1D "MICROSAR RTE" VAL_BLK 0x0 RTE_RL_UWORD 0 NO_COMPU_METHOD 0 65535 MATRIX_DIM 6 1 1 SYMBOL_LINK "Rte_CalprmRom_CalRegn02Rt04GroupC_DEFAULT_RTE_CALPRM_GROUP.GmTqArbnLkaSlewX_Ary1D" 0 DISPLAY_IDENTIFIER AAACalRegn02Rt01GroupC_Dummy_4.CalibrationPorts.GmTqArbnLkaSlewX.Ary1D /end CHARACTERISTIC
/begin CHARACTERISTIC AAACalRegn02Rt01GroupC_Dummy_4.GmTqArbnLkaSlewY.Ary1D "MICROSAR RTE" VAL_BLK 0x0 RTE_RL_UWORD 0 NO_COMPU_METHOD 0 65535 MATRIX_DIM 6 1 1 SYMBOL_LINK "Rte_CalprmRom_CalRegn02Rt04GroupC_DEFAULT_RTE_CALPRM_GROUP.GmTqArbnLkaSlewY_Ary1D" 0 DISPLAY_IDENTIFIER AAACalRegn02Rt01GroupC_Dummy_4.CalibrationPorts.GmTqArbnLkaSlewY.Ary1D /end CHARACTERISTIC
/begin CHARACTERISTIC AAACalRegn03Rt01GroupA_Dummy.AssiHiFrqGainY.Ary2D "MICROSAR RTE" VAL_BLK 0x0 RTE_RL_UWORD 0 NO_COMPU_METHOD 0 65535 MATRIX_DIM 13 12 1 SYMBOL_LINK "Rte_CalprmRom_CalRegn03Rt01GroupA_DEFAULT_RTE_CALPRM_GROUP.AssiHiFrqGainY_Ary2D" 0 DISPLAY_IDENTIFIER AAACalRegn03Rt01GroupA_Dummy.CalibrationPorts.AssiHiFrqGainY.Ary2D /end CHARACTERISTIC
/begin CHARACTERISTIC AAACalRegn03Rt01GroupA_Dummy.AssiHiFrqTqX.Ary2D "MICROSAR RTE" VAL_BLK 0x0 RTE_RL_UWORD 0 NO_COMPU_METHOD 0 65535 MATRIX_DIM 13 12 1 SYMBOL_LINK "Rte_CalprmRom_CalRegn03Rt01GroupA_DEFAULT_RTE_CALPRM_GROUP.AssiHiFrqTqX_Ary2D" 0 DISPLAY_IDENTIFIER AAACalRegn03Rt01GroupA_Dummy.CalibrationPorts.AssiHiFrqTqX.Ary2D /end CHARACTERISTIC
/begin CHARACTERISTIC AAACalRegn03Rt01GroupA_Dummy.AssiMotTqWhlImbRejctnMinX.Ary2D "MICROSAR RTE" VAL_BLK 0x0 RTE_RL_UWORD 0 NO_COMPU_METHOD 0 65535 MATRIX_DIM 20 12 1 SYMBOL_LINK "Rte_CalprmRom_CalRegn03Rt01GroupA_DEFAULT_RTE_CALPRM_GROUP.AssiMotTqWhlImbRejctnMinX_Ary2D" 0 DISPLAY_IDENTIFIER AAACalRegn03Rt01GroupA_Dummy.CalibrationPorts.AssiMotTqWhlImbRejctnMinX.Ary2D /end CHARACTERISTIC
/begin CHARACTERISTIC AAACalRegn03Rt01GroupA_Dummy.AssiMotTqWhlImbRejctnMinY.Ary2D "MICROSAR RTE" VAL_BLK 0x0 RTE_RL_SWORD 0 NO_COMPU_METHOD -32768 32767 MATRIX_DIM 20 12 1 SYMBOL_LINK "Rte_CalprmRom_CalRegn03Rt01GroupA_DEFAULT_RTE_CALPRM_GROUP.AssiMotTqWhlImbRejctnMinY_Ary2D" 0 DISPLAY_IDENTIFIER AAACalRegn03Rt01GroupA_Dummy.CalibrationPorts.AssiMotTqWhlImbRejctnMinY.Ary2D /end CHARACTERISTIC
/begin CHARACTERISTIC AAACalRegn03Rt01GroupA_Dummy.DampgHydCoeff1ScaY.Ary1D "MICROSAR RTE" VAL_BLK 0x0 RTE_RL_UWORD 0 NO_COMPU_METHOD 0 65535 MATRIX_DIM 12 1 1 SYMBOL_LINK "Rte_CalprmRom_CalRegn03Rt01GroupA_DEFAULT_RTE_CALPRM_GROUP.DampgHydCoeff1ScaY_Ary1D" 0 DISPLAY_IDENTIFIER AAACalRegn03Rt01GroupA_Dummy.CalibrationPorts.DampgHydCoeff1ScaY.Ary1D /end CHARACTERISTIC
/begin CHARACTERISTIC AAACalRegn03Rt01GroupA_Dummy.DampgHydCoeff2ScaY.Ary1D "MICROSAR RTE" VAL_BLK 0x0 RTE_RL_UWORD 0 NO_COMPU_METHOD 0 65535 MATRIX_DIM 12 1 1 SYMBOL_LINK "Rte_CalprmRom_CalRegn03Rt01GroupA_DEFAULT_RTE_CALPRM_GROUP.DampgHydCoeff2ScaY_Ary1D" 0 DISPLAY_IDENTIFIER AAACalRegn03Rt01GroupA_Dummy.CalibrationPorts.DampgHydCoeff2ScaY.Ary1D /end CHARACTERISTIC
/begin CHARACTERISTIC AAACalRegn03Rt01GroupA_Dummy.DampgHydCoeff3ScaY.Ary1D "MICROSAR RTE" VAL_BLK 0x0 RTE_RL_UWORD 0 NO_COMPU_METHOD 0 65535 MATRIX_DIM 12 1 1 SYMBOL_LINK "Rte_CalprmRom_CalRegn03Rt01GroupA_DEFAULT_RTE_CALPRM_GROUP.DampgHydCoeff3ScaY_Ary1D" 0 DISPLAY_IDENTIFIER AAACalRegn03Rt01GroupA_Dummy.CalibrationPorts.DampgHydCoeff3ScaY.Ary1D /end CHARACTERISTIC
/begin CHARACTERISTIC AAACalRegn03Rt01GroupA_Dummy.DampgHydCoeff4ScaY.Ary1D "MICROSAR RTE" VAL_BLK 0x0 RTE_RL_UWORD 0 NO_COMPU_METHOD 0 65535 MATRIX_DIM 12 1 1 SYMBOL_LINK "Rte_CalprmRom_CalRegn03Rt01GroupA_DEFAULT_RTE_CALPRM_GROUP.DampgHydCoeff4ScaY_Ary1D" 0 DISPLAY_IDENTIFIER AAACalRegn03Rt01GroupA_Dummy.CalibrationPorts.DampgHydCoeff4ScaY.Ary1D /end CHARACTERISTIC
/begin CHARACTERISTIC AAACalRegn03Rt01GroupA_Dummy.DampgMotVelX.Ary2D "MICROSAR RTE" VAL_BLK 0x0 RTE_RL_UWORD 0 NO_COMPU_METHOD 0 65535 MATRIX_DIM 13 12 1 SYMBOL_LINK "Rte_CalprmRom_CalRegn03Rt01GroupA_DEFAULT_RTE_CALPRM_GROUP.DampgMotVelX_Ary2D" 0 DISPLAY_IDENTIFIER AAACalRegn03Rt01GroupA_Dummy.CalibrationPorts.DampgMotVelX.Ary2D /end CHARACTERISTIC
/begin CHARACTERISTIC AAACalRegn03Rt01GroupA_Dummy.DampgMotVelY.Ary2D "MICROSAR RTE" VAL_BLK 0x0 RTE_RL_UWORD 0 NO_COMPU_METHOD 0 65535 MATRIX_DIM 13 12 1 SYMBOL_LINK "Rte_CalprmRom_CalRegn03Rt01GroupA_DEFAULT_RTE_CALPRM_GROUP.DampgMotVelY_Ary2D" 0 DISPLAY_IDENTIFIER AAACalRegn03Rt01GroupA_Dummy.CalibrationPorts.DampgMotVelY.Ary2D /end CHARACTERISTIC
/begin CHARACTERISTIC AAACalRegn03Rt01GroupA_Dummy.HysCmpFricWhlImbRejctnBlndX.Ary1D "MICROSAR RTE" VAL_BLK 0x0 RTE_RL_UWORD 0 NO_COMPU_METHOD 0 65535 MATRIX_DIM 6 1 1 SYMBOL_LINK "Rte_CalprmRom_CalRegn03Rt01GroupA_DEFAULT_RTE_CALPRM_GROUP.HysCmpFricWhlImbRejctnBlndX_Ary1D" 0 DISPLAY_IDENTIFIER AAACalRegn03Rt01GroupA_Dummy.CalibrationPorts.HysCmpFricWhlImbRejctnBlndX.Ary1D /end CHARACTERISTIC
/begin CHARACTERISTIC AAACalRegn03Rt01GroupA_Dummy.HysCmpFricWhlImbRejctnBlndY.Ary1D "MICROSAR RTE" VAL_BLK 0x0 RTE_RL_UWORD 0 NO_COMPU_METHOD 0 65535 MATRIX_DIM 6 1 1 SYMBOL_LINK "Rte_CalprmRom_CalRegn03Rt01GroupA_DEFAULT_RTE_CALPRM_GROUP.HysCmpFricWhlImbRejctnBlndY_Ary1D" 0 DISPLAY_IDENTIFIER AAACalRegn03Rt01GroupA_Dummy.CalibrationPorts.HysCmpFricWhlImbRejctnBlndY.Ary1D /end CHARACTERISTIC
/begin CHARACTERISTIC AAACalRegn03Rt01GroupA_Dummy.HysCmpFricWhlImbRejctnOffY.Ary1D "MICROSAR RTE" VAL_BLK 0x0 RTE_RL_UWORD 0 NO_COMPU_METHOD 0 65535 MATRIX_DIM 12 1 1 SYMBOL_LINK "Rte_CalprmRom_CalRegn03Rt01GroupA_DEFAULT_RTE_CALPRM_GROUP.HysCmpFricWhlImbRejctnOffY_Ary1D" 0 DISPLAY_IDENTIFIER AAACalRegn03Rt01GroupA_Dummy.CalibrationPorts.HysCmpFricWhlImbRejctnOffY.Ary1D /end CHARACTERISTIC
/begin CHARACTERISTIC AAACalRegn03Rt01GroupA_Dummy.HysCmpFricWhlImbRejctnOnY.Ary1D "MICROSAR RTE" VAL_BLK 0x0 RTE_RL_UWORD 0 NO_COMPU_METHOD 0 65535 MATRIX_DIM 12 1 1 SYMBOL_LINK "Rte_CalprmRom_CalRegn03Rt01GroupA_DEFAULT_RTE_CALPRM_GROUP.HysCmpFricWhlImbRejctnOnY_Ary1D" 0 DISPLAY_IDENTIFIER AAACalRegn03Rt01GroupA_Dummy.CalibrationPorts.HysCmpFricWhlImbRejctnOnY.Ary1D /end CHARACTERISTIC
/begin CHARACTERISTIC AAACalRegn03Rt01GroupA_Dummy.InertiaCmpVelAssiBasdDampgCoeffX.Ary1D "MICROSAR RTE" VAL_BLK 0x0 RTE_RL_UWORD 0 NO_COMPU_METHOD 0 65535 MATRIX_DIM 10 1 1 SYMBOL_LINK "Rte_CalprmRom_CalRegn03Rt01GroupA_DEFAULT_RTE_CALPRM_GROUP.InertiaCmpVelAssiBasdDampgCoeffX_Ary1D" 0 DISPLAY_IDENTIFIER AAACalRegn03Rt01GroupA_Dummy.CalibrationPorts.InertiaCmpVelAssiBasdDampgCoeffX.Ary1D /end CHARACTERISTIC
/begin CHARACTERISTIC AAACalRegn03Rt01GroupA_Dummy.InertiaCmpVelAssiBasdDampgRollgY.Ary1D "MICROSAR RTE" VAL_BLK 0x0 RTE_RL_UWORD 0 NO_COMPU_METHOD 0 65535 MATRIX_DIM 10 1 1 SYMBOL_LINK "Rte_CalprmRom_CalRegn03Rt01GroupA_DEFAULT_RTE_CALPRM_GROUP.InertiaCmpVelAssiBasdDampgRollgY_Ary1D" 0 DISPLAY_IDENTIFIER AAACalRegn03Rt01GroupA_Dummy.CalibrationPorts.InertiaCmpVelAssiBasdDampgRollgY.Ary1D /end CHARACTERISTIC
/begin CHARACTERISTIC AAACalRegn03Rt01GroupA_Dummy.InertiaCmpVelAssiBasdDampgStatY.Ary1D "MICROSAR RTE" VAL_BLK 0x0 RTE_RL_UWORD 0 NO_COMPU_METHOD 0 65535 MATRIX_DIM 10 1 1 SYMBOL_LINK "Rte_CalprmRom_CalRegn03Rt01GroupA_DEFAULT_RTE_CALPRM_GROUP.InertiaCmpVelAssiBasdDampgStatY_Ary1D" 0 DISPLAY_IDENTIFIER AAACalRegn03Rt01GroupA_Dummy.CalibrationPorts.InertiaCmpVelAssiBasdDampgStatY.Ary1D /end CHARACTERISTIC
/begin CHARACTERISTIC AAACalRegn03Rt01GroupA_Dummy.InertiaCmpVelDampgSpdBlndY.Ary1D "MICROSAR RTE" VAL_BLK 0x0 RTE_RL_UWORD 0 NO_COMPU_METHOD 0 65535 MATRIX_DIM 12 1 1 SYMBOL_LINK "Rte_CalprmRom_CalRegn03Rt01GroupA_DEFAULT_RTE_CALPRM_GROUP.InertiaCmpVelDampgSpdBlndY_Ary1D" 0 DISPLAY_IDENTIFIER AAACalRegn03Rt01GroupA_Dummy.CalibrationPorts.InertiaCmpVelDampgSpdBlndY.Ary1D /end CHARACTERISTIC
/begin CHARACTERISTIC AAACalRegn03Rt01GroupA_Dummy.InertiaCmpVelNotchBlndY.Ary1D "MICROSAR RTE" VAL_BLK 0x0 RTE_RL_UWORD 0 NO_COMPU_METHOD 0 65535 MATRIX_DIM 12 1 1 SYMBOL_LINK "Rte_CalprmRom_CalRegn03Rt01GroupA_DEFAULT_RTE_CALPRM_GROUP.InertiaCmpVelNotchBlndY_Ary1D" 0 DISPLAY_IDENTIFIER AAACalRegn03Rt01GroupA_Dummy.CalibrationPorts.InertiaCmpVelNotchBlndY.Ary1D /end CHARACTERISTIC
/begin CHARACTERISTIC AAACalRegn03Rt01GroupA_Dummy.RtnHwAgOffsCalcdX.Ary2D "MICROSAR RTE" VAL_BLK 0x0 RTE_RL_UWORD 0 NO_COMPU_METHOD 0 65535 MATRIX_DIM 16 9 1 SYMBOL_LINK "Rte_CalprmRom_CalRegn03Rt01GroupA_DEFAULT_RTE_CALPRM_GROUP.RtnHwAgOffsCalcdX_Ary2D" 0 DISPLAY_IDENTIFIER AAACalRegn03Rt01GroupA_Dummy.CalibrationPorts.RtnHwAgOffsCalcdX.Ary2D /end CHARACTERISTIC
/begin CHARACTERISTIC AAACalRegn03Rt01GroupA_Dummy.RtnHwAgOffsCalcdY.Ary2D "MICROSAR RTE" VAL_BLK 0x0 RTE_RL_UWORD 0 NO_COMPU_METHOD 0 65535 MATRIX_DIM 16 9 1 SYMBOL_LINK "Rte_CalprmRom_CalRegn03Rt01GroupA_DEFAULT_RTE_CALPRM_GROUP.RtnHwAgOffsCalcdY_Ary2D" 0 DISPLAY_IDENTIFIER AAACalRegn03Rt01GroupA_Dummy.CalibrationPorts.RtnHwAgOffsCalcdY.Ary2D /end CHARACTERISTIC
/begin CHARACTERISTIC AAACalRegn03Rt01GroupA_Dummy.RtnScaTqX.Ary2D "MICROSAR RTE" VAL_BLK 0x0 RTE_RL_UWORD 0 NO_COMPU_METHOD 0 65535 MATRIX_DIM 8 9 1 SYMBOL_LINK "Rte_CalprmRom_CalRegn03Rt01GroupA_DEFAULT_RTE_CALPRM_GROUP.RtnScaTqX_Ary2D" 0 DISPLAY_IDENTIFIER AAACalRegn03Rt01GroupA_Dummy.CalibrationPorts.RtnScaTqX.Ary2D /end CHARACTERISTIC
/begin CHARACTERISTIC AAACalRegn03Rt01GroupA_Dummy.RtnScaTqY.Ary2D "MICROSAR RTE" VAL_BLK 0x0 RTE_RL_UWORD 0 NO_COMPU_METHOD 0 65535 MATRIX_DIM 8 9 1 SYMBOL_LINK "Rte_CalprmRom_CalRegn03Rt01GroupA_DEFAULT_RTE_CALPRM_GROUP.RtnScaTqY_Ary2D" 0 DISPLAY_IDENTIFIER AAACalRegn03Rt01GroupA_Dummy.CalibrationPorts.RtnScaTqY.Ary2D /end CHARACTERISTIC
/begin CHARACTERISTIC AAACalRegn03Rt01GroupA_Dummy.RtnScaVelX.Ary2D "MICROSAR RTE" VAL_BLK 0x0 RTE_RL_UWORD 0 NO_COMPU_METHOD 0 65535 MATRIX_DIM 4 9 1 SYMBOL_LINK "Rte_CalprmRom_CalRegn03Rt01GroupA_DEFAULT_RTE_CALPRM_GROUP.RtnScaVelX_Ary2D" 0 DISPLAY_IDENTIFIER AAACalRegn03Rt01GroupA_Dummy.CalibrationPorts.RtnScaVelX.Ary2D /end CHARACTERISTIC
/begin CHARACTERISTIC AAACalRegn03Rt01GroupA_Dummy.RtnScaVelY.Ary2D "MICROSAR RTE" VAL_BLK 0x0 RTE_RL_UWORD 0 NO_COMPU_METHOD 0 65535 MATRIX_DIM 4 9 1 SYMBOL_LINK "Rte_CalprmRom_CalRegn03Rt01GroupA_DEFAULT_RTE_CALPRM_GROUP.RtnScaVelY_Ary2D" 0 DISPLAY_IDENTIFIER AAACalRegn03Rt01GroupA_Dummy.CalibrationPorts.RtnScaVelY.Ary2D /end CHARACTERISTIC
/begin CHARACTERISTIC AAACalRegn03Rt01GroupA_Dummy_1.AssiHiFrqGainY.Ary2D "MICROSAR RTE" VAL_BLK 0x0 RTE_RL_UWORD 0 NO_COMPU_METHOD 0 65535 MATRIX_DIM 13 12 1 SYMBOL_LINK "Rte_CalprmRom_CalRegn03Rt02GroupA_DEFAULT_RTE_CALPRM_GROUP.AssiHiFrqGainY_Ary2D" 0 DISPLAY_IDENTIFIER AAACalRegn03Rt01GroupA_Dummy_1.CalibrationPorts.AssiHiFrqGainY.Ary2D /end CHARACTERISTIC
/begin CHARACTERISTIC AAACalRegn03Rt01GroupA_Dummy_1.AssiHiFrqTqX.Ary2D "MICROSAR RTE" VAL_BLK 0x0 RTE_RL_UWORD 0 NO_COMPU_METHOD 0 65535 MATRIX_DIM 13 12 1 SYMBOL_LINK "Rte_CalprmRom_CalRegn03Rt02GroupA_DEFAULT_RTE_CALPRM_GROUP.AssiHiFrqTqX_Ary2D" 0 DISPLAY_IDENTIFIER AAACalRegn03Rt01GroupA_Dummy_1.CalibrationPorts.AssiHiFrqTqX.Ary2D /end CHARACTERISTIC
/begin CHARACTERISTIC AAACalRegn03Rt01GroupA_Dummy_1.AssiMotTqWhlImbRejctnMinX.Ary2D "MICROSAR RTE" VAL_BLK 0x0 RTE_RL_UWORD 0 NO_COMPU_METHOD 0 65535 MATRIX_DIM 20 12 1 SYMBOL_LINK "Rte_CalprmRom_CalRegn03Rt02GroupA_DEFAULT_RTE_CALPRM_GROUP.AssiMotTqWhlImbRejctnMinX_Ary2D" 0 DISPLAY_IDENTIFIER AAACalRegn03Rt01GroupA_Dummy_1.CalibrationPorts.AssiMotTqWhlImbRejctnMinX.Ary2D /end CHARACTERISTIC
/begin CHARACTERISTIC AAACalRegn03Rt01GroupA_Dummy_1.AssiMotTqWhlImbRejctnMinY.Ary2D "MICROSAR RTE" VAL_BLK 0x0 RTE_RL_SWORD 0 NO_COMPU_METHOD -32768 32767 MATRIX_DIM 20 12 1 SYMBOL_LINK "Rte_CalprmRom_CalRegn03Rt02GroupA_DEFAULT_RTE_CALPRM_GROUP.AssiMotTqWhlImbRejctnMinY_Ary2D" 0 DISPLAY_IDENTIFIER AAACalRegn03Rt01GroupA_Dummy_1.CalibrationPorts.AssiMotTqWhlImbRejctnMinY.Ary2D /end CHARACTERISTIC
/begin CHARACTERISTIC AAACalRegn03Rt01GroupA_Dummy_1.DampgHydCoeff1ScaY.Ary1D "MICROSAR RTE" VAL_BLK 0x0 RTE_RL_UWORD 0 NO_COMPU_METHOD 0 65535 MATRIX_DIM 12 1 1 SYMBOL_LINK "Rte_CalprmRom_CalRegn03Rt02GroupA_DEFAULT_RTE_CALPRM_GROUP.DampgHydCoeff1ScaY_Ary1D" 0 DISPLAY_IDENTIFIER AAACalRegn03Rt01GroupA_Dummy_1.CalibrationPorts.DampgHydCoeff1ScaY.Ary1D /end CHARACTERISTIC
/begin CHARACTERISTIC AAACalRegn03Rt01GroupA_Dummy_1.DampgHydCoeff2ScaY.Ary1D "MICROSAR RTE" VAL_BLK 0x0 RTE_RL_UWORD 0 NO_COMPU_METHOD 0 65535 MATRIX_DIM 12 1 1 SYMBOL_LINK "Rte_CalprmRom_CalRegn03Rt02GroupA_DEFAULT_RTE_CALPRM_GROUP.DampgHydCoeff2ScaY_Ary1D" 0 DISPLAY_IDENTIFIER AAACalRegn03Rt01GroupA_Dummy_1.CalibrationPorts.DampgHydCoeff2ScaY.Ary1D /end CHARACTERISTIC
/begin CHARACTERISTIC AAACalRegn03Rt01GroupA_Dummy_1.DampgHydCoeff3ScaY.Ary1D "MICROSAR RTE" VAL_BLK 0x0 RTE_RL_UWORD 0 NO_COMPU_METHOD 0 65535 MATRIX_DIM 12 1 1 SYMBOL_LINK "Rte_CalprmRom_CalRegn03Rt02GroupA_DEFAULT_RTE_CALPRM_GROUP.DampgHydCoeff3ScaY_Ary1D" 0 DISPLAY_IDENTIFIER AAACalRegn03Rt01GroupA_Dummy_1.CalibrationPorts.DampgHydCoeff3ScaY.Ary1D /end CHARACTERISTIC
/begin CHARACTERISTIC AAACalRegn03Rt01GroupA_Dummy_1.DampgHydCoeff4ScaY.Ary1D "MICROSAR RTE" VAL_BLK 0x0 RTE_RL_UWORD 0 NO_COMPU_METHOD 0 65535 MATRIX_DIM 12 1 1 SYMBOL_LINK "Rte_CalprmRom_CalRegn03Rt02GroupA_DEFAULT_RTE_CALPRM_GROUP.DampgHydCoeff4ScaY_Ary1D" 0 DISPLAY_IDENTIFIER AAACalRegn03Rt01GroupA_Dummy_1.CalibrationPorts.DampgHydCoeff4ScaY.Ary1D /end CHARACTERISTIC
/begin CHARACTERISTIC AAACalRegn03Rt01GroupA_Dummy_1.DampgMotVelX.Ary2D "MICROSAR RTE" VAL_BLK 0x0 RTE_RL_UWORD 0 NO_COMPU_METHOD 0 65535 MATRIX_DIM 13 12 1 SYMBOL_LINK "Rte_CalprmRom_CalRegn03Rt02GroupA_DEFAULT_RTE_CALPRM_GROUP.DampgMotVelX_Ary2D" 0 DISPLAY_IDENTIFIER AAACalRegn03Rt01GroupA_Dummy_1.CalibrationPorts.DampgMotVelX.Ary2D /end CHARACTERISTIC
/begin CHARACTERISTIC AAACalRegn03Rt01GroupA_Dummy_1.DampgMotVelY.Ary2D "MICROSAR RTE" VAL_BLK 0x0 RTE_RL_UWORD 0 NO_COMPU_METHOD 0 65535 MATRIX_DIM 13 12 1 SYMBOL_LINK "Rte_CalprmRom_CalRegn03Rt02GroupA_DEFAULT_RTE_CALPRM_GROUP.DampgMotVelY_Ary2D" 0 DISPLAY_IDENTIFIER AAACalRegn03Rt01GroupA_Dummy_1.CalibrationPorts.DampgMotVelY.Ary2D /end CHARACTERISTIC
/begin CHARACTERISTIC AAACalRegn03Rt01GroupA_Dummy_1.HysCmpFricWhlImbRejctnBlndX.Ary1D "MICROSAR RTE" VAL_BLK 0x0 RTE_RL_UWORD 0 NO_COMPU_METHOD 0 65535 MATRIX_DIM 6 1 1 SYMBOL_LINK "Rte_CalprmRom_CalRegn03Rt02GroupA_DEFAULT_RTE_CALPRM_GROUP.HysCmpFricWhlImbRejctnBlndX_Ary1D" 0 DISPLAY_IDENTIFIER AAACalRegn03Rt01GroupA_Dummy_1.CalibrationPorts.HysCmpFricWhlImbRejctnBlndX.Ary1D /end CHARACTERISTIC
/begin CHARACTERISTIC AAACalRegn03Rt01GroupA_Dummy_1.HysCmpFricWhlImbRejctnBlndY.Ary1D "MICROSAR RTE" VAL_BLK 0x0 RTE_RL_UWORD 0 NO_COMPU_METHOD 0 65535 MATRIX_DIM 6 1 1 SYMBOL_LINK "Rte_CalprmRom_CalRegn03Rt02GroupA_DEFAULT_RTE_CALPRM_GROUP.HysCmpFricWhlImbRejctnBlndY_Ary1D" 0 DISPLAY_IDENTIFIER AAACalRegn03Rt01GroupA_Dummy_1.CalibrationPorts.HysCmpFricWhlImbRejctnBlndY.Ary1D /end CHARACTERISTIC
/begin CHARACTERISTIC AAACalRegn03Rt01GroupA_Dummy_1.HysCmpFricWhlImbRejctnOffY.Ary1D "MICROSAR RTE" VAL_BLK 0x0 RTE_RL_UWORD 0 NO_COMPU_METHOD 0 65535 MATRIX_DIM 12 1 1 SYMBOL_LINK "Rte_CalprmRom_CalRegn03Rt02GroupA_DEFAULT_RTE_CALPRM_GROUP.HysCmpFricWhlImbRejctnOffY_Ary1D" 0 DISPLAY_IDENTIFIER AAACalRegn03Rt01GroupA_Dummy_1.CalibrationPorts.HysCmpFricWhlImbRejctnOffY.Ary1D /end CHARACTERISTIC
/begin CHARACTERISTIC AAACalRegn03Rt01GroupA_Dummy_1.HysCmpFricWhlImbRejctnOnY.Ary1D "MICROSAR RTE" VAL_BLK 0x0 RTE_RL_UWORD 0 NO_COMPU_METHOD 0 65535 MATRIX_DIM 12 1 1 SYMBOL_LINK "Rte_CalprmRom_CalRegn03Rt02GroupA_DEFAULT_RTE_CALPRM_GROUP.HysCmpFricWhlImbRejctnOnY_Ary1D" 0 DISPLAY_IDENTIFIER AAACalRegn03Rt01GroupA_Dummy_1.CalibrationPorts.HysCmpFricWhlImbRejctnOnY.Ary1D /end CHARACTERISTIC
/begin CHARACTERISTIC AAACalRegn03Rt01GroupA_Dummy_1.InertiaCmpVelAssiBasdDampgCoeffX.Ary1D "MICROSAR RTE" VAL_BLK 0x0 RTE_RL_UWORD 0 NO_COMPU_METHOD 0 65535 MATRIX_DIM 10 1 1 SYMBOL_LINK "Rte_CalprmRom_CalRegn03Rt02GroupA_DEFAULT_RTE_CALPRM_GROUP.InertiaCmpVelAssiBasdDampgCoeffX_Ary1D" 0 DISPLAY_IDENTIFIER AAACalRegn03Rt01GroupA_Dummy_1.CalibrationPorts.InertiaCmpVelAssiBasdDampgCoeffX.Ary1D /end CHARACTERISTIC
/begin CHARACTERISTIC AAACalRegn03Rt01GroupA_Dummy_1.InertiaCmpVelAssiBasdDampgRollgY.Ary1D "MICROSAR RTE" VAL_BLK 0x0 RTE_RL_UWORD 0 NO_COMPU_METHOD 0 65535 MATRIX_DIM 10 1 1 SYMBOL_LINK "Rte_CalprmRom_CalRegn03Rt02GroupA_DEFAULT_RTE_CALPRM_GROUP.InertiaCmpVelAssiBasdDampgRollgY_Ary1D" 0 DISPLAY_IDENTIFIER AAACalRegn03Rt01GroupA_Dummy_1.CalibrationPorts.InertiaCmpVelAssiBasdDampgRollgY.Ary1D /end CHARACTERISTIC
/begin CHARACTERISTIC AAACalRegn03Rt01GroupA_Dummy_1.InertiaCmpVelAssiBasdDampgStatY.Ary1D "MICROSAR RTE" VAL_BLK 0x0 RTE_RL_UWORD 0 NO_COMPU_METHOD 0 65535 MATRIX_DIM 10 1 1 SYMBOL_LINK "Rte_CalprmRom_CalRegn03Rt02GroupA_DEFAULT_RTE_CALPRM_GROUP.InertiaCmpVelAssiBasdDampgStatY_Ary1D" 0 DISPLAY_IDENTIFIER AAACalRegn03Rt01GroupA_Dummy_1.CalibrationPorts.InertiaCmpVelAssiBasdDampgStatY.Ary1D /end CHARACTERISTIC
/begin CHARACTERISTIC AAACalRegn03Rt01GroupA_Dummy_1.InertiaCmpVelDampgSpdBlndY.Ary1D "MICROSAR RTE" VAL_BLK 0x0 RTE_RL_UWORD 0 NO_COMPU_METHOD 0 65535 MATRIX_DIM 12 1 1 SYMBOL_LINK "Rte_CalprmRom_CalRegn03Rt02GroupA_DEFAULT_RTE_CALPRM_GROUP.InertiaCmpVelDampgSpdBlndY_Ary1D" 0 DISPLAY_IDENTIFIER AAACalRegn03Rt01GroupA_Dummy_1.CalibrationPorts.InertiaCmpVelDampgSpdBlndY.Ary1D /end CHARACTERISTIC
/begin CHARACTERISTIC AAACalRegn03Rt01GroupA_Dummy_1.InertiaCmpVelNotchBlndY.Ary1D "MICROSAR RTE" VAL_BLK 0x0 RTE_RL_UWORD 0 NO_COMPU_METHOD 0 65535 MATRIX_DIM 12 1 1 SYMBOL_LINK "Rte_CalprmRom_CalRegn03Rt02GroupA_DEFAULT_RTE_CALPRM_GROUP.InertiaCmpVelNotchBlndY_Ary1D" 0 DISPLAY_IDENTIFIER AAACalRegn03Rt01GroupA_Dummy_1.CalibrationPorts.InertiaCmpVelNotchBlndY.Ary1D /end CHARACTERISTIC
/begin CHARACTERISTIC AAACalRegn03Rt01GroupA_Dummy_1.RtnHwAgOffsCalcdX.Ary2D "MICROSAR RTE" VAL_BLK 0x0 RTE_RL_UWORD 0 NO_COMPU_METHOD 0 65535 MATRIX_DIM 16 9 1 SYMBOL_LINK "Rte_CalprmRom_CalRegn03Rt02GroupA_DEFAULT_RTE_CALPRM_GROUP.RtnHwAgOffsCalcdX_Ary2D" 0 DISPLAY_IDENTIFIER AAACalRegn03Rt01GroupA_Dummy_1.CalibrationPorts.RtnHwAgOffsCalcdX.Ary2D /end CHARACTERISTIC
/begin CHARACTERISTIC AAACalRegn03Rt01GroupA_Dummy_1.RtnHwAgOffsCalcdY.Ary2D "MICROSAR RTE" VAL_BLK 0x0 RTE_RL_UWORD 0 NO_COMPU_METHOD 0 65535 MATRIX_DIM 16 9 1 SYMBOL_LINK "Rte_CalprmRom_CalRegn03Rt02GroupA_DEFAULT_RTE_CALPRM_GROUP.RtnHwAgOffsCalcdY_Ary2D" 0 DISPLAY_IDENTIFIER AAACalRegn03Rt01GroupA_Dummy_1.CalibrationPorts.RtnHwAgOffsCalcdY.Ary2D /end CHARACTERISTIC
/begin CHARACTERISTIC AAACalRegn03Rt01GroupA_Dummy_1.RtnScaTqX.Ary2D "MICROSAR RTE" VAL_BLK 0x0 RTE_RL_UWORD 0 NO_COMPU_METHOD 0 65535 MATRIX_DIM 8 9 1 SYMBOL_LINK "Rte_CalprmRom_CalRegn03Rt02GroupA_DEFAULT_RTE_CALPRM_GROUP.RtnScaTqX_Ary2D" 0 DISPLAY_IDENTIFIER AAACalRegn03Rt01GroupA_Dummy_1.CalibrationPorts.RtnScaTqX.Ary2D /end CHARACTERISTIC
/begin CHARACTERISTIC AAACalRegn03Rt01GroupA_Dummy_1.RtnScaTqY.Ary2D "MICROSAR RTE" VAL_BLK 0x0 RTE_RL_UWORD 0 NO_COMPU_METHOD 0 65535 MATRIX_DIM 8 9 1 SYMBOL_LINK "Rte_CalprmRom_CalRegn03Rt02GroupA_DEFAULT_RTE_CALPRM_GROUP.RtnScaTqY_Ary2D" 0 DISPLAY_IDENTIFIER AAACalRegn03Rt01GroupA_Dummy_1.CalibrationPorts.RtnScaTqY.Ary2D /end CHARACTERISTIC
/begin CHARACTERISTIC AAACalRegn03Rt01GroupA_Dummy_1.RtnScaVelX.Ary2D "MICROSAR RTE" VAL_BLK 0x0 RTE_RL_UWORD 0 NO_COMPU_METHOD 0 65535 MATRIX_DIM 4 9 1 SYMBOL_LINK "Rte_CalprmRom_CalRegn03Rt02GroupA_DEFAULT_RTE_CALPRM_GROUP.RtnScaVelX_Ary2D" 0 DISPLAY_IDENTIFIER AAACalRegn03Rt01GroupA_Dummy_1.CalibrationPorts.RtnScaVelX.Ary2D /end CHARACTERISTIC
/begin CHARACTERISTIC AAACalRegn03Rt01GroupA_Dummy_1.RtnScaVelY.Ary2D "MICROSAR RTE" VAL_BLK 0x0 RTE_RL_UWORD 0 NO_COMPU_METHOD 0 65535 MATRIX_DIM 4 9 1 SYMBOL_LINK "Rte_CalprmRom_CalRegn03Rt02GroupA_DEFAULT_RTE_CALPRM_GROUP.RtnScaVelY_Ary2D" 0 DISPLAY_IDENTIFIER AAACalRegn03Rt01GroupA_Dummy_1.CalibrationPorts.RtnScaVelY.Ary2D /end CHARACTERISTIC
/begin CHARACTERISTIC AAACalRegn03Rt01GroupA_Dummy_2.AssiHiFrqGainY.Ary2D "MICROSAR RTE" VAL_BLK 0x0 RTE_RL_UWORD 0 NO_COMPU_METHOD 0 65535 MATRIX_DIM 13 12 1 SYMBOL_LINK "Rte_CalprmRom_CalRegn03Rt03GroupA_DEFAULT_RTE_CALPRM_GROUP.AssiHiFrqGainY_Ary2D" 0 DISPLAY_IDENTIFIER AAACalRegn03Rt01GroupA_Dummy_2.CalibrationPorts.AssiHiFrqGainY.Ary2D /end CHARACTERISTIC
/begin CHARACTERISTIC AAACalRegn03Rt01GroupA_Dummy_2.AssiHiFrqTqX.Ary2D "MICROSAR RTE" VAL_BLK 0x0 RTE_RL_UWORD 0 NO_COMPU_METHOD 0 65535 MATRIX_DIM 13 12 1 SYMBOL_LINK "Rte_CalprmRom_CalRegn03Rt03GroupA_DEFAULT_RTE_CALPRM_GROUP.AssiHiFrqTqX_Ary2D" 0 DISPLAY_IDENTIFIER AAACalRegn03Rt01GroupA_Dummy_2.CalibrationPorts.AssiHiFrqTqX.Ary2D /end CHARACTERISTIC
/begin CHARACTERISTIC AAACalRegn03Rt01GroupA_Dummy_2.AssiMotTqWhlImbRejctnMinX.Ary2D "MICROSAR RTE" VAL_BLK 0x0 RTE_RL_UWORD 0 NO_COMPU_METHOD 0 65535 MATRIX_DIM 20 12 1 SYMBOL_LINK "Rte_CalprmRom_CalRegn03Rt03GroupA_DEFAULT_RTE_CALPRM_GROUP.AssiMotTqWhlImbRejctnMinX_Ary2D" 0 DISPLAY_IDENTIFIER AAACalRegn03Rt01GroupA_Dummy_2.CalibrationPorts.AssiMotTqWhlImbRejctnMinX.Ary2D /end CHARACTERISTIC
/begin CHARACTERISTIC AAACalRegn03Rt01GroupA_Dummy_2.AssiMotTqWhlImbRejctnMinY.Ary2D "MICROSAR RTE" VAL_BLK 0x0 RTE_RL_SWORD 0 NO_COMPU_METHOD -32768 32767 MATRIX_DIM 20 12 1 SYMBOL_LINK "Rte_CalprmRom_CalRegn03Rt03GroupA_DEFAULT_RTE_CALPRM_GROUP.AssiMotTqWhlImbRejctnMinY_Ary2D" 0 DISPLAY_IDENTIFIER AAACalRegn03Rt01GroupA_Dummy_2.CalibrationPorts.AssiMotTqWhlImbRejctnMinY.Ary2D /end CHARACTERISTIC
/begin CHARACTERISTIC AAACalRegn03Rt01GroupA_Dummy_2.DampgHydCoeff1ScaY.Ary1D "MICROSAR RTE" VAL_BLK 0x0 RTE_RL_UWORD 0 NO_COMPU_METHOD 0 65535 MATRIX_DIM 12 1 1 SYMBOL_LINK "Rte_CalprmRom_CalRegn03Rt03GroupA_DEFAULT_RTE_CALPRM_GROUP.DampgHydCoeff1ScaY_Ary1D" 0 DISPLAY_IDENTIFIER AAACalRegn03Rt01GroupA_Dummy_2.CalibrationPorts.DampgHydCoeff1ScaY.Ary1D /end CHARACTERISTIC
/begin CHARACTERISTIC AAACalRegn03Rt01GroupA_Dummy_2.DampgHydCoeff2ScaY.Ary1D "MICROSAR RTE" VAL_BLK 0x0 RTE_RL_UWORD 0 NO_COMPU_METHOD 0 65535 MATRIX_DIM 12 1 1 SYMBOL_LINK "Rte_CalprmRom_CalRegn03Rt03GroupA_DEFAULT_RTE_CALPRM_GROUP.DampgHydCoeff2ScaY_Ary1D" 0 DISPLAY_IDENTIFIER AAACalRegn03Rt01GroupA_Dummy_2.CalibrationPorts.DampgHydCoeff2ScaY.Ary1D /end CHARACTERISTIC
/begin CHARACTERISTIC AAACalRegn03Rt01GroupA_Dummy_2.DampgHydCoeff3ScaY.Ary1D "MICROSAR RTE" VAL_BLK 0x0 RTE_RL_UWORD 0 NO_COMPU_METHOD 0 65535 MATRIX_DIM 12 1 1 SYMBOL_LINK "Rte_CalprmRom_CalRegn03Rt03GroupA_DEFAULT_RTE_CALPRM_GROUP.DampgHydCoeff3ScaY_Ary1D" 0 DISPLAY_IDENTIFIER AAACalRegn03Rt01GroupA_Dummy_2.CalibrationPorts.DampgHydCoeff3ScaY.Ary1D /end CHARACTERISTIC
/begin CHARACTERISTIC AAACalRegn03Rt01GroupA_Dummy_2.DampgHydCoeff4ScaY.Ary1D "MICROSAR RTE" VAL_BLK 0x0 RTE_RL_UWORD 0 NO_COMPU_METHOD 0 65535 MATRIX_DIM 12 1 1 SYMBOL_LINK "Rte_CalprmRom_CalRegn03Rt03GroupA_DEFAULT_RTE_CALPRM_GROUP.DampgHydCoeff4ScaY_Ary1D" 0 DISPLAY_IDENTIFIER AAACalRegn03Rt01GroupA_Dummy_2.CalibrationPorts.DampgHydCoeff4ScaY.Ary1D /end CHARACTERISTIC
/begin CHARACTERISTIC AAACalRegn03Rt01GroupA_Dummy_2.DampgMotVelX.Ary2D "MICROSAR RTE" VAL_BLK 0x0 RTE_RL_UWORD 0 NO_COMPU_METHOD 0 65535 MATRIX_DIM 13 12 1 SYMBOL_LINK "Rte_CalprmRom_CalRegn03Rt03GroupA_DEFAULT_RTE_CALPRM_GROUP.DampgMotVelX_Ary2D" 0 DISPLAY_IDENTIFIER AAACalRegn03Rt01GroupA_Dummy_2.CalibrationPorts.DampgMotVelX.Ary2D /end CHARACTERISTIC
/begin CHARACTERISTIC AAACalRegn03Rt01GroupA_Dummy_2.DampgMotVelY.Ary2D "MICROSAR RTE" VAL_BLK 0x0 RTE_RL_UWORD 0 NO_COMPU_METHOD 0 65535 MATRIX_DIM 13 12 1 SYMBOL_LINK "Rte_CalprmRom_CalRegn03Rt03GroupA_DEFAULT_RTE_CALPRM_GROUP.DampgMotVelY_Ary2D" 0 DISPLAY_IDENTIFIER AAACalRegn03Rt01GroupA_Dummy_2.CalibrationPorts.DampgMotVelY.Ary2D /end CHARACTERISTIC
/begin CHARACTERISTIC AAACalRegn03Rt01GroupA_Dummy_2.HysCmpFricWhlImbRejctnBlndX.Ary1D "MICROSAR RTE" VAL_BLK 0x0 RTE_RL_UWORD 0 NO_COMPU_METHOD 0 65535 MATRIX_DIM 6 1 1 SYMBOL_LINK "Rte_CalprmRom_CalRegn03Rt03GroupA_DEFAULT_RTE_CALPRM_GROUP.HysCmpFricWhlImbRejctnBlndX_Ary1D" 0 DISPLAY_IDENTIFIER AAACalRegn03Rt01GroupA_Dummy_2.CalibrationPorts.HysCmpFricWhlImbRejctnBlndX.Ary1D /end CHARACTERISTIC
/begin CHARACTERISTIC AAACalRegn03Rt01GroupA_Dummy_2.HysCmpFricWhlImbRejctnBlndY.Ary1D "MICROSAR RTE" VAL_BLK 0x0 RTE_RL_UWORD 0 NO_COMPU_METHOD 0 65535 MATRIX_DIM 6 1 1 SYMBOL_LINK "Rte_CalprmRom_CalRegn03Rt03GroupA_DEFAULT_RTE_CALPRM_GROUP.HysCmpFricWhlImbRejctnBlndY_Ary1D" 0 DISPLAY_IDENTIFIER AAACalRegn03Rt01GroupA_Dummy_2.CalibrationPorts.HysCmpFricWhlImbRejctnBlndY.Ary1D /end CHARACTERISTIC
/begin CHARACTERISTIC AAACalRegn03Rt01GroupA_Dummy_2.HysCmpFricWhlImbRejctnOffY.Ary1D "MICROSAR RTE" VAL_BLK 0x0 RTE_RL_UWORD 0 NO_COMPU_METHOD 0 65535 MATRIX_DIM 12 1 1 SYMBOL_LINK "Rte_CalprmRom_CalRegn03Rt03GroupA_DEFAULT_RTE_CALPRM_GROUP.HysCmpFricWhlImbRejctnOffY_Ary1D" 0 DISPLAY_IDENTIFIER AAACalRegn03Rt01GroupA_Dummy_2.CalibrationPorts.HysCmpFricWhlImbRejctnOffY.Ary1D /end CHARACTERISTIC
/begin CHARACTERISTIC AAACalRegn03Rt01GroupA_Dummy_2.HysCmpFricWhlImbRejctnOnY.Ary1D "MICROSAR RTE" VAL_BLK 0x0 RTE_RL_UWORD 0 NO_COMPU_METHOD 0 65535 MATRIX_DIM 12 1 1 SYMBOL_LINK "Rte_CalprmRom_CalRegn03Rt03GroupA_DEFAULT_RTE_CALPRM_GROUP.HysCmpFricWhlImbRejctnOnY_Ary1D" 0 DISPLAY_IDENTIFIER AAACalRegn03Rt01GroupA_Dummy_2.CalibrationPorts.HysCmpFricWhlImbRejctnOnY.Ary1D /end CHARACTERISTIC
/begin CHARACTERISTIC AAACalRegn03Rt01GroupA_Dummy_2.InertiaCmpVelAssiBasdDampgCoeffX.Ary1D "MICROSAR RTE" VAL_BLK 0x0 RTE_RL_UWORD 0 NO_COMPU_METHOD 0 65535 MATRIX_DIM 10 1 1 SYMBOL_LINK "Rte_CalprmRom_CalRegn03Rt03GroupA_DEFAULT_RTE_CALPRM_GROUP.InertiaCmpVelAssiBasdDampgCoeffX_Ary1D" 0 DISPLAY_IDENTIFIER AAACalRegn03Rt01GroupA_Dummy_2.CalibrationPorts.InertiaCmpVelAssiBasdDampgCoeffX.Ary1D /end CHARACTERISTIC
/begin CHARACTERISTIC AAACalRegn03Rt01GroupA_Dummy_2.InertiaCmpVelAssiBasdDampgRollgY.Ary1D "MICROSAR RTE" VAL_BLK 0x0 RTE_RL_UWORD 0 NO_COMPU_METHOD 0 65535 MATRIX_DIM 10 1 1 SYMBOL_LINK "Rte_CalprmRom_CalRegn03Rt03GroupA_DEFAULT_RTE_CALPRM_GROUP.InertiaCmpVelAssiBasdDampgRollgY_Ary1D" 0 DISPLAY_IDENTIFIER AAACalRegn03Rt01GroupA_Dummy_2.CalibrationPorts.InertiaCmpVelAssiBasdDampgRollgY.Ary1D /end CHARACTERISTIC
/begin CHARACTERISTIC AAACalRegn03Rt01GroupA_Dummy_2.InertiaCmpVelAssiBasdDampgStatY.Ary1D "MICROSAR RTE" VAL_BLK 0x0 RTE_RL_UWORD 0 NO_COMPU_METHOD 0 65535 MATRIX_DIM 10 1 1 SYMBOL_LINK "Rte_CalprmRom_CalRegn03Rt03GroupA_DEFAULT_RTE_CALPRM_GROUP.InertiaCmpVelAssiBasdDampgStatY_Ary1D" 0 DISPLAY_IDENTIFIER AAACalRegn03Rt01GroupA_Dummy_2.CalibrationPorts.InertiaCmpVelAssiBasdDampgStatY.Ary1D /end CHARACTERISTIC
/begin CHARACTERISTIC AAACalRegn03Rt01GroupA_Dummy_2.InertiaCmpVelDampgSpdBlndY.Ary1D "MICROSAR RTE" VAL_BLK 0x0 RTE_RL_UWORD 0 NO_COMPU_METHOD 0 65535 MATRIX_DIM 12 1 1 SYMBOL_LINK "Rte_CalprmRom_CalRegn03Rt03GroupA_DEFAULT_RTE_CALPRM_GROUP.InertiaCmpVelDampgSpdBlndY_Ary1D" 0 DISPLAY_IDENTIFIER AAACalRegn03Rt01GroupA_Dummy_2.CalibrationPorts.InertiaCmpVelDampgSpdBlndY.Ary1D /end CHARACTERISTIC
/begin CHARACTERISTIC AAACalRegn03Rt01GroupA_Dummy_2.InertiaCmpVelNotchBlndY.Ary1D "MICROSAR RTE" VAL_BLK 0x0 RTE_RL_UWORD 0 NO_COMPU_METHOD 0 65535 MATRIX_DIM 12 1 1 SYMBOL_LINK "Rte_CalprmRom_CalRegn03Rt03GroupA_DEFAULT_RTE_CALPRM_GROUP.InertiaCmpVelNotchBlndY_Ary1D" 0 DISPLAY_IDENTIFIER AAACalRegn03Rt01GroupA_Dummy_2.CalibrationPorts.InertiaCmpVelNotchBlndY.Ary1D /end CHARACTERISTIC
/begin CHARACTERISTIC AAACalRegn03Rt01GroupA_Dummy_2.RtnHwAgOffsCalcdX.Ary2D "MICROSAR RTE" VAL_BLK 0x0 RTE_RL_UWORD 0 NO_COMPU_METHOD 0 65535 MATRIX_DIM 16 9 1 SYMBOL_LINK "Rte_CalprmRom_CalRegn03Rt03GroupA_DEFAULT_RTE_CALPRM_GROUP.RtnHwAgOffsCalcdX_Ary2D" 0 DISPLAY_IDENTIFIER AAACalRegn03Rt01GroupA_Dummy_2.CalibrationPorts.RtnHwAgOffsCalcdX.Ary2D /end CHARACTERISTIC
/begin CHARACTERISTIC AAACalRegn03Rt01GroupA_Dummy_2.RtnHwAgOffsCalcdY.Ary2D "MICROSAR RTE" VAL_BLK 0x0 RTE_RL_UWORD 0 NO_COMPU_METHOD 0 65535 MATRIX_DIM 16 9 1 SYMBOL_LINK "Rte_CalprmRom_CalRegn03Rt03GroupA_DEFAULT_RTE_CALPRM_GROUP.RtnHwAgOffsCalcdY_Ary2D" 0 DISPLAY_IDENTIFIER AAACalRegn03Rt01GroupA_Dummy_2.CalibrationPorts.RtnHwAgOffsCalcdY.Ary2D /end CHARACTERISTIC
/begin CHARACTERISTIC AAACalRegn03Rt01GroupA_Dummy_2.RtnScaTqX.Ary2D "MICROSAR RTE" VAL_BLK 0x0 RTE_RL_UWORD 0 NO_COMPU_METHOD 0 65535 MATRIX_DIM 8 9 1 SYMBOL_LINK "Rte_CalprmRom_CalRegn03Rt03GroupA_DEFAULT_RTE_CALPRM_GROUP.RtnScaTqX_Ary2D" 0 DISPLAY_IDENTIFIER AAACalRegn03Rt01GroupA_Dummy_2.CalibrationPorts.RtnScaTqX.Ary2D /end CHARACTERISTIC
/begin CHARACTERISTIC AAACalRegn03Rt01GroupA_Dummy_2.RtnScaTqY.Ary2D "MICROSAR RTE" VAL_BLK 0x0 RTE_RL_UWORD 0 NO_COMPU_METHOD 0 65535 MATRIX_DIM 8 9 1 SYMBOL_LINK "Rte_CalprmRom_CalRegn03Rt03GroupA_DEFAULT_RTE_CALPRM_GROUP.RtnScaTqY_Ary2D" 0 DISPLAY_IDENTIFIER AAACalRegn03Rt01GroupA_Dummy_2.CalibrationPorts.RtnScaTqY.Ary2D /end CHARACTERISTIC
/begin CHARACTERISTIC AAACalRegn03Rt01GroupA_Dummy_2.RtnScaVelX.Ary2D "MICROSAR RTE" VAL_BLK 0x0 RTE_RL_UWORD 0 NO_COMPU_METHOD 0 65535 MATRIX_DIM 4 9 1 SYMBOL_LINK "Rte_CalprmRom_CalRegn03Rt03GroupA_DEFAULT_RTE_CALPRM_GROUP.RtnScaVelX_Ary2D" 0 DISPLAY_IDENTIFIER AAACalRegn03Rt01GroupA_Dummy_2.CalibrationPorts.RtnScaVelX.Ary2D /end CHARACTERISTIC
/begin CHARACTERISTIC AAACalRegn03Rt01GroupA_Dummy_2.RtnScaVelY.Ary2D "MICROSAR RTE" VAL_BLK 0x0 RTE_RL_UWORD 0 NO_COMPU_METHOD 0 65535 MATRIX_DIM 4 9 1 SYMBOL_LINK "Rte_CalprmRom_CalRegn03Rt03GroupA_DEFAULT_RTE_CALPRM_GROUP.RtnScaVelY_Ary2D" 0 DISPLAY_IDENTIFIER AAACalRegn03Rt01GroupA_Dummy_2.CalibrationPorts.RtnScaVelY.Ary2D /end CHARACTERISTIC
/begin CHARACTERISTIC AAACalRegn03Rt01GroupA_Dummy_3.AssiHiFrqGainY.Ary2D "MICROSAR RTE" VAL_BLK 0x0 RTE_RL_UWORD 0 NO_COMPU_METHOD 0 65535 MATRIX_DIM 13 12 1 SYMBOL_LINK "Rte_CalprmRom_CalRegn03Rt04GroupA_DEFAULT_RTE_CALPRM_GROUP.AssiHiFrqGainY_Ary2D" 0 DISPLAY_IDENTIFIER AAACalRegn03Rt01GroupA_Dummy_3.CalibrationPorts.AssiHiFrqGainY.Ary2D /end CHARACTERISTIC
/begin CHARACTERISTIC AAACalRegn03Rt01GroupA_Dummy_3.AssiHiFrqTqX.Ary2D "MICROSAR RTE" VAL_BLK 0x0 RTE_RL_UWORD 0 NO_COMPU_METHOD 0 65535 MATRIX_DIM 13 12 1 SYMBOL_LINK "Rte_CalprmRom_CalRegn03Rt04GroupA_DEFAULT_RTE_CALPRM_GROUP.AssiHiFrqTqX_Ary2D" 0 DISPLAY_IDENTIFIER AAACalRegn03Rt01GroupA_Dummy_3.CalibrationPorts.AssiHiFrqTqX.Ary2D /end CHARACTERISTIC
/begin CHARACTERISTIC AAACalRegn03Rt01GroupA_Dummy_3.AssiMotTqWhlImbRejctnMinX.Ary2D "MICROSAR RTE" VAL_BLK 0x0 RTE_RL_UWORD 0 NO_COMPU_METHOD 0 65535 MATRIX_DIM 20 12 1 SYMBOL_LINK "Rte_CalprmRom_CalRegn03Rt04GroupA_DEFAULT_RTE_CALPRM_GROUP.AssiMotTqWhlImbRejctnMinX_Ary2D" 0 DISPLAY_IDENTIFIER AAACalRegn03Rt01GroupA_Dummy_3.CalibrationPorts.AssiMotTqWhlImbRejctnMinX.Ary2D /end CHARACTERISTIC
/begin CHARACTERISTIC AAACalRegn03Rt01GroupA_Dummy_3.AssiMotTqWhlImbRejctnMinY.Ary2D "MICROSAR RTE" VAL_BLK 0x0 RTE_RL_SWORD 0 NO_COMPU_METHOD -32768 32767 MATRIX_DIM 20 12 1 SYMBOL_LINK "Rte_CalprmRom_CalRegn03Rt04GroupA_DEFAULT_RTE_CALPRM_GROUP.AssiMotTqWhlImbRejctnMinY_Ary2D" 0 DISPLAY_IDENTIFIER AAACalRegn03Rt01GroupA_Dummy_3.CalibrationPorts.AssiMotTqWhlImbRejctnMinY.Ary2D /end CHARACTERISTIC
/begin CHARACTERISTIC AAACalRegn03Rt01GroupA_Dummy_3.DampgHydCoeff1ScaY.Ary1D "MICROSAR RTE" VAL_BLK 0x0 RTE_RL_UWORD 0 NO_COMPU_METHOD 0 65535 MATRIX_DIM 12 1 1 SYMBOL_LINK "Rte_CalprmRom_CalRegn03Rt04GroupA_DEFAULT_RTE_CALPRM_GROUP.DampgHydCoeff1ScaY_Ary1D" 0 DISPLAY_IDENTIFIER AAACalRegn03Rt01GroupA_Dummy_3.CalibrationPorts.DampgHydCoeff1ScaY.Ary1D /end CHARACTERISTIC
/begin CHARACTERISTIC AAACalRegn03Rt01GroupA_Dummy_3.DampgHydCoeff2ScaY.Ary1D "MICROSAR RTE" VAL_BLK 0x0 RTE_RL_UWORD 0 NO_COMPU_METHOD 0 65535 MATRIX_DIM 12 1 1 SYMBOL_LINK "Rte_CalprmRom_CalRegn03Rt04GroupA_DEFAULT_RTE_CALPRM_GROUP.DampgHydCoeff2ScaY_Ary1D" 0 DISPLAY_IDENTIFIER AAACalRegn03Rt01GroupA_Dummy_3.CalibrationPorts.DampgHydCoeff2ScaY.Ary1D /end CHARACTERISTIC
/begin CHARACTERISTIC AAACalRegn03Rt01GroupA_Dummy_3.DampgHydCoeff3ScaY.Ary1D "MICROSAR RTE" VAL_BLK 0x0 RTE_RL_UWORD 0 NO_COMPU_METHOD 0 65535 MATRIX_DIM 12 1 1 SYMBOL_LINK "Rte_CalprmRom_CalRegn03Rt04GroupA_DEFAULT_RTE_CALPRM_GROUP.DampgHydCoeff3ScaY_Ary1D" 0 DISPLAY_IDENTIFIER AAACalRegn03Rt01GroupA_Dummy_3.CalibrationPorts.DampgHydCoeff3ScaY.Ary1D /end CHARACTERISTIC
/begin CHARACTERISTIC AAACalRegn03Rt01GroupA_Dummy_3.DampgHydCoeff4ScaY.Ary1D "MICROSAR RTE" VAL_BLK 0x0 RTE_RL_UWORD 0 NO_COMPU_METHOD 0 65535 MATRIX_DIM 12 1 1 SYMBOL_LINK "Rte_CalprmRom_CalRegn03Rt04GroupA_DEFAULT_RTE_CALPRM_GROUP.DampgHydCoeff4ScaY_Ary1D" 0 DISPLAY_IDENTIFIER AAACalRegn03Rt01GroupA_Dummy_3.CalibrationPorts.DampgHydCoeff4ScaY.Ary1D /end CHARACTERISTIC
/begin CHARACTERISTIC AAACalRegn03Rt01GroupA_Dummy_3.DampgMotVelX.Ary2D "MICROSAR RTE" VAL_BLK 0x0 RTE_RL_UWORD 0 NO_COMPU_METHOD 0 65535 MATRIX_DIM 13 12 1 SYMBOL_LINK "Rte_CalprmRom_CalRegn03Rt04GroupA_DEFAULT_RTE_CALPRM_GROUP.DampgMotVelX_Ary2D" 0 DISPLAY_IDENTIFIER AAACalRegn03Rt01GroupA_Dummy_3.CalibrationPorts.DampgMotVelX.Ary2D /end CHARACTERISTIC
/begin CHARACTERISTIC AAACalRegn03Rt01GroupA_Dummy_3.DampgMotVelY.Ary2D "MICROSAR RTE" VAL_BLK 0x0 RTE_RL_UWORD 0 NO_COMPU_METHOD 0 65535 MATRIX_DIM 13 12 1 SYMBOL_LINK "Rte_CalprmRom_CalRegn03Rt04GroupA_DEFAULT_RTE_CALPRM_GROUP.DampgMotVelY_Ary2D" 0 DISPLAY_IDENTIFIER AAACalRegn03Rt01GroupA_Dummy_3.CalibrationPorts.DampgMotVelY.Ary2D /end CHARACTERISTIC
/begin CHARACTERISTIC AAACalRegn03Rt01GroupA_Dummy_3.HysCmpFricWhlImbRejctnBlndX.Ary1D "MICROSAR RTE" VAL_BLK 0x0 RTE_RL_UWORD 0 NO_COMPU_METHOD 0 65535 MATRIX_DIM 6 1 1 SYMBOL_LINK "Rte_CalprmRom_CalRegn03Rt04GroupA_DEFAULT_RTE_CALPRM_GROUP.HysCmpFricWhlImbRejctnBlndX_Ary1D" 0 DISPLAY_IDENTIFIER AAACalRegn03Rt01GroupA_Dummy_3.CalibrationPorts.HysCmpFricWhlImbRejctnBlndX.Ary1D /end CHARACTERISTIC
/begin CHARACTERISTIC AAACalRegn03Rt01GroupA_Dummy_3.HysCmpFricWhlImbRejctnBlndY.Ary1D "MICROSAR RTE" VAL_BLK 0x0 RTE_RL_UWORD 0 NO_COMPU_METHOD 0 65535 MATRIX_DIM 6 1 1 SYMBOL_LINK "Rte_CalprmRom_CalRegn03Rt04GroupA_DEFAULT_RTE_CALPRM_GROUP.HysCmpFricWhlImbRejctnBlndY_Ary1D" 0 DISPLAY_IDENTIFIER AAACalRegn03Rt01GroupA_Dummy_3.CalibrationPorts.HysCmpFricWhlImbRejctnBlndY.Ary1D /end CHARACTERISTIC
/begin CHARACTERISTIC AAACalRegn03Rt01GroupA_Dummy_3.HysCmpFricWhlImbRejctnOffY.Ary1D "MICROSAR RTE" VAL_BLK 0x0 RTE_RL_UWORD 0 NO_COMPU_METHOD 0 65535 MATRIX_DIM 12 1 1 SYMBOL_LINK "Rte_CalprmRom_CalRegn03Rt04GroupA_DEFAULT_RTE_CALPRM_GROUP.HysCmpFricWhlImbRejctnOffY_Ary1D" 0 DISPLAY_IDENTIFIER AAACalRegn03Rt01GroupA_Dummy_3.CalibrationPorts.HysCmpFricWhlImbRejctnOffY.Ary1D /end CHARACTERISTIC
/begin CHARACTERISTIC AAACalRegn03Rt01GroupA_Dummy_3.HysCmpFricWhlImbRejctnOnY.Ary1D "MICROSAR RTE" VAL_BLK 0x0 RTE_RL_UWORD 0 NO_COMPU_METHOD 0 65535 MATRIX_DIM 12 1 1 SYMBOL_LINK "Rte_CalprmRom_CalRegn03Rt04GroupA_DEFAULT_RTE_CALPRM_GROUP.HysCmpFricWhlImbRejctnOnY_Ary1D" 0 DISPLAY_IDENTIFIER AAACalRegn03Rt01GroupA_Dummy_3.CalibrationPorts.HysCmpFricWhlImbRejctnOnY.Ary1D /end CHARACTERISTIC
/begin CHARACTERISTIC AAACalRegn03Rt01GroupA_Dummy_3.InertiaCmpVelAssiBasdDampgCoeffX.Ary1D "MICROSAR RTE" VAL_BLK 0x0 RTE_RL_UWORD 0 NO_COMPU_METHOD 0 65535 MATRIX_DIM 10 1 1 SYMBOL_LINK "Rte_CalprmRom_CalRegn03Rt04GroupA_DEFAULT_RTE_CALPRM_GROUP.InertiaCmpVelAssiBasdDampgCoeffX_Ary1D" 0 DISPLAY_IDENTIFIER AAACalRegn03Rt01GroupA_Dummy_3.CalibrationPorts.InertiaCmpVelAssiBasdDampgCoeffX.Ary1D /end CHARACTERISTIC
/begin CHARACTERISTIC AAACalRegn03Rt01GroupA_Dummy_3.InertiaCmpVelAssiBasdDampgRollgY.Ary1D "MICROSAR RTE" VAL_BLK 0x0 RTE_RL_UWORD 0 NO_COMPU_METHOD 0 65535 MATRIX_DIM 10 1 1 SYMBOL_LINK "Rte_CalprmRom_CalRegn03Rt04GroupA_DEFAULT_RTE_CALPRM_GROUP.InertiaCmpVelAssiBasdDampgRollgY_Ary1D" 0 DISPLAY_IDENTIFIER AAACalRegn03Rt01GroupA_Dummy_3.CalibrationPorts.InertiaCmpVelAssiBasdDampgRollgY.Ary1D /end CHARACTERISTIC
/begin CHARACTERISTIC AAACalRegn03Rt01GroupA_Dummy_3.InertiaCmpVelAssiBasdDampgStatY.Ary1D "MICROSAR RTE" VAL_BLK 0x0 RTE_RL_UWORD 0 NO_COMPU_METHOD 0 65535 MATRIX_DIM 10 1 1 SYMBOL_LINK "Rte_CalprmRom_CalRegn03Rt04GroupA_DEFAULT_RTE_CALPRM_GROUP.InertiaCmpVelAssiBasdDampgStatY_Ary1D" 0 DISPLAY_IDENTIFIER AAACalRegn03Rt01GroupA_Dummy_3.CalibrationPorts.InertiaCmpVelAssiBasdDampgStatY.Ary1D /end CHARACTERISTIC
/begin CHARACTERISTIC AAACalRegn03Rt01GroupA_Dummy_3.InertiaCmpVelDampgSpdBlndY.Ary1D "MICROSAR RTE" VAL_BLK 0x0 RTE_RL_UWORD 0 NO_COMPU_METHOD 0 65535 MATRIX_DIM 12 1 1 SYMBOL_LINK "Rte_CalprmRom_CalRegn03Rt04GroupA_DEFAULT_RTE_CALPRM_GROUP.InertiaCmpVelDampgSpdBlndY_Ary1D" 0 DISPLAY_IDENTIFIER AAACalRegn03Rt01GroupA_Dummy_3.CalibrationPorts.InertiaCmpVelDampgSpdBlndY.Ary1D /end CHARACTERISTIC
/begin CHARACTERISTIC AAACalRegn03Rt01GroupA_Dummy_3.InertiaCmpVelNotchBlndY.Ary1D "MICROSAR RTE" VAL_BLK 0x0 RTE_RL_UWORD 0 NO_COMPU_METHOD 0 65535 MATRIX_DIM 12 1 1 SYMBOL_LINK "Rte_CalprmRom_CalRegn03Rt04GroupA_DEFAULT_RTE_CALPRM_GROUP.InertiaCmpVelNotchBlndY_Ary1D" 0 DISPLAY_IDENTIFIER AAACalRegn03Rt01GroupA_Dummy_3.CalibrationPorts.InertiaCmpVelNotchBlndY.Ary1D /end CHARACTERISTIC
/begin CHARACTERISTIC AAACalRegn03Rt01GroupA_Dummy_3.RtnHwAgOffsCalcdX.Ary2D "MICROSAR RTE" VAL_BLK 0x0 RTE_RL_UWORD 0 NO_COMPU_METHOD 0 65535 MATRIX_DIM 16 9 1 SYMBOL_LINK "Rte_CalprmRom_CalRegn03Rt04GroupA_DEFAULT_RTE_CALPRM_GROUP.RtnHwAgOffsCalcdX_Ary2D" 0 DISPLAY_IDENTIFIER AAACalRegn03Rt01GroupA_Dummy_3.CalibrationPorts.RtnHwAgOffsCalcdX.Ary2D /end CHARACTERISTIC
/begin CHARACTERISTIC AAACalRegn03Rt01GroupA_Dummy_3.RtnHwAgOffsCalcdY.Ary2D "MICROSAR RTE" VAL_BLK 0x0 RTE_RL_UWORD 0 NO_COMPU_METHOD 0 65535 MATRIX_DIM 16 9 1 SYMBOL_LINK "Rte_CalprmRom_CalRegn03Rt04GroupA_DEFAULT_RTE_CALPRM_GROUP.RtnHwAgOffsCalcdY_Ary2D" 0 DISPLAY_IDENTIFIER AAACalRegn03Rt01GroupA_Dummy_3.CalibrationPorts.RtnHwAgOffsCalcdY.Ary2D /end CHARACTERISTIC
/begin CHARACTERISTIC AAACalRegn03Rt01GroupA_Dummy_3.RtnScaTqX.Ary2D "MICROSAR RTE" VAL_BLK 0x0 RTE_RL_UWORD 0 NO_COMPU_METHOD 0 65535 MATRIX_DIM 8 9 1 SYMBOL_LINK "Rte_CalprmRom_CalRegn03Rt04GroupA_DEFAULT_RTE_CALPRM_GROUP.RtnScaTqX_Ary2D" 0 DISPLAY_IDENTIFIER AAACalRegn03Rt01GroupA_Dummy_3.CalibrationPorts.RtnScaTqX.Ary2D /end CHARACTERISTIC
/begin CHARACTERISTIC AAACalRegn03Rt01GroupA_Dummy_3.RtnScaTqY.Ary2D "MICROSAR RTE" VAL_BLK 0x0 RTE_RL_UWORD 0 NO_COMPU_METHOD 0 65535 MATRIX_DIM 8 9 1 SYMBOL_LINK "Rte_CalprmRom_CalRegn03Rt04GroupA_DEFAULT_RTE_CALPRM_GROUP.RtnScaTqY_Ary2D" 0 DISPLAY_IDENTIFIER AAACalRegn03Rt01GroupA_Dummy_3.CalibrationPorts.RtnScaTqY.Ary2D /end CHARACTERISTIC
/begin CHARACTERISTIC AAACalRegn03Rt01GroupA_Dummy_3.RtnScaVelX.Ary2D "MICROSAR RTE" VAL_BLK 0x0 RTE_RL_UWORD 0 NO_COMPU_METHOD 0 65535 MATRIX_DIM 4 9 1 SYMBOL_LINK "Rte_CalprmRom_CalRegn03Rt04GroupA_DEFAULT_RTE_CALPRM_GROUP.RtnScaVelX_Ary2D" 0 DISPLAY_IDENTIFIER AAACalRegn03Rt01GroupA_Dummy_3.CalibrationPorts.RtnScaVelX.Ary2D /end CHARACTERISTIC
/begin CHARACTERISTIC AAACalRegn03Rt01GroupA_Dummy_3.RtnScaVelY.Ary2D "MICROSAR RTE" VAL_BLK 0x0 RTE_RL_UWORD 0 NO_COMPU_METHOD 0 65535 MATRIX_DIM 4 9 1 SYMBOL_LINK "Rte_CalprmRom_CalRegn03Rt04GroupA_DEFAULT_RTE_CALPRM_GROUP.RtnScaVelY_Ary2D" 0 DISPLAY_IDENTIFIER AAACalRegn03Rt01GroupA_Dummy_3.CalibrationPorts.RtnScaVelY.Ary2D /end CHARACTERISTIC
/begin CHARACTERISTIC AAACalRegn03Rt01GroupA_Dummy_4.AssiHiFrqGainY.Ary2D "MICROSAR RTE" VAL_BLK 0x0 RTE_RL_UWORD 0 NO_COMPU_METHOD 0 65535 MATRIX_DIM 13 12 1 SYMBOL_LINK "Rte_CalprmRom_CalRegn03Rt00GroupA_DEFAULT_RTE_CALPRM_GROUP.AssiHiFrqGainY_Ary2D" 0 DISPLAY_IDENTIFIER AAACalRegn03Rt01GroupA_Dummy_4.CalibrationPorts.AssiHiFrqGainY.Ary2D /end CHARACTERISTIC
/begin CHARACTERISTIC AAACalRegn03Rt01GroupA_Dummy_4.AssiHiFrqTqX.Ary2D "MICROSAR RTE" VAL_BLK 0x0 RTE_RL_UWORD 0 NO_COMPU_METHOD 0 65535 MATRIX_DIM 13 12 1 SYMBOL_LINK "Rte_CalprmRom_CalRegn03Rt00GroupA_DEFAULT_RTE_CALPRM_GROUP.AssiHiFrqTqX_Ary2D" 0 DISPLAY_IDENTIFIER AAACalRegn03Rt01GroupA_Dummy_4.CalibrationPorts.AssiHiFrqTqX.Ary2D /end CHARACTERISTIC
/begin CHARACTERISTIC AAACalRegn03Rt01GroupA_Dummy_4.AssiMotTqWhlImbRejctnMinX.Ary2D "MICROSAR RTE" VAL_BLK 0x0 RTE_RL_UWORD 0 NO_COMPU_METHOD 0 65535 MATRIX_DIM 20 12 1 SYMBOL_LINK "Rte_CalprmRom_CalRegn03Rt00GroupA_DEFAULT_RTE_CALPRM_GROUP.AssiMotTqWhlImbRejctnMinX_Ary2D" 0 DISPLAY_IDENTIFIER AAACalRegn03Rt01GroupA_Dummy_4.CalibrationPorts.AssiMotTqWhlImbRejctnMinX.Ary2D /end CHARACTERISTIC
/begin CHARACTERISTIC AAACalRegn03Rt01GroupA_Dummy_4.AssiMotTqWhlImbRejctnMinY.Ary2D "MICROSAR RTE" VAL_BLK 0x0 RTE_RL_SWORD 0 NO_COMPU_METHOD -32768 32767 MATRIX_DIM 20 12 1 SYMBOL_LINK "Rte_CalprmRom_CalRegn03Rt00GroupA_DEFAULT_RTE_CALPRM_GROUP.AssiMotTqWhlImbRejctnMinY_Ary2D" 0 DISPLAY_IDENTIFIER AAACalRegn03Rt01GroupA_Dummy_4.CalibrationPorts.AssiMotTqWhlImbRejctnMinY.Ary2D /end CHARACTERISTIC
/begin CHARACTERISTIC AAACalRegn03Rt01GroupA_Dummy_4.DampgHydCoeff1ScaY.Ary1D "MICROSAR RTE" VAL_BLK 0x0 RTE_RL_UWORD 0 NO_COMPU_METHOD 0 65535 MATRIX_DIM 12 1 1 SYMBOL_LINK "Rte_CalprmRom_CalRegn03Rt00GroupA_DEFAULT_RTE_CALPRM_GROUP.DampgHydCoeff1ScaY_Ary1D" 0 DISPLAY_IDENTIFIER AAACalRegn03Rt01GroupA_Dummy_4.CalibrationPorts.DampgHydCoeff1ScaY.Ary1D /end CHARACTERISTIC
/begin CHARACTERISTIC AAACalRegn03Rt01GroupA_Dummy_4.DampgHydCoeff2ScaY.Ary1D "MICROSAR RTE" VAL_BLK 0x0 RTE_RL_UWORD 0 NO_COMPU_METHOD 0 65535 MATRIX_DIM 12 1 1 SYMBOL_LINK "Rte_CalprmRom_CalRegn03Rt00GroupA_DEFAULT_RTE_CALPRM_GROUP.DampgHydCoeff2ScaY_Ary1D" 0 DISPLAY_IDENTIFIER AAACalRegn03Rt01GroupA_Dummy_4.CalibrationPorts.DampgHydCoeff2ScaY.Ary1D /end CHARACTERISTIC
/begin CHARACTERISTIC AAACalRegn03Rt01GroupA_Dummy_4.DampgHydCoeff3ScaY.Ary1D "MICROSAR RTE" VAL_BLK 0x0 RTE_RL_UWORD 0 NO_COMPU_METHOD 0 65535 MATRIX_DIM 12 1 1 SYMBOL_LINK "Rte_CalprmRom_CalRegn03Rt00GroupA_DEFAULT_RTE_CALPRM_GROUP.DampgHydCoeff3ScaY_Ary1D" 0 DISPLAY_IDENTIFIER AAACalRegn03Rt01GroupA_Dummy_4.CalibrationPorts.DampgHydCoeff3ScaY.Ary1D /end CHARACTERISTIC
/begin CHARACTERISTIC AAACalRegn03Rt01GroupA_Dummy_4.DampgHydCoeff4ScaY.Ary1D "MICROSAR RTE" VAL_BLK 0x0 RTE_RL_UWORD 0 NO_COMPU_METHOD 0 65535 MATRIX_DIM 12 1 1 SYMBOL_LINK "Rte_CalprmRom_CalRegn03Rt00GroupA_DEFAULT_RTE_CALPRM_GROUP.DampgHydCoeff4ScaY_Ary1D" 0 DISPLAY_IDENTIFIER AAACalRegn03Rt01GroupA_Dummy_4.CalibrationPorts.DampgHydCoeff4ScaY.Ary1D /end CHARACTERISTIC
/begin CHARACTERISTIC AAACalRegn03Rt01GroupA_Dummy_4.DampgMotVelX.Ary2D "MICROSAR RTE" VAL_BLK 0x0 RTE_RL_UWORD 0 NO_COMPU_METHOD 0 65535 MATRIX_DIM 13 12 1 SYMBOL_LINK "Rte_CalprmRom_CalRegn03Rt00GroupA_DEFAULT_RTE_CALPRM_GROUP.DampgMotVelX_Ary2D" 0 DISPLAY_IDENTIFIER AAACalRegn03Rt01GroupA_Dummy_4.CalibrationPorts.DampgMotVelX.Ary2D /end CHARACTERISTIC
/begin CHARACTERISTIC AAACalRegn03Rt01GroupA_Dummy_4.DampgMotVelY.Ary2D "MICROSAR RTE" VAL_BLK 0x0 RTE_RL_UWORD 0 NO_COMPU_METHOD 0 65535 MATRIX_DIM 13 12 1 SYMBOL_LINK "Rte_CalprmRom_CalRegn03Rt00GroupA_DEFAULT_RTE_CALPRM_GROUP.DampgMotVelY_Ary2D" 0 DISPLAY_IDENTIFIER AAACalRegn03Rt01GroupA_Dummy_4.CalibrationPorts.DampgMotVelY.Ary2D /end CHARACTERISTIC
/begin CHARACTERISTIC AAACalRegn03Rt01GroupA_Dummy_4.HysCmpFricWhlImbRejctnBlndX.Ary1D "MICROSAR RTE" VAL_BLK 0x0 RTE_RL_UWORD 0 NO_COMPU_METHOD 0 65535 MATRIX_DIM 6 1 1 SYMBOL_LINK "Rte_CalprmRom_CalRegn03Rt00GroupA_DEFAULT_RTE_CALPRM_GROUP.HysCmpFricWhlImbRejctnBlndX_Ary1D" 0 DISPLAY_IDENTIFIER AAACalRegn03Rt01GroupA_Dummy_4.CalibrationPorts.HysCmpFricWhlImbRejctnBlndX.Ary1D /end CHARACTERISTIC
/begin CHARACTERISTIC AAACalRegn03Rt01GroupA_Dummy_4.HysCmpFricWhlImbRejctnBlndY.Ary1D "MICROSAR RTE" VAL_BLK 0x0 RTE_RL_UWORD 0 NO_COMPU_METHOD 0 65535 MATRIX_DIM 6 1 1 SYMBOL_LINK "Rte_CalprmRom_CalRegn03Rt00GroupA_DEFAULT_RTE_CALPRM_GROUP.HysCmpFricWhlImbRejctnBlndY_Ary1D" 0 DISPLAY_IDENTIFIER AAACalRegn03Rt01GroupA_Dummy_4.CalibrationPorts.HysCmpFricWhlImbRejctnBlndY.Ary1D /end CHARACTERISTIC
/begin CHARACTERISTIC AAACalRegn03Rt01GroupA_Dummy_4.HysCmpFricWhlImbRejctnOffY.Ary1D "MICROSAR RTE" VAL_BLK 0x0 RTE_RL_UWORD 0 NO_COMPU_METHOD 0 65535 MATRIX_DIM 12 1 1 SYMBOL_LINK "Rte_CalprmRom_CalRegn03Rt00GroupA_DEFAULT_RTE_CALPRM_GROUP.HysCmpFricWhlImbRejctnOffY_Ary1D" 0 DISPLAY_IDENTIFIER AAACalRegn03Rt01GroupA_Dummy_4.CalibrationPorts.HysCmpFricWhlImbRejctnOffY.Ary1D /end CHARACTERISTIC
/begin CHARACTERISTIC AAACalRegn03Rt01GroupA_Dummy_4.HysCmpFricWhlImbRejctnOnY.Ary1D "MICROSAR RTE" VAL_BLK 0x0 RTE_RL_UWORD 0 NO_COMPU_METHOD 0 65535 MATRIX_DIM 12 1 1 SYMBOL_LINK "Rte_CalprmRom_CalRegn03Rt00GroupA_DEFAULT_RTE_CALPRM_GROUP.HysCmpFricWhlImbRejctnOnY_Ary1D" 0 DISPLAY_IDENTIFIER AAACalRegn03Rt01GroupA_Dummy_4.CalibrationPorts.HysCmpFricWhlImbRejctnOnY.Ary1D /end CHARACTERISTIC
/begin CHARACTERISTIC AAACalRegn03Rt01GroupA_Dummy_4.InertiaCmpVelAssiBasdDampgCoeffX.Ary1D "MICROSAR RTE" VAL_BLK 0x0 RTE_RL_UWORD 0 NO_COMPU_METHOD 0 65535 MATRIX_DIM 10 1 1 SYMBOL_LINK "Rte_CalprmRom_CalRegn03Rt00GroupA_DEFAULT_RTE_CALPRM_GROUP.InertiaCmpVelAssiBasdDampgCoeffX_Ary1D" 0 DISPLAY_IDENTIFIER AAACalRegn03Rt01GroupA_Dummy_4.CalibrationPorts.InertiaCmpVelAssiBasdDampgCoeffX.Ary1D /end CHARACTERISTIC
/begin CHARACTERISTIC AAACalRegn03Rt01GroupA_Dummy_4.InertiaCmpVelAssiBasdDampgRollgY.Ary1D "MICROSAR RTE" VAL_BLK 0x0 RTE_RL_UWORD 0 NO_COMPU_METHOD 0 65535 MATRIX_DIM 10 1 1 SYMBOL_LINK "Rte_CalprmRom_CalRegn03Rt00GroupA_DEFAULT_RTE_CALPRM_GROUP.InertiaCmpVelAssiBasdDampgRollgY_Ary1D" 0 DISPLAY_IDENTIFIER AAACalRegn03Rt01GroupA_Dummy_4.CalibrationPorts.InertiaCmpVelAssiBasdDampgRollgY.Ary1D /end CHARACTERISTIC
/begin CHARACTERISTIC AAACalRegn03Rt01GroupA_Dummy_4.InertiaCmpVelAssiBasdDampgStatY.Ary1D "MICROSAR RTE" VAL_BLK 0x0 RTE_RL_UWORD 0 NO_COMPU_METHOD 0 65535 MATRIX_DIM 10 1 1 SYMBOL_LINK "Rte_CalprmRom_CalRegn03Rt00GroupA_DEFAULT_RTE_CALPRM_GROUP.InertiaCmpVelAssiBasdDampgStatY_Ary1D" 0 DISPLAY_IDENTIFIER AAACalRegn03Rt01GroupA_Dummy_4.CalibrationPorts.InertiaCmpVelAssiBasdDampgStatY.Ary1D /end CHARACTERISTIC
/begin CHARACTERISTIC AAACalRegn03Rt01GroupA_Dummy_4.InertiaCmpVelDampgSpdBlndY.Ary1D "MICROSAR RTE" VAL_BLK 0x0 RTE_RL_UWORD 0 NO_COMPU_METHOD 0 65535 MATRIX_DIM 12 1 1 SYMBOL_LINK "Rte_CalprmRom_CalRegn03Rt00GroupA_DEFAULT_RTE_CALPRM_GROUP.InertiaCmpVelDampgSpdBlndY_Ary1D" 0 DISPLAY_IDENTIFIER AAACalRegn03Rt01GroupA_Dummy_4.CalibrationPorts.InertiaCmpVelDampgSpdBlndY.Ary1D /end CHARACTERISTIC
/begin CHARACTERISTIC AAACalRegn03Rt01GroupA_Dummy_4.InertiaCmpVelNotchBlndY.Ary1D "MICROSAR RTE" VAL_BLK 0x0 RTE_RL_UWORD 0 NO_COMPU_METHOD 0 65535 MATRIX_DIM 12 1 1 SYMBOL_LINK "Rte_CalprmRom_CalRegn03Rt00GroupA_DEFAULT_RTE_CALPRM_GROUP.InertiaCmpVelNotchBlndY_Ary1D" 0 DISPLAY_IDENTIFIER AAACalRegn03Rt01GroupA_Dummy_4.CalibrationPorts.InertiaCmpVelNotchBlndY.Ary1D /end CHARACTERISTIC
/begin CHARACTERISTIC AAACalRegn03Rt01GroupA_Dummy_4.RtnHwAgOffsCalcdX.Ary2D "MICROSAR RTE" VAL_BLK 0x0 RTE_RL_UWORD 0 NO_COMPU_METHOD 0 65535 MATRIX_DIM 16 9 1 SYMBOL_LINK "Rte_CalprmRom_CalRegn03Rt00GroupA_DEFAULT_RTE_CALPRM_GROUP.RtnHwAgOffsCalcdX_Ary2D" 0 DISPLAY_IDENTIFIER AAACalRegn03Rt01GroupA_Dummy_4.CalibrationPorts.RtnHwAgOffsCalcdX.Ary2D /end CHARACTERISTIC
/begin CHARACTERISTIC AAACalRegn03Rt01GroupA_Dummy_4.RtnHwAgOffsCalcdY.Ary2D "MICROSAR RTE" VAL_BLK 0x0 RTE_RL_UWORD 0 NO_COMPU_METHOD 0 65535 MATRIX_DIM 16 9 1 SYMBOL_LINK "Rte_CalprmRom_CalRegn03Rt00GroupA_DEFAULT_RTE_CALPRM_GROUP.RtnHwAgOffsCalcdY_Ary2D" 0 DISPLAY_IDENTIFIER AAACalRegn03Rt01GroupA_Dummy_4.CalibrationPorts.RtnHwAgOffsCalcdY.Ary2D /end CHARACTERISTIC
/begin CHARACTERISTIC AAACalRegn03Rt01GroupA_Dummy_4.RtnScaTqX.Ary2D "MICROSAR RTE" VAL_BLK 0x0 RTE_RL_UWORD 0 NO_COMPU_METHOD 0 65535 MATRIX_DIM 8 9 1 SYMBOL_LINK "Rte_CalprmRom_CalRegn03Rt00GroupA_DEFAULT_RTE_CALPRM_GROUP.RtnScaTqX_Ary2D" 0 DISPLAY_IDENTIFIER AAACalRegn03Rt01GroupA_Dummy_4.CalibrationPorts.RtnScaTqX.Ary2D /end CHARACTERISTIC
/begin CHARACTERISTIC AAACalRegn03Rt01GroupA_Dummy_4.RtnScaTqY.Ary2D "MICROSAR RTE" VAL_BLK 0x0 RTE_RL_UWORD 0 NO_COMPU_METHOD 0 65535 MATRIX_DIM 8 9 1 SYMBOL_LINK "Rte_CalprmRom_CalRegn03Rt00GroupA_DEFAULT_RTE_CALPRM_GROUP.RtnScaTqY_Ary2D" 0 DISPLAY_IDENTIFIER AAACalRegn03Rt01GroupA_Dummy_4.CalibrationPorts.RtnScaTqY.Ary2D /end CHARACTERISTIC
/begin CHARACTERISTIC AAACalRegn03Rt01GroupA_Dummy_4.RtnScaVelX.Ary2D "MICROSAR RTE" VAL_BLK 0x0 RTE_RL_UWORD 0 NO_COMPU_METHOD 0 65535 MATRIX_DIM 4 9 1 SYMBOL_LINK "Rte_CalprmRom_CalRegn03Rt00GroupA_DEFAULT_RTE_CALPRM_GROUP.RtnScaVelX_Ary2D" 0 DISPLAY_IDENTIFIER AAACalRegn03Rt01GroupA_Dummy_4.CalibrationPorts.RtnScaVelX.Ary2D /end CHARACTERISTIC
/begin CHARACTERISTIC AAACalRegn03Rt01GroupA_Dummy_4.RtnScaVelY.Ary2D "MICROSAR RTE" VAL_BLK 0x0 RTE_RL_UWORD 0 NO_COMPU_METHOD 0 65535 MATRIX_DIM 4 9 1 SYMBOL_LINK "Rte_CalprmRom_CalRegn03Rt00GroupA_DEFAULT_RTE_CALPRM_GROUP.RtnScaVelY_Ary2D" 0 DISPLAY_IDENTIFIER AAACalRegn03Rt01GroupA_Dummy_4.CalibrationPorts.RtnScaVelY.Ary2D /end CHARACTERISTIC
/begin CHARACTERISTIC AAACalRegn03Rt01GroupB_Dummy.AssiHiFrqTqWhlImbRejctnTqX.Ary2D "MICROSAR RTE" VAL_BLK 0x0 RTE_RL_UWORD 0 NO_COMPU_METHOD 0 65535 MATRIX_DIM 13 12 1 SYMBOL_LINK "Rte_CalprmRom_CalRegn03Rt00GroupB_DEFAULT_RTE_CALPRM_GROUP.AssiHiFrqTqWhlImbRejctnTqX_Ary2D" 0 DISPLAY_IDENTIFIER AAACalRegn03Rt01GroupB_Dummy.CalibrationPorts.AssiHiFrqTqWhlImbRejctnTqX.Ary2D /end CHARACTERISTIC
/begin CHARACTERISTIC AAACalRegn03Rt01GroupB_Dummy.AssiHiFrqWhlImbRejctnBlndX.Ary2D "MICROSAR RTE" VAL_BLK 0x0 RTE_RL_UWORD 0 NO_COMPU_METHOD 0 65535 MATRIX_DIM 5 12 1 SYMBOL_LINK "Rte_CalprmRom_CalRegn03Rt00GroupB_DEFAULT_RTE_CALPRM_GROUP.AssiHiFrqWhlImbRejctnBlndX_Ary2D" 0 DISPLAY_IDENTIFIER AAACalRegn03Rt01GroupB_Dummy.CalibrationPorts.AssiHiFrqWhlImbRejctnBlndX.Ary2D /end CHARACTERISTIC
/begin CHARACTERISTIC AAACalRegn03Rt01GroupB_Dummy.AssiHiFrqWhlImbRejctnBlndY.Ary2D "MICROSAR RTE" VAL_BLK 0x0 RTE_RL_UWORD 0 NO_COMPU_METHOD 0 65535 MATRIX_DIM 5 12 1 SYMBOL_LINK "Rte_CalprmRom_CalRegn03Rt00GroupB_DEFAULT_RTE_CALPRM_GROUP.AssiHiFrqWhlImbRejctnBlndY_Ary2D" 0 DISPLAY_IDENTIFIER AAACalRegn03Rt01GroupB_Dummy.CalibrationPorts.AssiHiFrqWhlImbRejctnBlndY.Ary2D /end CHARACTERISTIC
/begin CHARACTERISTIC AAACalRegn03Rt01GroupB_Dummy.AssiHiFrqWhlImbRejctnGainY.Ary2D "MICROSAR RTE" VAL_BLK 0x0 RTE_RL_UWORD 0 NO_COMPU_METHOD 0 65535 MATRIX_DIM 13 12 1 SYMBOL_LINK "Rte_CalprmRom_CalRegn03Rt00GroupB_DEFAULT_RTE_CALPRM_GROUP.AssiHiFrqWhlImbRejctnGainY_Ary2D" 0 DISPLAY_IDENTIFIER AAACalRegn03Rt01GroupB_Dummy.CalibrationPorts.AssiHiFrqWhlImbRejctnGainY.Ary2D /end CHARACTERISTIC
/begin CHARACTERISTIC AAACalRegn03Rt01GroupB_Dummy.AssiMotTqWhlImbRejctnMaxX.Ary2D "MICROSAR RTE" VAL_BLK 0x0 RTE_RL_UWORD 0 NO_COMPU_METHOD 0 65535 MATRIX_DIM 20 12 1 SYMBOL_LINK "Rte_CalprmRom_CalRegn03Rt00GroupB_DEFAULT_RTE_CALPRM_GROUP.AssiMotTqWhlImbRejctnMaxX_Ary2D" 0 DISPLAY_IDENTIFIER AAACalRegn03Rt01GroupB_Dummy.CalibrationPorts.AssiMotTqWhlImbRejctnMaxX.Ary2D /end CHARACTERISTIC
/begin CHARACTERISTIC AAACalRegn03Rt01GroupB_Dummy.AssiMotTqWhlImbRejctnMaxY.Ary2D "MICROSAR RTE" VAL_BLK 0x0 RTE_RL_SWORD 0 NO_COMPU_METHOD -32768 32767 MATRIX_DIM 20 12 1 SYMBOL_LINK "Rte_CalprmRom_CalRegn03Rt00GroupB_DEFAULT_RTE_CALPRM_GROUP.AssiMotTqWhlImbRejctnMaxY_Ary2D" 0 DISPLAY_IDENTIFIER AAACalRegn03Rt01GroupB_Dummy.CalibrationPorts.AssiMotTqWhlImbRejctnMaxY.Ary2D /end CHARACTERISTIC
/begin CHARACTERISTIC AAACalRegn03Rt01GroupB_Dummy.AssiWhlImbRejctnBlndScaX.Ary2D "MICROSAR RTE" VAL_BLK 0x0 RTE_RL_UWORD 0 NO_COMPU_METHOD 0 65535 MATRIX_DIM 5 12 1 SYMBOL_LINK "Rte_CalprmRom_CalRegn03Rt00GroupB_DEFAULT_RTE_CALPRM_GROUP.AssiWhlImbRejctnBlndScaX_Ary2D" 0 DISPLAY_IDENTIFIER AAACalRegn03Rt01GroupB_Dummy.CalibrationPorts.AssiWhlImbRejctnBlndScaX.Ary2D /end CHARACTERISTIC
/begin CHARACTERISTIC AAACalRegn03Rt01GroupB_Dummy.AssiWhlImbRejctnBlndScaY.Ary2D "MICROSAR RTE" VAL_BLK 0x0 RTE_RL_UWORD 0 NO_COMPU_METHOD 0 65535 MATRIX_DIM 5 12 1 SYMBOL_LINK "Rte_CalprmRom_CalRegn03Rt00GroupB_DEFAULT_RTE_CALPRM_GROUP.AssiWhlImbRejctnBlndScaY_Ary2D" 0 DISPLAY_IDENTIFIER AAACalRegn03Rt01GroupB_Dummy.CalibrationPorts.AssiWhlImbRejctnBlndScaY.Ary2D /end CHARACTERISTIC
/begin CHARACTERISTIC AAACalRegn03Rt01GroupB_Dummy.EotProtnDampgVehSpdTbl.Ary1D "MICROSAR RTE" VAL_BLK 0x0 RTE_RL_UWORD 0 NO_COMPU_METHOD 0 65535 MATRIX_DIM 4 1 1 SYMBOL_LINK "Rte_CalprmRom_CalRegn03Rt00GroupB_DEFAULT_RTE_CALPRM_GROUP.EotProtnDampgVehSpdTbl_Ary1D" 0 DISPLAY_IDENTIFIER AAACalRegn03Rt01GroupB_Dummy.CalibrationPorts.EotProtnDampgVehSpdTbl.Ary1D /end CHARACTERISTIC
/begin CHARACTERISTIC AAACalRegn03Rt01GroupB_Dummy.EotProtnEntrGainVehSpdTbl.Ary1D "MICROSAR RTE" VAL_BLK 0x0 RTE_RL_UWORD 0 NO_COMPU_METHOD 0 65535 MATRIX_DIM 5 1 1 SYMBOL_LINK "Rte_CalprmRom_CalRegn03Rt00GroupB_DEFAULT_RTE_CALPRM_GROUP.EotProtnEntrGainVehSpdTbl_Ary1D" 0 DISPLAY_IDENTIFIER AAACalRegn03Rt01GroupB_Dummy.CalibrationPorts.EotProtnEntrGainVehSpdTbl.Ary1D /end CHARACTERISTIC
/begin CHARACTERISTIC AAACalRegn03Rt01GroupB_Dummy.EotProtnEntrGainX.Ary2D "MICROSAR RTE" VAL_BLK 0x0 RTE_RL_UWORD 0 NO_COMPU_METHOD 0 65535 MATRIX_DIM 4 5 1 SYMBOL_LINK "Rte_CalprmRom_CalRegn03Rt00GroupB_DEFAULT_RTE_CALPRM_GROUP.EotProtnEntrGainX_Ary2D" 0 DISPLAY_IDENTIFIER AAACalRegn03Rt01GroupB_Dummy.CalibrationPorts.EotProtnEntrGainX.Ary2D /end CHARACTERISTIC
/begin CHARACTERISTIC AAACalRegn03Rt01GroupB_Dummy.EotProtnEntrGainY.Ary2D "MICROSAR RTE" VAL_BLK 0x0 RTE_RL_UWORD 0 NO_COMPU_METHOD 0 65535 MATRIX_DIM 4 5 1 SYMBOL_LINK "Rte_CalprmRom_CalRegn03Rt00GroupB_DEFAULT_RTE_CALPRM_GROUP.EotProtnEntrGainY_Ary2D" 0 DISPLAY_IDENTIFIER AAACalRegn03Rt01GroupB_Dummy.CalibrationPorts.EotProtnEntrGainY.Ary2D /end CHARACTERISTIC
/begin CHARACTERISTIC AAACalRegn03Rt01GroupB_Dummy.EotProtnExitDampgY.Ary2D "MICROSAR RTE" VAL_BLK 0x0 RTE_RL_UWORD 0 NO_COMPU_METHOD 0 65535 MATRIX_DIM 2 4 1 SYMBOL_LINK "Rte_CalprmRom_CalRegn03Rt00GroupB_DEFAULT_RTE_CALPRM_GROUP.EotProtnExitDampgY_Ary2D" 0 DISPLAY_IDENTIFIER AAACalRegn03Rt01GroupB_Dummy.CalibrationPorts.EotProtnExitDampgY.Ary2D /end CHARACTERISTIC
/begin CHARACTERISTIC AAACalRegn03Rt01GroupB_Dummy.EotProtnHwDegDampgX.Ary2D "MICROSAR RTE" VAL_BLK 0x0 RTE_RL_UWORD 0 NO_COMPU_METHOD 0 65535 MATRIX_DIM 2 4 1 SYMBOL_LINK "Rte_CalprmRom_CalRegn03Rt00GroupB_DEFAULT_RTE_CALPRM_GROUP.EotProtnHwDegDampgX_Ary2D" 0 DISPLAY_IDENTIFIER AAACalRegn03Rt01GroupB_Dummy.CalibrationPorts.EotProtnHwDegDampgX.Ary2D /end CHARACTERISTIC
/begin CHARACTERISTIC AAACalRegn03Rt01GroupB_Dummy.EotProtnNormDampgY.Ary2D "MICROSAR RTE" VAL_BLK 0x0 RTE_RL_UWORD 0 NO_COMPU_METHOD 0 65535 MATRIX_DIM 2 4 1 SYMBOL_LINK "Rte_CalprmRom_CalRegn03Rt00GroupB_DEFAULT_RTE_CALPRM_GROUP.EotProtnNormDampgY_Ary2D" 0 DISPLAY_IDENTIFIER AAACalRegn03Rt01GroupB_Dummy.CalibrationPorts.EotProtnNormDampgY.Ary2D /end CHARACTERISTIC
/begin CHARACTERISTIC AAACalRegn03Rt01GroupB_Dummy.InertiaCmpVelAssiBasdDampgRollgWhlImbRejctnOnY.Ary1D "MICROSAR RTE" VAL_BLK 0x0 RTE_RL_UWORD 0 NO_COMPU_METHOD 0 65535 MATRIX_DIM 10 1 1 SYMBOL_LINK "Rte_CalprmRom_CalRegn03Rt00GroupB_DEFAULT_RTE_CALPRM_GROUP.InertiaCmpVelAssiBasdDampgRollgWhlImbRejctnOnY_Ary1D" 0 DISPLAY_IDENTIFIER AAACalRegn03Rt01GroupB_Dummy.CalibrationPorts.InertiaCmpVelAssiBasdDampgRollgWhlImbRejctnOnY.Ary1D /end CHARACTERISTIC
/begin CHARACTERISTIC AAACalRegn03Rt01GroupB_Dummy_1.AssiHiFrqTqWhlImbRejctnTqX.Ary2D "MICROSAR RTE" VAL_BLK 0x0 RTE_RL_UWORD 0 NO_COMPU_METHOD 0 65535 MATRIX_DIM 13 12 1 SYMBOL_LINK "Rte_CalprmRom_CalRegn03Rt01GroupB_DEFAULT_RTE_CALPRM_GROUP.AssiHiFrqTqWhlImbRejctnTqX_Ary2D" 0 DISPLAY_IDENTIFIER AAACalRegn03Rt01GroupB_Dummy_1.CalibrationPorts.AssiHiFrqTqWhlImbRejctnTqX.Ary2D /end CHARACTERISTIC
/begin CHARACTERISTIC AAACalRegn03Rt01GroupB_Dummy_1.AssiHiFrqWhlImbRejctnBlndX.Ary2D "MICROSAR RTE" VAL_BLK 0x0 RTE_RL_UWORD 0 NO_COMPU_METHOD 0 65535 MATRIX_DIM 5 12 1 SYMBOL_LINK "Rte_CalprmRom_CalRegn03Rt01GroupB_DEFAULT_RTE_CALPRM_GROUP.AssiHiFrqWhlImbRejctnBlndX_Ary2D" 0 DISPLAY_IDENTIFIER AAACalRegn03Rt01GroupB_Dummy_1.CalibrationPorts.AssiHiFrqWhlImbRejctnBlndX.Ary2D /end CHARACTERISTIC
/begin CHARACTERISTIC AAACalRegn03Rt01GroupB_Dummy_1.AssiHiFrqWhlImbRejctnBlndY.Ary2D "MICROSAR RTE" VAL_BLK 0x0 RTE_RL_UWORD 0 NO_COMPU_METHOD 0 65535 MATRIX_DIM 5 12 1 SYMBOL_LINK "Rte_CalprmRom_CalRegn03Rt01GroupB_DEFAULT_RTE_CALPRM_GROUP.AssiHiFrqWhlImbRejctnBlndY_Ary2D" 0 DISPLAY_IDENTIFIER AAACalRegn03Rt01GroupB_Dummy_1.CalibrationPorts.AssiHiFrqWhlImbRejctnBlndY.Ary2D /end CHARACTERISTIC
/begin CHARACTERISTIC AAACalRegn03Rt01GroupB_Dummy_1.AssiHiFrqWhlImbRejctnGainY.Ary2D "MICROSAR RTE" VAL_BLK 0x0 RTE_RL_UWORD 0 NO_COMPU_METHOD 0 65535 MATRIX_DIM 13 12 1 SYMBOL_LINK "Rte_CalprmRom_CalRegn03Rt01GroupB_DEFAULT_RTE_CALPRM_GROUP.AssiHiFrqWhlImbRejctnGainY_Ary2D" 0 DISPLAY_IDENTIFIER AAACalRegn03Rt01GroupB_Dummy_1.CalibrationPorts.AssiHiFrqWhlImbRejctnGainY.Ary2D /end CHARACTERISTIC
/begin CHARACTERISTIC AAACalRegn03Rt01GroupB_Dummy_1.AssiMotTqWhlImbRejctnMaxX.Ary2D "MICROSAR RTE" VAL_BLK 0x0 RTE_RL_UWORD 0 NO_COMPU_METHOD 0 65535 MATRIX_DIM 20 12 1 SYMBOL_LINK "Rte_CalprmRom_CalRegn03Rt01GroupB_DEFAULT_RTE_CALPRM_GROUP.AssiMotTqWhlImbRejctnMaxX_Ary2D" 0 DISPLAY_IDENTIFIER AAACalRegn03Rt01GroupB_Dummy_1.CalibrationPorts.AssiMotTqWhlImbRejctnMaxX.Ary2D /end CHARACTERISTIC
/begin CHARACTERISTIC AAACalRegn03Rt01GroupB_Dummy_1.AssiMotTqWhlImbRejctnMaxY.Ary2D "MICROSAR RTE" VAL_BLK 0x0 RTE_RL_SWORD 0 NO_COMPU_METHOD -32768 32767 MATRIX_DIM 20 12 1 SYMBOL_LINK "Rte_CalprmRom_CalRegn03Rt01GroupB_DEFAULT_RTE_CALPRM_GROUP.AssiMotTqWhlImbRejctnMaxY_Ary2D" 0 DISPLAY_IDENTIFIER AAACalRegn03Rt01GroupB_Dummy_1.CalibrationPorts.AssiMotTqWhlImbRejctnMaxY.Ary2D /end CHARACTERISTIC
/begin CHARACTERISTIC AAACalRegn03Rt01GroupB_Dummy_1.AssiWhlImbRejctnBlndScaX.Ary2D "MICROSAR RTE" VAL_BLK 0x0 RTE_RL_UWORD 0 NO_COMPU_METHOD 0 65535 MATRIX_DIM 5 12 1 SYMBOL_LINK "Rte_CalprmRom_CalRegn03Rt01GroupB_DEFAULT_RTE_CALPRM_GROUP.AssiWhlImbRejctnBlndScaX_Ary2D" 0 DISPLAY_IDENTIFIER AAACalRegn03Rt01GroupB_Dummy_1.CalibrationPorts.AssiWhlImbRejctnBlndScaX.Ary2D /end CHARACTERISTIC
/begin CHARACTERISTIC AAACalRegn03Rt01GroupB_Dummy_1.AssiWhlImbRejctnBlndScaY.Ary2D "MICROSAR RTE" VAL_BLK 0x0 RTE_RL_UWORD 0 NO_COMPU_METHOD 0 65535 MATRIX_DIM 5 12 1 SYMBOL_LINK "Rte_CalprmRom_CalRegn03Rt01GroupB_DEFAULT_RTE_CALPRM_GROUP.AssiWhlImbRejctnBlndScaY_Ary2D" 0 DISPLAY_IDENTIFIER AAACalRegn03Rt01GroupB_Dummy_1.CalibrationPorts.AssiWhlImbRejctnBlndScaY.Ary2D /end CHARACTERISTIC
/begin CHARACTERISTIC AAACalRegn03Rt01GroupB_Dummy_1.EotProtnDampgVehSpdTbl.Ary1D "MICROSAR RTE" VAL_BLK 0x0 RTE_RL_UWORD 0 NO_COMPU_METHOD 0 65535 MATRIX_DIM 4 1 1 SYMBOL_LINK "Rte_CalprmRom_CalRegn03Rt01GroupB_DEFAULT_RTE_CALPRM_GROUP.EotProtnDampgVehSpdTbl_Ary1D" 0 DISPLAY_IDENTIFIER AAACalRegn03Rt01GroupB_Dummy_1.CalibrationPorts.EotProtnDampgVehSpdTbl.Ary1D /end CHARACTERISTIC
/begin CHARACTERISTIC AAACalRegn03Rt01GroupB_Dummy_1.EotProtnEntrGainVehSpdTbl.Ary1D "MICROSAR RTE" VAL_BLK 0x0 RTE_RL_UWORD 0 NO_COMPU_METHOD 0 65535 MATRIX_DIM 5 1 1 SYMBOL_LINK "Rte_CalprmRom_CalRegn03Rt01GroupB_DEFAULT_RTE_CALPRM_GROUP.EotProtnEntrGainVehSpdTbl_Ary1D" 0 DISPLAY_IDENTIFIER AAACalRegn03Rt01GroupB_Dummy_1.CalibrationPorts.EotProtnEntrGainVehSpdTbl.Ary1D /end CHARACTERISTIC
/begin CHARACTERISTIC AAACalRegn03Rt01GroupB_Dummy_1.EotProtnEntrGainX.Ary2D "MICROSAR RTE" VAL_BLK 0x0 RTE_RL_UWORD 0 NO_COMPU_METHOD 0 65535 MATRIX_DIM 4 5 1 SYMBOL_LINK "Rte_CalprmRom_CalRegn03Rt01GroupB_DEFAULT_RTE_CALPRM_GROUP.EotProtnEntrGainX_Ary2D" 0 DISPLAY_IDENTIFIER AAACalRegn03Rt01GroupB_Dummy_1.CalibrationPorts.EotProtnEntrGainX.Ary2D /end CHARACTERISTIC
/**********************************************************************************************************************
* GROUP
*********************************************************************************************************************/
/begin GROUP AAACalRegn01Rt01_Dummy "MICROSAR RTE" /begin SUB_GROUP AAACalRegn01Rt01_Dummy.CalibrationPorts /end SUB_GROUP /begin FUNCTION_LIST /end FUNCTION_LIST /begin REF_CHARACTERISTIC /end REF_CHARACTERISTIC /begin REF_MEASUREMENT /end REF_MEASUREMENT /end GROUP
/begin GROUP AAACalRegn01Rt01_Dummy.CalibrationPorts "MICROSAR RTE"
 /begin SUB_GROUP AAACalRegn01Rt01_Dummy.TEstimnMagAmbMplr.Val AAACalRegn01Rt01_Dummy.TunSelnAuthyHwTqY.Ary1D AAACalRegn01Rt01_Dummy.TunSelnAuthyHwVelY.Ary1D /end SUB_GROUP
 /begin FUNCTION_LIST /end FUNCTION_LIST
 /begin REF_CHARACTERISTIC /end REF_CHARACTERISTIC
 /begin REF_MEASUREMENT /end REF_MEASUREMENT
/end GROUP
/begin GROUP AAACalRegn01Rt01_Dummy.TEstimnMagAmbMplr.Val "MICROSAR RTE" /begin SUB_GROUP /end SUB_GROUP /begin FUNCTION_LIST /end FUNCTION_LIST /begin REF_CHARACTERISTIC AAACalRegn01Rt01_Dummy.TEstimnMagAmbMplr.Val /end REF_CHARACTERISTIC /begin REF_MEASUREMENT /end REF_MEASUREMENT /end GROUP
/begin GROUP AAACalRegn01Rt01_Dummy.TunSelnAuthyHwTqY.Ary1D "MICROSAR RTE" /begin SUB_GROUP /end SUB_GROUP /begin FUNCTION_LIST /end FUNCTION_LIST /begin REF_CHARACTERISTIC AAACalRegn01Rt01_Dummy.TunSelnAuthyHwTqY.Ary1D /end REF_CHARACTERISTIC /begin REF_MEASUREMENT /end REF_MEASUREMENT /end GROUP
/begin GROUP AAACalRegn01Rt01_Dummy.TunSelnAuthyHwVelY.Ary1D "MICROSAR RTE" /begin SUB_GROUP /end SUB_GROUP /begin FUNCTION_LIST /end FUNCTION_LIST /begin REF_CHARACTERISTIC AAACalRegn01Rt01_Dummy.TunSelnAuthyHwVelY.Ary1D /end REF_CHARACTERISTIC /begin REF_MEASUREMENT /end REF_MEASUREMENT /end GROUP
/begin GROUP AAACalRegn01Rt01_Dummy_1 "MICROSAR RTE" /begin SUB_GROUP AAACalRegn01Rt01_Dummy_1.CalibrationPorts /end SUB_GROUP /begin FUNCTION_LIST /end FUNCTION_LIST /begin REF_CHARACTERISTIC /end REF_CHARACTERISTIC /begin REF_MEASUREMENT /end REF_MEASUREMENT /end GROUP
/begin GROUP AAACalRegn01Rt01_Dummy_1.CalibrationPorts "MICROSAR RTE"
 /begin SUB_GROUP AAACalRegn01Rt01_Dummy_1.TEstimnMagAmbMplr.Val AAACalRegn01Rt01_Dummy_1.TunSelnAuthyHwTqY.Ary1D AAACalRegn01Rt01_Dummy_1.TunSelnAuthyHwVelY.Ary1D /end SUB_GROUP
 /begin FUNCTION_LIST /end FUNCTION_LIST
 /begin REF_CHARACTERISTIC /end REF_CHARACTERISTIC
 /begin REF_MEASUREMENT /end REF_MEASUREMENT
/end GROUP
/begin GROUP AAACalRegn01Rt01_Dummy_1.TEstimnMagAmbMplr.Val "MICROSAR RTE" /begin SUB_GROUP /end SUB_GROUP /begin FUNCTION_LIST /end FUNCTION_LIST /begin REF_CHARACTERISTIC AAACalRegn01Rt01_Dummy_1.TEstimnMagAmbMplr.Val /end REF_CHARACTERISTIC /begin REF_MEASUREMENT /end REF_MEASUREMENT /end GROUP
/begin GROUP AAACalRegn01Rt01_Dummy_1.TunSelnAuthyHwTqY.Ary1D "MICROSAR RTE" /begin SUB_GROUP /end SUB_GROUP /begin FUNCTION_LIST /end FUNCTION_LIST /begin REF_CHARACTERISTIC AAACalRegn01Rt01_Dummy_1.TunSelnAuthyHwTqY.Ary1D /end REF_CHARACTERISTIC /begin REF_MEASUREMENT /end REF_MEASUREMENT /end GROUP
/begin GROUP AAACalRegn01Rt01_Dummy_1.TunSelnAuthyHwVelY.Ary1D "MICROSAR RTE" /begin SUB_GROUP /end SUB_GROUP /begin FUNCTION_LIST /end FUNCTION_LIST /begin REF_CHARACTERISTIC AAACalRegn01Rt01_Dummy_1.TunSelnAuthyHwVelY.Ary1D /end REF_CHARACTERISTIC /begin REF_MEASUREMENT /end REF_MEASUREMENT /end GROUP
/begin GROUP AAACalRegn01Rt01_Dummy_2 "MICROSAR RTE" /begin SUB_GROUP AAACalRegn01Rt01_Dummy_2.CalibrationPorts /end SUB_GROUP /begin FUNCTION_LIST /end FUNCTION_LIST /begin REF_CHARACTERISTIC /end REF_CHARACTERISTIC /begin REF_MEASUREMENT /end REF_MEASUREMENT /end GROUP
/begin GROUP AAACalRegn01Rt01_Dummy_2.CalibrationPorts "MICROSAR RTE"
 /begin SUB_GROUP AAACalRegn01Rt01_Dummy_2.TEstimnMagAmbMplr.Val AAACalRegn01Rt01_Dummy_2.TunSelnAuthyHwTqY.Ary1D AAACalRegn01Rt01_Dummy_2.TunSelnAuthyHwVelY.Ary1D /end SUB_GROUP
 /begin FUNCTION_LIST /end FUNCTION_LIST
 /begin REF_CHARACTERISTIC /end REF_CHARACTERISTIC
 /begin REF_MEASUREMENT /end REF_MEASUREMENT
/end GROUP
/begin GROUP AAACalRegn01Rt01_Dummy_2.TEstimnMagAmbMplr.Val "MICROSAR RTE" /begin SUB_GROUP /end SUB_GROUP /begin FUNCTION_LIST /end FUNCTION_LIST /begin REF_CHARACTERISTIC AAACalRegn01Rt01_Dummy_2.TEstimnMagAmbMplr.Val /end REF_CHARACTERISTIC /begin REF_MEASUREMENT /end REF_MEASUREMENT /end GROUP
/begin GROUP AAACalRegn01Rt01_Dummy_2.TunSelnAuthyHwTqY.Ary1D "MICROSAR RTE" /begin SUB_GROUP /end SUB_GROUP /begin FUNCTION_LIST /end FUNCTION_LIST /begin REF_CHARACTERISTIC AAACalRegn01Rt01_Dummy_2.TunSelnAuthyHwTqY.Ary1D /end REF_CHARACTERISTIC /begin REF_MEASUREMENT /end REF_MEASUREMENT /end GROUP
/begin GROUP AAACalRegn01Rt01_Dummy_2.TunSelnAuthyHwVelY.Ary1D "MICROSAR RTE" /begin SUB_GROUP /end SUB_GROUP /begin FUNCTION_LIST /end FUNCTION_LIST /begin REF_CHARACTERISTIC AAACalRegn01Rt01_Dummy_2.TunSelnAuthyHwVelY.Ary1D /end REF_CHARACTERISTIC /begin REF_MEASUREMENT /end REF_MEASUREMENT /end GROUP
/begin GROUP AAACalRegn01Rt01_Dummy_3 "MICROSAR RTE" /begin SUB_GROUP AAACalRegn01Rt01_Dummy_3.CalibrationPorts /end SUB_GROUP /begin FUNCTION_LIST /end FUNCTION_LIST /begin REF_CHARACTERISTIC /end REF_CHARACTERISTIC /begin REF_MEASUREMENT /end REF_MEASUREMENT /end GROUP
/begin GROUP AAACalRegn01Rt01_Dummy_3.CalibrationPorts "MICROSAR RTE"
 /begin SUB_GROUP AAACalRegn01Rt01_Dummy_3.TEstimnMagAmbMplr.Val AAACalRegn01Rt01_Dummy_3.TunSelnAuthyHwTqY.Ary1D AAACalRegn01Rt01_Dummy_3.TunSelnAuthyHwVelY.Ary1D /end SUB_GROUP
 /begin FUNCTION_LIST /end FUNCTION_LIST
 /begin REF_CHARACTERISTIC /end REF_CHARACTERISTIC
 /begin REF_MEASUREMENT /end REF_MEASUREMENT
/end GROUP
/begin GROUP AAACalRegn01Rt01_Dummy_3.TEstimnMagAmbMplr.Val "MICROSAR RTE" /begin SUB_GROUP /end SUB_GROUP /begin FUNCTION_LIST /end FUNCTION_LIST /begin REF_CHARACTERISTIC AAACalRegn01Rt01_Dummy_3.TEstimnMagAmbMplr.Val /end REF_CHARACTERISTIC /begin REF_MEASUREMENT /end REF_MEASUREMENT /end GROUP
/begin GROUP AAACalRegn01Rt01_Dummy_3.TunSelnAuthyHwTqY.Ary1D "MICROSAR RTE" /begin SUB_GROUP /end SUB_GROUP /begin FUNCTION_LIST /end FUNCTION_LIST /begin REF_CHARACTERISTIC AAACalRegn01Rt01_Dummy_3.TunSelnAuthyHwTqY.Ary1D /end REF_CHARACTERISTIC /begin REF_MEASUREMENT /end REF_MEASUREMENT /end GROUP
/begin GROUP AAACalRegn01Rt01_Dummy_3.TunSelnAuthyHwVelY.Ary1D "MICROSAR RTE" /begin SUB_GROUP /end SUB_GROUP /begin FUNCTION_LIST /end FUNCTION_LIST /begin REF_CHARACTERISTIC AAACalRegn01Rt01_Dummy_3.TunSelnAuthyHwVelY.Ary1D /end REF_CHARACTERISTIC /begin REF_MEASUREMENT /end REF_MEASUREMENT /end GROUP
/begin GROUP AAACalRegn01Rt01_Dummy_4 "MICROSAR RTE" /begin SUB_GROUP AAACalRegn01Rt01_Dummy_4.CalibrationPorts /end SUB_GROUP /begin FUNCTION_LIST /end FUNCTION_LIST /begin REF_CHARACTERISTIC /end REF_CHARACTERISTIC /begin REF_MEASUREMENT /end REF_MEASUREMENT /end GROUP
/begin GROUP AAACalRegn01Rt01_Dummy_4.CalibrationPorts "MICROSAR RTE"
 /begin SUB_GROUP AAACalRegn01Rt01_Dummy_4.TEstimnMagAmbMplr.Val AAACalRegn01Rt01_Dummy_4.TunSelnAuthyHwTqY.Ary1D AAACalRegn01Rt01_Dummy_4.TunSelnAuthyHwVelY.Ary1D /end SUB_GROUP
 /begin FUNCTION_LIST /end FUNCTION_LIST
 /begin REF_CHARACTERISTIC /end REF_CHARACTERISTIC
 /begin REF_MEASUREMENT /end REF_MEASUREMENT
/end GROUP
/begin GROUP AAACalRegn01Rt01_Dummy_4.TEstimnMagAmbMplr.Val "MICROSAR RTE" /begin SUB_GROUP /end SUB_GROUP /begin FUNCTION_LIST /end FUNCTION_LIST /begin REF_CHARACTERISTIC AAACalRegn01Rt01_Dummy_4.TEstimnMagAmbMplr.Val /end REF_CHARACTERISTIC /begin REF_MEASUREMENT /end REF_MEASUREMENT /end GROUP
/begin GROUP AAACalRegn01Rt01_Dummy_4.TunSelnAuthyHwTqY.Ary1D "MICROSAR RTE" /begin SUB_GROUP /end SUB_GROUP /begin FUNCTION_LIST /end FUNCTION_LIST /begin REF_CHARACTERISTIC AAACalRegn01Rt01_Dummy_4.TunSelnAuthyHwTqY.Ary1D /end REF_CHARACTERISTIC /begin REF_MEASUREMENT /end REF_MEASUREMENT /end GROUP
/begin GROUP AAACalRegn01Rt01_Dummy_4.TunSelnAuthyHwVelY.Ary1D "MICROSAR RTE" /begin SUB_GROUP /end SUB_GROUP /begin FUNCTION_LIST /end FUNCTION_LIST /begin REF_CHARACTERISTIC AAACalRegn01Rt01_Dummy_4.TunSelnAuthyHwVelY.Ary1D /end REF_CHARACTERISTIC /begin REF_MEASUREMENT /end REF_MEASUREMENT /end GROUP
/begin GROUP AAACalRegn02Rt01GroupC_Dummy "MICROSAR RTE" /begin SUB_GROUP AAACalRegn02Rt01GroupC_Dummy.CalibrationPorts /end SUB_GROUP /begin FUNCTION_LIST /end FUNCTION_LIST /begin REF_CHARACTERISTIC /end REF_CHARACTERISTIC /begin REF_MEASUREMENT /end REF_MEASUREMENT /end GROUP
/begin GROUP AAACalRegn02Rt01GroupC_Dummy.CalibrationPorts "MICROSAR RTE"
 /begin SUB_GROUP AAACalRegn02Rt01GroupC_Dummy.GmOvrlStMgrHwAgTarLimr.Val AAACalRegn02Rt01GroupC_Dummy.GmOvrlStMgrShiftLvrTiThd.Val AAACalRegn02Rt01GroupC_Dummy.GmOvrlStMgrStandStillThd.Val AAACalRegn02Rt01GroupC_Dummy.GmOvrlStMgrStandStillTiThd.Val AAACalRegn02Rt01GroupC_Dummy.GmTqArbnApaDiRateY.Ary1D AAACalRegn02Rt01GroupC_Dummy.GmTqArbnApaEnaRate.Val AAACalRegn02Rt01GroupC_Dummy.GmTqArbnApaSmotngHwTqLpFilFrq.Val AAACalRegn02Rt01GroupC_Dummy.GmTqArbnApaSmotngX.Ary1D AAACalRegn02Rt01GroupC_Dummy.GmTqArbnApaSmotngY.Ary1D AAACalRegn02Rt01GroupC_Dummy.GmTqArbnLkaOutpOvrlX.Ary2D AAACalRegn02Rt01GroupC_Dummy.GmTqArbnLkaOutpOvrlY.Ary2D AAACalRegn02Rt01GroupC_Dummy.GmTqArbnLkaSlewX.Ary1D AAACalRegn02Rt01GroupC_Dummy.GmTqArbnLkaSlewY.Ary1D /end SUB_GROUP
 /begin FUNCTION_LIST /end FUNCTION_LIST
 /begin REF_CHARACTERISTIC /end REF_CHARACTERISTIC
 /begin REF_MEASUREMENT /end REF_MEASUREMENT
/end GROUP
/begin GROUP AAACalRegn02Rt01GroupC_Dummy.GmOvrlStMgrHwAgTarLimr.Val "MICROSAR RTE" /begin SUB_GROUP /end SUB_GROUP /begin FUNCTION_LIST /end FUNCTION_LIST /begin REF_CHARACTERISTIC AAACalRegn02Rt01GroupC_Dummy.GmOvrlStMgrHwAgTarLimr.Val /end REF_CHARACTERISTIC /begin REF_MEASUREMENT /end REF_MEASUREMENT /end GROUP
/begin GROUP AAACalRegn02Rt01GroupC_Dummy.GmOvrlStMgrShiftLvrTiThd.Val "MICROSAR RTE" /begin SUB_GROUP /end SUB_GROUP /begin FUNCTION_LIST /end FUNCTION_LIST /begin REF_CHARACTERISTIC AAACalRegn02Rt01GroupC_Dummy.GmOvrlStMgrShiftLvrTiThd.Val /end REF_CHARACTERISTIC /begin REF_MEASUREMENT /end REF_MEASUREMENT /end GROUP
/begin GROUP AAACalRegn02Rt01GroupC_Dummy.GmOvrlStMgrStandStillThd.Val "MICROSAR RTE" /begin SUB_GROUP /end SUB_GROUP /begin FUNCTION_LIST /end FUNCTION_LIST /begin REF_CHARACTERISTIC AAACalRegn02Rt01GroupC_Dummy.GmOvrlStMgrStandStillThd.Val /end REF_CHARACTERISTIC /begin REF_MEASUREMENT /end REF_MEASUREMENT /end GROUP
/begin GROUP AAACalRegn02Rt01GroupC_Dummy.GmOvrlStMgrStandStillTiThd.Val "MICROSAR RTE" /begin SUB_GROUP /end SUB_GROUP /begin FUNCTION_LIST /end FUNCTION_LIST
 /begin REF_CHARACTERISTIC AAACalRegn02Rt01GroupC_Dummy.GmOvrlStMgrStandStillTiThd.Val /end REF_CHARACTERISTIC
 /begin REF_MEASUREMENT /end REF_MEASUREMENT
/end GROUP
/begin GROUP AAACalRegn02Rt01GroupC_Dummy.GmTqArbnApaDiRateY.Ary1D "MICROSAR RTE" /begin SUB_GROUP /end SUB_GROUP /begin FUNCTION_LIST /end FUNCTION_LIST /begin REF_CHARACTERISTIC AAACalRegn02Rt01GroupC_Dummy.GmTqArbnApaDiRateY.Ary1D /end REF_CHARACTERISTIC /begin REF_MEASUREMENT /end REF_MEASUREMENT /end GROUP
/begin GROUP AAACalRegn02Rt01GroupC_Dummy.GmTqArbnApaEnaRate.Val "MICROSAR RTE" /begin SUB_GROUP /end SUB_GROUP /begin FUNCTION_LIST /end FUNCTION_LIST /begin REF_CHARACTERISTIC AAACalRegn02Rt01GroupC_Dummy.GmTqArbnApaEnaRate.Val /end REF_CHARACTERISTIC /begin REF_MEASUREMENT /end REF_MEASUREMENT /end GROUP
/begin GROUP AAACalRegn02Rt01GroupC_Dummy.GmTqArbnApaSmotngHwTqLpFilFrq.Val "MICROSAR RTE" /begin SUB_GROUP /end SUB_GROUP /begin FUNCTION_LIST /end FUNCTION_LIST
 /begin REF_CHARACTERISTIC AAACalRegn02Rt01GroupC_Dummy.GmTqArbnApaSmotngHwTqLpFilFrq.Val /end REF_CHARACTERISTIC
 /begin REF_MEASUREMENT /end REF_MEASUREMENT
/end GROUP
/begin GROUP AAACalRegn02Rt01GroupC_Dummy.GmTqArbnApaSmotngX.Ary1D "MICROSAR RTE" /begin SUB_GROUP /end SUB_GROUP /begin FUNCTION_LIST /end FUNCTION_LIST /begin REF_CHARACTERISTIC AAACalRegn02Rt01GroupC_Dummy.GmTqArbnApaSmotngX.Ary1D /end REF_CHARACTERISTIC /begin REF_MEASUREMENT /end REF_MEASUREMENT /end GROUP
/begin GROUP AAACalRegn02Rt01GroupC_Dummy.GmTqArbnApaSmotngY.Ary1D "MICROSAR RTE" /begin SUB_GROUP /end SUB_GROUP /begin FUNCTION_LIST /end FUNCTION_LIST /begin REF_CHARACTERISTIC AAACalRegn02Rt01GroupC_Dummy.GmTqArbnApaSmotngY.Ary1D /end REF_CHARACTERISTIC /begin REF_MEASUREMENT /end REF_MEASUREMENT /end GROUP
/begin GROUP AAACalRegn02Rt01GroupC_Dummy.GmTqArbnLkaOutpOvrlX.Ary2D "MICROSAR RTE" /begin SUB_GROUP /end SUB_GROUP /begin FUNCTION_LIST /end FUNCTION_LIST /begin REF_CHARACTERISTIC AAACalRegn02Rt01GroupC_Dummy.GmTqArbnLkaOutpOvrlX.Ary2D /end REF_CHARACTERISTIC /begin REF_MEASUREMENT /end REF_MEASUREMENT /end GROUP
/begin GROUP AAACalRegn02Rt01GroupC_Dummy.GmTqArbnLkaOutpOvrlY.Ary2D "MICROSAR RTE" /begin SUB_GROUP /end SUB_GROUP /begin FUNCTION_LIST /end FUNCTION_LIST /begin REF_CHARACTERISTIC AAACalRegn02Rt01GroupC_Dummy.GmTqArbnLkaOutpOvrlY.Ary2D /end REF_CHARACTERISTIC /begin REF_MEASUREMENT /end REF_MEASUREMENT /end GROUP
/begin GROUP AAACalRegn02Rt01GroupC_Dummy.GmTqArbnLkaSlewX.Ary1D "MICROSAR RTE" /begin SUB_GROUP /end SUB_GROUP /begin FUNCTION_LIST /end FUNCTION_LIST /begin REF_CHARACTERISTIC AAACalRegn02Rt01GroupC_Dummy.GmTqArbnLkaSlewX.Ary1D /end REF_CHARACTERISTIC /begin REF_MEASUREMENT /end REF_MEASUREMENT /end GROUP
/begin GROUP AAACalRegn02Rt01GroupC_Dummy.GmTqArbnLkaSlewY.Ary1D "MICROSAR RTE" /begin SUB_GROUP /end SUB_GROUP /begin FUNCTION_LIST /end FUNCTION_LIST /begin REF_CHARACTERISTIC AAACalRegn02Rt01GroupC_Dummy.GmTqArbnLkaSlewY.Ary1D /end REF_CHARACTERISTIC /begin REF_MEASUREMENT /end REF_MEASUREMENT /end GROUP
/begin GROUP AAACalRegn02Rt01GroupC_Dummy_1 "MICROSAR RTE" /begin SUB_GROUP AAACalRegn02Rt01GroupC_Dummy_1.CalibrationPorts /end SUB_GROUP /begin FUNCTION_LIST /end FUNCTION_LIST /begin REF_CHARACTERISTIC /end REF_CHARACTERISTIC /begin REF_MEASUREMENT /end REF_MEASUREMENT /end GROUP
/begin GROUP AAACalRegn02Rt01GroupC_Dummy_1.CalibrationPorts "MICROSAR RTE"
 /begin SUB_GROUP AAACalRegn02Rt01GroupC_Dummy_1.GmOvrlStMgrHwAgTarLimr.Val AAACalRegn02Rt01GroupC_Dummy_1.GmOvrlStMgrShiftLvrTiThd.Val AAACalRegn02Rt01GroupC_Dummy_1.GmOvrlStMgrStandStillThd.Val AAACalRegn02Rt01GroupC_Dummy_1.GmOvrlStMgrStandStillTiThd.Val AAACalRegn02Rt01GroupC_Dummy_1.GmTqArbnApaDiRateY.Ary1D AAACalRegn02Rt01GroupC_Dummy_1.GmTqArbnApaEnaRate.Val AAACalRegn02Rt01GroupC_Dummy_1.GmTqArbnApaSmotngHwTqLpFilFrq.Val AAACalRegn02Rt01GroupC_Dummy_1.GmTqArbnApaSmotngX.Ary1D AAACalRegn02Rt01GroupC_Dummy_1.GmTqArbnApaSmotngY.Ary1D AAACalRegn02Rt01GroupC_Dummy_1.GmTqArbnLkaOutpOvrlX.Ary2D AAACalRegn02Rt01GroupC_Dummy_1.GmTqArbnLkaOutpOvrlY.Ary2D AAACalRegn02Rt01GroupC_Dummy_1.GmTqArbnLkaSlewX.Ary1D AAACalRegn02Rt01GroupC_Dummy_1.GmTqArbnLkaSlewY.Ary1D /end SUB_GROUP
 /begin FUNCTION_LIST /end FUNCTION_LIST
 /begin REF_CHARACTERISTIC /end REF_CHARACTERISTIC
 /begin REF_MEASUREMENT /end REF_MEASUREMENT
/end GROUP
/begin GROUP AAACalRegn02Rt01GroupC_Dummy_1.GmOvrlStMgrHwAgTarLimr.Val "MICROSAR RTE" /begin SUB_GROUP /end SUB_GROUP /begin FUNCTION_LIST /end FUNCTION_LIST /begin REF_CHARACTERISTIC AAACalRegn02Rt01GroupC_Dummy_1.GmOvrlStMgrHwAgTarLimr.Val /end REF_CHARACTERISTIC /begin REF_MEASUREMENT /end REF_MEASUREMENT /end GROUP
/begin GROUP AAACalRegn02Rt01GroupC_Dummy_1.GmOvrlStMgrShiftLvrTiThd.Val "MICROSAR RTE" /begin SUB_GROUP /end SUB_GROUP /begin FUNCTION_LIST /end FUNCTION_LIST
 /begin REF_CHARACTERISTIC AAACalRegn02Rt01GroupC_Dummy_1.GmOvrlStMgrShiftLvrTiThd.Val /end REF_CHARACTERISTIC
 /begin REF_MEASUREMENT /end REF_MEASUREMENT
/end GROUP
/begin GROUP AAACalRegn02Rt01GroupC_Dummy_1.GmOvrlStMgrStandStillThd.Val "MICROSAR RTE" /begin SUB_GROUP /end SUB_GROUP /begin FUNCTION_LIST /end FUNCTION_LIST
 /begin REF_CHARACTERISTIC AAACalRegn02Rt01GroupC_Dummy_1.GmOvrlStMgrStandStillThd.Val /end REF_CHARACTERISTIC
 /begin REF_MEASUREMENT /end REF_MEASUREMENT
/end GROUP
/begin GROUP AAACalRegn02Rt01GroupC_Dummy_1.GmOvrlStMgrStandStillTiThd.Val "MICROSAR RTE" /begin SUB_GROUP /end SUB_GROUP /begin FUNCTION_LIST /end FUNCTION_LIST
 /begin REF_CHARACTERISTIC AAACalRegn02Rt01GroupC_Dummy_1.GmOvrlStMgrStandStillTiThd.Val /end REF_CHARACTERISTIC
 /begin REF_MEASUREMENT /end REF_MEASUREMENT
/end GROUP
/begin GROUP AAACalRegn02Rt01GroupC_Dummy_1.GmTqArbnApaDiRateY.Ary1D "MICROSAR RTE" /begin SUB_GROUP /end SUB_GROUP /begin FUNCTION_LIST /end FUNCTION_LIST /begin REF_CHARACTERISTIC AAACalRegn02Rt01GroupC_Dummy_1.GmTqArbnApaDiRateY.Ary1D /end REF_CHARACTERISTIC /begin REF_MEASUREMENT /end REF_MEASUREMENT /end GROUP
/begin GROUP AAACalRegn02Rt01GroupC_Dummy_1.GmTqArbnApaEnaRate.Val "MICROSAR RTE" /begin SUB_GROUP /end SUB_GROUP /begin FUNCTION_LIST /end FUNCTION_LIST /begin REF_CHARACTERISTIC AAACalRegn02Rt01GroupC_Dummy_1.GmTqArbnApaEnaRate.Val /end REF_CHARACTERISTIC /begin REF_MEASUREMENT /end REF_MEASUREMENT /end GROUP
/begin GROUP AAACalRegn02Rt01GroupC_Dummy_1.GmTqArbnApaSmotngHwTqLpFilFrq.Val "MICROSAR RTE" /begin SUB_GROUP /end SUB_GROUP /begin FUNCTION_LIST /end FUNCTION_LIST
 /begin REF_CHARACTERISTIC AAACalRegn02Rt01GroupC_Dummy_1.GmTqArbnApaSmotngHwTqLpFilFrq.Val /end REF_CHARACTERISTIC
 /begin REF_MEASUREMENT /end REF_MEASUREMENT
/end GROUP
/begin GROUP AAACalRegn02Rt01GroupC_Dummy_1.GmTqArbnApaSmotngX.Ary1D "MICROSAR RTE" /begin SUB_GROUP /end SUB_GROUP /begin FUNCTION_LIST /end FUNCTION_LIST /begin REF_CHARACTERISTIC AAACalRegn02Rt01GroupC_Dummy_1.GmTqArbnApaSmotngX.Ary1D /end REF_CHARACTERISTIC /begin REF_MEASUREMENT /end REF_MEASUREMENT /end GROUP
/begin GROUP AAACalRegn02Rt01GroupC_Dummy_1.GmTqArbnApaSmotngY.Ary1D "MICROSAR RTE" /begin SUB_GROUP /end SUB_GROUP /begin FUNCTION_LIST /end FUNCTION_LIST /begin REF_CHARACTERISTIC AAACalRegn02Rt01GroupC_Dummy_1.GmTqArbnApaSmotngY.Ary1D /end REF_CHARACTERISTIC /begin REF_MEASUREMENT /end REF_MEASUREMENT /end GROUP
/begin GROUP AAACalRegn02Rt01GroupC_Dummy_1.GmTqArbnLkaOutpOvrlX.Ary2D "MICROSAR RTE" /begin SUB_GROUP /end SUB_GROUP /begin FUNCTION_LIST /end FUNCTION_LIST /begin REF_CHARACTERISTIC AAACalRegn02Rt01GroupC_Dummy_1.GmTqArbnLkaOutpOvrlX.Ary2D /end REF_CHARACTERISTIC /begin REF_MEASUREMENT /end REF_MEASUREMENT /end GROUP
/begin GROUP AAACalRegn02Rt01GroupC_Dummy_1.GmTqArbnLkaOutpOvrlY.Ary2D "MICROSAR RTE" /begin SUB_GROUP /end SUB_GROUP /begin FUNCTION_LIST /end FUNCTION_LIST /begin REF_CHARACTERISTIC AAACalRegn02Rt01GroupC_Dummy_1.GmTqArbnLkaOutpOvrlY.Ary2D /end REF_CHARACTERISTIC /begin REF_MEASUREMENT /end REF_MEASUREMENT /end GROUP
/begin GROUP AAACalRegn02Rt01GroupC_Dummy_1.GmTqArbnLkaSlewX.Ary1D "MICROSAR RTE" /begin SUB_GROUP /end SUB_GROUP /begin FUNCTION_LIST /end FUNCTION_LIST /begin REF_CHARACTERISTIC AAACalRegn02Rt01GroupC_Dummy_1.GmTqArbnLkaSlewX.Ary1D /end REF_CHARACTERISTIC /begin REF_MEASUREMENT /end REF_MEASUREMENT /end GROUP
/begin GROUP AAACalRegn02Rt01GroupC_Dummy_1.GmTqArbnLkaSlewY.Ary1D "MICROSAR RTE" /begin SUB_GROUP /end SUB_GROUP /begin FUNCTION_LIST /end FUNCTION_LIST /begin REF_CHARACTERISTIC AAACalRegn02Rt01GroupC_Dummy_1.GmTqArbnLkaSlewY.Ary1D /end REF_CHARACTERISTIC /begin REF_MEASUREMENT /end REF_MEASUREMENT /end GROUP
/begin GROUP AAACalRegn02Rt01GroupC_Dummy_2 "MICROSAR RTE" /begin SUB_GROUP AAACalRegn02Rt01GroupC_Dummy_2.CalibrationPorts /end SUB_GROUP /begin FUNCTION_LIST /end FUNCTION_LIST /begin REF_CHARACTERISTIC /end REF_CHARACTERISTIC /begin REF_MEASUREMENT /end REF_MEASUREMENT /end GROUP
/begin GROUP AAACalRegn02Rt01GroupC_Dummy_2.CalibrationPorts "MICROSAR RTE"
 /begin SUB_GROUP AAACalRegn02Rt01GroupC_Dummy_2.GmOvrlStMgrHwAgTarLimr.Val AAACalRegn02Rt01GroupC_Dummy_2.GmOvrlStMgrShiftLvrTiThd.Val AAACalRegn02Rt01GroupC_Dummy_2.GmOvrlStMgrStandStillThd.Val AAACalRegn02Rt01GroupC_Dummy_2.GmOvrlStMgrStandStillTiThd.Val AAACalRegn02Rt01GroupC_Dummy_2.GmTqArbnApaDiRateY.Ary1D AAACalRegn02Rt01GroupC_Dummy_2.GmTqArbnApaEnaRate.Val AAACalRegn02Rt01GroupC_Dummy_2.GmTqArbnApaSmotngHwTqLpFilFrq.Val AAACalRegn02Rt01GroupC_Dummy_2.GmTqArbnApaSmotngX.Ary1D AAACalRegn02Rt01GroupC_Dummy_2.GmTqArbnApaSmotngY.Ary1D AAACalRegn02Rt01GroupC_Dummy_2.GmTqArbnLkaOutpOvrlX.Ary2D AAACalRegn02Rt01GroupC_Dummy_2.GmTqArbnLkaOutpOvrlY.Ary2D AAACalRegn02Rt01GroupC_Dummy_2.GmTqArbnLkaSlewX.Ary1D AAACalRegn02Rt01GroupC_Dummy_2.GmTqArbnLkaSlewY.Ary1D /end SUB_GROUP
 /begin FUNCTION_LIST /end FUNCTION_LIST
 /begin REF_CHARACTERISTIC /end REF_CHARACTERISTIC
 /begin REF_MEASUREMENT /end REF_MEASUREMENT
/end GROUP
/begin GROUP AAACalRegn02Rt01GroupC_Dummy_2.GmOvrlStMgrHwAgTarLimr.Val "MICROSAR RTE" /begin SUB_GROUP /end SUB_GROUP /begin FUNCTION_LIST /end FUNCTION_LIST /begin REF_CHARACTERISTIC AAACalRegn02Rt01GroupC_Dummy_2.GmOvrlStMgrHwAgTarLimr.Val /end REF_CHARACTERISTIC /begin REF_MEASUREMENT /end REF_MEASUREMENT /end GROUP
/begin GROUP AAACalRegn02Rt01GroupC_Dummy_2.GmOvrlStMgrShiftLvrTiThd.Val "MICROSAR RTE" /begin SUB_GROUP /end SUB_GROUP /begin FUNCTION_LIST /end FUNCTION_LIST
 /begin REF_CHARACTERISTIC AAACalRegn02Rt01GroupC_Dummy_2.GmOvrlStMgrShiftLvrTiThd.Val /end REF_CHARACTERISTIC
 /begin REF_MEASUREMENT /end REF_MEASUREMENT
/end GROUP
/begin GROUP AAACalRegn02Rt01GroupC_Dummy_2.GmOvrlStMgrStandStillThd.Val "MICROSAR RTE" /begin SUB_GROUP /end SUB_GROUP /begin FUNCTION_LIST /end FUNCTION_LIST
 /begin REF_CHARACTERISTIC AAACalRegn02Rt01GroupC_Dummy_2.GmOvrlStMgrStandStillThd.Val /end REF_CHARACTERISTIC
 /begin REF_MEASUREMENT /end REF_MEASUREMENT
/end GROUP
/begin GROUP AAACalRegn02Rt01GroupC_Dummy_2.GmOvrlStMgrStandStillTiThd.Val "MICROSAR RTE" /begin SUB_GROUP /end SUB_GROUP /begin FUNCTION_LIST /end FUNCTION_LIST
 /begin REF_CHARACTERISTIC AAACalRegn02Rt01GroupC_Dummy_2.GmOvrlStMgrStandStillTiThd.Val /end REF_CHARACTERISTIC
 /begin REF_MEASUREMENT /end REF_MEASUREMENT
/end GROUP
/begin GROUP AAACalRegn02Rt01GroupC_Dummy_2.GmTqArbnApaDiRateY.Ary1D "MICROSAR RTE" /begin SUB_GROUP /end SUB_GROUP /begin FUNCTION_LIST /end FUNCTION_LIST /begin REF_CHARACTERISTIC AAACalRegn02Rt01GroupC_Dummy_2.GmTqArbnApaDiRateY.Ary1D /end REF_CHARACTERISTIC /begin REF_MEASUREMENT /end REF_MEASUREMENT /end GROUP
/begin GROUP AAACalRegn02Rt01GroupC_Dummy_2.GmTqArbnApaEnaRate.Val "MICROSAR RTE" /begin SUB_GROUP /end SUB_GROUP /begin FUNCTION_LIST /end FUNCTION_LIST /begin REF_CHARACTERISTIC AAACalRegn02Rt01GroupC_Dummy_2.GmTqArbnApaEnaRate.Val /end REF_CHARACTERISTIC /begin REF_MEASUREMENT /end REF_MEASUREMENT /end GROUP
/begin GROUP AAACalRegn02Rt01GroupC_Dummy_2.GmTqArbnApaSmotngHwTqLpFilFrq.Val "MICROSAR RTE" /begin SUB_GROUP /end SUB_GROUP /begin FUNCTION_LIST /end FUNCTION_LIST
 /begin REF_CHARACTERISTIC AAACalRegn02Rt01GroupC_Dummy_2.GmTqArbnApaSmotngHwTqLpFilFrq.Val /end REF_CHARACTERISTIC
 /begin REF_MEASUREMENT /end REF_MEASUREMENT
/end GROUP
/begin GROUP AAACalRegn02Rt01GroupC_Dummy_2.GmTqArbnApaSmotngX.Ary1D "MICROSAR RTE" /begin SUB_GROUP /end SUB_GROUP /begin FUNCTION_LIST /end FUNCTION_LIST /begin REF_CHARACTERISTIC AAACalRegn02Rt01GroupC_Dummy_2.GmTqArbnApaSmotngX.Ary1D /end REF_CHARACTERISTIC /begin REF_MEASUREMENT /end REF_MEASUREMENT /end GROUP
/begin GROUP AAACalRegn02Rt01GroupC_Dummy_2.GmTqArbnApaSmotngY.Ary1D "MICROSAR RTE" /begin SUB_GROUP /end SUB_GROUP /begin FUNCTION_LIST /end FUNCTION_LIST /begin REF_CHARACTERISTIC AAACalRegn02Rt01GroupC_Dummy_2.GmTqArbnApaSmotngY.Ary1D /end REF_CHARACTERISTIC /begin REF_MEASUREMENT /end REF_MEASUREMENT /end GROUP
/begin GROUP AAACalRegn02Rt01GroupC_Dummy_2.GmTqArbnLkaOutpOvrlX.Ary2D "MICROSAR RTE" /begin SUB_GROUP /end SUB_GROUP /begin FUNCTION_LIST /end FUNCTION_LIST /begin REF_CHARACTERISTIC AAACalRegn02Rt01GroupC_Dummy_2.GmTqArbnLkaOutpOvrlX.Ary2D /end REF_CHARACTERISTIC /begin REF_MEASUREMENT /end REF_MEASUREMENT /end GROUP
/begin GROUP AAACalRegn02Rt01GroupC_Dummy_2.GmTqArbnLkaOutpOvrlY.Ary2D "MICROSAR RTE" /begin SUB_GROUP /end SUB_GROUP /begin FUNCTION_LIST /end FUNCTION_LIST /begin REF_CHARACTERISTIC AAACalRegn02Rt01GroupC_Dummy_2.GmTqArbnLkaOutpOvrlY.Ary2D /end REF_CHARACTERISTIC /begin REF_MEASUREMENT /end REF_MEASUREMENT /end GROUP
/begin GROUP AAACalRegn02Rt01GroupC_Dummy_2.GmTqArbnLkaSlewX.Ary1D "MICROSAR RTE" /begin SUB_GROUP /end SUB_GROUP /begin FUNCTION_LIST /end FUNCTION_LIST /begin REF_CHARACTERISTIC AAACalRegn02Rt01GroupC_Dummy_2.GmTqArbnLkaSlewX.Ary1D /end REF_CHARACTERISTIC /begin REF_MEASUREMENT /end REF_MEASUREMENT /end GROUP
/begin GROUP AAACalRegn02Rt01GroupC_Dummy_2.GmTqArbnLkaSlewY.Ary1D "MICROSAR RTE" /begin SUB_GROUP /end SUB_GROUP /begin FUNCTION_LIST /end FUNCTION_LIST /begin REF_CHARACTERISTIC AAACalRegn02Rt01GroupC_Dummy_2.GmTqArbnLkaSlewY.Ary1D /end REF_CHARACTERISTIC /begin REF_MEASUREMENT /end REF_MEASUREMENT /end GROUP
/begin GROUP AAACalRegn02Rt01GroupC_Dummy_3 "MICROSAR RTE" /begin SUB_GROUP AAACalRegn02Rt01GroupC_Dummy_3.CalibrationPorts /end SUB_GROUP /begin FUNCTION_LIST /end FUNCTION_LIST /begin REF_CHARACTERISTIC /end REF_CHARACTERISTIC /begin REF_MEASUREMENT /end REF_MEASUREMENT /end GROUP
/begin GROUP AAACalRegn02Rt01GroupC_Dummy_3.CalibrationPorts "MICROSAR RTE"
 /begin SUB_GROUP AAACalRegn02Rt01GroupC_Dummy_3.GmOvrlStMgrHwAgTarLimr.Val AAACalRegn02Rt01GroupC_Dummy_3.GmOvrlStMgrShiftLvrTiThd.Val AAACalRegn02Rt01GroupC_Dummy_3.GmOvrlStMgrStandStillThd.Val AAACalRegn02Rt01GroupC_Dummy_3.GmOvrlStMgrStandStillTiThd.Val AAACalRegn02Rt01GroupC_Dummy_3.GmTqArbnApaDiRateY.Ary1D AAACalRegn02Rt01GroupC_Dummy_3.GmTqArbnApaEnaRate.Val AAACalRegn02Rt01GroupC_Dummy_3.GmTqArbnApaSmotngHwTqLpFilFrq.Val AAACalRegn02Rt01GroupC_Dummy_3.GmTqArbnApaSmotngX.Ary1D AAACalRegn02Rt01GroupC_Dummy_3.GmTqArbnApaSmotngY.Ary1D AAACalRegn02Rt01GroupC_Dummy_3.GmTqArbnLkaOutpOvrlX.Ary2D AAACalRegn02Rt01GroupC_Dummy_3.GmTqArbnLkaOutpOvrlY.Ary2D AAACalRegn02Rt01GroupC_Dummy_3.GmTqArbnLkaSlewX.Ary1D AAACalRegn02Rt01GroupC_Dummy_3.GmTqArbnLkaSlewY.Ary1D /end SUB_GROUP
 /begin FUNCTION_LIST /end FUNCTION_LIST
 /begin REF_CHARACTERISTIC /end REF_CHARACTERISTIC
 /begin REF_MEASUREMENT /end REF_MEASUREMENT
/end GROUP
/begin GROUP AAACalRegn02Rt01GroupC_Dummy_3.GmOvrlStMgrHwAgTarLimr.Val "MICROSAR RTE" /begin SUB_GROUP /end SUB_GROUP /begin FUNCTION_LIST /end FUNCTION_LIST /begin REF_CHARACTERISTIC AAACalRegn02Rt01GroupC_Dummy_3.GmOvrlStMgrHwAgTarLimr.Val /end REF_CHARACTERISTIC /begin REF_MEASUREMENT /end REF_MEASUREMENT /end GROUP
/begin GROUP AAACalRegn02Rt01GroupC_Dummy_3.GmOvrlStMgrShiftLvrTiThd.Val "MICROSAR RTE" /begin SUB_GROUP /end SUB_GROUP /begin FUNCTION_LIST /end FUNCTION_LIST
 /begin REF_CHARACTERISTIC AAACalRegn02Rt01GroupC_Dummy_3.GmOvrlStMgrShiftLvrTiThd.Val /end REF_CHARACTERISTIC
 /begin REF_MEASUREMENT /end REF_MEASUREMENT
/end GROUP
/begin GROUP AAACalRegn02Rt01GroupC_Dummy_3.GmOvrlStMgrStandStillThd.Val "MICROSAR RTE" /begin SUB_GROUP /end SUB_GROUP /begin FUNCTION_LIST /end FUNCTION_LIST
 /begin REF_CHARACTERISTIC AAACalRegn02Rt01GroupC_Dummy_3.GmOvrlStMgrStandStillThd.Val /end REF_CHARACTERISTIC
 /begin REF_MEASUREMENT /end REF_MEASUREMENT
/end GROUP
/begin GROUP AAACalRegn02Rt01GroupC_Dummy_3.GmOvrlStMgrStandStillTiThd.Val "MICROSAR RTE" /begin SUB_GROUP /end SUB_GROUP /begin FUNCTION_LIST /end FUNCTION_LIST
 /begin REF_CHARACTERISTIC AAACalRegn02Rt01GroupC_Dummy_3.GmOvrlStMgrStandStillTiThd.Val /end REF_CHARACTERISTIC
 /begin REF_MEASUREMENT /end REF_MEASUREMENT
/end GROUP
/begin GROUP AAACalRegn02Rt01GroupC_Dummy_3.GmTqArbnApaDiRateY.Ary1D "MICROSAR RTE" /begin SUB_GROUP /end SUB_GROUP /begin FUNCTION_LIST /end FUNCTION_LIST /begin REF_CHARACTERISTIC AAACalRegn02Rt01GroupC_Dummy_3.GmTqArbnApaDiRateY.Ary1D /end REF_CHARACTERISTIC /begin REF_MEASUREMENT /end REF_MEASUREMENT /end GROUP
/begin GROUP AAACalRegn02Rt01GroupC_Dummy_3.GmTqArbnApaEnaRate.Val "MICROSAR RTE" /begin SUB_GROUP /end SUB_GROUP /begin FUNCTION_LIST /end FUNCTION_LIST /begin REF_CHARACTERISTIC AAACalRegn02Rt01GroupC_Dummy_3.GmTqArbnApaEnaRate.Val /end REF_CHARACTERISTIC /begin REF_MEASUREMENT /end REF_MEASUREMENT /end GROUP
/begin GROUP AAACalRegn02Rt01GroupC_Dummy_3.GmTqArbnApaSmotngHwTqLpFilFrq.Val "MICROSAR RTE" /begin SUB_GROUP /end SUB_GROUP /begin FUNCTION_LIST /end FUNCTION_LIST
 /begin REF_CHARACTERISTIC AAACalRegn02Rt01GroupC_Dummy_3.GmTqArbnApaSmotngHwTqLpFilFrq.Val /end REF_CHARACTERISTIC
 /begin REF_MEASUREMENT /end REF_MEASUREMENT
/end GROUP
/begin GROUP AAACalRegn02Rt01GroupC_Dummy_3.GmTqArbnApaSmotngX.Ary1D "MICROSAR RTE" /begin SUB_GROUP /end SUB_GROUP /begin FUNCTION_LIST /end FUNCTION_LIST /begin REF_CHARACTERISTIC AAACalRegn02Rt01GroupC_Dummy_3.GmTqArbnApaSmotngX.Ary1D /end REF_CHARACTERISTIC /begin REF_MEASUREMENT /end REF_MEASUREMENT /end GROUP
/begin GROUP AAACalRegn02Rt01GroupC_Dummy_3.GmTqArbnApaSmotngY.Ary1D "MICROSAR RTE" /begin SUB_GROUP /end SUB_GROUP /begin FUNCTION_LIST /end FUNCTION_LIST /begin REF_CHARACTERISTIC AAACalRegn02Rt01GroupC_Dummy_3.GmTqArbnApaSmotngY.Ary1D /end REF_CHARACTERISTIC /begin REF_MEASUREMENT /end REF_MEASUREMENT /end GROUP
/begin GROUP AAACalRegn02Rt01GroupC_Dummy_3.GmTqArbnLkaOutpOvrlX.Ary2D "MICROSAR RTE" /begin SUB_GROUP /end SUB_GROUP /begin FUNCTION_LIST /end FUNCTION_LIST /begin REF_CHARACTERISTIC AAACalRegn02Rt01GroupC_Dummy_3.GmTqArbnLkaOutpOvrlX.Ary2D /end REF_CHARACTERISTIC /begin REF_MEASUREMENT /end REF_MEASUREMENT /end GROUP
/begin GROUP AAACalRegn02Rt01GroupC_Dummy_3.GmTqArbnLkaOutpOvrlY.Ary2D "MICROSAR RTE" /begin SUB_GROUP /end SUB_GROUP /begin FUNCTION_LIST /end FUNCTION_LIST /begin REF_CHARACTERISTIC AAACalRegn02Rt01GroupC_Dummy_3.GmTqArbnLkaOutpOvrlY.Ary2D /end REF_CHARACTERISTIC /begin REF_MEASUREMENT /end REF_MEASUREMENT /end GROUP
/begin GROUP AAACalRegn02Rt01GroupC_Dummy_3.GmTqArbnLkaSlewX.Ary1D "MICROSAR RTE" /begin SUB_GROUP /end SUB_GROUP /begin FUNCTION_LIST /end FUNCTION_LIST /begin REF_CHARACTERISTIC AAACalRegn02Rt01GroupC_Dummy_3.GmTqArbnLkaSlewX.Ary1D /end REF_CHARACTERISTIC /begin REF_MEASUREMENT /end REF_MEASUREMENT /end GROUP
/begin GROUP AAACalRegn02Rt01GroupC_Dummy_3.GmTqArbnLkaSlewY.Ary1D "MICROSAR RTE" /begin SUB_GROUP /end SUB_GROUP /begin FUNCTION_LIST /end FUNCTION_LIST /begin REF_CHARACTERISTIC AAACalRegn02Rt01GroupC_Dummy_3.GmTqArbnLkaSlewY.Ary1D /end REF_CHARACTERISTIC /begin REF_MEASUREMENT /end REF_MEASUREMENT /end GROUP
/begin GROUP AAACalRegn02Rt01GroupC_Dummy_4 "MICROSAR RTE" /begin SUB_GROUP AAACalRegn02Rt01GroupC_Dummy_4.CalibrationPorts /end SUB_GROUP /begin FUNCTION_LIST /end FUNCTION_LIST /begin REF_CHARACTERISTIC /end REF_CHARACTERISTIC /begin REF_MEASUREMENT /end REF_MEASUREMENT /end GROUP
/begin GROUP AAACalRegn02Rt01GroupC_Dummy_4.CalibrationPorts "MICROSAR RTE"
 /begin SUB_GROUP AAACalRegn02Rt01GroupC_Dummy_4.GmOvrlStMgrHwAgTarLimr.Val AAACalRegn02Rt01GroupC_Dummy_4.GmOvrlStMgrShiftLvrTiThd.Val AAACalRegn02Rt01GroupC_Dummy_4.GmOvrlStMgrStandStillThd.Val AAACalRegn02Rt01GroupC_Dummy_4.GmOvrlStMgrStandStillTiThd.Val AAACalRegn02Rt01GroupC_Dummy_4.GmTqArbnApaDiRateY.Ary1D AAACalRegn02Rt01GroupC_Dummy_4.GmTqArbnApaEnaRate.Val AAACalRegn02Rt01GroupC_Dummy_4.GmTqArbnApaSmotngHwTqLpFilFrq.Val AAACalRegn02Rt01GroupC_Dummy_4.GmTqArbnApaSmotngX.Ary1D AAACalRegn02Rt01GroupC_Dummy_4.GmTqArbnApaSmotngY.Ary1D AAACalRegn02Rt01GroupC_Dummy_4.GmTqArbnLkaOutpOvrlX.Ary2D AAACalRegn02Rt01GroupC_Dummy_4.GmTqArbnLkaOutpOvrlY.Ary2D AAACalRegn02Rt01GroupC_Dummy_4.GmTqArbnLkaSlewX.Ary1D AAACalRegn02Rt01GroupC_Dummy_4.GmTqArbnLkaSlewY.Ary1D /end SUB_GROUP
 /begin FUNCTION_LIST /end FUNCTION_LIST
 /begin REF_CHARACTERISTIC /end REF_CHARACTERISTIC
 /begin REF_MEASUREMENT /end REF_MEASUREMENT
/end GROUP
/begin GROUP AAACalRegn02Rt01GroupC_Dummy_4.GmOvrlStMgrHwAgTarLimr.Val "MICROSAR RTE" /begin SUB_GROUP /end SUB_GROUP /begin FUNCTION_LIST /end FUNCTION_LIST /begin REF_CHARACTERISTIC AAACalRegn02Rt01GroupC_Dummy_4.GmOvrlStMgrHwAgTarLimr.Val /end REF_CHARACTERISTIC /begin REF_MEASUREMENT /end REF_MEASUREMENT /end GROUP
/begin GROUP AAACalRegn02Rt01GroupC_Dummy_4.GmOvrlStMgrShiftLvrTiThd.Val "MICROSAR RTE" /begin SUB_GROUP /end SUB_GROUP /begin FUNCTION_LIST /end FUNCTION_LIST
 /begin REF_CHARACTERISTIC AAACalRegn02Rt01GroupC_Dummy_4.GmOvrlStMgrShiftLvrTiThd.Val /end REF_CHARACTERISTIC
 /begin REF_MEASUREMENT /end REF_MEASUREMENT
/end GROUP
/begin GROUP AAACalRegn02Rt01GroupC_Dummy_4.GmOvrlStMgrStandStillThd.Val "MICROSAR RTE" /begin SUB_GROUP /end SUB_GROUP /begin FUNCTION_LIST /end FUNCTION_LIST
 /begin REF_CHARACTERISTIC AAACalRegn02Rt01GroupC_Dummy_4.GmOvrlStMgrStandStillThd.Val /end REF_CHARACTERISTIC
 /begin REF_MEASUREMENT /end REF_MEASUREMENT
/end GROUP
/begin GROUP AAACalRegn02Rt01GroupC_Dummy_4.GmOvrlStMgrStandStillTiThd.Val "MICROSAR RTE" /begin SUB_GROUP /end SUB_GROUP /begin FUNCTION_LIST /end FUNCTION_LIST
 /begin REF_CHARACTERISTIC AAACalRegn02Rt01GroupC_Dummy_4.GmOvrlStMgrStandStillTiThd.Val /end REF_CHARACTERISTIC
 /begin REF_MEASUREMENT /end REF_MEASUREMENT
/end GROUP
/begin GROUP AAACalRegn02Rt01GroupC_Dummy_4.GmTqArbnApaDiRateY.Ary1D "MICROSAR RTE" /begin SUB_GROUP /end SUB_GROUP /begin FUNCTION_LIST /end FUNCTION_LIST /begin REF_CHARACTERISTIC AAACalRegn02Rt01GroupC_Dummy_4.GmTqArbnApaDiRateY.Ary1D /end REF_CHARACTERISTIC /begin REF_MEASUREMENT /end REF_MEASUREMENT /end GROUP
/begin GROUP AAACalRegn02Rt01GroupC_Dummy_4.GmTqArbnApaEnaRate.Val "MICROSAR RTE" /begin SUB_GROUP /end SUB_GROUP /begin FUNCTION_LIST /end FUNCTION_LIST /begin REF_CHARACTERISTIC AAACalRegn02Rt01GroupC_Dummy_4.GmTqArbnApaEnaRate.Val /end REF_CHARACTERISTIC /begin REF_MEASUREMENT /end REF_MEASUREMENT /end GROUP
/begin GROUP AAACalRegn02Rt01GroupC_Dummy_4.GmTqArbnApaSmotngHwTqLpFilFrq.Val "MICROSAR RTE" /begin SUB_GROUP /end SUB_GROUP /begin FUNCTION_LIST /end FUNCTION_LIST
 /begin REF_CHARACTERISTIC AAACalRegn02Rt01GroupC_Dummy_4.GmTqArbnApaSmotngHwTqLpFilFrq.Val /end REF_CHARACTERISTIC
 /begin REF_MEASUREMENT /end REF_MEASUREMENT
/end GROUP
/begin GROUP AAACalRegn02Rt01GroupC_Dummy_4.GmTqArbnApaSmotngX.Ary1D "MICROSAR RTE" /begin SUB_GROUP /end SUB_GROUP /begin FUNCTION_LIST /end FUNCTION_LIST /begin REF_CHARACTERISTIC AAACalRegn02Rt01GroupC_Dummy_4.GmTqArbnApaSmotngX.Ary1D /end REF_CHARACTERISTIC /begin REF_MEASUREMENT /end REF_MEASUREMENT /end GROUP
/begin GROUP AAACalRegn02Rt01GroupC_Dummy_4.GmTqArbnApaSmotngY.Ary1D "MICROSAR RTE" /begin SUB_GROUP /end SUB_GROUP /begin FUNCTION_LIST /end FUNCTION_LIST /begin REF_CHARACTERISTIC AAACalRegn02Rt01GroupC_Dummy_4.GmTqArbnApaSmotngY.Ary1D /end REF_CHARACTERISTIC /begin REF_MEASUREMENT /end REF_MEASUREMENT /end GROUP
/begin GROUP AAACalRegn02Rt01GroupC_Dummy_4.GmTqArbnLkaOutpOvrlX.Ary2D "MICROSAR RTE" /begin SUB_GROUP /end SUB_GROUP /begin FUNCTION_LIST /end FUNCTION_LIST /begin REF_CHARACTERISTIC AAACalRegn02Rt01GroupC_Dummy_4.GmTqArbnLkaOutpOvrlX.Ary2D /end REF_CHARACTERISTIC /begin REF_MEASUREMENT /end REF_MEASUREMENT /end GROUP
/begin GROUP AAACalRegn02Rt01GroupC_Dummy_4.GmTqArbnLkaOutpOvrlY.Ary2D "MICROSAR RTE" /begin SUB_GROUP /end SUB_GROUP /begin FUNCTION_LIST /end FUNCTION_LIST /begin REF_CHARACTERISTIC AAACalRegn02Rt01GroupC_Dummy_4.GmTqArbnLkaOutpOvrlY.Ary2D /end REF_CHARACTERISTIC /begin REF_MEASUREMENT /end REF_MEASUREMENT /end GROUP
/begin GROUP AAACalRegn02Rt01GroupC_Dummy_4.GmTqArbnLkaSlewX.Ary1D "MICROSAR RTE" /begin SUB_GROUP /end SUB_GROUP /begin FUNCTION_LIST /end FUNCTION_LIST /begin REF_CHARACTERISTIC AAACalRegn02Rt01GroupC_Dummy_4.GmTqArbnLkaSlewX.Ary1D /end REF_CHARACTERISTIC /begin REF_MEASUREMENT /end REF_MEASUREMENT /end GROUP
/begin GROUP AAACalRegn02Rt01GroupC_Dummy_4.GmTqArbnLkaSlewY.Ary1D "MICROSAR RTE" /begin SUB_GROUP /end SUB_GROUP /begin FUNCTION_LIST /end FUNCTION_LIST /begin REF_CHARACTERISTIC AAACalRegn02Rt01GroupC_Dummy_4.GmTqArbnLkaSlewY.Ary1D /end REF_CHARACTERISTIC /begin REF_MEASUREMENT /end REF_MEASUREMENT /end GROUP
/begin GROUP AAACalRegn03Rt01GroupA_Dummy "MICROSAR RTE" /begin SUB_GROUP AAACalRegn03Rt01GroupA_Dummy.CalibrationPorts /end SUB_GROUP /begin FUNCTION_LIST /end FUNCTION_LIST /begin REF_CHARACTERISTIC /end REF_CHARACTERISTIC /begin REF_MEASUREMENT /end REF_MEASUREMENT /end GROUP
/begin GROUP AAACalRegn03Rt01GroupA_Dummy.AssiHiFrqGainY.Ary2D "MICROSAR RTE" /begin SUB_GROUP /end SUB_GROUP /begin FUNCTION_LIST /end FUNCTION_LIST /begin REF_CHARACTERISTIC AAACalRegn03Rt01GroupA_Dummy.AssiHiFrqGainY.Ary2D /end REF_CHARACTERISTIC /begin REF_MEASUREMENT /end REF_MEASUREMENT /end GROUP
/begin GROUP AAACalRegn03Rt01GroupA_Dummy.AssiHiFrqTqX.Ary2D "MICROSAR RTE" /begin SUB_GROUP /end SUB_GROUP /begin FUNCTION_LIST /end FUNCTION_LIST /begin REF_CHARACTERISTIC AAACalRegn03Rt01GroupA_Dummy.AssiHiFrqTqX.Ary2D /end REF_CHARACTERISTIC /begin REF_MEASUREMENT /end REF_MEASUREMENT /end GROUP
/begin GROUP AAACalRegn03Rt01GroupA_Dummy.AssiMotTqWhlImbRejctnMinX.Ary2D "MICROSAR RTE" /begin SUB_GROUP /end SUB_GROUP /begin FUNCTION_LIST /end FUNCTION_LIST
 /begin REF_CHARACTERISTIC AAACalRegn03Rt01GroupA_Dummy.AssiMotTqWhlImbRejctnMinX.Ary2D /end REF_CHARACTERISTIC
 /begin REF_MEASUREMENT /end REF_MEASUREMENT
/end GROUP
/begin GROUP AAACalRegn03Rt01GroupA_Dummy.AssiMotTqWhlImbRejctnMinY.Ary2D "MICROSAR RTE" /begin SUB_GROUP /end SUB_GROUP /begin FUNCTION_LIST /end FUNCTION_LIST
 /begin REF_CHARACTERISTIC AAACalRegn03Rt01GroupA_Dummy.AssiMotTqWhlImbRejctnMinY.Ary2D /end REF_CHARACTERISTIC
 /begin REF_MEASUREMENT /end REF_MEASUREMENT
/end GROUP
/begin GROUP AAACalRegn03Rt01GroupA_Dummy.CalibrationPorts "MICROSAR RTE"
 /begin SUB_GROUP AAACalRegn03Rt01GroupA_Dummy.AssiHiFrqGainY.Ary2D AAACalRegn03Rt01GroupA_Dummy.AssiHiFrqTqX.Ary2D AAACalRegn03Rt01GroupA_Dummy.AssiMotTqWhlImbRejctnMinX.Ary2D AAACalRegn03Rt01GroupA_Dummy.AssiMotTqWhlImbRejctnMinY.Ary2D AAACalRegn03Rt01GroupA_Dummy.DampgHydCoeff1ScaY.Ary1D AAACalRegn03Rt01GroupA_Dummy.DampgHydCoeff2ScaY.Ary1D AAACalRegn03Rt01GroupA_Dummy.DampgHydCoeff3ScaY.Ary1D AAACalRegn03Rt01GroupA_Dummy.DampgHydCoeff4ScaY.Ary1D AAACalRegn03Rt01GroupA_Dummy.DampgMotVelX.Ary2D AAACalRegn03Rt01GroupA_Dummy.DampgMotVelY.Ary2D AAACalRegn03Rt01GroupA_Dummy.HysCmpFricWhlImbRejctnBlndX.Ary1D AAACalRegn03Rt01GroupA_Dummy.HysCmpFricWhlImbRejctnBlndY.Ary1D AAACalRegn03Rt01GroupA_Dummy.HysCmpFricWhlImbRejctnOffY.Ary1D AAACalRegn03Rt01GroupA_Dummy.HysCmpFricWhlImbRejctnOnY.Ary1D AAACalRegn03Rt01GroupA_Dummy.InertiaCmpVelAssiBasdDampgCoeffX.Ary1D AAACalRegn03Rt01GroupA_Dummy.InertiaCmpVelAssiBasdDampgRollgY.Ary1D AAACalRegn03Rt01GroupA_Dummy.InertiaCmpVelAssiBasdDampgStatY.Ary1D AAACalRegn03Rt01GroupA_Dummy.InertiaCmpVelDampgSpdBlndY.Ary1D AAACalRegn03Rt01GroupA_Dummy.InertiaCmpVelNotchBlndY.Ary1D AAACalRegn03Rt01GroupA_Dummy.RtnHwAgOffsCalcdX.Ary2D AAACalRegn03Rt01GroupA_Dummy.RtnHwAgOffsCalcdY.Ary2D AAACalRegn03Rt01GroupA_Dummy.RtnScaTqX.Ary2D AAACalRegn03Rt01GroupA_Dummy.RtnScaTqY.Ary2D AAACalRegn03Rt01GroupA_Dummy.RtnScaVelX.Ary2D AAACalRegn03Rt01GroupA_Dummy.RtnScaVelY.Ary2D /end SUB_GROUP
 /begin FUNCTION_LIST /end FUNCTION_LIST
 /begin REF_CHARACTERISTIC /end REF_CHARACTERISTIC
 /begin REF_MEASUREMENT /end REF_MEASUREMENT
/end GROUP
/begin GROUP AAACalRegn03Rt01GroupA_Dummy.DampgHydCoeff1ScaY.Ary1D "MICROSAR RTE" /begin SUB_GROUP /end SUB_GROUP /begin FUNCTION_LIST /end FUNCTION_LIST /begin REF_CHARACTERISTIC AAACalRegn03Rt01GroupA_Dummy.DampgHydCoeff1ScaY.Ary1D /end REF_CHARACTERISTIC /begin REF_MEASUREMENT /end REF_MEASUREMENT /end GROUP
/begin GROUP AAACalRegn03Rt01GroupA_Dummy.DampgHydCoeff2ScaY.Ary1D "MICROSAR RTE" /begin SUB_GROUP /end SUB_GROUP /begin FUNCTION_LIST /end FUNCTION_LIST /begin REF_CHARACTERISTIC AAACalRegn03Rt01GroupA_Dummy.DampgHydCoeff2ScaY.Ary1D /end REF_CHARACTERISTIC /begin REF_MEASUREMENT /end REF_MEASUREMENT /end GROUP
/begin GROUP AAACalRegn03Rt01GroupA_Dummy.DampgHydCoeff3ScaY.Ary1D "MICROSAR RTE" /begin SUB_GROUP /end SUB_GROUP /begin FUNCTION_LIST /end FUNCTION_LIST /begin REF_CHARACTERISTIC AAACalRegn03Rt01GroupA_Dummy.DampgHydCoeff3ScaY.Ary1D /end REF_CHARACTERISTIC /begin REF_MEASUREMENT /end REF_MEASUREMENT /end GROUP
/begin GROUP AAACalRegn03Rt01GroupA_Dummy.DampgHydCoeff4ScaY.Ary1D "MICROSAR RTE" /begin SUB_GROUP /end SUB_GROUP /begin FUNCTION_LIST /end FUNCTION_LIST /begin REF_CHARACTERISTIC AAACalRegn03Rt01GroupA_Dummy.DampgHydCoeff4ScaY.Ary1D /end REF_CHARACTERISTIC /begin REF_MEASUREMENT /end REF_MEASUREMENT /end GROUP
/begin GROUP AAACalRegn03Rt01GroupA_Dummy.DampgMotVelX.Ary2D "MICROSAR RTE" /begin SUB_GROUP /end SUB_GROUP /begin FUNCTION_LIST /end FUNCTION_LIST /begin REF_CHARACTERISTIC AAACalRegn03Rt01GroupA_Dummy.DampgMotVelX.Ary2D /end REF_CHARACTERISTIC /begin REF_MEASUREMENT /end REF_MEASUREMENT /end GROUP
/begin GROUP AAACalRegn03Rt01GroupA_Dummy.DampgMotVelY.Ary2D "MICROSAR RTE" /begin SUB_GROUP /end SUB_GROUP /begin FUNCTION_LIST /end FUNCTION_LIST /begin REF_CHARACTERISTIC AAACalRegn03Rt01GroupA_Dummy.DampgMotVelY.Ary2D /end REF_CHARACTERISTIC /begin REF_MEASUREMENT /end REF_MEASUREMENT /end GROUP
/begin GROUP AAACalRegn03Rt01GroupA_Dummy.HysCmpFricWhlImbRejctnBlndX.Ary1D "MICROSAR RTE" /begin SUB_GROUP /end SUB_GROUP /begin FUNCTION_LIST /end FUNCTION_LIST
 /begin REF_CHARACTERISTIC AAACalRegn03Rt01GroupA_Dummy.HysCmpFricWhlImbRejctnBlndX.Ary1D /end REF_CHARACTERISTIC
 /begin REF_MEASUREMENT /end REF_MEASUREMENT
/end GROUP
/begin GROUP AAACalRegn03Rt01GroupA_Dummy.HysCmpFricWhlImbRejctnBlndY.Ary1D "MICROSAR RTE" /begin SUB_GROUP /end SUB_GROUP /begin FUNCTION_LIST /end FUNCTION_LIST
 /begin REF_CHARACTERISTIC AAACalRegn03Rt01GroupA_Dummy.HysCmpFricWhlImbRejctnBlndY.Ary1D /end REF_CHARACTERISTIC
 /begin REF_MEASUREMENT /end REF_MEASUREMENT
/end GROUP
/begin GROUP AAACalRegn03Rt01GroupA_Dummy.HysCmpFricWhlImbRejctnOffY.Ary1D "MICROSAR RTE" /begin SUB_GROUP /end SUB_GROUP /begin FUNCTION_LIST /end FUNCTION_LIST
 /begin REF_CHARACTERISTIC AAACalRegn03Rt01GroupA_Dummy.HysCmpFricWhlImbRejctnOffY.Ary1D /end REF_CHARACTERISTIC
 /begin REF_MEASUREMENT /end REF_MEASUREMENT
/end GROUP
/begin GROUP AAACalRegn03Rt01GroupA_Dummy.HysCmpFricWhlImbRejctnOnY.Ary1D "MICROSAR RTE" /begin SUB_GROUP /end SUB_GROUP /begin FUNCTION_LIST /end FUNCTION_LIST
 /begin REF_CHARACTERISTIC AAACalRegn03Rt01GroupA_Dummy.HysCmpFricWhlImbRejctnOnY.Ary1D /end REF_CHARACTERISTIC
 /begin REF_MEASUREMENT /end REF_MEASUREMENT
/end GROUP
/begin GROUP AAACalRegn03Rt01GroupA_Dummy.InertiaCmpVelAssiBasdDampgCoeffX.Ary1D "MICROSAR RTE" /begin SUB_GROUP /end SUB_GROUP /begin FUNCTION_LIST /end FUNCTION_LIST
 /begin REF_CHARACTERISTIC AAACalRegn03Rt01GroupA_Dummy.InertiaCmpVelAssiBasdDampgCoeffX.Ary1D /end REF_CHARACTERISTIC
 /begin REF_MEASUREMENT /end REF_MEASUREMENT
/end GROUP
/begin GROUP AAACalRegn03Rt01GroupA_Dummy.InertiaCmpVelAssiBasdDampgRollgY.Ary1D "MICROSAR RTE" /begin SUB_GROUP /end SUB_GROUP /begin FUNCTION_LIST /end FUNCTION_LIST
 /begin REF_CHARACTERISTIC AAACalRegn03Rt01GroupA_Dummy.InertiaCmpVelAssiBasdDampgRollgY.Ary1D /end REF_CHARACTERISTIC
 /begin REF_MEASUREMENT /end REF_MEASUREMENT
/end GROUP
/begin GROUP AAACalRegn03Rt01GroupA_Dummy.InertiaCmpVelAssiBasdDampgStatY.Ary1D "MICROSAR RTE" /begin SUB_GROUP /end SUB_GROUP /begin FUNCTION_LIST /end FUNCTION_LIST
 /begin REF_CHARACTERISTIC AAACalRegn03Rt01GroupA_Dummy.InertiaCmpVelAssiBasdDampgStatY.Ary1D /end REF_CHARACTERISTIC
 /begin REF_MEASUREMENT /end REF_MEASUREMENT
/end GROUP
/begin GROUP AAACalRegn03Rt01GroupA_Dummy.InertiaCmpVelDampgSpdBlndY.Ary1D "MICROSAR RTE" /begin SUB_GROUP /end SUB_GROUP /begin FUNCTION_LIST /end FUNCTION_LIST
 /begin REF_CHARACTERISTIC AAACalRegn03Rt01GroupA_Dummy.InertiaCmpVelDampgSpdBlndY.Ary1D /end REF_CHARACTERISTIC
 /begin REF_MEASUREMENT /end REF_MEASUREMENT
/end GROUP
/begin GROUP AAACalRegn03Rt01GroupA_Dummy.InertiaCmpVelNotchBlndY.Ary1D "MICROSAR RTE" /begin SUB_GROUP /end SUB_GROUP /begin FUNCTION_LIST /end FUNCTION_LIST /begin REF_CHARACTERISTIC AAACalRegn03Rt01GroupA_Dummy.InertiaCmpVelNotchBlndY.Ary1D /end REF_CHARACTERISTIC /begin REF_MEASUREMENT /end REF_MEASUREMENT /end GROUP
/begin GROUP AAACalRegn03Rt01GroupA_Dummy.RtnHwAgOffsCalcdX.Ary2D "MICROSAR RTE" /begin SUB_GROUP /end SUB_GROUP /begin FUNCTION_LIST /end FUNCTION_LIST /begin REF_CHARACTERISTIC AAACalRegn03Rt01GroupA_Dummy.RtnHwAgOffsCalcdX.Ary2D /end REF_CHARACTERISTIC /begin REF_MEASUREMENT /end REF_MEASUREMENT /end GROUP
/begin GROUP AAACalRegn03Rt01GroupA_Dummy.RtnHwAgOffsCalcdY.Ary2D "MICROSAR RTE" /begin SUB_GROUP /end SUB_GROUP /begin FUNCTION_LIST /end FUNCTION_LIST /begin REF_CHARACTERISTIC AAACalRegn03Rt01GroupA_Dummy.RtnHwAgOffsCalcdY.Ary2D /end REF_CHARACTERISTIC /begin REF_MEASUREMENT /end REF_MEASUREMENT /end GROUP
/begin GROUP AAACalRegn03Rt01GroupA_Dummy.RtnScaTqX.Ary2D "MICROSAR RTE" /begin SUB_GROUP /end SUB_GROUP /begin FUNCTION_LIST /end FUNCTION_LIST /begin REF_CHARACTERISTIC AAACalRegn03Rt01GroupA_Dummy.RtnScaTqX.Ary2D /end REF_CHARACTERISTIC /begin REF_MEASUREMENT /end REF_MEASUREMENT /end GROUP
/begin GROUP AAACalRegn03Rt01GroupA_Dummy.RtnScaTqY.Ary2D "MICROSAR RTE" /begin SUB_GROUP /end SUB_GROUP /begin FUNCTION_LIST /end FUNCTION_LIST /begin REF_CHARACTERISTIC AAACalRegn03Rt01GroupA_Dummy.RtnScaTqY.Ary2D /end REF_CHARACTERISTIC /begin REF_MEASUREMENT /end REF_MEASUREMENT /end GROUP
/begin GROUP AAACalRegn03Rt01GroupA_Dummy.RtnScaVelX.Ary2D "MICROSAR RTE" /begin SUB_GROUP /end SUB_GROUP /begin FUNCTION_LIST /end FUNCTION_LIST /begin REF_CHARACTERISTIC AAACalRegn03Rt01GroupA_Dummy.RtnScaVelX.Ary2D /end REF_CHARACTERISTIC /begin REF_MEASUREMENT /end REF_MEASUREMENT /end GROUP
/begin GROUP AAACalRegn03Rt01GroupA_Dummy.RtnScaVelY.Ary2D "MICROSAR RTE" /begin SUB_GROUP /end SUB_GROUP /begin FUNCTION_LIST /end FUNCTION_LIST /begin REF_CHARACTERISTIC AAACalRegn03Rt01GroupA_Dummy.RtnScaVelY.Ary2D /end REF_CHARACTERISTIC /begin REF_MEASUREMENT /end REF_MEASUREMENT /end GROUP
/begin GROUP AAACalRegn03Rt01GroupA_Dummy_1 "MICROSAR RTE" /begin SUB_GROUP AAACalRegn03Rt01GroupA_Dummy_1.CalibrationPorts /end SUB_GROUP /begin FUNCTION_LIST /end FUNCTION_LIST /begin REF_CHARACTERISTIC /end REF_CHARACTERISTIC /begin REF_MEASUREMENT /end REF_MEASUREMENT /end GROUP
/begin GROUP AAACalRegn03Rt01GroupA_Dummy_1.AssiHiFrqGainY.Ary2D "MICROSAR RTE" /begin SUB_GROUP /end SUB_GROUP /begin FUNCTION_LIST /end FUNCTION_LIST /begin REF_CHARACTERISTIC AAACalRegn03Rt01GroupA_Dummy_1.AssiHiFrqGainY.Ary2D /end REF_CHARACTERISTIC /begin REF_MEASUREMENT /end REF_MEASUREMENT /end GROUP
/begin GROUP AAACalRegn03Rt01GroupA_Dummy_1.AssiHiFrqTqX.Ary2D "MICROSAR RTE" /begin SUB_GROUP /end SUB_GROUP /begin FUNCTION_LIST /end FUNCTION_LIST /begin REF_CHARACTERISTIC AAACalRegn03Rt01GroupA_Dummy_1.AssiHiFrqTqX.Ary2D /end REF_CHARACTERISTIC /begin REF_MEASUREMENT /end REF_MEASUREMENT /end GROUP
/begin GROUP AAACalRegn03Rt01GroupA_Dummy_1.AssiMotTqWhlImbRejctnMinX.Ary2D "MICROSAR RTE" /begin SUB_GROUP /end SUB_GROUP /begin FUNCTION_LIST /end FUNCTION_LIST
 /begin REF_CHARACTERISTIC AAACalRegn03Rt01GroupA_Dummy_1.AssiMotTqWhlImbRejctnMinX.Ary2D /end REF_CHARACTERISTIC
 /begin REF_MEASUREMENT /end REF_MEASUREMENT
/end GROUP
/begin GROUP AAACalRegn03Rt01GroupA_Dummy_1.AssiMotTqWhlImbRejctnMinY.Ary2D "MICROSAR RTE" /begin SUB_GROUP /end SUB_GROUP /begin FUNCTION_LIST /end FUNCTION_LIST
 /begin REF_CHARACTERISTIC AAACalRegn03Rt01GroupA_Dummy_1.AssiMotTqWhlImbRejctnMinY.Ary2D /end REF_CHARACTERISTIC
 /begin REF_MEASUREMENT /end REF_MEASUREMENT
/end GROUP
/begin GROUP AAACalRegn03Rt01GroupA_Dummy_1.CalibrationPorts "MICROSAR RTE"
 /begin SUB_GROUP AAACalRegn03Rt01GroupA_Dummy_1.AssiHiFrqGainY.Ary2D AAACalRegn03Rt01GroupA_Dummy_1.AssiHiFrqTqX.Ary2D AAACalRegn03Rt01GroupA_Dummy_1.AssiMotTqWhlImbRejctnMinX.Ary2D AAACalRegn03Rt01GroupA_Dummy_1.AssiMotTqWhlImbRejctnMinY.Ary2D AAACalRegn03Rt01GroupA_Dummy_1.DampgHydCoeff1ScaY.Ary1D AAACalRegn03Rt01GroupA_Dummy_1.DampgHydCoeff2ScaY.Ary1D AAACalRegn03Rt01GroupA_Dummy_1.DampgHydCoeff3ScaY.Ary1D AAACalRegn03Rt01GroupA_Dummy_1.DampgHydCoeff4ScaY.Ary1D AAACalRegn03Rt01GroupA_Dummy_1.DampgMotVelX.Ary2D AAACalRegn03Rt01GroupA_Dummy_1.DampgMotVelY.Ary2D AAACalRegn03Rt01GroupA_Dummy_1.HysCmpFricWhlImbRejctnBlndX.Ary1D AAACalRegn03Rt01GroupA_Dummy_1.HysCmpFricWhlImbRejctnBlndY.Ary1D AAACalRegn03Rt01GroupA_Dummy_1.HysCmpFricWhlImbRejctnOffY.Ary1D AAACalRegn03Rt01GroupA_Dummy_1.HysCmpFricWhlImbRejctnOnY.Ary1D AAACalRegn03Rt01GroupA_Dummy_1.InertiaCmpVelAssiBasdDampgCoeffX.Ary1D AAACalRegn03Rt01GroupA_Dummy_1.InertiaCmpVelAssiBasdDampgRollgY.Ary1D AAACalRegn03Rt01GroupA_Dummy_1.InertiaCmpVelAssiBasdDampgStatY.Ary1D AAACalRegn03Rt01GroupA_Dummy_1.InertiaCmpVelDampgSpdBlndY.Ary1D AAACalRegn03Rt01GroupA_Dummy_1.InertiaCmpVelNotchBlndY.Ary1D AAACalRegn03Rt01GroupA_Dummy_1.RtnHwAgOffsCalcdX.Ary2D AAACalRegn03Rt01GroupA_Dummy_1.RtnHwAgOffsCalcdY.Ary2D AAACalRegn03Rt01GroupA_Dummy_1.RtnScaTqX.Ary2D AAACalRegn03Rt01GroupA_Dummy_1.RtnScaTqY.Ary2D AAACalRegn03Rt01GroupA_Dummy_1.RtnScaVelX.Ary2D AAACalRegn03Rt01GroupA_Dummy_1.RtnScaVelY.Ary2D /end SUB_GROUP
 /begin FUNCTION_LIST /end FUNCTION_LIST
 /begin REF_CHARACTERISTIC /end REF_CHARACTERISTIC
 /begin REF_MEASUREMENT /end REF_MEASUREMENT
/end GROUP
/begin GROUP AAACalRegn03Rt01GroupA_Dummy_1.DampgHydCoeff1ScaY.Ary1D "MICROSAR RTE" /begin SUB_GROUP /end SUB_GROUP /begin FUNCTION_LIST /end FUNCTION_LIST /begin REF_CHARACTERISTIC AAACalRegn03Rt01GroupA_Dummy_1.DampgHydCoeff1ScaY.Ary1D /end REF_CHARACTERISTIC /begin REF_MEASUREMENT /end REF_MEASUREMENT /end GROUP
/begin GROUP AAACalRegn03Rt01GroupA_Dummy_1.DampgHydCoeff2ScaY.Ary1D "MICROSAR RTE" /begin SUB_GROUP /end SUB_GROUP /begin FUNCTION_LIST /end FUNCTION_LIST /begin REF_CHARACTERISTIC AAACalRegn03Rt01GroupA_Dummy_1.DampgHydCoeff2ScaY.Ary1D /end REF_CHARACTERISTIC /begin REF_MEASUREMENT /end REF_MEASUREMENT /end GROUP
/begin GROUP AAACalRegn03Rt01GroupA_Dummy_1.DampgHydCoeff3ScaY.Ary1D "MICROSAR RTE" /begin SUB_GROUP /end SUB_GROUP /begin FUNCTION_LIST /end FUNCTION_LIST /begin REF_CHARACTERISTIC AAACalRegn03Rt01GroupA_Dummy_1.DampgHydCoeff3ScaY.Ary1D /end REF_CHARACTERISTIC /begin REF_MEASUREMENT /end REF_MEASUREMENT /end GROUP
/begin GROUP AAACalRegn03Rt01GroupA_Dummy_1.DampgHydCoeff4ScaY.Ary1D "MICROSAR RTE" /begin SUB_GROUP /end SUB_GROUP /begin FUNCTION_LIST /end FUNCTION_LIST /begin REF_CHARACTERISTIC AAACalRegn03Rt01GroupA_Dummy_1.DampgHydCoeff4ScaY.Ary1D /end REF_CHARACTERISTIC /begin REF_MEASUREMENT /end REF_MEASUREMENT /end GROUP
/begin GROUP AAACalRegn03Rt01GroupA_Dummy_1.DampgMotVelX.Ary2D "MICROSAR RTE" /begin SUB_GROUP /end SUB_GROUP /begin FUNCTION_LIST /end FUNCTION_LIST /begin REF_CHARACTERISTIC AAACalRegn03Rt01GroupA_Dummy_1.DampgMotVelX.Ary2D /end REF_CHARACTERISTIC /begin REF_MEASUREMENT /end REF_MEASUREMENT /end GROUP
/begin GROUP AAACalRegn03Rt01GroupA_Dummy_1.DampgMotVelY.Ary2D "MICROSAR RTE" /begin SUB_GROUP /end SUB_GROUP /begin FUNCTION_LIST /end FUNCTION_LIST /begin REF_CHARACTERISTIC AAACalRegn03Rt01GroupA_Dummy_1.DampgMotVelY.Ary2D /end REF_CHARACTERISTIC /begin REF_MEASUREMENT /end REF_MEASUREMENT /end GROUP
/begin GROUP AAACalRegn03Rt01GroupA_Dummy_1.HysCmpFricWhlImbRejctnBlndX.Ary1D "MICROSAR RTE" /begin SUB_GROUP /end SUB_GROUP /begin FUNCTION_LIST /end FUNCTION_LIST
 /begin REF_CHARACTERISTIC AAACalRegn03Rt01GroupA_Dummy_1.HysCmpFricWhlImbRejctnBlndX.Ary1D /end REF_CHARACTERISTIC
 /begin REF_MEASUREMENT /end REF_MEASUREMENT
/end GROUP
/begin GROUP AAACalRegn03Rt01GroupA_Dummy_1.HysCmpFricWhlImbRejctnBlndY.Ary1D "MICROSAR RTE" /begin SUB_GROUP /end SUB_GROUP /begin FUNCTION_LIST /end FUNCTION_LIST
 /begin REF_CHARACTERISTIC AAACalRegn03Rt01GroupA_Dummy_1.HysCmpFricWhlImbRejctnBlndY.Ary1D /end REF_CHARACTERISTIC
 /begin REF_MEASUREMENT /end REF_MEASUREMENT
/end GROUP
/begin GROUP AAACalRegn03Rt01GroupA_Dummy_1.HysCmpFricWhlImbRejctnOffY.Ary1D "MICROSAR RTE" /begin SUB_GROUP /end SUB_GROUP /begin FUNCTION_LIST /end FUNCTION_LIST
 /begin REF_CHARACTERISTIC AAACalRegn03Rt01GroupA_Dummy_1.HysCmpFricWhlImbRejctnOffY.Ary1D /end REF_CHARACTERISTIC
 /begin REF_MEASUREMENT /end REF_MEASUREMENT
/end GROUP
/begin GROUP AAACalRegn03Rt01GroupA_Dummy_1.HysCmpFricWhlImbRejctnOnY.Ary1D "MICROSAR RTE" /begin SUB_GROUP /end SUB_GROUP /begin FUNCTION_LIST /end FUNCTION_LIST
 /begin REF_CHARACTERISTIC AAACalRegn03Rt01GroupA_Dummy_1.HysCmpFricWhlImbRejctnOnY.Ary1D /end REF_CHARACTERISTIC
 /begin REF_MEASUREMENT /end REF_MEASUREMENT
/end GROUP
/begin GROUP AAACalRegn03Rt01GroupA_Dummy_1.InertiaCmpVelAssiBasdDampgCoeffX.Ary1D "MICROSAR RTE" /begin SUB_GROUP /end SUB_GROUP /begin FUNCTION_LIST /end FUNCTION_LIST
 /begin REF_CHARACTERISTIC AAACalRegn03Rt01GroupA_Dummy_1.InertiaCmpVelAssiBasdDampgCoeffX.Ary1D /end REF_CHARACTERISTIC
 /begin REF_MEASUREMENT /end REF_MEASUREMENT
/end GROUP
/begin GROUP AAACalRegn03Rt01GroupA_Dummy_1.InertiaCmpVelAssiBasdDampgRollgY.Ary1D "MICROSAR RTE" /begin SUB_GROUP /end SUB_GROUP /begin FUNCTION_LIST /end FUNCTION_LIST
 /begin REF_CHARACTERISTIC AAACalRegn03Rt01GroupA_Dummy_1.InertiaCmpVelAssiBasdDampgRollgY.Ary1D /end REF_CHARACTERISTIC
 /begin REF_MEASUREMENT /end REF_MEASUREMENT
/end GROUP
/begin GROUP AAACalRegn03Rt01GroupA_Dummy_1.InertiaCmpVelAssiBasdDampgStatY.Ary1D "MICROSAR RTE" /begin SUB_GROUP /end SUB_GROUP /begin FUNCTION_LIST /end FUNCTION_LIST
 /begin REF_CHARACTERISTIC AAACalRegn03Rt01GroupA_Dummy_1.InertiaCmpVelAssiBasdDampgStatY.Ary1D /end REF_CHARACTERISTIC
 /begin REF_MEASUREMENT /end REF_MEASUREMENT
/end GROUP
/begin GROUP AAACalRegn03Rt01GroupA_Dummy_1.InertiaCmpVelDampgSpdBlndY.Ary1D "MICROSAR RTE" /begin SUB_GROUP /end SUB_GROUP /begin FUNCTION_LIST /end FUNCTION_LIST
 /begin REF_CHARACTERISTIC AAACalRegn03Rt01GroupA_Dummy_1.InertiaCmpVelDampgSpdBlndY.Ary1D /end REF_CHARACTERISTIC
 /begin REF_MEASUREMENT /end REF_MEASUREMENT
/end GROUP
/begin GROUP AAACalRegn03Rt01GroupA_Dummy_1.InertiaCmpVelNotchBlndY.Ary1D "MICROSAR RTE" /begin SUB_GROUP /end SUB_GROUP /begin FUNCTION_LIST /end FUNCTION_LIST
 /begin REF_CHARACTERISTIC AAACalRegn03Rt01GroupA_Dummy_1.InertiaCmpVelNotchBlndY.Ary1D /end REF_CHARACTERISTIC
 /begin REF_MEASUREMENT /end REF_MEASUREMENT
/end GROUP
/begin GROUP AAACalRegn03Rt01GroupA_Dummy_1.RtnHwAgOffsCalcdX.Ary2D "MICROSAR RTE" /begin SUB_GROUP /end SUB_GROUP /begin FUNCTION_LIST /end FUNCTION_LIST /begin REF_CHARACTERISTIC AAACalRegn03Rt01GroupA_Dummy_1.RtnHwAgOffsCalcdX.Ary2D /end REF_CHARACTERISTIC /begin REF_MEASUREMENT /end REF_MEASUREMENT /end GROUP
/begin GROUP AAACalRegn03Rt01GroupA_Dummy_1.RtnHwAgOffsCalcdY.Ary2D "MICROSAR RTE" /begin SUB_GROUP /end SUB_GROUP /begin FUNCTION_LIST /end FUNCTION_LIST /begin REF_CHARACTERISTIC AAACalRegn03Rt01GroupA_Dummy_1.RtnHwAgOffsCalcdY.Ary2D /end REF_CHARACTERISTIC /begin REF_MEASUREMENT /end REF_MEASUREMENT /end GROUP
/begin GROUP AAACalRegn03Rt01GroupA_Dummy_1.RtnScaTqX.Ary2D "MICROSAR RTE" /begin SUB_GROUP /end SUB_GROUP /begin FUNCTION_LIST /end FUNCTION_LIST /begin REF_CHARACTERISTIC AAACalRegn03Rt01GroupA_Dummy_1.RtnScaTqX.Ary2D /end REF_CHARACTERISTIC /begin REF_MEASUREMENT /end REF_MEASUREMENT /end GROUP
/begin GROUP AAACalRegn03Rt01GroupA_Dummy_1.RtnScaTqY.Ary2D "MICROSAR RTE" /begin SUB_GROUP /end SUB_GROUP /begin FUNCTION_LIST /end FUNCTION_LIST /begin REF_CHARACTERISTIC AAACalRegn03Rt01GroupA_Dummy_1.RtnScaTqY.Ary2D /end REF_CHARACTERISTIC /begin REF_MEASUREMENT /end REF_MEASUREMENT /end GROUP
/begin GROUP AAACalRegn03Rt01GroupA_Dummy_1.RtnScaVelX.Ary2D "MICROSAR RTE" /begin SUB_GROUP /end SUB_GROUP /begin FUNCTION_LIST /end FUNCTION_LIST /begin REF_CHARACTERISTIC AAACalRegn03Rt01GroupA_Dummy_1.RtnScaVelX.Ary2D /end REF_CHARACTERISTIC /begin REF_MEASUREMENT /end REF_MEASUREMENT /end GROUP
/begin GROUP AAACalRegn03Rt01GroupA_Dummy_1.RtnScaVelY.Ary2D "MICROSAR RTE" /begin SUB_GROUP /end SUB_GROUP /begin FUNCTION_LIST /end FUNCTION_LIST /begin REF_CHARACTERISTIC AAACalRegn03Rt01GroupA_Dummy_1.RtnScaVelY.Ary2D /end REF_CHARACTERISTIC /begin REF_MEASUREMENT /end REF_MEASUREMENT /end GROUP
/begin GROUP AAACalRegn03Rt01GroupA_Dummy_2 "MICROSAR RTE" /begin SUB_GROUP AAACalRegn03Rt01GroupA_Dummy_2.CalibrationPorts /end SUB_GROUP /begin FUNCTION_LIST /end FUNCTION_LIST /begin REF_CHARACTERISTIC /end REF_CHARACTERISTIC /begin REF_MEASUREMENT /end REF_MEASUREMENT /end GROUP
/begin GROUP AAACalRegn03Rt01GroupA_Dummy_2.AssiHiFrqGainY.Ary2D "MICROSAR RTE" /begin SUB_GROUP /end SUB_GROUP /begin FUNCTION_LIST /end FUNCTION_LIST /begin REF_CHARACTERISTIC AAACalRegn03Rt01GroupA_Dummy_2.AssiHiFrqGainY.Ary2D /end REF_CHARACTERISTIC /begin REF_MEASUREMENT /end REF_MEASUREMENT /end GROUP
/begin GROUP AAACalRegn03Rt01GroupA_Dummy_2.AssiHiFrqTqX.Ary2D "MICROSAR RTE" /begin SUB_GROUP /end SUB_GROUP /begin FUNCTION_LIST /end FUNCTION_LIST /begin REF_CHARACTERISTIC AAACalRegn03Rt01GroupA_Dummy_2.AssiHiFrqTqX.Ary2D /end REF_CHARACTERISTIC /begin REF_MEASUREMENT /end REF_MEASUREMENT /end GROUP
/begin GROUP AAACalRegn03Rt01GroupA_Dummy_2.AssiMotTqWhlImbRejctnMinX.Ary2D "MICROSAR RTE" /begin SUB_GROUP /end SUB_GROUP /begin FUNCTION_LIST /end FUNCTION_LIST
 /begin REF_CHARACTERISTIC AAACalRegn03Rt01GroupA_Dummy_2.AssiMotTqWhlImbRejctnMinX.Ary2D /end REF_CHARACTERISTIC
 /begin REF_MEASUREMENT /end REF_MEASUREMENT
/end GROUP
/begin GROUP AAACalRegn03Rt01GroupA_Dummy_2.AssiMotTqWhlImbRejctnMinY.Ary2D "MICROSAR RTE" /begin SUB_GROUP /end SUB_GROUP /begin FUNCTION_LIST /end FUNCTION_LIST
 /begin REF_CHARACTERISTIC AAACalRegn03Rt01GroupA_Dummy_2.AssiMotTqWhlImbRejctnMinY.Ary2D /end REF_CHARACTERISTIC
 /begin REF_MEASUREMENT /end REF_MEASUREMENT
/end GROUP
/begin GROUP AAACalRegn03Rt01GroupA_Dummy_2.CalibrationPorts "MICROSAR RTE"
 /begin SUB_GROUP AAACalRegn03Rt01GroupA_Dummy_2.AssiHiFrqGainY.Ary2D AAACalRegn03Rt01GroupA_Dummy_2.AssiHiFrqTqX.Ary2D AAACalRegn03Rt01GroupA_Dummy_2.AssiMotTqWhlImbRejctnMinX.Ary2D AAACalRegn03Rt01GroupA_Dummy_2.AssiMotTqWhlImbRejctnMinY.Ary2D AAACalRegn03Rt01GroupA_Dummy_2.DampgHydCoeff1ScaY.Ary1D AAACalRegn03Rt01GroupA_Dummy_2.DampgHydCoeff2ScaY.Ary1D AAACalRegn03Rt01GroupA_Dummy_2.DampgHydCoeff3ScaY.Ary1D AAACalRegn03Rt01GroupA_Dummy_2.DampgHydCoeff4ScaY.Ary1D AAACalRegn03Rt01GroupA_Dummy_2.DampgMotVelX.Ary2D AAACalRegn03Rt01GroupA_Dummy_2.DampgMotVelY.Ary2D AAACalRegn03Rt01GroupA_Dummy_2.HysCmpFricWhlImbRejctnBlndX.Ary1D AAACalRegn03Rt01GroupA_Dummy_2.HysCmpFricWhlImbRejctnBlndY.Ary1D AAACalRegn03Rt01GroupA_Dummy_2.HysCmpFricWhlImbRejctnOffY.Ary1D AAACalRegn03Rt01GroupA_Dummy_2.HysCmpFricWhlImbRejctnOnY.Ary1D AAACalRegn03Rt01GroupA_Dummy_2.InertiaCmpVelAssiBasdDampgCoeffX.Ary1D AAACalRegn03Rt01GroupA_Dummy_2.InertiaCmpVelAssiBasdDampgRollgY.Ary1D AAACalRegn03Rt01GroupA_Dummy_2.InertiaCmpVelAssiBasdDampgStatY.Ary1D AAACalRegn03Rt01GroupA_Dummy_2.InertiaCmpVelDampgSpdBlndY.Ary1D AAACalRegn03Rt01GroupA_Dummy_2.InertiaCmpVelNotchBlndY.Ary1D AAACalRegn03Rt01GroupA_Dummy_2.RtnHwAgOffsCalcdX.Ary2D AAACalRegn03Rt01GroupA_Dummy_2.RtnHwAgOffsCalcdY.Ary2D AAACalRegn03Rt01GroupA_Dummy_2.RtnScaTqX.Ary2D AAACalRegn03Rt01GroupA_Dummy_2.RtnScaTqY.Ary2D AAACalRegn03Rt01GroupA_Dummy_2.RtnScaVelX.Ary2D AAACalRegn03Rt01GroupA_Dummy_2.RtnScaVelY.Ary2D /end SUB_GROUP
 /begin FUNCTION_LIST /end FUNCTION_LIST
 /begin REF_CHARACTERISTIC /end REF_CHARACTERISTIC
 /begin REF_MEASUREMENT /end REF_MEASUREMENT
/end GROUP
/begin GROUP AAACalRegn03Rt01GroupA_Dummy_2.DampgHydCoeff1ScaY.Ary1D "MICROSAR RTE" /begin SUB_GROUP /end SUB_GROUP /begin FUNCTION_LIST /end FUNCTION_LIST /begin REF_CHARACTERISTIC AAACalRegn03Rt01GroupA_Dummy_2.DampgHydCoeff1ScaY.Ary1D /end REF_CHARACTERISTIC /begin REF_MEASUREMENT /end REF_MEASUREMENT /end GROUP
/begin GROUP AAACalRegn03Rt01GroupA_Dummy_2.DampgHydCoeff2ScaY.Ary1D "MICROSAR RTE" /begin SUB_GROUP /end SUB_GROUP /begin FUNCTION_LIST /end FUNCTION_LIST /begin REF_CHARACTERISTIC AAACalRegn03Rt01GroupA_Dummy_2.DampgHydCoeff2ScaY.Ary1D /end REF_CHARACTERISTIC /begin REF_MEASUREMENT /end REF_MEASUREMENT /end GROUP
/begin GROUP AAACalRegn03Rt01GroupA_Dummy_2.DampgHydCoeff3ScaY.Ary1D "MICROSAR RTE" /begin SUB_GROUP /end SUB_GROUP /begin FUNCTION_LIST /end FUNCTION_LIST /begin REF_CHARACTERISTIC AAACalRegn03Rt01GroupA_Dummy_2.DampgHydCoeff3ScaY.Ary1D /end REF_CHARACTERISTIC /begin REF_MEASUREMENT /end REF_MEASUREMENT /end GROUP
/begin GROUP AAACalRegn03Rt01GroupA_Dummy_2.DampgHydCoeff4ScaY.Ary1D "MICROSAR RTE" /begin SUB_GROUP /end SUB_GROUP /begin FUNCTION_LIST /end FUNCTION_LIST /begin REF_CHARACTERISTIC AAACalRegn03Rt01GroupA_Dummy_2.DampgHydCoeff4ScaY.Ary1D /end REF_CHARACTERISTIC /begin REF_MEASUREMENT /end REF_MEASUREMENT /end GROUP
/begin GROUP AAACalRegn03Rt01GroupA_Dummy_2.DampgMotVelX.Ary2D "MICROSAR RTE" /begin SUB_GROUP /end SUB_GROUP /begin FUNCTION_LIST /end FUNCTION_LIST /begin REF_CHARACTERISTIC AAACalRegn03Rt01GroupA_Dummy_2.DampgMotVelX.Ary2D /end REF_CHARACTERISTIC /begin REF_MEASUREMENT /end REF_MEASUREMENT /end GROUP
/begin GROUP AAACalRegn03Rt01GroupA_Dummy_2.DampgMotVelY.Ary2D "MICROSAR RTE" /begin SUB_GROUP /end SUB_GROUP /begin FUNCTION_LIST /end FUNCTION_LIST /begin REF_CHARACTERISTIC AAACalRegn03Rt01GroupA_Dummy_2.DampgMotVelY.Ary2D /end REF_CHARACTERISTIC /begin REF_MEASUREMENT /end REF_MEASUREMENT /end GROUP
/begin GROUP AAACalRegn03Rt01GroupA_Dummy_2.HysCmpFricWhlImbRejctnBlndX.Ary1D "MICROSAR RTE" /begin SUB_GROUP /end SUB_GROUP /begin FUNCTION_LIST /end FUNCTION_LIST
 /begin REF_CHARACTERISTIC AAACalRegn03Rt01GroupA_Dummy_2.HysCmpFricWhlImbRejctnBlndX.Ary1D /end REF_CHARACTERISTIC
 /begin REF_MEASUREMENT /end REF_MEASUREMENT
/end GROUP
/begin GROUP AAACalRegn03Rt01GroupA_Dummy_2.HysCmpFricWhlImbRejctnBlndY.Ary1D "MICROSAR RTE" /begin SUB_GROUP /end SUB_GROUP /begin FUNCTION_LIST /end FUNCTION_LIST
 /begin REF_CHARACTERISTIC AAACalRegn03Rt01GroupA_Dummy_2.HysCmpFricWhlImbRejctnBlndY.Ary1D /end REF_CHARACTERISTIC
 /begin REF_MEASUREMENT /end REF_MEASUREMENT
/end GROUP
/begin GROUP AAACalRegn03Rt01GroupA_Dummy_2.HysCmpFricWhlImbRejctnOffY.Ary1D "MICROSAR RTE" /begin SUB_GROUP /end SUB_GROUP /begin FUNCTION_LIST /end FUNCTION_LIST
 /begin REF_CHARACTERISTIC AAACalRegn03Rt01GroupA_Dummy_2.HysCmpFricWhlImbRejctnOffY.Ary1D /end REF_CHARACTERISTIC
 /begin REF_MEASUREMENT /end REF_MEASUREMENT
/end GROUP
/begin GROUP AAACalRegn03Rt01GroupA_Dummy_2.HysCmpFricWhlImbRejctnOnY.Ary1D "MICROSAR RTE" /begin SUB_GROUP /end SUB_GROUP /begin FUNCTION_LIST /end FUNCTION_LIST
 /begin REF_CHARACTERISTIC AAACalRegn03Rt01GroupA_Dummy_2.HysCmpFricWhlImbRejctnOnY.Ary1D /end REF_CHARACTERISTIC
 /begin REF_MEASUREMENT /end REF_MEASUREMENT
/end GROUP
/begin GROUP AAACalRegn03Rt01GroupA_Dummy_2.InertiaCmpVelAssiBasdDampgCoeffX.Ary1D "MICROSAR RTE" /begin SUB_GROUP /end SUB_GROUP /begin FUNCTION_LIST /end FUNCTION_LIST
 /begin REF_CHARACTERISTIC AAACalRegn03Rt01GroupA_Dummy_2.InertiaCmpVelAssiBasdDampgCoeffX.Ary1D /end REF_CHARACTERISTIC
 /begin REF_MEASUREMENT /end REF_MEASUREMENT
/end GROUP
/begin GROUP AAACalRegn03Rt01GroupA_Dummy_2.InertiaCmpVelAssiBasdDampgRollgY.Ary1D "MICROSAR RTE" /begin SUB_GROUP /end SUB_GROUP /begin FUNCTION_LIST /end FUNCTION_LIST
 /begin REF_CHARACTERISTIC AAACalRegn03Rt01GroupA_Dummy_2.InertiaCmpVelAssiBasdDampgRollgY.Ary1D /end REF_CHARACTERISTIC
 /begin REF_MEASUREMENT /end REF_MEASUREMENT
/end GROUP
/begin GROUP AAACalRegn03Rt01GroupA_Dummy_2.InertiaCmpVelAssiBasdDampgStatY.Ary1D "MICROSAR RTE" /begin SUB_GROUP /end SUB_GROUP /begin FUNCTION_LIST /end FUNCTION_LIST
 /begin REF_CHARACTERISTIC AAACalRegn03Rt01GroupA_Dummy_2.InertiaCmpVelAssiBasdDampgStatY.Ary1D /end REF_CHARACTERISTIC
 /begin REF_MEASUREMENT /end REF_MEASUREMENT
/end GROUP
/begin GROUP AAACalRegn03Rt01GroupA_Dummy_2.InertiaCmpVelDampgSpdBlndY.Ary1D "MICROSAR RTE" /begin SUB_GROUP /end SUB_GROUP /begin FUNCTION_LIST /end FUNCTION_LIST
 /begin REF_CHARACTERISTIC AAACalRegn03Rt01GroupA_Dummy_2.InertiaCmpVelDampgSpdBlndY.Ary1D /end REF_CHARACTERISTIC
 /begin REF_MEASUREMENT /end REF_MEASUREMENT
/end GROUP
/begin GROUP AAACalRegn03Rt01GroupA_Dummy_2.InertiaCmpVelNotchBlndY.Ary1D "MICROSAR RTE" /begin SUB_GROUP /end SUB_GROUP /begin FUNCTION_LIST /end FUNCTION_LIST
 /begin REF_CHARACTERISTIC AAACalRegn03Rt01GroupA_Dummy_2.InertiaCmpVelNotchBlndY.Ary1D /end REF_CHARACTERISTIC
 /begin REF_MEASUREMENT /end REF_MEASUREMENT
/end GROUP
/begin GROUP AAACalRegn03Rt01GroupA_Dummy_2.RtnHwAgOffsCalcdX.Ary2D "MICROSAR RTE" /begin SUB_GROUP /end SUB_GROUP /begin FUNCTION_LIST /end FUNCTION_LIST /begin REF_CHARACTERISTIC AAACalRegn03Rt01GroupA_Dummy_2.RtnHwAgOffsCalcdX.Ary2D /end REF_CHARACTERISTIC /begin REF_MEASUREMENT /end REF_MEASUREMENT /end GROUP
/begin GROUP AAACalRegn03Rt01GroupA_Dummy_2.RtnHwAgOffsCalcdY.Ary2D "MICROSAR RTE" /begin SUB_GROUP /end SUB_GROUP /begin FUNCTION_LIST /end FUNCTION_LIST /begin REF_CHARACTERISTIC AAACalRegn03Rt01GroupA_Dummy_2.RtnHwAgOffsCalcdY.Ary2D /end REF_CHARACTERISTIC /begin REF_MEASUREMENT /end REF_MEASUREMENT /end GROUP
/begin GROUP AAACalRegn03Rt01GroupA_Dummy_2.RtnScaTqX.Ary2D "MICROSAR RTE" /begin SUB_GROUP /end SUB_GROUP /begin FUNCTION_LIST /end FUNCTION_LIST /begin REF_CHARACTERISTIC AAACalRegn03Rt01GroupA_Dummy_2.RtnScaTqX.Ary2D /end REF_CHARACTERISTIC /begin REF_MEASUREMENT /end REF_MEASUREMENT /end GROUP
/begin GROUP AAACalRegn03Rt01GroupA_Dummy_2.RtnScaTqY.Ary2D "MICROSAR RTE" /begin SUB_GROUP /end SUB_GROUP /begin FUNCTION_LIST /end FUNCTION_LIST /begin REF_CHARACTERISTIC AAACalRegn03Rt01GroupA_Dummy_2.RtnScaTqY.Ary2D /end REF_CHARACTERISTIC /begin REF_MEASUREMENT /end REF_MEASUREMENT /end GROUP
/begin GROUP AAACalRegn03Rt01GroupA_Dummy_2.RtnScaVelX.Ary2D "MICROSAR RTE" /begin SUB_GROUP /end SUB_GROUP /begin FUNCTION_LIST /end FUNCTION_LIST /begin REF_CHARACTERISTIC AAACalRegn03Rt01GroupA_Dummy_2.RtnScaVelX.Ary2D /end REF_CHARACTERISTIC /begin REF_MEASUREMENT /end REF_MEASUREMENT /end GROUP
/begin GROUP AAACalRegn03Rt01GroupA_Dummy_2.RtnScaVelY.Ary2D "MICROSAR RTE" /begin SUB_GROUP /end SUB_GROUP /begin FUNCTION_LIST /end FUNCTION_LIST /begin REF_CHARACTERISTIC AAACalRegn03Rt01GroupA_Dummy_2.RtnScaVelY.Ary2D /end REF_CHARACTERISTIC /begin REF_MEASUREMENT /end REF_MEASUREMENT /end GROUP
/begin GROUP AAACalRegn03Rt01GroupA_Dummy_3 "MICROSAR RTE" /begin SUB_GROUP AAACalRegn03Rt01GroupA_Dummy_3.CalibrationPorts /end SUB_GROUP /begin FUNCTION_LIST /end FUNCTION_LIST /begin REF_CHARACTERISTIC /end REF_CHARACTERISTIC /begin REF_MEASUREMENT /end REF_MEASUREMENT /end GROUP
/begin GROUP AAACalRegn03Rt01GroupA_Dummy_3.AssiHiFrqGainY.Ary2D "MICROSAR RTE" /begin SUB_GROUP /end SUB_GROUP /begin FUNCTION_LIST /end FUNCTION_LIST /begin REF_CHARACTERISTIC AAACalRegn03Rt01GroupA_Dummy_3.AssiHiFrqGainY.Ary2D /end REF_CHARACTERISTIC /begin REF_MEASUREMENT /end REF_MEASUREMENT /end GROUP
/begin GROUP AAACalRegn03Rt01GroupA_Dummy_3.AssiHiFrqTqX.Ary2D "MICROSAR RTE" /begin SUB_GROUP /end SUB_GROUP /begin FUNCTION_LIST /end FUNCTION_LIST /begin REF_CHARACTERISTIC AAACalRegn03Rt01GroupA_Dummy_3.AssiHiFrqTqX.Ary2D /end REF_CHARACTERISTIC /begin REF_MEASUREMENT /end REF_MEASUREMENT /end GROUP
/begin GROUP AAACalRegn03Rt01GroupA_Dummy_3.AssiMotTqWhlImbRejctnMinX.Ary2D "MICROSAR RTE" /begin SUB_GROUP /end SUB_GROUP /begin FUNCTION_LIST /end FUNCTION_LIST
 /begin REF_CHARACTERISTIC AAACalRegn03Rt01GroupA_Dummy_3.AssiMotTqWhlImbRejctnMinX.Ary2D /end REF_CHARACTERISTIC
 /begin REF_MEASUREMENT /end REF_MEASUREMENT
/end GROUP
/begin GROUP AAACalRegn03Rt01GroupA_Dummy_3.AssiMotTqWhlImbRejctnMinY.Ary2D "MICROSAR RTE" /begin SUB_GROUP /end SUB_GROUP /begin FUNCTION_LIST /end FUNCTION_LIST
 /begin REF_CHARACTERISTIC AAACalRegn03Rt01GroupA_Dummy_3.AssiMotTqWhlImbRejctnMinY.Ary2D /end REF_CHARACTERISTIC
 /begin REF_MEASUREMENT /end REF_MEASUREMENT
/end GROUP
/begin GROUP AAACalRegn03Rt01GroupA_Dummy_3.CalibrationPorts "MICROSAR RTE"
 /begin SUB_GROUP AAACalRegn03Rt01GroupA_Dummy_3.AssiHiFrqGainY.Ary2D AAACalRegn03Rt01GroupA_Dummy_3.AssiHiFrqTqX.Ary2D AAACalRegn03Rt01GroupA_Dummy_3.AssiMotTqWhlImbRejctnMinX.Ary2D AAACalRegn03Rt01GroupA_Dummy_3.AssiMotTqWhlImbRejctnMinY.Ary2D AAACalRegn03Rt01GroupA_Dummy_3.DampgHydCoeff1ScaY.Ary1D AAACalRegn03Rt01GroupA_Dummy_3.DampgHydCoeff2ScaY.Ary1D AAACalRegn03Rt01GroupA_Dummy_3.DampgHydCoeff3ScaY.Ary1D AAACalRegn03Rt01GroupA_Dummy_3.DampgHydCoeff4ScaY.Ary1D AAACalRegn03Rt01GroupA_Dummy_3.DampgMotVelX.Ary2D AAACalRegn03Rt01GroupA_Dummy_3.DampgMotVelY.Ary2D AAACalRegn03Rt01GroupA_Dummy_3.HysCmpFricWhlImbRejctnBlndX.Ary1D AAACalRegn03Rt01GroupA_Dummy_3.HysCmpFricWhlImbRejctnBlndY.Ary1D AAACalRegn03Rt01GroupA_Dummy_3.HysCmpFricWhlImbRejctnOffY.Ary1D AAACalRegn03Rt01GroupA_Dummy_3.HysCmpFricWhlImbRejctnOnY.Ary1D AAACalRegn03Rt01GroupA_Dummy_3.InertiaCmpVelAssiBasdDampgCoeffX.Ary1D AAACalRegn03Rt01GroupA_Dummy_3.InertiaCmpVelAssiBasdDampgRollgY.Ary1D AAACalRegn03Rt01GroupA_Dummy_3.InertiaCmpVelAssiBasdDampgStatY.Ary1D AAACalRegn03Rt01GroupA_Dummy_3.InertiaCmpVelDampgSpdBlndY.Ary1D AAACalRegn03Rt01GroupA_Dummy_3.InertiaCmpVelNotchBlndY.Ary1D AAACalRegn03Rt01GroupA_Dummy_3.RtnHwAgOffsCalcdX.Ary2D AAACalRegn03Rt01GroupA_Dummy_3.RtnHwAgOffsCalcdY.Ary2D AAACalRegn03Rt01GroupA_Dummy_3.RtnScaTqX.Ary2D AAACalRegn03Rt01GroupA_Dummy_3.RtnScaTqY.Ary2D AAACalRegn03Rt01GroupA_Dummy_3.RtnScaVelX.Ary2D AAACalRegn03Rt01GroupA_Dummy_3.RtnScaVelY.Ary2D /end SUB_GROUP
 /begin FUNCTION_LIST /end FUNCTION_LIST
 /begin REF_CHARACTERISTIC /end REF_CHARACTERISTIC
 /begin REF_MEASUREMENT /end REF_MEASUREMENT
/end GROUP
/begin GROUP AAACalRegn03Rt01GroupA_Dummy_3.DampgHydCoeff1ScaY.Ary1D "MICROSAR RTE" /begin SUB_GROUP /end SUB_GROUP /begin FUNCTION_LIST /end FUNCTION_LIST /begin REF_CHARACTERISTIC AAACalRegn03Rt01GroupA_Dummy_3.DampgHydCoeff1ScaY.Ary1D /end REF_CHARACTERISTIC /begin REF_MEASUREMENT /end REF_MEASUREMENT /end GROUP
/begin GROUP AAACalRegn03Rt01GroupA_Dummy_3.DampgHydCoeff2ScaY.Ary1D "MICROSAR RTE" /begin SUB_GROUP /end SUB_GROUP /begin FUNCTION_LIST /end FUNCTION_LIST /begin REF_CHARACTERISTIC AAACalRegn03Rt01GroupA_Dummy_3.DampgHydCoeff2ScaY.Ary1D /end REF_CHARACTERISTIC /begin REF_MEASUREMENT /end REF_MEASUREMENT /end GROUP
/begin GROUP AAACalRegn03Rt01GroupA_Dummy_3.DampgHydCoeff3ScaY.Ary1D "MICROSAR RTE" /begin SUB_GROUP /end SUB_GROUP /begin FUNCTION_LIST /end FUNCTION_LIST /begin REF_CHARACTERISTIC AAACalRegn03Rt01GroupA_Dummy_3.DampgHydCoeff3ScaY.Ary1D /end REF_CHARACTERISTIC /begin REF_MEASUREMENT /end REF_MEASUREMENT /end GROUP
/begin GROUP AAACalRegn03Rt01GroupA_Dummy_3.DampgHydCoeff4ScaY.Ary1D "MICROSAR RTE" /begin SUB_GROUP /end SUB_GROUP /begin FUNCTION_LIST /end FUNCTION_LIST /begin REF_CHARACTERISTIC AAACalRegn03Rt01GroupA_Dummy_3.DampgHydCoeff4ScaY.Ary1D /end REF_CHARACTERISTIC /begin REF_MEASUREMENT /end REF_MEASUREMENT /end GROUP
/begin GROUP AAACalRegn03Rt01GroupA_Dummy_3.DampgMotVelX.Ary2D "MICROSAR RTE" /begin SUB_GROUP /end SUB_GROUP /begin FUNCTION_LIST /end FUNCTION_LIST /begin REF_CHARACTERISTIC AAACalRegn03Rt01GroupA_Dummy_3.DampgMotVelX.Ary2D /end REF_CHARACTERISTIC /begin REF_MEASUREMENT /end REF_MEASUREMENT /end GROUP
/begin GROUP AAACalRegn03Rt01GroupA_Dummy_3.DampgMotVelY.Ary2D "MICROSAR RTE" /begin SUB_GROUP /end SUB_GROUP /begin FUNCTION_LIST /end FUNCTION_LIST /begin REF_CHARACTERISTIC AAACalRegn03Rt01GroupA_Dummy_3.DampgMotVelY.Ary2D /end REF_CHARACTERISTIC /begin REF_MEASUREMENT /end REF_MEASUREMENT /end GROUP
/begin GROUP AAACalRegn03Rt01GroupA_Dummy_3.HysCmpFricWhlImbRejctnBlndX.Ary1D "MICROSAR RTE" /begin SUB_GROUP /end SUB_GROUP /begin FUNCTION_LIST /end FUNCTION_LIST
 /begin REF_CHARACTERISTIC AAACalRegn03Rt01GroupA_Dummy_3.HysCmpFricWhlImbRejctnBlndX.Ary1D /end REF_CHARACTERISTIC
 /begin REF_MEASUREMENT /end REF_MEASUREMENT
/end GROUP
/begin GROUP AAACalRegn03Rt01GroupA_Dummy_3.HysCmpFricWhlImbRejctnBlndY.Ary1D "MICROSAR RTE" /begin SUB_GROUP /end SUB_GROUP /begin FUNCTION_LIST /end FUNCTION_LIST
 /begin REF_CHARACTERISTIC AAACalRegn03Rt01GroupA_Dummy_3.HysCmpFricWhlImbRejctnBlndY.Ary1D /end REF_CHARACTERISTIC
 /begin REF_MEASUREMENT /end REF_MEASUREMENT
/end GROUP
/begin GROUP AAACalRegn03Rt01GroupA_Dummy_3.HysCmpFricWhlImbRejctnOffY.Ary1D "MICROSAR RTE" /begin SUB_GROUP /end SUB_GROUP /begin FUNCTION_LIST /end FUNCTION_LIST
 /begin REF_CHARACTERISTIC AAACalRegn03Rt01GroupA_Dummy_3.HysCmpFricWhlImbRejctnOffY.Ary1D /end REF_CHARACTERISTIC
 /begin REF_MEASUREMENT /end REF_MEASUREMENT
/end GROUP
/begin GROUP AAACalRegn03Rt01GroupA_Dummy_3.HysCmpFricWhlImbRejctnOnY.Ary1D "MICROSAR RTE" /begin SUB_GROUP /end SUB_GROUP /begin FUNCTION_LIST /end FUNCTION_LIST
 /begin REF_CHARACTERISTIC AAACalRegn03Rt01GroupA_Dummy_3.HysCmpFricWhlImbRejctnOnY.Ary1D /end REF_CHARACTERISTIC
 /begin REF_MEASUREMENT /end REF_MEASUREMENT
/end GROUP
/begin GROUP AAACalRegn03Rt01GroupA_Dummy_3.InertiaCmpVelAssiBasdDampgCoeffX.Ary1D "MICROSAR RTE" /begin SUB_GROUP /end SUB_GROUP /begin FUNCTION_LIST /end FUNCTION_LIST
 /begin REF_CHARACTERISTIC AAACalRegn03Rt01GroupA_Dummy_3.InertiaCmpVelAssiBasdDampgCoeffX.Ary1D /end REF_CHARACTERISTIC
 /begin REF_MEASUREMENT /end REF_MEASUREMENT
/end GROUP
/begin GROUP AAACalRegn03Rt01GroupA_Dummy_3.InertiaCmpVelAssiBasdDampgRollgY.Ary1D "MICROSAR RTE" /begin SUB_GROUP /end SUB_GROUP /begin FUNCTION_LIST /end FUNCTION_LIST
 /begin REF_CHARACTERISTIC AAACalRegn03Rt01GroupA_Dummy_3.InertiaCmpVelAssiBasdDampgRollgY.Ary1D /end REF_CHARACTERISTIC
 /begin REF_MEASUREMENT /end REF_MEASUREMENT
/end GROUP
/begin GROUP AAACalRegn03Rt01GroupA_Dummy_3.InertiaCmpVelAssiBasdDampgStatY.Ary1D "MICROSAR RTE" /begin SUB_GROUP /end SUB_GROUP /begin FUNCTION_LIST /end FUNCTION_LIST
 /begin REF_CHARACTERISTIC AAACalRegn03Rt01GroupA_Dummy_3.InertiaCmpVelAssiBasdDampgStatY.Ary1D /end REF_CHARACTERISTIC
 /begin REF_MEASUREMENT /end REF_MEASUREMENT
/end GROUP
/begin GROUP AAACalRegn03Rt01GroupA_Dummy_3.InertiaCmpVelDampgSpdBlndY.Ary1D "MICROSAR RTE" /begin SUB_GROUP /end SUB_GROUP /begin FUNCTION_LIST /end FUNCTION_LIST
 /begin REF_CHARACTERISTIC AAACalRegn03Rt01GroupA_Dummy_3.InertiaCmpVelDampgSpdBlndY.Ary1D /end REF_CHARACTERISTIC
 /begin REF_MEASUREMENT /end REF_MEASUREMENT
/end GROUP
/begin GROUP AAACalRegn03Rt01GroupA_Dummy_3.InertiaCmpVelNotchBlndY.Ary1D "MICROSAR RTE" /begin SUB_GROUP /end SUB_GROUP /begin FUNCTION_LIST /end FUNCTION_LIST
 /begin REF_CHARACTERISTIC AAACalRegn03Rt01GroupA_Dummy_3.InertiaCmpVelNotchBlndY.Ary1D /end REF_CHARACTERISTIC
 /begin REF_MEASUREMENT /end REF_MEASUREMENT
/end GROUP
/begin GROUP AAACalRegn03Rt01GroupA_Dummy_3.RtnHwAgOffsCalcdX.Ary2D "MICROSAR RTE" /begin SUB_GROUP /end SUB_GROUP /begin FUNCTION_LIST /end FUNCTION_LIST /begin REF_CHARACTERISTIC AAACalRegn03Rt01GroupA_Dummy_3.RtnHwAgOffsCalcdX.Ary2D /end REF_CHARACTERISTIC /begin REF_MEASUREMENT /end REF_MEASUREMENT /end GROUP
/begin GROUP AAACalRegn03Rt01GroupA_Dummy_3.RtnHwAgOffsCalcdY.Ary2D "MICROSAR RTE" /begin SUB_GROUP /end SUB_GROUP /begin FUNCTION_LIST /end FUNCTION_LIST /begin REF_CHARACTERISTIC AAACalRegn03Rt01GroupA_Dummy_3.RtnHwAgOffsCalcdY.Ary2D /end REF_CHARACTERISTIC /begin REF_MEASUREMENT /end REF_MEASUREMENT /end GROUP
/begin GROUP AAACalRegn03Rt01GroupA_Dummy_3.RtnScaTqX.Ary2D "MICROSAR RTE" /begin SUB_GROUP /end SUB_GROUP /begin FUNCTION_LIST /end FUNCTION_LIST /begin REF_CHARACTERISTIC AAACalRegn03Rt01GroupA_Dummy_3.RtnScaTqX.Ary2D /end REF_CHARACTERISTIC /begin REF_MEASUREMENT /end REF_MEASUREMENT /end GROUP
/begin GROUP AAACalRegn03Rt01GroupA_Dummy_3.RtnScaTqY.Ary2D "MICROSAR RTE" /begin SUB_GROUP /end SUB_GROUP /begin FUNCTION_LIST /end FUNCTION_LIST /begin REF_CHARACTERISTIC AAACalRegn03Rt01GroupA_Dummy_3.RtnScaTqY.Ary2D /end REF_CHARACTERISTIC /begin REF_MEASUREMENT /end REF_MEASUREMENT /end GROUP
/begin GROUP AAACalRegn03Rt01GroupA_Dummy_3.RtnScaVelX.Ary2D "MICROSAR RTE" /begin SUB_GROUP /end SUB_GROUP /begin FUNCTION_LIST /end FUNCTION_LIST /begin REF_CHARACTERISTIC AAACalRegn03Rt01GroupA_Dummy_3.RtnScaVelX.Ary2D /end REF_CHARACTERISTIC /begin REF_MEASUREMENT /end REF_MEASUREMENT /end GROUP
/begin GROUP AAACalRegn03Rt01GroupA_Dummy_3.RtnScaVelY.Ary2D "MICROSAR RTE" /begin SUB_GROUP /end SUB_GROUP /begin FUNCTION_LIST /end FUNCTION_LIST /begin REF_CHARACTERISTIC AAACalRegn03Rt01GroupA_Dummy_3.RtnScaVelY.Ary2D /end REF_CHARACTERISTIC /begin REF_MEASUREMENT /end REF_MEASUREMENT /end GROUP
/begin GROUP AAACalRegn03Rt01GroupA_Dummy_4 "MICROSAR RTE" /begin SUB_GROUP AAACalRegn03Rt01GroupA_Dummy_4.CalibrationPorts /end SUB_GROUP /begin FUNCTION_LIST /end FUNCTION_LIST /begin REF_CHARACTERISTIC /end REF_CHARACTERISTIC /begin REF_MEASUREMENT /end REF_MEASUREMENT /end GROUP
/begin GROUP AAACalRegn03Rt01GroupA_Dummy_4.AssiHiFrqGainY.Ary2D "MICROSAR RTE" /begin SUB_GROUP /end SUB_GROUP /begin FUNCTION_LIST /end FUNCTION_LIST /begin REF_CHARACTERISTIC AAACalRegn03Rt01GroupA_Dummy_4.AssiHiFrqGainY.Ary2D /end REF_CHARACTERISTIC /begin REF_MEASUREMENT /end REF_MEASUREMENT /end GROUP
/begin GROUP AAACalRegn03Rt01GroupA_Dummy_4.AssiHiFrqTqX.Ary2D "MICROSAR RTE" /begin SUB_GROUP /end SUB_GROUP /begin FUNCTION_LIST /end FUNCTION_LIST /begin REF_CHARACTERISTIC AAACalRegn03Rt01GroupA_Dummy_4.AssiHiFrqTqX.Ary2D /end REF_CHARACTERISTIC /begin REF_MEASUREMENT /end REF_MEASUREMENT /end GROUP
/begin GROUP AAACalRegn03Rt01GroupA_Dummy_4.AssiMotTqWhlImbRejctnMinX.Ary2D "MICROSAR RTE" /begin SUB_GROUP /end SUB_GROUP /begin FUNCTION_LIST /end FUNCTION_LIST
 /begin REF_CHARACTERISTIC AAACalRegn03Rt01GroupA_Dummy_4.AssiMotTqWhlImbRejctnMinX.Ary2D /end REF_CHARACTERISTIC
 /begin REF_MEASUREMENT /end REF_MEASUREMENT
/end GROUP
/begin GROUP AAACalRegn03Rt01GroupA_Dummy_4.AssiMotTqWhlImbRejctnMinY.Ary2D "MICROSAR RTE" /begin SUB_GROUP /end SUB_GROUP /begin FUNCTION_LIST /end FUNCTION_LIST
 /begin REF_CHARACTERISTIC AAACalRegn03Rt01GroupA_Dummy_4.AssiMotTqWhlImbRejctnMinY.Ary2D /end REF_CHARACTERISTIC
 /begin REF_MEASUREMENT /end REF_MEASUREMENT
/end GROUP
/begin GROUP AAACalRegn03Rt01GroupA_Dummy_4.CalibrationPorts "MICROSAR RTE"
 /begin SUB_GROUP AAACalRegn03Rt01GroupA_Dummy_4.AssiHiFrqGainY.Ary2D AAACalRegn03Rt01GroupA_Dummy_4.AssiHiFrqTqX.Ary2D AAACalRegn03Rt01GroupA_Dummy_4.AssiMotTqWhlImbRejctnMinX.Ary2D AAACalRegn03Rt01GroupA_Dummy_4.AssiMotTqWhlImbRejctnMinY.Ary2D AAACalRegn03Rt01GroupA_Dummy_4.DampgHydCoeff1ScaY.Ary1D AAACalRegn03Rt01GroupA_Dummy_4.DampgHydCoeff2ScaY.Ary1D AAACalRegn03Rt01GroupA_Dummy_4.DampgHydCoeff3ScaY.Ary1D AAACalRegn03Rt01GroupA_Dummy_4.DampgHydCoeff4ScaY.Ary1D AAACalRegn03Rt01GroupA_Dummy_4.DampgMotVelX.Ary2D AAACalRegn03Rt01GroupA_Dummy_4.DampgMotVelY.Ary2D AAACalRegn03Rt01GroupA_Dummy_4.HysCmpFricWhlImbRejctnBlndX.Ary1D AAACalRegn03Rt01GroupA_Dummy_4.HysCmpFricWhlImbRejctnBlndY.Ary1D AAACalRegn03Rt01GroupA_Dummy_4.HysCmpFricWhlImbRejctnOffY.Ary1D AAACalRegn03Rt01GroupA_Dummy_4.HysCmpFricWhlImbRejctnOnY.Ary1D AAACalRegn03Rt01GroupA_Dummy_4.InertiaCmpVelAssiBasdDampgCoeffX.Ary1D AAACalRegn03Rt01GroupA_Dummy_4.InertiaCmpVelAssiBasdDampgRollgY.Ary1D AAACalRegn03Rt01GroupA_Dummy_4.InertiaCmpVelAssiBasdDampgStatY.Ary1D AAACalRegn03Rt01GroupA_Dummy_4.InertiaCmpVelDampgSpdBlndY.Ary1D AAACalRegn03Rt01GroupA_Dummy_4.InertiaCmpVelNotchBlndY.Ary1D AAACalRegn03Rt01GroupA_Dummy_4.RtnHwAgOffsCalcdX.Ary2D AAACalRegn03Rt01GroupA_Dummy_4.RtnHwAgOffsCalcdY.Ary2D AAACalRegn03Rt01GroupA_Dummy_4.RtnScaTqX.Ary2D AAACalRegn03Rt01GroupA_Dummy_4.RtnScaTqY.Ary2D AAACalRegn03Rt01GroupA_Dummy_4.RtnScaVelX.Ary2D AAACalRegn03Rt01GroupA_Dummy_4.RtnScaVelY.Ary2D /end SUB_GROUP
 /begin FUNCTION_LIST /end FUNCTION_LIST
 /begin REF_CHARACTERISTIC /end REF_CHARACTERISTIC
 /begin REF_MEASUREMENT /end REF_MEASUREMENT
/end GROUP
/begin GROUP AAACalRegn03Rt01GroupA_Dummy_4.DampgHydCoeff1ScaY.Ary1D "MICROSAR RTE" /begin SUB_GROUP /end SUB_GROUP /begin FUNCTION_LIST /end FUNCTION_LIST /begin REF_CHARACTERISTIC AAACalRegn03Rt01GroupA_Dummy_4.DampgHydCoeff1ScaY.Ary1D /end REF_CHARACTERISTIC /begin REF_MEASUREMENT /end REF_MEASUREMENT /end GROUP
/begin GROUP AAACalRegn03Rt01GroupA_Dummy_4.DampgHydCoeff2ScaY.Ary1D "MICROSAR RTE" /begin SUB_GROUP /end SUB_GROUP /begin FUNCTION_LIST /end FUNCTION_LIST /begin REF_CHARACTERISTIC AAACalRegn03Rt01GroupA_Dummy_4.DampgHydCoeff2ScaY.Ary1D /end REF_CHARACTERISTIC /begin REF_MEASUREMENT /end REF_MEASUREMENT /end GROUP
/begin GROUP AAACalRegn03Rt01GroupA_Dummy_4.DampgHydCoeff3ScaY.Ary1D "MICROSAR RTE" /begin SUB_GROUP /end SUB_GROUP /begin FUNCTION_LIST /end FUNCTION_LIST /begin REF_CHARACTERISTIC AAACalRegn03Rt01GroupA_Dummy_4.DampgHydCoeff3ScaY.Ary1D /end REF_CHARACTERISTIC /begin REF_MEASUREMENT /end REF_MEASUREMENT /end GROUP
/begin GROUP AAACalRegn03Rt01GroupA_Dummy_4.DampgHydCoeff4ScaY.Ary1D "MICROSAR RTE" /begin SUB_GROUP /end SUB_GROUP /begin FUNCTION_LIST /end FUNCTION_LIST /begin REF_CHARACTERISTIC AAACalRegn03Rt01GroupA_Dummy_4.DampgHydCoeff4ScaY.Ary1D /end REF_CHARACTERISTIC /begin REF_MEASUREMENT /end REF_MEASUREMENT /end GROUP
/begin GROUP AAACalRegn03Rt01GroupA_Dummy_4.DampgMotVelX.Ary2D "MICROSAR RTE" /begin SUB_GROUP /end SUB_GROUP /begin FUNCTION_LIST /end FUNCTION_LIST /begin REF_CHARACTERISTIC AAACalRegn03Rt01GroupA_Dummy_4.DampgMotVelX.Ary2D /end REF_CHARACTERISTIC /begin REF_MEASUREMENT /end REF_MEASUREMENT /end GROUP
/begin GROUP AAACalRegn03Rt01GroupA_Dummy_4.DampgMotVelY.Ary2D "MICROSAR RTE" /begin SUB_GROUP /end SUB_GROUP /begin FUNCTION_LIST /end FUNCTION_LIST /begin REF_CHARACTERISTIC AAACalRegn03Rt01GroupA_Dummy_4.DampgMotVelY.Ary2D /end REF_CHARACTERISTIC /begin REF_MEASUREMENT /end REF_MEASUREMENT /end GROUP
/begin GROUP AAACalRegn03Rt01GroupA_Dummy_4.HysCmpFricWhlImbRejctnBlndX.Ary1D "MICROSAR RTE" /begin SUB_GROUP /end SUB_GROUP /begin FUNCTION_LIST /end FUNCTION_LIST
 /begin REF_CHARACTERISTIC AAACalRegn03Rt01GroupA_Dummy_4.HysCmpFricWhlImbRejctnBlndX.Ary1D /end REF_CHARACTERISTIC
 /begin REF_MEASUREMENT /end REF_MEASUREMENT
/end GROUP
/begin GROUP AAACalRegn03Rt01GroupA_Dummy_4.HysCmpFricWhlImbRejctnBlndY.Ary1D "MICROSAR RTE" /begin SUB_GROUP /end SUB_GROUP /begin FUNCTION_LIST /end FUNCTION_LIST
 /begin REF_CHARACTERISTIC AAACalRegn03Rt01GroupA_Dummy_4.HysCmpFricWhlImbRejctnBlndY.Ary1D /end REF_CHARACTERISTIC
 /begin REF_MEASUREMENT /end REF_MEASUREMENT
/end GROUP
/begin GROUP AAACalRegn03Rt01GroupA_Dummy_4.HysCmpFricWhlImbRejctnOffY.Ary1D "MICROSAR RTE" /begin SUB_GROUP /end SUB_GROUP /begin FUNCTION_LIST /end FUNCTION_LIST
 /begin REF_CHARACTERISTIC AAACalRegn03Rt01GroupA_Dummy_4.HysCmpFricWhlImbRejctnOffY.Ary1D /end REF_CHARACTERISTIC
 /begin REF_MEASUREMENT /end REF_MEASUREMENT
/end GROUP
/begin GROUP AAACalRegn03Rt01GroupA_Dummy_4.HysCmpFricWhlImbRejctnOnY.Ary1D "MICROSAR RTE" /begin SUB_GROUP /end SUB_GROUP /begin FUNCTION_LIST /end FUNCTION_LIST
 /begin REF_CHARACTERISTIC AAACalRegn03Rt01GroupA_Dummy_4.HysCmpFricWhlImbRejctnOnY.Ary1D /end REF_CHARACTERISTIC
 /begin REF_MEASUREMENT /end REF_MEASUREMENT
/end GROUP
/begin GROUP AAACalRegn03Rt01GroupA_Dummy_4.InertiaCmpVelAssiBasdDampgCoeffX.Ary1D "MICROSAR RTE" /begin SUB_GROUP /end SUB_GROUP /begin FUNCTION_LIST /end FUNCTION_LIST
 /begin REF_CHARACTERISTIC AAACalRegn03Rt01GroupA_Dummy_4.InertiaCmpVelAssiBasdDampgCoeffX.Ary1D /end REF_CHARACTERISTIC
 /begin REF_MEASUREMENT /end REF_MEASUREMENT
/end GROUP
/begin GROUP AAACalRegn03Rt01GroupA_Dummy_4.InertiaCmpVelAssiBasdDampgRollgY.Ary1D "MICROSAR RTE" /begin SUB_GROUP /end SUB_GROUP /begin FUNCTION_LIST /end FUNCTION_LIST
 /begin REF_CHARACTERISTIC AAACalRegn03Rt01GroupA_Dummy_4.InertiaCmpVelAssiBasdDampgRollgY.Ary1D /end REF_CHARACTERISTIC
 /begin REF_MEASUREMENT /end REF_MEASUREMENT
/end GROUP
/begin GROUP AAACalRegn03Rt01GroupA_Dummy_4.InertiaCmpVelAssiBasdDampgStatY.Ary1D "MICROSAR RTE" /begin SUB_GROUP /end SUB_GROUP /begin FUNCTION_LIST /end FUNCTION_LIST
 /begin REF_CHARACTERISTIC AAACalRegn03Rt01GroupA_Dummy_4.InertiaCmpVelAssiBasdDampgStatY.Ary1D /end REF_CHARACTERISTIC
 /begin REF_MEASUREMENT /end REF_MEASUREMENT
/end GROUP
/begin GROUP AAACalRegn03Rt01GroupA_Dummy_4.InertiaCmpVelDampgSpdBlndY.Ary1D "MICROSAR RTE" /begin SUB_GROUP /end SUB_GROUP /begin FUNCTION_LIST /end FUNCTION_LIST
 /begin REF_CHARACTERISTIC AAACalRegn03Rt01GroupA_Dummy_4.InertiaCmpVelDampgSpdBlndY.Ary1D /end REF_CHARACTERISTIC
 /begin REF_MEASUREMENT /end REF_MEASUREMENT
/end GROUP
/begin GROUP AAACalRegn03Rt01GroupA_Dummy_4.InertiaCmpVelNotchBlndY.Ary1D "MICROSAR RTE" /begin SUB_GROUP /end SUB_GROUP /begin FUNCTION_LIST /end FUNCTION_LIST
 /begin REF_CHARACTERISTIC AAACalRegn03Rt01GroupA_Dummy_4.InertiaCmpVelNotchBlndY.Ary1D /end REF_CHARACTERISTIC
 /begin REF_MEASUREMENT /end REF_MEASUREMENT
/end GROUP
/begin GROUP AAACalRegn03Rt01GroupA_Dummy_4.RtnHwAgOffsCalcdX.Ary2D "MICROSAR RTE" /begin SUB_GROUP /end SUB_GROUP /begin FUNCTION_LIST /end FUNCTION_LIST /begin REF_CHARACTERISTIC AAACalRegn03Rt01GroupA_Dummy_4.RtnHwAgOffsCalcdX.Ary2D /end REF_CHARACTERISTIC /begin REF_MEASUREMENT /end REF_MEASUREMENT /end GROUP
/begin GROUP AAACalRegn03Rt01GroupA_Dummy_4.RtnHwAgOffsCalcdY.Ary2D "MICROSAR RTE" /begin SUB_GROUP /end SUB_GROUP /begin FUNCTION_LIST /end FUNCTION_LIST /begin REF_CHARACTERISTIC AAACalRegn03Rt01GroupA_Dummy_4.RtnHwAgOffsCalcdY.Ary2D /end REF_CHARACTERISTIC /begin REF_MEASUREMENT /end REF_MEASUREMENT /end GROUP
/begin GROUP AAACalRegn03Rt01GroupA_Dummy_4.RtnScaTqX.Ary2D "MICROSAR RTE" /begin SUB_GROUP /end SUB_GROUP /begin FUNCTION_LIST /end FUNCTION_LIST /begin REF_CHARACTERISTIC AAACalRegn03Rt01GroupA_Dummy_4.RtnScaTqX.Ary2D /end REF_CHARACTERISTIC /begin REF_MEASUREMENT /end REF_MEASUREMENT /end GROUP
/begin GROUP AAACalRegn03Rt01GroupA_Dummy_4.RtnScaTqY.Ary2D "MICROSAR RTE" /begin SUB_GROUP /end SUB_GROUP /begin FUNCTION_LIST /end FUNCTION_LIST /begin REF_CHARACTERISTIC AAACalRegn03Rt01GroupA_Dummy_4.RtnScaTqY.Ary2D /end REF_CHARACTERISTIC /begin REF_MEASUREMENT /end REF_MEASUREMENT /end GROUP
/begin GROUP AAACalRegn03Rt01GroupA_Dummy_4.RtnScaVelX.Ary2D "MICROSAR RTE" /begin SUB_GROUP /end SUB_GROUP /begin FUNCTION_LIST /end FUNCTION_LIST /begin REF_CHARACTERISTIC AAACalRegn03Rt01GroupA_Dummy_4.RtnScaVelX.Ary2D /end REF_CHARACTERISTIC /begin REF_MEASUREMENT /end REF_MEASUREMENT /end GROUP
/begin GROUP AAACalRegn03Rt01GroupA_Dummy_4.RtnScaVelY.Ary2D "MICROSAR RTE" /begin SUB_GROUP /end SUB_GROUP /begin FUNCTION_LIST /end FUNCTION_LIST /begin REF_CHARACTERISTIC AAACalRegn03Rt01GroupA_Dummy_4.RtnScaVelY.Ary2D /end REF_CHARACTERISTIC /begin REF_MEASUREMENT /end REF_MEASUREMENT /end GROUP
/begin GROUP AAACalRegn03Rt01GroupB_Dummy "MICROSAR RTE" /begin SUB_GROUP AAACalRegn03Rt01GroupB_Dummy.CalibrationPorts /end SUB_GROUP /begin FUNCTION_LIST /end FUNCTION_LIST /begin REF_CHARACTERISTIC /end REF_CHARACTERISTIC /begin REF_MEASUREMENT /end REF_MEASUREMENT /end GROUP
/begin GROUP AAACalRegn03Rt01GroupB_Dummy.AssiHiFrqTqWhlImbRejctnTqX.Ary2D "MICROSAR RTE" /begin SUB_GROUP /end SUB_GROUP /begin FUNCTION_LIST /end FUNCTION_LIST
 /begin REF_CHARACTERISTIC AAACalRegn03Rt01GroupB_Dummy.AssiHiFrqTqWhlImbRejctnTqX.Ary2D /end REF_CHARACTERISTIC
 /begin REF_MEASUREMENT /end REF_MEASUREMENT
/end GROUP
/begin GROUP AAACalRegn03Rt01GroupB_Dummy.AssiHiFrqWhlImbRejctnBlndX.Ary2D "MICROSAR RTE" /begin SUB_GROUP /end SUB_GROUP /begin FUNCTION_LIST /end FUNCTION_LIST
 /begin REF_CHARACTERISTIC AAACalRegn03Rt01GroupB_Dummy.AssiHiFrqWhlImbRejctnBlndX.Ary2D /end REF_CHARACTERISTIC
 /begin REF_MEASUREMENT /end REF_MEASUREMENT
/end GROUP
/begin GROUP AAACalRegn03Rt01GroupB_Dummy.AssiHiFrqWhlImbRejctnBlndY.Ary2D "MICROSAR RTE" /begin SUB_GROUP /end SUB_GROUP /begin FUNCTION_LIST /end FUNCTION_LIST
 /begin REF_CHARACTERISTIC AAACalRegn03Rt01GroupB_Dummy.AssiHiFrqWhlImbRejctnBlndY.Ary2D /end REF_CHARACTERISTIC
 /begin REF_MEASUREMENT /end REF_MEASUREMENT
/end GROUP
/begin GROUP AAACalRegn03Rt01GroupB_Dummy.AssiHiFrqWhlImbRejctnGainY.Ary2D "MICROSAR RTE" /begin SUB_GROUP /end SUB_GROUP /begin FUNCTION_LIST /end FUNCTION_LIST
 /begin REF_CHARACTERISTIC AAACalRegn03Rt01GroupB_Dummy.AssiHiFrqWhlImbRejctnGainY.Ary2D /end REF_CHARACTERISTIC
 /begin REF_MEASUREMENT /end REF_MEASUREMENT
/end GROUP
/begin GROUP AAACalRegn03Rt01GroupB_Dummy.AssiMotTqWhlImbRejctnMaxX.Ary2D "MICROSAR RTE" /begin SUB_GROUP /end SUB_GROUP /begin FUNCTION_LIST /end FUNCTION_LIST
 /begin REF_CHARACTERISTIC AAACalRegn03Rt01GroupB_Dummy.AssiMotTqWhlImbRejctnMaxX.Ary2D /end REF_CHARACTERISTIC
 /begin REF_MEASUREMENT /end REF_MEASUREMENT
/end GROUP
/begin GROUP AAACalRegn03Rt01GroupB_Dummy.AssiMotTqWhlImbRejctnMaxY.Ary2D "MICROSAR RTE" /begin SUB_GROUP /end SUB_GROUP /begin FUNCTION_LIST /end FUNCTION_LIST
 /begin REF_CHARACTERISTIC AAACalRegn03Rt01GroupB_Dummy.AssiMotTqWhlImbRejctnMaxY.Ary2D /end REF_CHARACTERISTIC
 /begin REF_MEASUREMENT /end REF_MEASUREMENT
/end GROUP
/begin GROUP AAACalRegn03Rt01GroupB_Dummy.AssiWhlImbRejctnBlndScaX.Ary2D "MICROSAR RTE" /begin SUB_GROUP /end SUB_GROUP /begin FUNCTION_LIST /end FUNCTION_LIST
 /begin REF_CHARACTERISTIC AAACalRegn03Rt01GroupB_Dummy.AssiWhlImbRejctnBlndScaX.Ary2D /end REF_CHARACTERISTIC
 /begin REF_MEASUREMENT /end REF_MEASUREMENT
/end GROUP
/begin GROUP AAACalRegn03Rt01GroupB_Dummy.AssiWhlImbRejctnBlndScaY.Ary2D "MICROSAR RTE" /begin SUB_GROUP /end SUB_GROUP /begin FUNCTION_LIST /end FUNCTION_LIST
 /begin REF_CHARACTERISTIC AAACalRegn03Rt01GroupB_Dummy.AssiWhlImbRejctnBlndScaY.Ary2D /end REF_CHARACTERISTIC
 /begin REF_MEASUREMENT /end REF_MEASUREMENT
/end GROUP
/begin GROUP AAACalRegn03Rt01GroupB_Dummy.CalibrationPorts "MICROSAR RTE"
 /begin SUB_GROUP AAACalRegn03Rt01GroupB_Dummy.AssiHiFrqTqWhlImbRejctnTqX.Ary2D AAACalRegn03Rt01GroupB_Dummy.AssiHiFrqWhlImbRejctnBlndX.Ary2D AAACalRegn03Rt01GroupB_Dummy.AssiHiFrqWhlImbRejctnBlndY.Ary2D AAACalRegn03Rt01GroupB_Dummy.AssiHiFrqWhlImbRejctnGainY.Ary2D AAACalRegn03Rt01GroupB_Dummy.AssiMotTqWhlImbRejctnMaxX.Ary2D AAACalRegn03Rt01GroupB_Dummy.AssiMotTqWhlImbRejctnMaxY.Ary2D AAACalRegn03Rt01GroupB_Dummy.AssiWhlImbRejctnBlndScaX.Ary2D AAACalRegn03Rt01GroupB_Dummy.AssiWhlImbRejctnBlndScaY.Ary2D AAACalRegn03Rt01GroupB_Dummy.EotProtnDampgVehSpdTbl.Ary1D AAACalRegn03Rt01GroupB_Dummy.EotProtnEntrGainVehSpdTbl.Ary1D AAACalRegn03Rt01GroupB_Dummy.EotProtnEntrGainX.Ary2D AAACalRegn03Rt01GroupB_Dummy.EotProtnEntrGainY.Ary2D AAACalRegn03Rt01GroupB_Dummy.EotProtnExitDampgY.Ary2D AAACalRegn03Rt01GroupB_Dummy.EotProtnHwDegDampgX.Ary2D AAACalRegn03Rt01GroupB_Dummy.EotProtnNormDampgY.Ary2D AAACalRegn03Rt01GroupB_Dummy.InertiaCmpVelAssiBasdDampgRollgWhlImbRejctnOnY.Ary1D /end SUB_GROUP
 /begin FUNCTION_LIST /end FUNCTION_LIST
 /begin REF_CHARACTERISTIC /end REF_CHARACTERISTIC
 /begin REF_MEASUREMENT /end REF_MEASUREMENT
/end GROUP
/begin GROUP AAACalRegn03Rt01GroupB_Dummy.EotProtnDampgVehSpdTbl.Ary1D "MICROSAR RTE" /begin SUB_GROUP /end SUB_GROUP /begin FUNCTION_LIST /end FUNCTION_LIST /begin REF_CHARACTERISTIC AAACalRegn03Rt01GroupB_Dummy.EotProtnDampgVehSpdTbl.Ary1D /end REF_CHARACTERISTIC /begin REF_MEASUREMENT /end REF_MEASUREMENT /end GROUP
/begin GROUP AAACalRegn03Rt01GroupB_Dummy.EotProtnEntrGainVehSpdTbl.Ary1D "MICROSAR RTE" /begin SUB_GROUP /end SUB_GROUP /begin FUNCTION_LIST /end FUNCTION_LIST
 /begin REF_CHARACTERISTIC AAACalRegn03Rt01GroupB_Dummy.EotProtnEntrGainVehSpdTbl.Ary1D /end REF_CHARACTERISTIC
 /begin REF_MEASUREMENT /end REF_MEASUREMENT
/end GROUP
/begin GROUP AAACalRegn03Rt01GroupB_Dummy.EotProtnEntrGainX.Ary2D "MICROSAR RTE" /begin SUB_GROUP /end SUB_GROUP /begin FUNCTION_LIST /end FUNCTION_LIST /begin REF_CHARACTERISTIC AAACalRegn03Rt01GroupB_Dummy.EotProtnEntrGainX.Ary2D /end REF_CHARACTERISTIC /begin REF_MEASUREMENT /end REF_MEASUREMENT /end GROUP
/begin GROUP AAACalRegn03Rt01GroupB_Dummy.EotProtnEntrGainY.Ary2D "MICROSAR RTE" /begin SUB_GROUP /end SUB_GROUP /begin FUNCTION_LIST /end FUNCTION_LIST /begin REF_CHARACTERISTIC AAACalRegn03Rt01GroupB_Dummy.EotProtnEntrGainY.Ary2D /end REF_CHARACTERISTIC /begin REF_MEASUREMENT /end REF_MEASUREMENT /end GROUP
/begin GROUP AAACalRegn03Rt01GroupB_Dummy.EotProtnExitDampgY.Ary2D "MICROSAR RTE" /begin SUB_GROUP /end SUB_GROUP /begin FUNCTION_LIST /end FUNCTION_LIST /begin REF_CHARACTERISTIC AAACalRegn03Rt01GroupB_Dummy.EotProtnExitDampgY.Ary2D /end REF_CHARACTERISTIC /begin REF_MEASUREMENT /end REF_MEASUREMENT /end GROUP
/begin GROUP AAACalRegn03Rt01GroupB_Dummy.EotProtnHwDegDampgX.Ary2D "MICROSAR RTE" /begin SUB_GROUP /end SUB_GROUP /begin FUNCTION_LIST /end FUNCTION_LIST /begin REF_CHARACTERISTIC AAACalRegn03Rt01GroupB_Dummy.EotProtnHwDegDampgX.Ary2D /end REF_CHARACTERISTIC /begin REF_MEASUREMENT /end REF_MEASUREMENT /end GROUP
/begin GROUP AAACalRegn03Rt01GroupB_Dummy.EotProtnNormDampgY.Ary2D "MICROSAR RTE" /begin SUB_GROUP /end SUB_GROUP /begin FUNCTION_LIST /end FUNCTION_LIST /begin REF_CHARACTERISTIC AAACalRegn03Rt01GroupB_Dummy.EotProtnNormDampgY.Ary2D /end REF_CHARACTERISTIC /begin REF_MEASUREMENT /end REF_MEASUREMENT /end GROUP
/begin GROUP AAACalRegn03Rt01GroupB_Dummy.InertiaCmpVelAssiBasdDampgRollgWhlImbRejctnOnY.Ary1D "MICROSAR RTE" /begin SUB_GROUP /end SUB_GROUP /begin FUNCTION_LIST /end FUNCTION_LIST
 /begin REF_CHARACTERISTIC AAACalRegn03Rt01GroupB_Dummy.InertiaCmpVelAssiBasdDampgRollgWhlImbRejctnOnY.Ary1D /end REF_CHARACTERISTIC
 /begin REF_MEASUREMENT /end REF_MEASUREMENT
/end GROUP
/begin GROUP AAACalRegn03Rt01GroupB_Dummy_1 "MICROSAR RTE" /begin SUB_GROUP AAACalRegn03Rt01GroupB_Dummy_1.CalibrationPorts /end SUB_GROUP /begin FUNCTION_LIST /end FUNCTION_LIST /begin REF_CHARACTERISTIC /end REF_CHARACTERISTIC /begin REF_MEASUREMENT /end REF_MEASUREMENT /end GROUP
/begin GROUP AAACalRegn03Rt01GroupB_Dummy_1.AssiHiFrqTqWhlImbRejctnTqX.Ary2D "MICROSAR RTE" /begin SUB_GROUP /end SUB_GROUP /begin FUNCTION_LIST /end FUNCTION_LIST
 /begin REF_CHARACTERISTIC AAACalRegn03Rt01GroupB_Dummy_1.AssiHiFrqTqWhlImbRejctnTqX.Ary2D /end REF_CHARACTERISTIC
 /begin REF_MEASUREMENT /end REF_MEASUREMENT
/end GROUP
/begin GROUP AAACalRegn03Rt01GroupB_Dummy_1.AssiHiFrqWhlImbRejctnBlndX.Ary2D "MICROSAR RTE" /begin SUB_GROUP /end SUB_GROUP /begin FUNCTION_LIST /end FUNCTION_LIST
 /begin REF_CHARACTERISTIC AAACalRegn03Rt01GroupB_Dummy_1.AssiHiFrqWhlImbRejctnBlndX.Ary2D /end REF_CHARACTERISTIC
 /begin REF_MEASUREMENT /end REF_MEASUREMENT
/end GROUP
/begin GROUP AAACalRegn03Rt01GroupB_Dummy_1.AssiHiFrqWhlImbRejctnBlndY.Ary2D "MICROSAR RTE" /begin SUB_GROUP /end SUB_GROUP /begin FUNCTION_LIST /end FUNCTION_LIST
 /begin REF_CHARACTERISTIC AAACalRegn03Rt01GroupB_Dummy_1.AssiHiFrqWhlImbRejctnBlndY.Ary2D /end REF_CHARACTERISTIC
 /begin REF_MEASUREMENT /end REF_MEASUREMENT
/end GROUP
/begin GROUP AAACalRegn03Rt01GroupB_Dummy_1.AssiHiFrqWhlImbRejctnGainY.Ary2D "MICROSAR RTE" /begin SUB_GROUP /end SUB_GROUP /begin FUNCTION_LIST /end FUNCTION_LIST
 /begin REF_CHARACTERISTIC AAACalRegn03Rt01GroupB_Dummy_1.AssiHiFrqWhlImbRejctnGainY.Ary2D /end REF_CHARACTERISTIC
 /begin REF_MEASUREMENT /end REF_MEASUREMENT
/end GROUP
/begin GROUP AAACalRegn03Rt01GroupB_Dummy_1.AssiMotTqWhlImbRejctnMaxX.Ary2D "MICROSAR RTE" /begin SUB_GROUP /end SUB_GROUP /begin FUNCTION_LIST /end FUNCTION_LIST
 /begin REF_CHARACTERISTIC AAACalRegn03Rt01GroupB_Dummy_1.AssiMotTqWhlImbRejctnMaxX.Ary2D /end REF_CHARACTERISTIC
 /begin REF_MEASUREMENT /end REF_MEASUREMENT
/end GROUP
/begin GROUP AAACalRegn03Rt01GroupB_Dummy_1.AssiMotTqWhlImbRejctnMaxY.Ary2D "MICROSAR RTE" /begin SUB_GROUP /end SUB_GROUP /begin FUNCTION_LIST /end FUNCTION_LIST
 /begin REF_CHARACTERISTIC AAACalRegn03Rt01GroupB_Dummy_1.AssiMotTqWhlImbRejctnMaxY.Ary2D /end REF_CHARACTERISTIC
 /begin REF_MEASUREMENT /end REF_MEASUREMENT
/end GROUP
/begin GROUP AAACalRegn03Rt01GroupB_Dummy_1.AssiWhlImbRejctnBlndScaX.Ary2D "MICROSAR RTE" /begin SUB_GROUP /end SUB_GROUP /begin FUNCTION_LIST /end FUNCTION_LIST
 /begin REF_CHARACTERISTIC AAACalRegn03Rt01GroupB_Dummy_1.AssiWhlImbRejctnBlndScaX.Ary2D /end REF_CHARACTERISTIC
 /begin REF_MEASUREMENT /end REF_MEASUREMENT
/end GROUP
/begin GROUP AAACalRegn03Rt01GroupB_Dummy_1.AssiWhlImbRejctnBlndScaY.Ary2D "MICROSAR RTE" /begin SUB_GROUP /end SUB_GROUP /begin FUNCTION_LIST /end FUNCTION_LIST
 /begin REF_CHARACTERISTIC AAACalRegn03Rt01GroupB_Dummy_1.AssiWhlImbRejctnBlndScaY.Ary2D /end REF_CHARACTERISTIC
 /begin REF_MEASUREMENT /end REF_MEASUREMENT
/end GROUP
/begin GROUP AAACalRegn03Rt01GroupB_Dummy_1.CalibrationPorts "MICROSAR RTE"
 /begin SUB_GROUP AAACalRegn03Rt01GroupB_Dummy_1.AssiHiFrqTqWhlImbRejctnTqX.Ary2D AAACalRegn03Rt01GroupB_Dummy_1.AssiHiFrqWhlImbRejctnBlndX.Ary2D AAACalRegn03Rt01GroupB_Dummy_1.AssiHiFrqWhlImbRejctnBlndY.Ary2D AAACalRegn03Rt01GroupB_Dummy_1.AssiHiFrqWhlImbRejctnGainY.Ary2D AAACalRegn03Rt01GroupB_Dummy_1.AssiMotTqWhlImbRejctnMaxX.Ary2D AAACalRegn03Rt01GroupB_Dummy_1.AssiMotTqWhlImbRejctnMaxY.Ary2D AAACalRegn03Rt01GroupB_Dummy_1.AssiWhlImbRejctnBlndScaX.Ary2D AAACalRegn03Rt01GroupB_Dummy_1.AssiWhlImbRejctnBlndScaY.Ary2D AAACalRegn03Rt01GroupB_Dummy_1.EotProtnDampgVehSpdTbl.Ary1D AAACalRegn03Rt01GroupB_Dummy_1.EotProtnEntrGainVehSpdTbl.Ary1D AAACalRegn03Rt01GroupB_Dummy_1.EotProtnEntrGainX.Ary2D AAACalRegn03Rt01GroupB_Dummy_1.EotProtnEntrGainY.Ary2D AAACalRegn03Rt01GroupB_Dummy_1.EotProtnExitDampgY.Ary2D AAACalRegn03Rt01GroupB_Dummy_1.EotProtnHwDegDampgX.Ary2D AAACalRegn03Rt01GroupB_Dummy_1.EotProtnNormDampgY.Ary2D AAACalRegn03Rt01GroupB_Dummy_1.InertiaCmpVelAssiBasdDampgRollgWhlImbRejctnOnY.Ary1D /end SUB_GROUP
 /begin FUNCTION_LIST /end FUNCTION_LIST
 /begin REF_CHARACTERISTIC /end REF_CHARACTERISTIC
 /begin REF_MEASUREMENT /end REF_MEASUREMENT
/end GROUP
/begin GROUP AAACalRegn03Rt01GroupB_Dummy_1.EotProtnDampgVehSpdTbl.Ary1D "MICROSAR RTE" /begin SUB_GROUP /end SUB_GROUP /begin FUNCTION_LIST /end FUNCTION_LIST
 /begin REF_CHARACTERISTIC AAACalRegn03Rt01GroupB_Dummy_1.EotProtnDampgVehSpdTbl.Ary1D /end REF_CHARACTERISTIC
 /begin REF_MEASUREMENT /end REF_MEASUREMENT
/end GROUP
/begin GROUP AAACalRegn03Rt01GroupB_Dummy_1.EotProtnEntrGainVehSpdTbl.Ary1D "MICROSAR RTE" /begin SUB_GROUP /end SUB_GROUP /begin FUNCTION_LIST /end FUNCTION_LIST
 /begin REF_CHARACTERISTIC AAACalRegn03Rt01GroupB_Dummy_1.EotProtnEntrGainVehSpdTbl.Ary1D /end REF_CHARACTERISTIC
 /begin REF_MEASUREMENT /end REF_MEASUREMENT
/end GROUP
/begin GROUP AAACalRegn03Rt01GroupB_Dummy_1.EotProtnEntrGainX.Ary2D "MICROSAR RTE" /begin SUB_GROUP /end SUB_GROUP /begin FUNCTION_LIST /end FUNCTION_LIST /begin REF_CHARACTERISTIC AAACalRegn03Rt01GroupB_Dummy_1.EotProtnEntrGainX.Ary2D /end REF_CHARACTERISTIC /begin REF_MEASUREMENT /end REF_MEASUREMENT /end GROUP
/begin RECORD_LAYOUT RTE_RL_UWORD FNC_VALUES 1 UWORD ROW_DIR DIRECT /end RECORD_LAYOUT
/begin RECORD_LAYOUT RTE_RL_ULONG FNC_VALUES 1 ULONG ROW_DIR DIRECT /end RECORD_LAYOUT
/begin RECORD_LAYOUT RTE_RL_SWORD FNC_VALUES 1 SWORD ROW_DIR DIRECT /end RECORD_LAYOUT
/begin RECORD_LAYOUT RTE_RL_FLOAT32_IEEE FNC_VALUES 1 FLOAT32_IEEE ROW_DIR DIRECT /end RECORD_LAYOUT
