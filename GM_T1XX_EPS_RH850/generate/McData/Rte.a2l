/begin CHARACTERISTIC HwTqCorrln.HwTqChACmnModCmpLpFilStDft "MICROSAR RTE" VALUE 0x0 RTE_RL_FLOAT32_IEEE 0 NO_COMPU_METHOD -3.402823466e+38 3.402823466e+38 SYMBOL_LINK "Rte_CalprmRom_HwTqCorrln_DEFAULT_RTE_CDATA_GROUP.HwTqChACmnModCmpLpFilStDft" 0 DISPLAY_IDENTIFIER HwTqCorrln.CalibrationParameters.HwTqChACmnModCmpLpFilStDft /end CHARACTERISTIC
/begin CHARACTERISTIC HwTqCorrln.HwTqChBCmnModCmpLpFilStDft "MICROSAR RTE" VALUE 0x0 RTE_RL_FLOAT32_IEEE 0 NO_COMPU_METHOD -3.402823466e+38 3.402823466e+38 SYMBOL_LINK "Rte_CalprmRom_HwTqCorrln_DEFAULT_RTE_CDATA_GROUP.HwTqChBCmnModCmpLpFilStDft" 0 DISPLAY_IDENTIFIER HwTqCorrln.CalibrationParameters.HwTqChBCmnModCmpLpFilStDft /end CHARACTERISTIC
/begin CHARACTERISTIC HwTqCorrln.HwTqCorrlnChACmnModCmpLpFilActvnThd.Val "MICROSAR RTE" VALUE 0x0 RTE_RL_FLOAT32_IEEE 0 NO_COMPU_METHOD -3.402823466e+38 3.402823466e+38 SYMBOL_LINK "Rte_CalprmRom_CalRegn01Cmn_DEFAULT_RTE_CALPRM_GROUP.HwTqCorrlnChACmnModCmpLpFilActvnThd_Val" 0 DISPLAY_IDENTIFIER HwTqCorrln.CalibrationPorts.HwTqCorrlnChACmnModCmpLpFilActvnThd.Val /end CHARACTERISTIC
/begin CHARACTERISTIC HwTqCorrln.HwTqCorrlnChACmnModCmpLpFilFrq.Val "MICROSAR RTE" VALUE 0x0 RTE_RL_FLOAT32_IEEE 0 NO_COMPU_METHOD -3.402823466e+38 3.402823466e+38 SYMBOL_LINK "Rte_CalprmRom_CalRegn01Cmn_DEFAULT_RTE_CALPRM_GROUP.HwTqCorrlnChACmnModCmpLpFilFrq_Val" 0 DISPLAY_IDENTIFIER HwTqCorrln.CalibrationPorts.HwTqCorrlnChACmnModCmpLpFilFrq.Val /end CHARACTERISTIC
/begin CHARACTERISTIC HwTqCorrln.HwTqCorrlnChACmnModCmpLpFilOutpLim.Val "MICROSAR RTE" VALUE 0x0 RTE_RL_FLOAT32_IEEE 0 NO_COMPU_METHOD -3.402823466e+38 3.402823466e+38 SYMBOL_LINK "Rte_CalprmRom_CalRegn01Cmn_DEFAULT_RTE_CALPRM_GROUP.HwTqCorrlnChACmnModCmpLpFilOutpLim_Val" 0 DISPLAY_IDENTIFIER HwTqCorrln.CalibrationPorts.HwTqCorrlnChACmnModCmpLpFilOutpLim.Val /end CHARACTERISTIC
/begin CHARACTERISTIC HwTqCorrln.HwTqCorrlnChAImdtCorrlnChkFailThd.Val "MICROSAR RTE" VALUE 0x0 RTE_RL_FLOAT32_IEEE 0 NO_COMPU_METHOD -3.402823466e+38 3.402823466e+38 SYMBOL_LINK "Rte_CalprmRom_CalRegn01Cmn_DEFAULT_RTE_CALPRM_GROUP.HwTqCorrlnChAImdtCorrlnChkFailThd_Val" 0 DISPLAY_IDENTIFIER HwTqCorrln.CalibrationPorts.HwTqCorrlnChAImdtCorrlnChkFailThd.Val /end CHARACTERISTIC
/begin CHARACTERISTIC HwTqCorrln.HwTqCorrlnChAImdtCorrlnChkPassThd.Val "MICROSAR RTE" VALUE 0x0 RTE_RL_FLOAT32_IEEE 0 NO_COMPU_METHOD -3.402823466e+38 3.402823466e+38 SYMBOL_LINK "Rte_CalprmRom_CalRegn01Cmn_DEFAULT_RTE_CALPRM_GROUP.HwTqCorrlnChAImdtCorrlnChkPassThd_Val" 0 DISPLAY_IDENTIFIER HwTqCorrln.CalibrationPorts.HwTqCorrlnChAImdtCorrlnChkPassThd.Val /end CHARACTERISTIC
/begin CHARACTERISTIC HwTqCorrln.HwTqCorrlnChAStabStClrFltThd.Val "MICROSAR RTE" VALUE 0x0 RTE_RL_FLOAT32_IEEE 0 NO_COMPU_METHOD -3.402823466e+38 3.402823466e+38 SYMBOL_LINK "Rte_CalprmRom_CalRegn01Cmn_DEFAULT_RTE_CALPRM_GROUP.HwTqCorrlnChAStabStClrFltThd_Val" 0 DISPLAY_IDENTIFIER HwTqCorrln.CalibrationPorts.HwTqCorrlnChAStabStClrFltThd.Val /end CHARACTERISTIC
/begin CHARACTERISTIC HwTqCorrln.HwTqCorrlnChAStabStLpFilFrq.Val "MICROSAR RTE" VALUE 0x0 RTE_RL_FLOAT32_IEEE 0 NO_COMPU_METHOD -3.402823466e+38 3.402823466e+38 SYMBOL_LINK "Rte_CalprmRom_CalRegn01Cmn_DEFAULT_RTE_CALPRM_GROUP.HwTqCorrlnChAStabStLpFilFrq_Val" 0 DISPLAY_IDENTIFIER HwTqCorrln.CalibrationPorts.HwTqCorrlnChAStabStLpFilFrq.Val /end CHARACTERISTIC
/begin CHARACTERISTIC HwTqCorrln.HwTqCorrlnChAStabStSetFltThd.Val "MICROSAR RTE" VALUE 0x0 RTE_RL_FLOAT32_IEEE 0 NO_COMPU_METHOD -3.402823466e+38 3.402823466e+38 SYMBOL_LINK "Rte_CalprmRom_CalRegn01Cmn_DEFAULT_RTE_CALPRM_GROUP.HwTqCorrlnChAStabStSetFltThd_Val" 0 DISPLAY_IDENTIFIER HwTqCorrln.CalibrationPorts.HwTqCorrlnChAStabStSetFltThd.Val /end CHARACTERISTIC
/begin CHARACTERISTIC HwTqCorrln.HwTqCorrlnChATqSumMaxLim.Val "MICROSAR RTE" VALUE 0x0 RTE_RL_FLOAT32_IEEE 0 NO_COMPU_METHOD -3.402823466e+38 3.402823466e+38 SYMBOL_LINK "Rte_CalprmRom_CalRegn01Cmn_DEFAULT_RTE_CALPRM_GROUP.HwTqCorrlnChATqSumMaxLim_Val" 0 DISPLAY_IDENTIFIER HwTqCorrln.CalibrationPorts.HwTqCorrlnChATqSumMaxLim.Val /end CHARACTERISTIC
/begin CHARACTERISTIC HwTqCorrln.HwTqCorrlnChATraLpFilX.Ary1D "MICROSAR RTE" VAL_BLK 0x0 RTE_RL_UWORD 0 NO_COMPU_METHOD 0 65535 MATRIX_DIM 17 1 1 SYMBOL_LINK "Rte_CalprmRom_CalRegn01Cmn_DEFAULT_RTE_CALPRM_GROUP.HwTqCorrlnChATraLpFilX_Ary1D" 0 DISPLAY_IDENTIFIER HwTqCorrln.CalibrationPorts.HwTqCorrlnChATraLpFilX.Ary1D /end CHARACTERISTIC
/begin CHARACTERISTIC HwTqCorrln.HwTqCorrlnChATraLpFilY.Ary1D "MICROSAR RTE" VAL_BLK 0x0 RTE_RL_UWORD 0 NO_COMPU_METHOD 0 65535 MATRIX_DIM 17 1 1 SYMBOL_LINK "Rte_CalprmRom_CalRegn01Cmn_DEFAULT_RTE_CALPRM_GROUP.HwTqCorrlnChATraLpFilY_Ary1D" 0 DISPLAY_IDENTIFIER HwTqCorrln.CalibrationPorts.HwTqCorrlnChATraLpFilY.Ary1D /end CHARACTERISTIC
/begin CHARACTERISTIC HwTqCorrln.HwTqCorrlnChATraSumClrFltThd.Val "MICROSAR RTE" VALUE 0x0 RTE_RL_FLOAT32_IEEE 0 NO_COMPU_METHOD -3.402823466e+38 3.402823466e+38 SYMBOL_LINK "Rte_CalprmRom_CalRegn01Cmn_DEFAULT_RTE_CALPRM_GROUP.HwTqCorrlnChATraSumClrFltThd_Val" 0 DISPLAY_IDENTIFIER HwTqCorrln.CalibrationPorts.HwTqCorrlnChATraSumClrFltThd.Val /end CHARACTERISTIC
/begin CHARACTERISTIC HwTqCorrln.HwTqCorrlnChATraSumSetFltThd.Val "MICROSAR RTE" VALUE 0x0 RTE_RL_FLOAT32_IEEE 0 NO_COMPU_METHOD -3.402823466e+38 3.402823466e+38 SYMBOL_LINK "Rte_CalprmRom_CalRegn01Cmn_DEFAULT_RTE_CALPRM_GROUP.HwTqCorrlnChATraSumSetFltThd_Val" 0 DISPLAY_IDENTIFIER HwTqCorrln.CalibrationPorts.HwTqCorrlnChATraSumSetFltThd.Val /end CHARACTERISTIC
/begin CHARACTERISTIC HwTqCorrln.HwTqCorrlnChBCmnModCmpLpFilActvnThd.Val "MICROSAR RTE" VALUE 0x0 RTE_RL_FLOAT32_IEEE 0 NO_COMPU_METHOD -3.402823466e+38 3.402823466e+38 SYMBOL_LINK "Rte_CalprmRom_CalRegn01Cmn_DEFAULT_RTE_CALPRM_GROUP.HwTqCorrlnChBCmnModCmpLpFilActvnThd_Val" 0 DISPLAY_IDENTIFIER HwTqCorrln.CalibrationPorts.HwTqCorrlnChBCmnModCmpLpFilActvnThd.Val /end CHARACTERISTIC
/begin CHARACTERISTIC HwTqCorrln.HwTqCorrlnChBCmnModCmpLpFilFrq.Val "MICROSAR RTE" VALUE 0x0 RTE_RL_FLOAT32_IEEE 0 NO_COMPU_METHOD -3.402823466e+38 3.402823466e+38 SYMBOL_LINK "Rte_CalprmRom_CalRegn01Cmn_DEFAULT_RTE_CALPRM_GROUP.HwTqCorrlnChBCmnModCmpLpFilFrq_Val" 0 DISPLAY_IDENTIFIER HwTqCorrln.CalibrationPorts.HwTqCorrlnChBCmnModCmpLpFilFrq.Val /end CHARACTERISTIC
/begin CHARACTERISTIC HwTqCorrln.HwTqCorrlnChBCmnModCmpLpFilOutpLim.Val "MICROSAR RTE" VALUE 0x0 RTE_RL_FLOAT32_IEEE 0 NO_COMPU_METHOD -3.402823466e+38 3.402823466e+38 SYMBOL_LINK "Rte_CalprmRom_CalRegn01Cmn_DEFAULT_RTE_CALPRM_GROUP.HwTqCorrlnChBCmnModCmpLpFilOutpLim_Val" 0 DISPLAY_IDENTIFIER HwTqCorrln.CalibrationPorts.HwTqCorrlnChBCmnModCmpLpFilOutpLim.Val /end CHARACTERISTIC
/begin CHARACTERISTIC HwTqCorrln.HwTqCorrlnChBImdtCorrlnChkFailThd.Val "MICROSAR RTE" VALUE 0x0 RTE_RL_FLOAT32_IEEE 0 NO_COMPU_METHOD -3.402823466e+38 3.402823466e+38 SYMBOL_LINK "Rte_CalprmRom_CalRegn01Cmn_DEFAULT_RTE_CALPRM_GROUP.HwTqCorrlnChBImdtCorrlnChkFailThd_Val" 0 DISPLAY_IDENTIFIER HwTqCorrln.CalibrationPorts.HwTqCorrlnChBImdtCorrlnChkFailThd.Val /end CHARACTERISTIC
/begin CHARACTERISTIC HwTqCorrln.HwTqCorrlnChBImdtCorrlnChkPassThd.Val "MICROSAR RTE" VALUE 0x0 RTE_RL_FLOAT32_IEEE 0 NO_COMPU_METHOD -3.402823466e+38 3.402823466e+38 SYMBOL_LINK "Rte_CalprmRom_CalRegn01Cmn_DEFAULT_RTE_CALPRM_GROUP.HwTqCorrlnChBImdtCorrlnChkPassThd_Val" 0 DISPLAY_IDENTIFIER HwTqCorrln.CalibrationPorts.HwTqCorrlnChBImdtCorrlnChkPassThd.Val /end CHARACTERISTIC
/begin CHARACTERISTIC HwTqCorrln.HwTqCorrlnChBStabStClrFltThd.Val "MICROSAR RTE" VALUE 0x0 RTE_RL_FLOAT32_IEEE 0 NO_COMPU_METHOD -3.402823466e+38 3.402823466e+38 SYMBOL_LINK "Rte_CalprmRom_CalRegn01Cmn_DEFAULT_RTE_CALPRM_GROUP.HwTqCorrlnChBStabStClrFltThd_Val" 0 DISPLAY_IDENTIFIER HwTqCorrln.CalibrationPorts.HwTqCorrlnChBStabStClrFltThd.Val /end CHARACTERISTIC
/begin CHARACTERISTIC HwTqCorrln.HwTqCorrlnChBStabStLpFilFrq.Val "MICROSAR RTE" VALUE 0x0 RTE_RL_FLOAT32_IEEE 0 NO_COMPU_METHOD -3.402823466e+38 3.402823466e+38 SYMBOL_LINK "Rte_CalprmRom_CalRegn01Cmn_DEFAULT_RTE_CALPRM_GROUP.HwTqCorrlnChBStabStLpFilFrq_Val" 0 DISPLAY_IDENTIFIER HwTqCorrln.CalibrationPorts.HwTqCorrlnChBStabStLpFilFrq.Val /end CHARACTERISTIC
/begin CHARACTERISTIC HwTqCorrln.HwTqCorrlnChBStabStSetFltThd.Val "MICROSAR RTE" VALUE 0x0 RTE_RL_FLOAT32_IEEE 0 NO_COMPU_METHOD -3.402823466e+38 3.402823466e+38 SYMBOL_LINK "Rte_CalprmRom_CalRegn01Cmn_DEFAULT_RTE_CALPRM_GROUP.HwTqCorrlnChBStabStSetFltThd_Val" 0 DISPLAY_IDENTIFIER HwTqCorrln.CalibrationPorts.HwTqCorrlnChBStabStSetFltThd.Val /end CHARACTERISTIC
/begin CHARACTERISTIC HwTqCorrln.HwTqCorrlnChBTqSumMaxLim.Val "MICROSAR RTE" VALUE 0x0 RTE_RL_FLOAT32_IEEE 0 NO_COMPU_METHOD -3.402823466e+38 3.402823466e+38 SYMBOL_LINK "Rte_CalprmRom_CalRegn01Cmn_DEFAULT_RTE_CALPRM_GROUP.HwTqCorrlnChBTqSumMaxLim_Val" 0 DISPLAY_IDENTIFIER HwTqCorrln.CalibrationPorts.HwTqCorrlnChBTqSumMaxLim.Val /end CHARACTERISTIC
/begin CHARACTERISTIC HwTqCorrln.HwTqCorrlnChBTraLpFilX.Ary1D "MICROSAR RTE" VAL_BLK 0x0 RTE_RL_UWORD 0 NO_COMPU_METHOD 0 65535 MATRIX_DIM 17 1 1 SYMBOL_LINK "Rte_CalprmRom_CalRegn01Cmn_DEFAULT_RTE_CALPRM_GROUP.HwTqCorrlnChBTraLpFilX_Ary1D" 0 DISPLAY_IDENTIFIER HwTqCorrln.CalibrationPorts.HwTqCorrlnChBTraLpFilX.Ary1D /end CHARACTERISTIC
/begin CHARACTERISTIC HwTqCorrln.HwTqCorrlnChBTraLpFilY.Ary1D "MICROSAR RTE" VAL_BLK 0x0 RTE_RL_UWORD 0 NO_COMPU_METHOD 0 65535 MATRIX_DIM 17 1 1 SYMBOL_LINK "Rte_CalprmRom_CalRegn01Cmn_DEFAULT_RTE_CALPRM_GROUP.HwTqCorrlnChBTraLpFilY_Ary1D" 0 DISPLAY_IDENTIFIER HwTqCorrln.CalibrationPorts.HwTqCorrlnChBTraLpFilY.Ary1D /end CHARACTERISTIC
/begin CHARACTERISTIC HwTqCorrln.HwTqCorrlnChBTraSumClrFltThd.Val "MICROSAR RTE" VALUE 0x0 RTE_RL_FLOAT32_IEEE 0 NO_COMPU_METHOD -3.402823466e+38 3.402823466e+38 SYMBOL_LINK "Rte_CalprmRom_CalRegn01Cmn_DEFAULT_RTE_CALPRM_GROUP.HwTqCorrlnChBTraSumClrFltThd_Val" 0 DISPLAY_IDENTIFIER HwTqCorrln.CalibrationPorts.HwTqCorrlnChBTraSumClrFltThd.Val /end CHARACTERISTIC
/begin CHARACTERISTIC HwTqCorrln.HwTqCorrlnChBTraSumSetFltThd.Val "MICROSAR RTE" VALUE 0x0 RTE_RL_FLOAT32_IEEE 0 NO_COMPU_METHOD -3.402823466e+38 3.402823466e+38 SYMBOL_LINK "Rte_CalprmRom_CalRegn01Cmn_DEFAULT_RTE_CALPRM_GROUP.HwTqCorrlnChBTraSumSetFltThd_Val" 0 DISPLAY_IDENTIFIER HwTqCorrln.CalibrationPorts.HwTqCorrlnChBTraSumSetFltThd.Val /end CHARACTERISTIC
/begin CHARACTERISTIC HwTqCorrln.HwTqCorrlnMaxStallTqA.Val "MICROSAR RTE" VALUE 0x0 RTE_RL_UBYTE 0 NO_COMPU_METHOD 0 255 SYMBOL_LINK "Rte_CalprmRom_CalRegn01Cmn_DEFAULT_RTE_CALPRM_GROUP.HwTqCorrlnMaxStallTqA_Val" 0 DISPLAY_IDENTIFIER HwTqCorrln.CalibrationPorts.HwTqCorrlnMaxStallTqA.Val /end CHARACTERISTIC
/begin CHARACTERISTIC HwTqCorrln.HwTqCorrlnMaxStallTqB.Val "MICROSAR RTE" VALUE 0x0 RTE_RL_UBYTE 0 NO_COMPU_METHOD 0 255 SYMBOL_LINK "Rte_CalprmRom_CalRegn01Cmn_DEFAULT_RTE_CALPRM_GROUP.HwTqCorrlnMaxStallTqB_Val" 0 DISPLAY_IDENTIFIER HwTqCorrln.CalibrationPorts.HwTqCorrlnMaxStallTqB.Val /end CHARACTERISTIC
/begin CHARACTERISTIC HwTqCorrln.HwTqCorrlnMaxStallTqC.Val "MICROSAR RTE" VALUE 0x0 RTE_RL_UBYTE 0 NO_COMPU_METHOD 0 255 SYMBOL_LINK "Rte_CalprmRom_CalRegn01Cmn_DEFAULT_RTE_CALPRM_GROUP.HwTqCorrlnMaxStallTqC_Val" 0 DISPLAY_IDENTIFIER HwTqCorrln.CalibrationPorts.HwTqCorrlnMaxStallTqC.Val /end CHARACTERISTIC
/begin CHARACTERISTIC HwTqCorrln.HwTqCorrlnMaxStallTqD.Val "MICROSAR RTE" VALUE 0x0 RTE_RL_UBYTE 0 NO_COMPU_METHOD 0 255 SYMBOL_LINK "Rte_CalprmRom_CalRegn01Cmn_DEFAULT_RTE_CALPRM_GROUP.HwTqCorrlnMaxStallTqD_Val" 0 DISPLAY_IDENTIFIER HwTqCorrln.CalibrationPorts.HwTqCorrlnMaxStallTqD.Val /end CHARACTERISTIC
/begin CHARACTERISTIC HysCmp.HysCmpAssiCmdLpFilFrq.Val "MICROSAR RTE" VALUE 0x0 RTE_RL_FLOAT32_IEEE 0 NO_COMPU_METHOD -3.402823466e+38 3.402823466e+38 SYMBOL_LINK "Rte_CalprmRom_CalRegn03Inin00_DEFAULT_RTE_CALPRM_GROUP.HysCmpAssiCmdLpFilFrq_Val" 0 DISPLAY_IDENTIFIER HysCmp.CalibrationPorts.HysCmpAssiCmdLpFilFrq.Val /end CHARACTERISTIC
/begin CHARACTERISTIC HysCmp.HysCmpAssiInpLim.Val "MICROSAR RTE" VALUE 0x0 RTE_RL_UWORD 0 NO_COMPU_METHOD 0 65535 SYMBOL_LINK "Rte_CalprmRom_CalRegn03Inin00GroupA_DEFAULT_RTE_CALPRM_GROUP.HysCmpAssiInpLim_Val" 0 DISPLAY_IDENTIFIER HysCmp.CalibrationPorts.HysCmpAssiInpLim.Val /end CHARACTERISTIC
/begin CHARACTERISTIC HysCmp.HysCmpEffLossY.Ary1D "MICROSAR RTE" VAL_BLK 0x0 RTE_RL_UWORD 0 NO_COMPU_METHOD 0 65535 MATRIX_DIM 12 1 1 SYMBOL_LINK "Rte_CalprmRom_CalRegn03CmnGroupA_DEFAULT_RTE_CALPRM_GROUP.HysCmpEffLossY_Ary1D" 0 DISPLAY_IDENTIFIER HysCmp.CalibrationPorts.HysCmpEffLossY.Ary1D /end CHARACTERISTIC
/begin CHARACTERISTIC HysCmp.HysCmpEffOffsY.Ary1D "MICROSAR RTE" VAL_BLK 0x0 RTE_RL_UWORD 0 NO_COMPU_METHOD 0 65535 MATRIX_DIM 12 1 1 SYMBOL_LINK "Rte_CalprmRom_CalRegn03CmnGroupA_DEFAULT_RTE_CALPRM_GROUP.HysCmpEffOffsY_Ary1D" 0 DISPLAY_IDENTIFIER HysCmp.CalibrationPorts.HysCmpEffOffsY.Ary1D /end CHARACTERISTIC
/begin CHARACTERISTIC HysCmp.HysCmpFinalOutpLpFilFrq.Val "MICROSAR RTE" VALUE 0x0 RTE_RL_FLOAT32_IEEE 0 NO_COMPU_METHOD -3.402823466e+38 3.402823466e+38 SYMBOL_LINK "Rte_CalprmRom_CalRegn03Inin00_DEFAULT_RTE_CALPRM_GROUP.HysCmpFinalOutpLpFilFrq_Val" 0 DISPLAY_IDENTIFIER HysCmp.CalibrationPorts.HysCmpFinalOutpLpFilFrq.Val /end CHARACTERISTIC
/begin CHARACTERISTIC HysCmp.HysCmpFricTScaX.Ary1D "MICROSAR RTE" VAL_BLK 0x0 RTE_RL_SWORD 0 NO_COMPU_METHOD -32768 32767 MATRIX_DIM 8 1 1 SYMBOL_LINK "Rte_CalprmRom_CalRegn03Inin00GroupA_DEFAULT_RTE_CALPRM_GROUP.HysCmpFricTScaX_Ary1D" 0 DISPLAY_IDENTIFIER HysCmp.CalibrationPorts.HysCmpFricTScaX.Ary1D /end CHARACTERISTIC
/begin CHARACTERISTIC HysCmp.HysCmpFricTScaY.Ary1D "MICROSAR RTE" VAL_BLK 0x0 RTE_RL_UWORD 0 NO_COMPU_METHOD 0 65535 MATRIX_DIM 8 1 1 SYMBOL_LINK "Rte_CalprmRom_CalRegn03Inin00GroupA_DEFAULT_RTE_CALPRM_GROUP.HysCmpFricTScaY_Ary1D" 0 DISPLAY_IDENTIFIER HysCmp.CalibrationPorts.HysCmpFricTScaY.Ary1D /end CHARACTERISTIC
/begin CHARACTERISTIC HysCmp.HysCmpFricWhlImbRejctnBlndX.Ary1D "MICROSAR RTE" VAL_BLK 0x0 RTE_RL_UWORD 0 NO_COMPU_METHOD 0 65535 MATRIX_DIM 6 1 1 SYMBOL_LINK "Rte_CalprmRom_CalRegn03Rt00GroupA_DEFAULT_RTE_CALPRM_GROUP.HysCmpFricWhlImbRejctnBlndX_Ary1D" 0 DISPLAY_IDENTIFIER HysCmp.CalibrationPorts.HysCmpFricWhlImbRejctnBlndX.Ary1D /end CHARACTERISTIC
/begin CHARACTERISTIC HysCmp.HysCmpFricWhlImbRejctnBlndY.Ary1D "MICROSAR RTE" VAL_BLK 0x0 RTE_RL_UWORD 0 NO_COMPU_METHOD 0 65535 MATRIX_DIM 6 1 1 SYMBOL_LINK "Rte_CalprmRom_CalRegn03Rt00GroupA_DEFAULT_RTE_CALPRM_GROUP.HysCmpFricWhlImbRejctnBlndY_Ary1D" 0 DISPLAY_IDENTIFIER HysCmp.CalibrationPorts.HysCmpFricWhlImbRejctnBlndY.Ary1D /end CHARACTERISTIC
/begin CHARACTERISTIC HysCmp.HysCmpFricWhlImbRejctnOffY.Ary1D "MICROSAR RTE" VAL_BLK 0x0 RTE_RL_UWORD 0 NO_COMPU_METHOD 0 65535 MATRIX_DIM 12 1 1 SYMBOL_LINK "Rte_CalprmRom_CalRegn03Rt00GroupA_DEFAULT_RTE_CALPRM_GROUP.HysCmpFricWhlImbRejctnOffY_Ary1D" 0 DISPLAY_IDENTIFIER HysCmp.CalibrationPorts.HysCmpFricWhlImbRejctnOffY.Ary1D /end CHARACTERISTIC
/begin CHARACTERISTIC HysCmp.HysCmpFricWhlImbRejctnOnY.Ary1D "MICROSAR RTE" VAL_BLK 0x0 RTE_RL_UWORD 0 NO_COMPU_METHOD 0 65535 MATRIX_DIM 12 1 1 SYMBOL_LINK "Rte_CalprmRom_CalRegn03Rt00GroupA_DEFAULT_RTE_CALPRM_GROUP.HysCmpFricWhlImbRejctnOnY_Ary1D" 0 DISPLAY_IDENTIFIER HysCmp.CalibrationPorts.HysCmpFricWhlImbRejctnOnY.Ary1D /end CHARACTERISTIC
/begin CHARACTERISTIC HysCmp.HysCmpHwTqLpFilFrq.Val "MICROSAR RTE" VALUE 0x0 RTE_RL_FLOAT32_IEEE 0 NO_COMPU_METHOD -3.402823466e+38 3.402823466e+38 SYMBOL_LINK "Rte_CalprmRom_CalRegn03Inin00_DEFAULT_RTE_CALPRM_GROUP.HysCmpHwTqLpFilFrq_Val" 0 DISPLAY_IDENTIFIER HysCmp.CalibrationPorts.HysCmpHwTqLpFilFrq.Val /end CHARACTERISTIC
/begin CHARACTERISTIC HysCmp.HysCmpHwTqScaX.Ary2D "MICROSAR RTE" VAL_BLK 0x0 RTE_RL_UWORD 0 NO_COMPU_METHOD 0 65535 MATRIX_DIM 8 12 1 SYMBOL_LINK "Rte_CalprmRom_CalRegn03CmnGroupA_DEFAULT_RTE_CALPRM_GROUP.HysCmpHwTqScaX_Ary2D" 0 DISPLAY_IDENTIFIER HysCmp.CalibrationPorts.HysCmpHwTqScaX.Ary2D /end CHARACTERISTIC
/begin CHARACTERISTIC HysCmp.HysCmpHwTqScaY.Ary2D "MICROSAR RTE" VAL_BLK 0x0 RTE_RL_UWORD 0 NO_COMPU_METHOD 0 65535 MATRIX_DIM 8 12 1 SYMBOL_LINK "Rte_CalprmRom_CalRegn03CmnGroupA_DEFAULT_RTE_CALPRM_GROUP.HysCmpHwTqScaY_Ary2D" 0 DISPLAY_IDENTIFIER HysCmp.CalibrationPorts.HysCmpHwTqScaY.Ary2D /end CHARACTERISTIC
/begin CHARACTERISTIC HysCmp.HysCmpHysSatnY.Ary1D "MICROSAR RTE" VAL_BLK 0x0 RTE_RL_UWORD 0 NO_COMPU_METHOD 0 65535 MATRIX_DIM 12 1 1 SYMBOL_LINK "Rte_CalprmRom_CalRegn03CmnGroupA_DEFAULT_RTE_CALPRM_GROUP.HysCmpHysSatnY_Ary1D" 0 DISPLAY_IDENTIFIER HysCmp.CalibrationPorts.HysCmpHysSatnY.Ary1D /end CHARACTERISTIC
/begin CHARACTERISTIC HysCmp.HysCmpNegHysCmpScaX.Ary1D "MICROSAR RTE" VAL_BLK 0x0 RTE_RL_UWORD 0 NO_COMPU_METHOD 0 65535 MATRIX_DIM 5 1 1 SYMBOL_LINK "Rte_CalprmRom_CalRegn03CmnGroupA_DEFAULT_RTE_CALPRM_GROUP.HysCmpNegHysCmpScaX_Ary1D" 0 DISPLAY_IDENTIFIER HysCmp.CalibrationPorts.HysCmpNegHysCmpScaX.Ary1D /end CHARACTERISTIC
/begin CHARACTERISTIC HysCmp.HysCmpNegHysCmpScaY.Ary1D "MICROSAR RTE" VAL_BLK 0x0 RTE_RL_UWORD 0 NO_COMPU_METHOD 0 65535 MATRIX_DIM 5 1 1 SYMBOL_LINK "Rte_CalprmRom_CalRegn03CmnGroupA_DEFAULT_RTE_CALPRM_GROUP.HysCmpNegHysCmpScaY_Ary1D" 0 DISPLAY_IDENTIFIER HysCmp.CalibrationPorts.HysCmpNegHysCmpScaY.Ary1D /end CHARACTERISTIC
/begin CHARACTERISTIC HysCmp.HysCmpNegHysCmpX.Ary1D "MICROSAR RTE" VAL_BLK 0x0 RTE_RL_UWORD 0 NO_COMPU_METHOD 0 65535 MATRIX_DIM 8 1 1 SYMBOL_LINK "Rte_CalprmRom_CalRegn03CmnGroupA_DEFAULT_RTE_CALPRM_GROUP.HysCmpNegHysCmpX_Ary1D" 0 DISPLAY_IDENTIFIER HysCmp.CalibrationPorts.HysCmpNegHysCmpX.Ary1D /end CHARACTERISTIC
/begin CHARACTERISTIC HysCmp.HysCmpNegHysCmpY.Ary1D "MICROSAR RTE" VAL_BLK 0x0 RTE_RL_UWORD 0 NO_COMPU_METHOD 0 65535 MATRIX_DIM 8 1 1 SYMBOL_LINK "Rte_CalprmRom_CalRegn03CmnGroupA_DEFAULT_RTE_CALPRM_GROUP.HysCmpNegHysCmpY_Ary1D" 0 DISPLAY_IDENTIFIER HysCmp.CalibrationPorts.HysCmpNegHysCmpY.Ary1D /end CHARACTERISTIC
/begin CHARACTERISTIC HysCmp.HysCmpOutpLim.Val "MICROSAR RTE" VALUE 0x0 RTE_RL_FLOAT32_IEEE 0 NO_COMPU_METHOD -3.402823466e+38 3.402823466e+38 SYMBOL_LINK "Rte_CalprmRom_CalRegn03CmnGroupA_DEFAULT_RTE_CALPRM_GROUP.HysCmpOutpLim_Val" 0 DISPLAY_IDENTIFIER HysCmp.CalibrationPorts.HysCmpOutpLim.Val /end CHARACTERISTIC
/begin CHARACTERISTIC HysCmp.HysCmpRevGain.Val "MICROSAR RTE" VALUE 0x0 RTE_RL_FLOAT32_IEEE 0 NO_COMPU_METHOD -3.402823466e+38 3.402823466e+38 SYMBOL_LINK "Rte_CalprmRom_CalRegn03CmnGroupA_DEFAULT_RTE_CALPRM_GROUP.HysCmpRevGain_Val" 0 DISPLAY_IDENTIFIER HysCmp.CalibrationPorts.HysCmpRevGain.Val /end CHARACTERISTIC
/begin CHARACTERISTIC HysCmp.HysCmpRiseX.Ary1D "MICROSAR RTE" VAL_BLK 0x0 RTE_RL_UWORD 0 NO_COMPU_METHOD 0 65535 MATRIX_DIM 6 1 1 SYMBOL_LINK "Rte_CalprmRom_CalRegn03CmnGroupA_DEFAULT_RTE_CALPRM_GROUP.HysCmpRiseX_Ary1D" 0 DISPLAY_IDENTIFIER HysCmp.CalibrationPorts.HysCmpRiseX.Ary1D /end CHARACTERISTIC
/begin CHARACTERISTIC HysCmp.HysCmpRiseY.Ary1D "MICROSAR RTE" VAL_BLK 0x0 RTE_RL_UWORD 0 NO_COMPU_METHOD 0 65535 MATRIX_DIM 6 1 1 SYMBOL_LINK "Rte_CalprmRom_CalRegn03CmnGroupA_DEFAULT_RTE_CALPRM_GROUP.HysCmpRiseY_Ary1D" 0 DISPLAY_IDENTIFIER HysCmp.CalibrationPorts.HysCmpRiseY.Ary1D /end CHARACTERISTIC
/begin CHARACTERISTIC HysCmp.SysGlbPrmSysTqRat.Val "MICROSAR RTE" VALUE 0x0 RTE_RL_FLOAT32_IEEE 0 NO_COMPU_METHOD -3.402823466e+38 3.402823466e+38 SYMBOL_LINK "Rte_CalprmRom_CalRegn03Inin00_DEFAULT_RTE_CALPRM_GROUP.SysGlbPrmSysTqRat_Val" 0 DISPLAY_IDENTIFIER HysCmp.CalibrationPorts.SysGlbPrmSysTqRat.Val /end CHARACTERISTIC
/begin CHARACTERISTIC HysCmp.SysGlbPrmVehSpdBilnrSeln.Ary1D "MICROSAR RTE" VAL_BLK 0x0 RTE_RL_UWORD 0 NO_COMPU_METHOD 0 65535 MATRIX_DIM 12 1 1 SYMBOL_LINK "Rte_CalprmRom_CalRegn01Cmn_DEFAULT_RTE_CALPRM_GROUP.SysGlbPrmVehSpdBilnrSeln_Ary1D" 0 DISPLAY_IDENTIFIER HysCmp.CalibrationPorts.SysGlbPrmVehSpdBilnrSeln.Ary1D /end CHARACTERISTIC
/begin CHARACTERISTIC InertiaCmpVel.InertiaCmpVelAssiBasdDampgCoeffX.Ary1D "MICROSAR RTE" VAL_BLK 0x0 RTE_RL_UWORD 0 NO_COMPU_METHOD 0 65535 MATRIX_DIM 10 1 1 SYMBOL_LINK "Rte_CalprmRom_CalRegn03Rt00GroupA_DEFAULT_RTE_CALPRM_GROUP.InertiaCmpVelAssiBasdDampgCoeffX_Ary1D" 0 DISPLAY_IDENTIFIER InertiaCmpVel.CalibrationPorts.InertiaCmpVelAssiBasdDampgCoeffX.Ary1D /end CHARACTERISTIC
/begin CHARACTERISTIC InertiaCmpVel.InertiaCmpVelAssiBasdDampgRollgWhlImbRejctnOnY.Ary1D "MICROSAR RTE" VAL_BLK 0x0 RTE_RL_UWORD 0 NO_COMPU_METHOD 0 65535 MATRIX_DIM 10 1 1 SYMBOL_LINK "Rte_CalprmRom_CalRegn03Rt00GroupB_DEFAULT_RTE_CALPRM_GROUP.InertiaCmpVelAssiBasdDampgRollgWhlImbRejctnOnY_Ary1D" 0 DISPLAY_IDENTIFIER InertiaCmpVel.CalibrationPorts.InertiaCmpVelAssiBasdDampgRollgWhlImbRejctnOnY.Ary1D /end CHARACTERISTIC
/begin CHARACTERISTIC InertiaCmpVel.InertiaCmpVelAssiBasdDampgRollgY.Ary1D "MICROSAR RTE" VAL_BLK 0x0 RTE_RL_UWORD 0 NO_COMPU_METHOD 0 65535 MATRIX_DIM 10 1 1 SYMBOL_LINK "Rte_CalprmRom_CalRegn03Rt00GroupA_DEFAULT_RTE_CALPRM_GROUP.InertiaCmpVelAssiBasdDampgRollgY_Ary1D" 0 DISPLAY_IDENTIFIER InertiaCmpVel.CalibrationPorts.InertiaCmpVelAssiBasdDampgRollgY.Ary1D /end CHARACTERISTIC
/begin CHARACTERISTIC InertiaCmpVel.InertiaCmpVelAssiBasdDampgStatY.Ary1D "MICROSAR RTE" VAL_BLK 0x0 RTE_RL_UWORD 0 NO_COMPU_METHOD 0 65535 MATRIX_DIM 10 1 1 SYMBOL_LINK "Rte_CalprmRom_CalRegn03Rt00GroupA_DEFAULT_RTE_CALPRM_GROUP.InertiaCmpVelAssiBasdDampgStatY_Ary1D" 0 DISPLAY_IDENTIFIER InertiaCmpVel.CalibrationPorts.InertiaCmpVelAssiBasdDampgStatY.Ary1D /end CHARACTERISTIC
/begin CHARACTERISTIC InertiaCmpVel.InertiaCmpVelCmdScaY.Ary1D "MICROSAR RTE" VAL_BLK 0x0 RTE_RL_UWORD 0 NO_COMPU_METHOD 0 65535 MATRIX_DIM 12 1 1 SYMBOL_LINK "Rte_CalprmRom_CalRegn03Inin00GroupA_DEFAULT_RTE_CALPRM_GROUP.InertiaCmpVelCmdScaY_Ary1D" 0 DISPLAY_IDENTIFIER InertiaCmpVel.CalibrationPorts.InertiaCmpVelCmdScaY.Ary1D /end CHARACTERISTIC
/begin CHARACTERISTIC InertiaCmpVel.InertiaCmpVelDampgDecelGain.Val "MICROSAR RTE" VALUE 0x0 RTE_RL_FLOAT32_IEEE 0 NO_COMPU_METHOD -3.402823466e+38 3.402823466e+38 SYMBOL_LINK "Rte_CalprmRom_CalRegn03Inin00GroupA_DEFAULT_RTE_CALPRM_GROUP.InertiaCmpVelDampgDecelGain_Val" 0 DISPLAY_IDENTIFIER InertiaCmpVel.CalibrationPorts.InertiaCmpVelDampgDecelGain.Val /end CHARACTERISTIC
/begin CHARACTERISTIC InertiaCmpVel.InertiaCmpVelDampgDecelGainFallSlew.Val "MICROSAR RTE" VALUE 0x0 RTE_RL_FLOAT32_IEEE 0 NO_COMPU_METHOD -3.402823466e+38 3.402823466e+38 SYMBOL_LINK "Rte_CalprmRom_CalRegn03Inin00GroupA_DEFAULT_RTE_CALPRM_GROUP.InertiaCmpVelDampgDecelGainFallSlew_Val" 0 DISPLAY_IDENTIFIER InertiaCmpVel.CalibrationPorts.InertiaCmpVelDampgDecelGainFallSlew.Val /end CHARACTERISTIC
/begin CHARACTERISTIC InertiaCmpVel.InertiaCmpVelDampgDecelGainRisngSlewX.Ary1D "MICROSAR RTE" VAL_BLK 0x0 RTE_RL_UWORD 0 NO_COMPU_METHOD 0 65535 MATRIX_DIM 6 1 1 SYMBOL_LINK "Rte_CalprmRom_CalRegn03Inin00GroupA_DEFAULT_RTE_CALPRM_GROUP.InertiaCmpVelDampgDecelGainRisngSlewX_Ary1D" 0 DISPLAY_IDENTIFIER InertiaCmpVel.CalibrationPorts.InertiaCmpVelDampgDecelGainRisngSlewX.Ary1D /end CHARACTERISTIC
/begin CHARACTERISTIC InertiaCmpVel.InertiaCmpVelDampgDecelGainRisngSlewY.Ary1D "MICROSAR RTE" VAL_BLK 0x0 RTE_RL_UWORD 0 NO_COMPU_METHOD 0 65535 MATRIX_DIM 6 1 1 SYMBOL_LINK "Rte_CalprmRom_CalRegn03Inin00GroupA_DEFAULT_RTE_CALPRM_GROUP.InertiaCmpVelDampgDecelGainRisngSlewY_Ary1D" 0 DISPLAY_IDENTIFIER InertiaCmpVel.CalibrationPorts.InertiaCmpVelDampgDecelGainRisngSlewY.Ary1D /end CHARACTERISTIC
/begin CHARACTERISTIC InertiaCmpVel.InertiaCmpVelDampgFilFrq.Ary1D "MICROSAR RTE" VAL_BLK 0x0 RTE_RL_UWORD 0 NO_COMPU_METHOD 0 65535 MATRIX_DIM 12 1 1 SYMBOL_LINK "Rte_CalprmRom_CalRegn03Rt00_DEFAULT_RTE_CALPRM_GROUP.InertiaCmpVelDampgFilFrq_Ary1D" 0 DISPLAY_IDENTIFIER InertiaCmpVel.CalibrationPorts.InertiaCmpVelDampgFilFrq.Ary1D /end CHARACTERISTIC
/begin CHARACTERISTIC InertiaCmpVel.InertiaCmpVelDampgFilFrqWhlImbRejctnOn.Ary1D "MICROSAR RTE" VAL_BLK 0x0 RTE_RL_UWORD 0 NO_COMPU_METHOD 0 65535 MATRIX_DIM 12 1 1 SYMBOL_LINK "Rte_CalprmRom_CalRegn03Rt00_DEFAULT_RTE_CALPRM_GROUP.InertiaCmpVelDampgFilFrqWhlImbRejctnOn_Ary1D" 0 DISPLAY_IDENTIFIER InertiaCmpVel.CalibrationPorts.InertiaCmpVelDampgFilFrqWhlImbRejctnOn.Ary1D /end CHARACTERISTIC
/begin CHARACTERISTIC InertiaCmpVel.InertiaCmpVelDampgGainOffThd.Val "MICROSAR RTE" VALUE 0x0 RTE_RL_FLOAT32_IEEE 0 NO_COMPU_METHOD -3.402823466e+38 3.402823466e+38 SYMBOL_LINK "Rte_CalprmRom_CalRegn03Inin00GroupA_DEFAULT_RTE_CALPRM_GROUP.InertiaCmpVelDampgGainOffThd_Val" 0 DISPLAY_IDENTIFIER InertiaCmpVel.CalibrationPorts.InertiaCmpVelDampgGainOffThd.Val /end CHARACTERISTIC
/begin CHARACTERISTIC InertiaCmpVel.InertiaCmpVelDampgGainOnThd.Val "MICROSAR RTE" VALUE 0x0 RTE_RL_FLOAT32_IEEE 0 NO_COMPU_METHOD -3.402823466e+38 3.402823466e+38 SYMBOL_LINK "Rte_CalprmRom_CalRegn03Inin00GroupA_DEFAULT_RTE_CALPRM_GROUP.InertiaCmpVelDampgGainOnThd_Val" 0 DISPLAY_IDENTIFIER InertiaCmpVel.CalibrationPorts.InertiaCmpVelDampgGainOnThd.Val /end CHARACTERISTIC
/begin CHARACTERISTIC InertiaCmpVel.InertiaCmpVelDampgSpdBlndY.Ary1D "MICROSAR RTE" VAL_BLK 0x0 RTE_RL_UWORD 0 NO_COMPU_METHOD 0 65535 MATRIX_DIM 12 1 1 SYMBOL_LINK "Rte_CalprmRom_CalRegn03Rt00GroupA_DEFAULT_RTE_CALPRM_GROUP.InertiaCmpVelDampgSpdBlndY_Ary1D" 0 DISPLAY_IDENTIFIER InertiaCmpVel.CalibrationPorts.InertiaCmpVelDampgSpdBlndY.Ary1D /end CHARACTERISTIC
/begin CHARACTERISTIC InertiaCmpVel.InertiaCmpVelDampgWhlImbRejctnBlndX.Ary1D "MICROSAR RTE" VAL_BLK 0x0 RTE_RL_UWORD 0 NO_COMPU_METHOD 0 65535 MATRIX_DIM 5 1 1 SYMBOL_LINK "Rte_CalprmRom_CalRegn03CmnGroupB_DEFAULT_RTE_CALPRM_GROUP.InertiaCmpVelDampgWhlImbRejctnBlndX_Ary1D" 0 DISPLAY_IDENTIFIER InertiaCmpVel.CalibrationPorts.InertiaCmpVelDampgWhlImbRejctnBlndX.Ary1D /end CHARACTERISTIC
/begin CHARACTERISTIC InertiaCmpVel.InertiaCmpVelDampgWhlImbRejctnBlndY.Ary1D "MICROSAR RTE" VAL_BLK 0x0 RTE_RL_UWORD 0 NO_COMPU_METHOD 0 65535 MATRIX_DIM 5 1 1 SYMBOL_LINK "Rte_CalprmRom_CalRegn03CmnGroupB_DEFAULT_RTE_CALPRM_GROUP.InertiaCmpVelDampgWhlImbRejctnBlndY_Ary1D" 0 DISPLAY_IDENTIFIER InertiaCmpVel.CalibrationPorts.InertiaCmpVelDampgWhlImbRejctnBlndY.Ary1D /end CHARACTERISTIC
/begin CHARACTERISTIC InertiaCmpVel.InertiaCmpVelDecelGainEnaCal.Logl "MICROSAR RTE" VALUE 0x0 RTE_RL_BOOLEAN 0 RTE_CM_BOOLEAN 0 255 SYMBOL_LINK "Rte_CalprmRom_CalRegn02Cmn_DEFAULT_RTE_CALPRM_GROUP.InertiaCmpVelDecelGainEnaCal_Logl" 0 DISPLAY_IDENTIFIER InertiaCmpVel.CalibrationPorts.InertiaCmpVelDecelGainEnaCal.Logl /end CHARACTERISTIC
/begin CHARACTERISTIC InertiaCmpVel.InertiaCmpVelMotInertia.Val "MICROSAR RTE" VALUE 0x0 RTE_RL_FLOAT32_IEEE 0 NO_COMPU_METHOD -3.402823466e+38 3.402823466e+38 SYMBOL_LINK "Rte_CalprmRom_CalRegn03Inin00_DEFAULT_RTE_CALPRM_GROUP.InertiaCmpVelMotInertia_Val" 0 DISPLAY_IDENTIFIER InertiaCmpVel.CalibrationPorts.InertiaCmpVelMotInertia.Val /end CHARACTERISTIC
/begin CHARACTERISTIC InertiaCmpVel.InertiaCmpVelMotVelBasdOutpScagX.Ary1D "MICROSAR RTE" VAL_BLK 0x0 RTE_RL_UWORD 0 NO_COMPU_METHOD 0 65535 MATRIX_DIM 2 1 1 SYMBOL_LINK "Rte_CalprmRom_CalRegn03Inin00GroupA_DEFAULT_RTE_CALPRM_GROUP.InertiaCmpVelMotVelBasdOutpScagX_Ary1D" 0 DISPLAY_IDENTIFIER InertiaCmpVel.CalibrationPorts.InertiaCmpVelMotVelBasdOutpScagX.Ary1D /end CHARACTERISTIC
/begin CHARACTERISTIC InertiaCmpVel.InertiaCmpVelMotVelBasdOutpScagY.Ary1D "MICROSAR RTE" VAL_BLK 0x0 RTE_RL_UWORD 0 NO_COMPU_METHOD 0 65535 MATRIX_DIM 2 1 1 SYMBOL_LINK "Rte_CalprmRom_CalRegn03Inin00GroupA_DEFAULT_RTE_CALPRM_GROUP.InertiaCmpVelMotVelBasdOutpScagY_Ary1D" 0 DISPLAY_IDENTIFIER InertiaCmpVel.CalibrationPorts.InertiaCmpVelMotVelBasdOutpScagY.Ary1D /end CHARACTERISTIC
/begin CHARACTERISTIC InertiaCmpVel.InertiaCmpVelNotchBlndY.Ary1D "MICROSAR RTE" VAL_BLK 0x0 RTE_RL_UWORD 0 NO_COMPU_METHOD 0 65535 MATRIX_DIM 12 1 1 SYMBOL_LINK "Rte_CalprmRom_CalRegn03Rt00GroupA_DEFAULT_RTE_CALPRM_GROUP.InertiaCmpVelNotchBlndY_Ary1D" 0 DISPLAY_IDENTIFIER InertiaCmpVel.CalibrationPorts.InertiaCmpVelNotchBlndY.Ary1D /end CHARACTERISTIC
/begin CHARACTERISTIC InertiaCmpVel.InertiaCmpVelNotchFilStruct.Rec.FilGainA1 "MICROSAR RTE" VALUE 0x0 RTE_RL_FLOAT32_IEEE 0 NO_COMPU_METHOD -3.402823466e+38 3.402823466e+38 SYMBOL_LINK "Rte_CalprmRom_CalRegn03Inin00_DEFAULT_RTE_CALPRM_GROUP.InertiaCmpVelNotchFilStruct_Rec.FilGainA1" 0 DISPLAY_IDENTIFIER InertiaCmpVel.CalibrationPorts.InertiaCmpVelNotchFilStruct.Rec.FilGainA1 /end CHARACTERISTIC
/begin CHARACTERISTIC InertiaCmpVel.InertiaCmpVelNotchFilStruct.Rec.FilGainA2 "MICROSAR RTE" VALUE 0x0 RTE_RL_FLOAT32_IEEE 0 NO_COMPU_METHOD -3.402823466e+38 3.402823466e+38 SYMBOL_LINK "Rte_CalprmRom_CalRegn03Inin00_DEFAULT_RTE_CALPRM_GROUP.InertiaCmpVelNotchFilStruct_Rec.FilGainA2" 0 DISPLAY_IDENTIFIER InertiaCmpVel.CalibrationPorts.InertiaCmpVelNotchFilStruct.Rec.FilGainA2 /end CHARACTERISTIC
/begin CHARACTERISTIC InertiaCmpVel.InertiaCmpVelNotchFilStruct.Rec.FilGainB0 "MICROSAR RTE" VALUE 0x0 RTE_RL_FLOAT32_IEEE 0 NO_COMPU_METHOD -3.402823466e+38 3.402823466e+38 SYMBOL_LINK "Rte_CalprmRom_CalRegn03Inin00_DEFAULT_RTE_CALPRM_GROUP.InertiaCmpVelNotchFilStruct_Rec.FilGainB0" 0 DISPLAY_IDENTIFIER InertiaCmpVel.CalibrationPorts.InertiaCmpVelNotchFilStruct.Rec.FilGainB0 /end CHARACTERISTIC
/begin CHARACTERISTIC InertiaCmpVel.InertiaCmpVelNotchFilStruct.Rec.FilGainB1 "MICROSAR RTE" VALUE 0x0 RTE_RL_FLOAT32_IEEE 0 NO_COMPU_METHOD -3.402823466e+38 3.402823466e+38 SYMBOL_LINK "Rte_CalprmRom_CalRegn03Inin00_DEFAULT_RTE_CALPRM_GROUP.InertiaCmpVelNotchFilStruct_Rec.FilGainB1" 0 DISPLAY_IDENTIFIER InertiaCmpVel.CalibrationPorts.InertiaCmpVelNotchFilStruct.Rec.FilGainB1 /end CHARACTERISTIC
/begin CHARACTERISTIC InertiaCmpVel.InertiaCmpVelNotchFilStruct.Rec.FilGainB2 "MICROSAR RTE" VALUE 0x0 RTE_RL_FLOAT32_IEEE 0 NO_COMPU_METHOD -3.402823466e+38 3.402823466e+38 SYMBOL_LINK "Rte_CalprmRom_CalRegn03Inin00_DEFAULT_RTE_CALPRM_GROUP.InertiaCmpVelNotchFilStruct_Rec.FilGainB2" 0 DISPLAY_IDENTIFIER InertiaCmpVel.CalibrationPorts.InertiaCmpVelNotchFilStruct.Rec.FilGainB2 /end CHARACTERISTIC
/begin CHARACTERISTIC InertiaCmpVel.InertiaCmpVelTqSnsrVelFilFrq.Val "MICROSAR RTE" VALUE 0x0 RTE_RL_FLOAT32_IEEE 0 NO_COMPU_METHOD -3.402823466e+38 3.402823466e+38 SYMBOL_LINK "Rte_CalprmRom_CalRegn03Inin00_DEFAULT_RTE_CALPRM_GROUP.InertiaCmpVelTqSnsrVelFilFrq_Val" 0 DISPLAY_IDENTIFIER InertiaCmpVel.CalibrationPorts.InertiaCmpVelTqSnsrVelFilFrq.Val /end CHARACTERISTIC
/begin CHARACTERISTIC InertiaCmpVel.InertiaCmpVelTqSnsrVelSca.Ary1D "MICROSAR RTE" VAL_BLK 0x0 RTE_RL_UWORD 0 NO_COMPU_METHOD 0 65535 MATRIX_DIM 12 1 1 SYMBOL_LINK "Rte_CalprmRom_CalRegn03Inin00GroupA_DEFAULT_RTE_CALPRM_GROUP.InertiaCmpVelTqSnsrVelSca_Ary1D" 0 DISPLAY_IDENTIFIER InertiaCmpVel.CalibrationPorts.InertiaCmpVelTqSnsrVelSca.Ary1D /end CHARACTERISTIC
/begin CHARACTERISTIC InertiaCmpVel.SysGlbPrmSysKineRat.Val "MICROSAR RTE" VALUE 0x0 RTE_RL_FLOAT32_IEEE 0 NO_COMPU_METHOD -3.402823466e+38 3.402823466e+38 SYMBOL_LINK "Rte_CalprmRom_CalRegn03Inin00_DEFAULT_RTE_CALPRM_GROUP.SysGlbPrmSysKineRat_Val" 0 DISPLAY_IDENTIFIER InertiaCmpVel.CalibrationPorts.SysGlbPrmSysKineRat.Val /end CHARACTERISTIC
/begin CHARACTERISTIC InertiaCmpVel.SysGlbPrmTorsBarStfn.Val "MICROSAR RTE" VALUE 0x0 RTE_RL_FLOAT32_IEEE 0 NO_COMPU_METHOD -3.402823466e+38 3.402823466e+38 SYMBOL_LINK "Rte_CalprmRom_CalRegn01Inin00_DEFAULT_RTE_CALPRM_GROUP.SysGlbPrmTorsBarStfn_Val" 0 DISPLAY_IDENTIFIER InertiaCmpVel.CalibrationPorts.SysGlbPrmTorsBarStfn.Val /end CHARACTERISTIC
/begin CHARACTERISTIC InertiaCmpVel.SysGlbPrmVehSpdBilnrSeln.Ary1D "MICROSAR RTE" VAL_BLK 0x0 RTE_RL_UWORD 0 NO_COMPU_METHOD 0 65535 MATRIX_DIM 12 1 1 SYMBOL_LINK "Rte_CalprmRom_CalRegn01Cmn_DEFAULT_RTE_CALPRM_GROUP.SysGlbPrmVehSpdBilnrSeln_Ary1D" 0 DISPLAY_IDENTIFIER InertiaCmpVel.CalibrationPorts.SysGlbPrmVehSpdBilnrSeln.Ary1D /end CHARACTERISTIC
/begin CHARACTERISTIC LimrCdng.LimrCdngGainDecSlew.Val "MICROSAR RTE" VALUE 0x0 RTE_RL_FLOAT32_IEEE 0 NO_COMPU_METHOD -3.402823466e+38 3.402823466e+38 SYMBOL_LINK "Rte_CalprmRom_CalRegn01Inin00_DEFAULT_RTE_CALPRM_GROUP.LimrCdngGainDecSlew_Val" 0 DISPLAY_IDENTIFIER LimrCdng.CalibrationPorts.LimrCdngGainDecSlew.Val /end CHARACTERISTIC
/begin CHARACTERISTIC LimrCdng.LimrCdngGainIncSlewX.Ary1D "MICROSAR RTE" VAL_BLK 0x0 RTE_RL_UWORD 0 NO_COMPU_METHOD 0 65535 MATRIX_DIM 2 1 1 SYMBOL_LINK "Rte_CalprmRom_CalRegn01Inin00_DEFAULT_RTE_CALPRM_GROUP.LimrCdngGainIncSlewX_Ary1D" 0 DISPLAY_IDENTIFIER LimrCdng.CalibrationPorts.LimrCdngGainIncSlewX.Ary1D /end CHARACTERISTIC
/begin CHARACTERISTIC LimrCdng.LimrCdngGainIncSlewY.Ary1D "MICROSAR RTE" VAL_BLK 0x0 RTE_RL_UWORD 0 NO_COMPU_METHOD 0 65535 MATRIX_DIM 2 1 1 SYMBOL_LINK "Rte_CalprmRom_CalRegn01Inin00_DEFAULT_RTE_CALPRM_GROUP.LimrCdngGainIncSlewY_Ary1D" 0 DISPLAY_IDENTIFIER LimrCdng.CalibrationPorts.LimrCdngGainIncSlewY.Ary1D /end CHARACTERISTIC
/begin CHARACTERISTIC LimrCdng.LimrCdngTqDecSlew.Val "MICROSAR RTE" VALUE 0x0 RTE_RL_FLOAT32_IEEE 0 NO_COMPU_METHOD -3.402823466e+38 3.402823466e+38 SYMBOL_LINK "Rte_CalprmRom_CalRegn01Inin00_DEFAULT_RTE_CALPRM_GROUP.LimrCdngTqDecSlew_Val" 0 DISPLAY_IDENTIFIER LimrCdng.CalibrationPorts.LimrCdngTqDecSlew.Val /end CHARACTERISTIC
/begin CHARACTERISTIC LimrCdng.LimrCdngTqIncSlewX.Ary1D "MICROSAR RTE" VAL_BLK 0x0 RTE_RL_UWORD 0 NO_COMPU_METHOD 0 65535 MATRIX_DIM 2 1 1 SYMBOL_LINK "Rte_CalprmRom_CalRegn01Inin00_DEFAULT_RTE_CALPRM_GROUP.LimrCdngTqIncSlewX_Ary1D" 0 DISPLAY_IDENTIFIER LimrCdng.CalibrationPorts.LimrCdngTqIncSlewX.Ary1D /end CHARACTERISTIC
/begin CHARACTERISTIC LimrCdng.LimrCdngTqIncSlewY.Ary1D "MICROSAR RTE" VAL_BLK 0x0 RTE_RL_UWORD 0 NO_COMPU_METHOD 0 65535 MATRIX_DIM 2 1 1 SYMBOL_LINK "Rte_CalprmRom_CalRegn01Inin00_DEFAULT_RTE_CALPRM_GROUP.LimrCdngTqIncSlewY_Ary1D" 0 DISPLAY_IDENTIFIER LimrCdng.CalibrationPorts.LimrCdngTqIncSlewY.Ary1D /end CHARACTERISTIC
/begin CHARACTERISTIC LoaMgr.LoaMgrCurrIvtrMtgtnRate.Val "MICROSAR RTE" VALUE 0x0 RTE_RL_FLOAT32_IEEE 0 NO_COMPU_METHOD -3.402823466e+38 3.402823466e+38 SYMBOL_LINK "Rte_CalprmRom_CalRegn01Cmn_DEFAULT_RTE_CALPRM_GROUP.LoaMgrCurrIvtrMtgtnRate_Val" 0 DISPLAY_IDENTIFIER LoaMgr.CalibrationPorts.LoaMgrCurrIvtrMtgtnRate.Val /end CHARACTERISTIC
/begin CHARACTERISTIC LoaMgr.LoaMgrCurrIvtrMtgtnSca.Val "MICROSAR RTE" VALUE 0x0 RTE_RL_FLOAT32_IEEE 0 NO_COMPU_METHOD -3.402823466e+38 3.402823466e+38 SYMBOL_LINK "Rte_CalprmRom_CalRegn01Cmn_DEFAULT_RTE_CALPRM_GROUP.LoaMgrCurrIvtrMtgtnSca_Val" 0 DISPLAY_IDENTIFIER LoaMgr.CalibrationPorts.LoaMgrCurrIvtrMtgtnSca.Val /end CHARACTERISTIC
/begin CHARACTERISTIC LoaMgr.LoaMgrCurrIvtrMtgtnScaZeroEna.Logl "MICROSAR RTE" VALUE 0x0 RTE_RL_BOOLEAN 0 RTE_CM_BOOLEAN 0 255 SYMBOL_LINK "Rte_CalprmRom_CalRegn01Cmn_DEFAULT_RTE_CALPRM_GROUP.LoaMgrCurrIvtrMtgtnScaZeroEna_Logl" 0 DISPLAY_IDENTIFIER LoaMgr.CalibrationPorts.LoaMgrCurrIvtrMtgtnScaZeroEna.Logl /end CHARACTERISTIC
/begin CHARACTERISTIC LoaMgr.LoaMgrCurrMeasIdptSig0Resp.Val "MICROSAR RTE" VALUE 0x0 RTE_RL_UBYTE 0 NO_COMPU_METHOD 0 255 SYMBOL_LINK "Rte_CalprmRom_CalRegn01Cmn_DEFAULT_RTE_CALPRM_GROUP.LoaMgrCurrMeasIdptSig0Resp_Val" 0 DISPLAY_IDENTIFIER LoaMgr.CalibrationPorts.LoaMgrCurrMeasIdptSig0Resp.Val /end CHARACTERISTIC
/begin CHARACTERISTIC LoaMgr.LoaMgrCurrMeasIdptSig1Resp.Val "MICROSAR RTE" VALUE 0x0 RTE_RL_UBYTE 0 NO_COMPU_METHOD 0 255 SYMBOL_LINK "Rte_CalprmRom_CalRegn01Cmn_DEFAULT_RTE_CALPRM_GROUP.LoaMgrCurrMeasIdptSig1Resp_Val" 0 DISPLAY_IDENTIFIER LoaMgr.CalibrationPorts.LoaMgrCurrMeasIdptSig1Resp.Val /end CHARACTERISTIC
/begin CHARACTERISTIC LoaMgr.LoaMgrCurrMeasIdptSig2Resp.Val "MICROSAR RTE" VALUE 0x0 RTE_RL_UBYTE 0 NO_COMPU_METHOD 0 255 SYMBOL_LINK "Rte_CalprmRom_CalRegn01Cmn_DEFAULT_RTE_CALPRM_GROUP.LoaMgrCurrMeasIdptSig2Resp_Val" 0 DISPLAY_IDENTIFIER LoaMgr.CalibrationPorts.LoaMgrCurrMeasIdptSig2Resp.Val /end CHARACTERISTIC
/begin CHARACTERISTIC LoaMgr.LoaMgrCurrMeasIdptSigFltThd.Val "MICROSAR RTE" VALUE 0x0 RTE_RL_UBYTE 0 NO_COMPU_METHOD 0 255 SYMBOL_LINK "Rte_CalprmRom_CalRegn01Cmn_DEFAULT_RTE_CALPRM_GROUP.LoaMgrCurrMeasIdptSigFltThd_Val" 0 DISPLAY_IDENTIFIER LoaMgr.CalibrationPorts.LoaMgrCurrMeasIdptSigFltThd.Val /end CHARACTERISTIC
/begin CHARACTERISTIC LoaMgr.LoaMgrCurrMeasMtgtnRate.Val "MICROSAR RTE" VALUE 0x0 RTE_RL_FLOAT32_IEEE 0 NO_COMPU_METHOD -3.402823466e+38 3.402823466e+38 SYMBOL_LINK "Rte_CalprmRom_CalRegn01Cmn_DEFAULT_RTE_CALPRM_GROUP.LoaMgrCurrMeasMtgtnRate_Val" 0 DISPLAY_IDENTIFIER LoaMgr.CalibrationPorts.LoaMgrCurrMeasMtgtnRate.Val /end CHARACTERISTIC
/begin CHARACTERISTIC LoaMgr.LoaMgrCurrMeasMtgtnSca.Val "MICROSAR RTE" VALUE 0x0 RTE_RL_FLOAT32_IEEE 0 NO_COMPU_METHOD -3.402823466e+38 3.402823466e+38 SYMBOL_LINK "Rte_CalprmRom_CalRegn01Cmn_DEFAULT_RTE_CALPRM_GROUP.LoaMgrCurrMeasMtgtnSca_Val" 0 DISPLAY_IDENTIFIER LoaMgr.CalibrationPorts.LoaMgrCurrMeasMtgtnSca.Val /end CHARACTERISTIC
/begin CHARACTERISTIC LoaMgr.LoaMgrCurrMeasMtgtnScaZeroEna.Logl "MICROSAR RTE" VALUE 0x0 RTE_RL_BOOLEAN 0 RTE_CM_BOOLEAN 0 255 SYMBOL_LINK "Rte_CalprmRom_CalRegn01Cmn_DEFAULT_RTE_CALPRM_GROUP.LoaMgrCurrMeasMtgtnScaZeroEna_Logl" 0 DISPLAY_IDENTIFIER LoaMgr.CalibrationPorts.LoaMgrCurrMeasMtgtnScaZeroEna.Logl /end CHARACTERISTIC
/begin CHARACTERISTIC LoaMgr.LoaMgrFadeOutStRate.Val "MICROSAR RTE" VALUE 0x0 RTE_RL_FLOAT32_IEEE 0 NO_COMPU_METHOD -3.402823466e+38 3.402823466e+38 SYMBOL_LINK "Rte_CalprmRom_CalRegn01Cmn_DEFAULT_RTE_CALPRM_GROUP.LoaMgrFadeOutStRate_Val" 0 DISPLAY_IDENTIFIER LoaMgr.CalibrationPorts.LoaMgrFadeOutStRate.Val /end CHARACTERISTIC
/begin CHARACTERISTIC LoaMgr.LoaMgrHwTqIdptSig0NoTqLoaResp.Val "MICROSAR RTE" VALUE 0x0 RTE_RL_UBYTE 0 NO_COMPU_METHOD 0 255 SYMBOL_LINK "Rte_CalprmRom_CalRegn01Cmn_DEFAULT_RTE_CALPRM_GROUP.LoaMgrHwTqIdptSig0NoTqLoaResp_Val" 0 DISPLAY_IDENTIFIER LoaMgr.CalibrationPorts.LoaMgrHwTqIdptSig0NoTqLoaResp.Val /end CHARACTERISTIC
/begin CHARACTERISTIC LoaMgr.LoaMgrHwTqIdptSig1NoTqLoaResp.Val "MICROSAR RTE" VALUE 0x0 RTE_RL_UBYTE 0 NO_COMPU_METHOD 0 255 SYMBOL_LINK "Rte_CalprmRom_CalRegn01Cmn_DEFAULT_RTE_CALPRM_GROUP.LoaMgrHwTqIdptSig1NoTqLoaResp_Val" 0 DISPLAY_IDENTIFIER LoaMgr.CalibrationPorts.LoaMgrHwTqIdptSig1NoTqLoaResp.Val /end CHARACTERISTIC
/begin CHARACTERISTIC LoaMgr.LoaMgrHwTqIdptSig2Resp.Val "MICROSAR RTE" VALUE 0x0 RTE_RL_UBYTE 0 NO_COMPU_METHOD 0 255 SYMBOL_LINK "Rte_CalprmRom_CalRegn01Cmn_DEFAULT_RTE_CALPRM_GROUP.LoaMgrHwTqIdptSig2Resp_Val" 0 DISPLAY_IDENTIFIER LoaMgr.CalibrationPorts.LoaMgrHwTqIdptSig2Resp.Val /end CHARACTERISTIC
/begin CHARACTERISTIC LoaMgr.LoaMgrHwTqIdptSig4Resp.Val "MICROSAR RTE" VALUE 0x0 RTE_RL_UBYTE 0 NO_COMPU_METHOD 0 255 SYMBOL_LINK "Rte_CalprmRom_CalRegn01Cmn_DEFAULT_RTE_CALPRM_GROUP.LoaMgrHwTqIdptSig4Resp_Val" 0 DISPLAY_IDENTIFIER LoaMgr.CalibrationPorts.LoaMgrHwTqIdptSig4Resp.Val /end CHARACTERISTIC
/begin CHARACTERISTIC LoaMgr.LoaMgrHwTqIdptSigFltThd.Val "MICROSAR RTE" VALUE 0x0 RTE_RL_UBYTE 0 NO_COMPU_METHOD 0 255 SYMBOL_LINK "Rte_CalprmRom_CalRegn01Cmn_DEFAULT_RTE_CALPRM_GROUP.LoaMgrHwTqIdptSigFltThd_Val" 0 DISPLAY_IDENTIFIER LoaMgr.CalibrationPorts.LoaMgrHwTqIdptSigFltThd.Val /end CHARACTERISTIC
/begin CHARACTERISTIC LoaMgr.LoaMgrHwTqLoaAvlResp.Val "MICROSAR RTE" VALUE 0x0 RTE_RL_UBYTE 0 NO_COMPU_METHOD 0 255 SYMBOL_LINK "Rte_CalprmRom_CalRegn01Cmn_DEFAULT_RTE_CALPRM_GROUP.LoaMgrHwTqLoaAvlResp_Val" 0 DISPLAY_IDENTIFIER LoaMgr.CalibrationPorts.LoaMgrHwTqLoaAvlResp.Val /end CHARACTERISTIC
/begin CHARACTERISTIC LoaMgr.LoaMgrIvtrIdptSig0Resp.Val "MICROSAR RTE" VALUE 0x0 RTE_RL_UBYTE 0 NO_COMPU_METHOD 0 255 SYMBOL_LINK "Rte_CalprmRom_CalRegn01Cmn_DEFAULT_RTE_CALPRM_GROUP.LoaMgrIvtrIdptSig0Resp_Val" 0 DISPLAY_IDENTIFIER LoaMgr.CalibrationPorts.LoaMgrIvtrIdptSig0Resp.Val /end CHARACTERISTIC
/begin CHARACTERISTIC LoaMgr.LoaMgrIvtrIdptSig1Resp.Val "MICROSAR RTE" VALUE 0x0 RTE_RL_UBYTE 0 NO_COMPU_METHOD 0 255 SYMBOL_LINK "Rte_CalprmRom_CalRegn01Cmn_DEFAULT_RTE_CALPRM_GROUP.LoaMgrIvtrIdptSig1Resp_Val" 0 DISPLAY_IDENTIFIER LoaMgr.CalibrationPorts.LoaMgrIvtrIdptSig1Resp.Val /end CHARACTERISTIC
/begin CHARACTERISTIC LoaMgr.LoaMgrIvtrIdptSig2Resp.Val "MICROSAR RTE" VALUE 0x0 RTE_RL_UBYTE 0 NO_COMPU_METHOD 0 255 SYMBOL_LINK "Rte_CalprmRom_CalRegn01Cmn_DEFAULT_RTE_CALPRM_GROUP.LoaMgrIvtrIdptSig2Resp_Val" 0 DISPLAY_IDENTIFIER LoaMgr.CalibrationPorts.LoaMgrIvtrIdptSig2Resp.Val /end CHARACTERISTIC
/begin CHARACTERISTIC LoaMgr.LoaMgrIvtrIdptSigFltThd.Val "MICROSAR RTE" VALUE 0x0 RTE_RL_UBYTE 0 NO_COMPU_METHOD 0 255 SYMBOL_LINK "Rte_CalprmRom_CalRegn01Cmn_DEFAULT_RTE_CALPRM_GROUP.LoaMgrIvtrIdptSigFltThd_Val" 0 DISPLAY_IDENTIFIER LoaMgr.CalibrationPorts.LoaMgrIvtrIdptSigFltThd.Val /end CHARACTERISTIC
/begin CHARACTERISTIC LoaMgr.LoaMgrIvtrMtgtnRate.Val "MICROSAR RTE" VALUE 0x0 RTE_RL_FLOAT32_IEEE 0 NO_COMPU_METHOD -3.402823466e+38 3.402823466e+38 SYMBOL_LINK "Rte_CalprmRom_CalRegn01Cmn_DEFAULT_RTE_CALPRM_GROUP.LoaMgrIvtrMtgtnRate_Val" 0 DISPLAY_IDENTIFIER LoaMgr.CalibrationPorts.LoaMgrIvtrMtgtnRate.Val /end CHARACTERISTIC
/begin CHARACTERISTIC LoaMgr.LoaMgrIvtrMtgtnSca.Val "MICROSAR RTE" VALUE 0x0 RTE_RL_FLOAT32_IEEE 0 NO_COMPU_METHOD -3.402823466e+38 3.402823466e+38 SYMBOL_LINK "Rte_CalprmRom_CalRegn01Cmn_DEFAULT_RTE_CALPRM_GROUP.LoaMgrIvtrMtgtnSca_Val" 0 DISPLAY_IDENTIFIER LoaMgr.CalibrationPorts.LoaMgrIvtrMtgtnSca.Val /end CHARACTERISTIC
/begin CHARACTERISTIC LoaMgr.LoaMgrIvtrMtgtnScaZeroEna.Logl "MICROSAR RTE" VALUE 0x0 RTE_RL_BOOLEAN 0 RTE_CM_BOOLEAN 0 255 SYMBOL_LINK "Rte_CalprmRom_CalRegn01Cmn_DEFAULT_RTE_CALPRM_GROUP.LoaMgrIvtrMtgtnScaZeroEna_Logl" 0 DISPLAY_IDENTIFIER LoaMgr.CalibrationPorts.LoaMgrIvtrMtgtnScaZeroEna.Logl /end CHARACTERISTIC
/begin CHARACTERISTIC LoaMgr.LoaMgrLimdStRate.Val "MICROSAR RTE" VALUE 0x0 RTE_RL_FLOAT32_IEEE 0 NO_COMPU_METHOD -3.402823466e+38 3.402823466e+38 SYMBOL_LINK "Rte_CalprmRom_CalRegn01Cmn_DEFAULT_RTE_CALPRM_GROUP.LoaMgrLimdStRate_Val" 0 DISPLAY_IDENTIFIER LoaMgr.CalibrationPorts.LoaMgrLimdStRate.Val /end CHARACTERISTIC
/begin CHARACTERISTIC LoaMgr.LoaMgrLimdStSca.Val "MICROSAR RTE" VALUE 0x0 RTE_RL_FLOAT32_IEEE 0 NO_COMPU_METHOD -3.402823466e+38 3.402823466e+38 SYMBOL_LINK "Rte_CalprmRom_CalRegn01Cmn_DEFAULT_RTE_CALPRM_GROUP.LoaMgrLimdStSca_Val" 0 DISPLAY_IDENTIFIER LoaMgr.CalibrationPorts.LoaMgrLimdStSca.Val /end CHARACTERISTIC
/begin CHARACTERISTIC LoaMgr.LoaMgrMotAgAvlSnsrlsResp.Val "MICROSAR RTE" VALUE 0x0 RTE_RL_UBYTE 0 NO_COMPU_METHOD 0 255 SYMBOL_LINK "Rte_CalprmRom_CalRegn01Cmn_DEFAULT_RTE_CALPRM_GROUP.LoaMgrMotAgAvlSnsrlsResp_Val" 0 DISPLAY_IDENTIFIER LoaMgr.CalibrationPorts.LoaMgrMotAgAvlSnsrlsResp.Val /end CHARACTERISTIC
/begin CHARACTERISTIC LoaMgr.LoaMgrMotAgIdptSig0NoSnsrlsResp.Val "MICROSAR RTE" VALUE 0x0 RTE_RL_UBYTE 0 NO_COMPU_METHOD 0 255 SYMBOL_LINK "Rte_CalprmRom_CalRegn01Cmn_DEFAULT_RTE_CALPRM_GROUP.LoaMgrMotAgIdptSig0NoSnsrlsResp_Val" 0 DISPLAY_IDENTIFIER LoaMgr.CalibrationPorts.LoaMgrMotAgIdptSig0NoSnsrlsResp.Val /end CHARACTERISTIC
/begin CHARACTERISTIC LoaMgr.LoaMgrMotAgIdptSig1NoSnsrlsResp.Val "MICROSAR RTE" VALUE 0x0 RTE_RL_UBYTE 0 NO_COMPU_METHOD 0 255 SYMBOL_LINK "Rte_CalprmRom_CalRegn01Cmn_DEFAULT_RTE_CALPRM_GROUP.LoaMgrMotAgIdptSig1NoSnsrlsResp_Val" 0 DISPLAY_IDENTIFIER LoaMgr.CalibrationPorts.LoaMgrMotAgIdptSig1NoSnsrlsResp.Val /end CHARACTERISTIC
/begin CHARACTERISTIC LoaMgr.LoaMgrMotAgIdptSig2Resp.Val "MICROSAR RTE" VALUE 0x0 RTE_RL_UBYTE 0 NO_COMPU_METHOD 0 255 SYMBOL_LINK "Rte_CalprmRom_CalRegn01Cmn_DEFAULT_RTE_CALPRM_GROUP.LoaMgrMotAgIdptSig2Resp_Val" 0 DISPLAY_IDENTIFIER LoaMgr.CalibrationPorts.LoaMgrMotAgIdptSig2Resp.Val /end CHARACTERISTIC
/begin CHARACTERISTIC LoaMgr.LoaMgrMotAgIdptSig3Resp.Val "MICROSAR RTE" VALUE 0x0 RTE_RL_UBYTE 0 NO_COMPU_METHOD 0 255 SYMBOL_LINK "Rte_CalprmRom_CalRegn01Cmn_DEFAULT_RTE_CALPRM_GROUP.LoaMgrMotAgIdptSig3Resp_Val" 0 DISPLAY_IDENTIFIER LoaMgr.CalibrationPorts.LoaMgrMotAgIdptSig3Resp.Val /end CHARACTERISTIC
/begin CHARACTERISTIC LoaMgr.LoaMgrMotAgIdptSigFltThd.Val "MICROSAR RTE" VALUE 0x0 RTE_RL_UBYTE 0 NO_COMPU_METHOD 0 255 SYMBOL_LINK "Rte_CalprmRom_CalRegn01Cmn_DEFAULT_RTE_CALPRM_GROUP.LoaMgrMotAgIdptSigFltThd_Val" 0 DISPLAY_IDENTIFIER LoaMgr.CalibrationPorts.LoaMgrMotAgIdptSigFltThd.Val /end CHARACTERISTIC
/begin CHARACTERISTIC LoaMgr.LoaMgrMotAgMtgtnRate.Val "MICROSAR RTE" VALUE 0x0 RTE_RL_FLOAT32_IEEE 0 NO_COMPU_METHOD -3.402823466e+38 3.402823466e+38 SYMBOL_LINK "Rte_CalprmRom_CalRegn01Cmn_DEFAULT_RTE_CALPRM_GROUP.LoaMgrMotAgMtgtnRate_Val" 0 DISPLAY_IDENTIFIER LoaMgr.CalibrationPorts.LoaMgrMotAgMtgtnRate.Val /end CHARACTERISTIC
/begin CHARACTERISTIC LoaMgr.LoaMgrMotAgMtgtnSca.Val "MICROSAR RTE" VALUE 0x0 RTE_RL_FLOAT32_IEEE 0 NO_COMPU_METHOD -3.402823466e+38 3.402823466e+38 SYMBOL_LINK "Rte_CalprmRom_CalRegn01Cmn_DEFAULT_RTE_CALPRM_GROUP.LoaMgrMotAgMtgtnSca_Val" 0 DISPLAY_IDENTIFIER LoaMgr.CalibrationPorts.LoaMgrMotAgMtgtnSca.Val /end CHARACTERISTIC
/begin CHARACTERISTIC LoaMgr.LoaMgrMotAgMtgtnScaZeroEna.Logl "MICROSAR RTE" VALUE 0x0 RTE_RL_BOOLEAN 0 RTE_CM_BOOLEAN 0 255 SYMBOL_LINK "Rte_CalprmRom_CalRegn01Cmn_DEFAULT_RTE_CALPRM_GROUP.LoaMgrMotAgMtgtnScaZeroEna_Logl" 0 DISPLAY_IDENTIFIER LoaMgr.CalibrationPorts.LoaMgrMotAgMtgtnScaZeroEna.Logl /end CHARACTERISTIC
/begin MEASUREMENT HwTqArbn.HwTqArbnTqAStallCntrPrev "MICROSAR RTE" UBYTE NO_COMPU_METHOD 0 0 0 255 ECU_ADDRESS 0 SYMBOL_LINK "Rte_HwTqArbn_HwTqArbnTqAStallCntrPrev" 0 DISPLAY_IDENTIFIER HwTqArbn.PerInstanceMemories.HwTqArbnTqAStallCntrPrev /end MEASUREMENT
/begin MEASUREMENT HwTqArbn.HwTqArbnTqBRollgCntrPrev "MICROSAR RTE" UBYTE NO_COMPU_METHOD 0 0 0 255 ECU_ADDRESS 0 SYMBOL_LINK "Rte_HwTqArbn_HwTqArbnTqBRollgCntrPrev" 0 DISPLAY_IDENTIFIER HwTqArbn.PerInstanceMemories.HwTqArbnTqBRollgCntrPrev /end MEASUREMENT
/begin MEASUREMENT HwTqArbn.HwTqArbnTqBStallCntrPrev "MICROSAR RTE" UBYTE NO_COMPU_METHOD 0 0 0 255 ECU_ADDRESS 0 SYMBOL_LINK "Rte_HwTqArbn_HwTqArbnTqBStallCntrPrev" 0 DISPLAY_IDENTIFIER HwTqArbn.PerInstanceMemories.HwTqArbnTqBStallCntrPrev /end MEASUREMENT
/begin MEASUREMENT HwTqArbn.HwTqArbnTqCRollgCntrPrev "MICROSAR RTE" UBYTE NO_COMPU_METHOD 0 0 0 255 ECU_ADDRESS 0 SYMBOL_LINK "Rte_HwTqArbn_HwTqArbnTqCRollgCntrPrev" 0 DISPLAY_IDENTIFIER HwTqArbn.PerInstanceMemories.HwTqArbnTqCRollgCntrPrev /end MEASUREMENT
/begin MEASUREMENT HwTqArbn.HwTqArbnTqCStallCntrPrev "MICROSAR RTE" UBYTE NO_COMPU_METHOD 0 0 0 255 ECU_ADDRESS 0 SYMBOL_LINK "Rte_HwTqArbn_HwTqArbnTqCStallCntrPrev" 0 DISPLAY_IDENTIFIER HwTqArbn.PerInstanceMemories.HwTqArbnTqCStallCntrPrev /end MEASUREMENT
/begin MEASUREMENT HwTqArbn.HwTqArbnTqDRollgCntrPrev "MICROSAR RTE" UBYTE NO_COMPU_METHOD 0 0 0 255 ECU_ADDRESS 0 SYMBOL_LINK "Rte_HwTqArbn_HwTqArbnTqDRollgCntrPrev" 0 DISPLAY_IDENTIFIER HwTqArbn.PerInstanceMemories.HwTqArbnTqDRollgCntrPrev /end MEASUREMENT
/begin MEASUREMENT HwTqArbn.HwTqArbnTqDStallCntrPrev "MICROSAR RTE" UBYTE NO_COMPU_METHOD 0 0 0 255 ECU_ADDRESS 0 SYMBOL_LINK "Rte_HwTqArbn_HwTqArbnTqDStallCntrPrev" 0 DISPLAY_IDENTIFIER HwTqArbn.PerInstanceMemories.HwTqArbnTqDStallCntrPrev /end MEASUREMENT
/begin MEASUREMENT HwTqArbn.HwTqB.Val "MICROSAR RTE" FLOAT32_IEEE NO_COMPU_METHOD 0 0 -10.0 10.0 ECU_ADDRESS 0 SYMBOL_LINK "Rte_CDD_HwTq1Meas_HwTq1_Val" 0 DISPLAY_IDENTIFIER HwTqArbn.ReceiverPorts.HwTqB.Val /end MEASUREMENT
/begin MEASUREMENT HwTqArbn.HwTqBQlfr.Val "MICROSAR RTE" UBYTE RTE_CM_ENUM_SigQlfr1 0 0 0 255 ECU_ADDRESS 0 SYMBOL_LINK "Rte_CDD_HwTq1Meas_HwTq1Qlfr_Val" 0 DISPLAY_IDENTIFIER HwTqArbn.ReceiverPorts.HwTqBQlfr.Val /end MEASUREMENT
/begin MEASUREMENT HwTqArbn.HwTqBRollgCntr.Val "MICROSAR RTE" UBYTE NO_COMPU_METHOD 0 0 0 255 ECU_ADDRESS 0 SYMBOL_LINK "Rte_CDD_HwTq1Meas_HwTq1RollgCntr_Val" 0 DISPLAY_IDENTIFIER HwTqArbn.ReceiverPorts.HwTqBRollgCntr.Val /end MEASUREMENT
/begin MEASUREMENT HwTqArbn.HwTqC.Val "MICROSAR RTE" FLOAT32_IEEE NO_COMPU_METHOD 0 0 -10.0 10.0 ECU_ADDRESS 0 SYMBOL_LINK "Rte_CDD_HwTq2Meas_HwTq2_Val" 0 DISPLAY_IDENTIFIER HwTqArbn.ReceiverPorts.HwTqC.Val /end MEASUREMENT
/begin MEASUREMENT HwTqArbn.HwTqCQlfr.Val "MICROSAR RTE" UBYTE RTE_CM_ENUM_SigQlfr1 0 0 0 255 ECU_ADDRESS 0 SYMBOL_LINK "Rte_CDD_HwTq2Meas_HwTq2Qlfr_Val" 0 DISPLAY_IDENTIFIER HwTqArbn.ReceiverPorts.HwTqCQlfr.Val /end MEASUREMENT
/begin MEASUREMENT HwTqArbn.HwTqCRollgCntr.Val "MICROSAR RTE" UBYTE NO_COMPU_METHOD 0 0 0 255 ECU_ADDRESS 0 SYMBOL_LINK "Rte_CDD_HwTq2Meas_HwTq2RollgCntr_Val" 0 DISPLAY_IDENTIFIER HwTqArbn.ReceiverPorts.HwTqCRollgCntr.Val /end MEASUREMENT
/begin MEASUREMENT HwTqArbn.HwTqChA.Val "MICROSAR RTE" FLOAT32_IEEE NO_COMPU_METHOD 0 0 -10.0 10.0 ECU_ADDRESS 0 SYMBOL_LINK "Rte_HwTqArbn_HwTqChA_Val" 0 DISPLAY_IDENTIFIER HwTqArbn.SenderPorts.HwTqChA.Val /end MEASUREMENT
/begin MEASUREMENT HwTqArbn.HwTqChB.Val "MICROSAR RTE" FLOAT32_IEEE NO_COMPU_METHOD 0 0 -10.0 10.0 ECU_ADDRESS 0 SYMBOL_LINK "Rte_HwTqArbn_HwTqChB_Val" 0 DISPLAY_IDENTIFIER HwTqArbn.SenderPorts.HwTqChB.Val /end MEASUREMENT
/begin MEASUREMENT HwTqArbn.HwTqCorrlnSts.Val "MICROSAR RTE" UBYTE NO_COMPU_METHOD 0 0 0 255 ECU_ADDRESS 0 SYMBOL_LINK "Rte_HwTqCorrln_HwTqCorrlnSts_Val" 0 DISPLAY_IDENTIFIER HwTqArbn.ReceiverPorts.HwTqCorrlnSts.Val /end MEASUREMENT
/begin MEASUREMENT HwTqArbn.HwTqD.Val "MICROSAR RTE" FLOAT32_IEEE NO_COMPU_METHOD 0 0 -10.0 10.0 ECU_ADDRESS 0 SYMBOL_LINK "Rte_CDD_HwTq3Meas_HwTq3_Val" 0 DISPLAY_IDENTIFIER HwTqArbn.ReceiverPorts.HwTqD.Val /end MEASUREMENT
/begin MEASUREMENT HwTqArbn.HwTqDQlfr.Val "MICROSAR RTE" UBYTE RTE_CM_ENUM_SigQlfr1 0 0 0 255 ECU_ADDRESS 0 SYMBOL_LINK "Rte_CDD_HwTq3Meas_HwTq3Qlfr_Val" 0 DISPLAY_IDENTIFIER HwTqArbn.ReceiverPorts.HwTqDQlfr.Val /end MEASUREMENT
/begin MEASUREMENT HwTqArbn.HwTqDRollgCntr.Val "MICROSAR RTE" UBYTE NO_COMPU_METHOD 0 0 0 255 ECU_ADDRESS 0 SYMBOL_LINK "Rte_CDD_HwTq3Meas_HwTq3RollgCntr_Val" 0 DISPLAY_IDENTIFIER HwTqArbn.ReceiverPorts.HwTqDRollgCntr.Val /end MEASUREMENT
/begin MEASUREMENT HwTqArbn.dHwTqArbnChAAvl "MICROSAR RTE" UBYTE RTE_CM_BOOLEAN 0 0 0 255 ECU_ADDRESS 0 SYMBOL_LINK "Rte_HwTqArbn_dHwTqArbnChAAvl" 0 DISPLAY_IDENTIFIER HwTqArbn.PerInstanceMemories.dHwTqArbnChAAvl /end MEASUREMENT
/begin MEASUREMENT HwTqArbn.dHwTqArbnChBAvl "MICROSAR RTE" UBYTE RTE_CM_BOOLEAN 0 0 0 255 ECU_ADDRESS 0 SYMBOL_LINK "Rte_HwTqArbn_dHwTqArbnChBAvl" 0 DISPLAY_IDENTIFIER HwTqArbn.PerInstanceMemories.dHwTqArbnChBAvl /end MEASUREMENT
/begin MEASUREMENT HwTqCorrln.HwTqA.Val "MICROSAR RTE" FLOAT32_IEEE NO_COMPU_METHOD 0 0 -3.402823466e+38 3.402823466e+38 ECU_ADDRESS 0 SYMBOL_LINK "Rte_CDD_HwTq0Meas_HwTq0_Val" 0 DISPLAY_IDENTIFIER HwTqCorrln.ReceiverPorts.HwTqA.Val /end MEASUREMENT
/begin MEASUREMENT HwTqCorrln.HwTqAQlfr.Val "MICROSAR RTE" UBYTE RTE_CM_ENUM_SigQlfr1 0 0 0 255 ECU_ADDRESS 0 SYMBOL_LINK "Rte_CDD_HwTq0Meas_HwTq0Qlfr_Val" 0 DISPLAY_IDENTIFIER HwTqCorrln.ReceiverPorts.HwTqAQlfr.Val /end MEASUREMENT
/begin MEASUREMENT HwTqCorrln.HwTqARollgCntr.Val "MICROSAR RTE" UBYTE NO_COMPU_METHOD 0 0 0 255 ECU_ADDRESS 0 SYMBOL_LINK "Rte_CDD_HwTq0Meas_HwTq0RollgCntr_Val" 0 DISPLAY_IDENTIFIER HwTqCorrln.ReceiverPorts.HwTqARollgCntr.Val /end MEASUREMENT
/begin MEASUREMENT HwTqCorrln.HwTqARollgCntrPrev "MICROSAR RTE" UBYTE NO_COMPU_METHOD 0 0 0 255 ECU_ADDRESS 0 SYMBOL_LINK "Rte_HwTqCorrln_HwTqARollgCntrPrev" 0 DISPLAY_IDENTIFIER HwTqCorrln.PerInstanceMemories.HwTqARollgCntrPrev /end MEASUREMENT
/begin MEASUREMENT HwTqCorrln.HwTqAStallCntrPrev "MICROSAR RTE" UBYTE NO_COMPU_METHOD 0 0 0 255 ECU_ADDRESS 0 SYMBOL_LINK "Rte_HwTqCorrln_HwTqAStallCntrPrev" 0 DISPLAY_IDENTIFIER HwTqCorrln.PerInstanceMemories.HwTqAStallCntrPrev /end MEASUREMENT
/begin MEASUREMENT HwTqCorrln.HwTqB.Val "MICROSAR RTE" FLOAT32_IEEE NO_COMPU_METHOD 0 0 -3.402823466e+38 3.402823466e+38 ECU_ADDRESS 0 SYMBOL_LINK "Rte_CDD_HwTq1Meas_HwTq1_Val" 0 DISPLAY_IDENTIFIER HwTqCorrln.ReceiverPorts.HwTqB.Val /end MEASUREMENT
/begin MEASUREMENT HwTqCorrln.HwTqBQlfr.Val "MICROSAR RTE" UBYTE RTE_CM_ENUM_SigQlfr1 0 0 0 255 ECU_ADDRESS 0 SYMBOL_LINK "Rte_CDD_HwTq1Meas_HwTq1Qlfr_Val" 0 DISPLAY_IDENTIFIER HwTqCorrln.ReceiverPorts.HwTqBQlfr.Val /end MEASUREMENT
/begin MEASUREMENT HwTqCorrln.HwTqBRollgCntr.Val "MICROSAR RTE" UBYTE NO_COMPU_METHOD 0 0 0 255 ECU_ADDRESS 0 SYMBOL_LINK "Rte_CDD_HwTq1Meas_HwTq1RollgCntr_Val" 0 DISPLAY_IDENTIFIER HwTqCorrln.ReceiverPorts.HwTqBRollgCntr.Val /end MEASUREMENT
/begin MEASUREMENT HwTqCorrln.HwTqBRollgCntrPrev "MICROSAR RTE" UBYTE NO_COMPU_METHOD 0 0 0 255 ECU_ADDRESS 0 SYMBOL_LINK "Rte_HwTqCorrln_HwTqBRollgCntrPrev" 0 DISPLAY_IDENTIFIER HwTqCorrln.PerInstanceMemories.HwTqBRollgCntrPrev /end MEASUREMENT
/begin MEASUREMENT HwTqCorrln.HwTqBStallCntrPrev "MICROSAR RTE" UBYTE NO_COMPU_METHOD 0 0 0 255 ECU_ADDRESS 0 SYMBOL_LINK "Rte_HwTqCorrln_HwTqBStallCntrPrev" 0 DISPLAY_IDENTIFIER HwTqCorrln.PerInstanceMemories.HwTqBStallCntrPrev /end MEASUREMENT
/begin MEASUREMENT HwTqCorrln.HwTqC.Val "MICROSAR RTE" FLOAT32_IEEE NO_COMPU_METHOD 0 0 -3.402823466e+38 3.402823466e+38 ECU_ADDRESS 0 SYMBOL_LINK "Rte_CDD_HwTq2Meas_HwTq2_Val" 0 DISPLAY_IDENTIFIER HwTqCorrln.ReceiverPorts.HwTqC.Val /end MEASUREMENT
/begin MEASUREMENT HwTqCorrln.HwTqCQlfr.Val "MICROSAR RTE" UBYTE RTE_CM_ENUM_SigQlfr1 0 0 0 255 ECU_ADDRESS 0 SYMBOL_LINK "Rte_CDD_HwTq2Meas_HwTq2Qlfr_Val" 0 DISPLAY_IDENTIFIER HwTqCorrln.ReceiverPorts.HwTqCQlfr.Val /end MEASUREMENT
/begin MEASUREMENT HwTqCorrln.HwTqCRollgCntr.Val "MICROSAR RTE" UBYTE NO_COMPU_METHOD 0 0 0 255 ECU_ADDRESS 0 SYMBOL_LINK "Rte_CDD_HwTq2Meas_HwTq2RollgCntr_Val" 0 DISPLAY_IDENTIFIER HwTqCorrln.ReceiverPorts.HwTqCRollgCntr.Val /end MEASUREMENT
/begin MEASUREMENT HwTqCorrln.HwTqCRollgCntrPrev "MICROSAR RTE" UBYTE NO_COMPU_METHOD 0 0 0 255 ECU_ADDRESS 0 SYMBOL_LINK "Rte_HwTqCorrln_HwTqCRollgCntrPrev" 0 DISPLAY_IDENTIFIER HwTqCorrln.PerInstanceMemories.HwTqCRollgCntrPrev /end MEASUREMENT
/begin MEASUREMENT HwTqCorrln.HwTqCStallCntrPrev "MICROSAR RTE" UBYTE NO_COMPU_METHOD 0 0 0 255 ECU_ADDRESS 0 SYMBOL_LINK "Rte_HwTqCorrln_HwTqCStallCntrPrev" 0 DISPLAY_IDENTIFIER HwTqCorrln.PerInstanceMemories.HwTqCStallCntrPrev /end MEASUREMENT
/begin MEASUREMENT HwTqCorrln.HwTqChA.Val "MICROSAR RTE" FLOAT32_IEEE NO_COMPU_METHOD 0 0 -3.402823466e+38 3.402823466e+38 ECU_ADDRESS 0 SYMBOL_LINK "Rte_HwTqArbn_HwTqChA_Val" 0 DISPLAY_IDENTIFIER HwTqCorrln.ReceiverPorts.HwTqChA.Val /end MEASUREMENT
/begin MEASUREMENT HwTqCorrln.HwTqChACmnModCmpLpFil.FilGain "MICROSAR RTE" FLOAT32_IEEE NO_COMPU_METHOD 0 0 -3.402823466e+38 3.402823466e+38 ECU_ADDRESS 0 SYMBOL_LINK "Rte_HwTqCorrln_HwTqChACmnModCmpLpFil.FilGain" 0 DISPLAY_IDENTIFIER HwTqCorrln.PerInstanceMemories.HwTqChACmnModCmpLpFil.FilGain /end MEASUREMENT
/begin MEASUREMENT HwTqCorrln.HwTqChACmnModCmpLpFil.FilSt "MICROSAR RTE" FLOAT32_IEEE NO_COMPU_METHOD 0 0 -3.402823466e+38 3.402823466e+38 ECU_ADDRESS 0 SYMBOL_LINK "Rte_HwTqCorrln_HwTqChACmnModCmpLpFil.FilSt" 0 DISPLAY_IDENTIFIER HwTqCorrln.PerInstanceMemories.HwTqChACmnModCmpLpFil.FilSt /end MEASUREMENT
/begin MEASUREMENT HwTqCorrln.HwTqChACmnModCmpLpFilSt "MICROSAR RTE" FLOAT32_IEEE NO_COMPU_METHOD 0 0 -3.402823466e+38 3.402823466e+38 ECU_ADDRESS 0 SYMBOL_LINK "Rte_HwTqCorrln_HwTqChACmnModCmpLpFilSt" 0 DISPLAY_IDENTIFIER HwTqCorrln.PerInstanceMemories.HwTqChACmnModCmpLpFilSt /end MEASUREMENT
/begin MEASUREMENT HwTqCorrln.HwTqChACorrlnTraErr.Val "MICROSAR RTE" FLOAT32_IEEE NO_COMPU_METHOD 0 0 -3.402823466e+38 3.402823466e+38 ECU_ADDRESS 0 SYMBOL_LINK "Rte_HwTqCorrln_HwTqChACorrlnTraErr_Val" 0 DISPLAY_IDENTIFIER HwTqCorrln.SenderPorts.HwTqChACorrlnTraErr.Val /end MEASUREMENT
/begin MEASUREMENT HwTqCorrln.HwTqChAImdtCorrlnChk "MICROSAR RTE" UBYTE RTE_CM_BOOLEAN 0 0 0 255 ECU_ADDRESS 0 SYMBOL_LINK "Rte_HwTqCorrln_HwTqChAImdtCorrlnChk" 0 DISPLAY_IDENTIFIER HwTqCorrln.PerInstanceMemories.HwTqChAImdtCorrlnChk /end MEASUREMENT
/begin MEASUREMENT HwTqCorrln.HwTqChAStabStLpFil.FilGain "MICROSAR RTE" FLOAT32_IEEE NO_COMPU_METHOD 0 0 -3.402823466e+38 3.402823466e+38 ECU_ADDRESS 0 SYMBOL_LINK "Rte_HwTqCorrln_HwTqChAStabStLpFil.FilGain" 0 DISPLAY_IDENTIFIER HwTqCorrln.PerInstanceMemories.HwTqChAStabStLpFil.FilGain /end MEASUREMENT
/begin MEASUREMENT HwTqCorrln.HwTqChAStabStLpFil.FilSt "MICROSAR RTE" FLOAT32_IEEE NO_COMPU_METHOD 0 0 -3.402823466e+38 3.402823466e+38 ECU_ADDRESS 0 SYMBOL_LINK "Rte_HwTqCorrln_HwTqChAStabStLpFil.FilSt" 0 DISPLAY_IDENTIFIER HwTqCorrln.PerInstanceMemories.HwTqChAStabStLpFil.FilSt /end MEASUREMENT
/begin MEASUREMENT HwTqCorrln.HwTqChATraLpFil.FilGain "MICROSAR RTE" FLOAT32_IEEE NO_COMPU_METHOD 0 0 -3.402823466e+38 3.402823466e+38 ECU_ADDRESS 0 SYMBOL_LINK "Rte_HwTqCorrln_HwTqChATraLpFil.FilGain" 0 DISPLAY_IDENTIFIER HwTqCorrln.PerInstanceMemories.HwTqChATraLpFil.FilGain /end MEASUREMENT
/begin MEASUREMENT HwTqCorrln.HwTqChATraLpFil.FilSt "MICROSAR RTE" FLOAT32_IEEE NO_COMPU_METHOD 0 0 -3.402823466e+38 3.402823466e+38 ECU_ADDRESS 0 SYMBOL_LINK "Rte_HwTqCorrln_HwTqChATraLpFil.FilSt" 0 DISPLAY_IDENTIFIER HwTqCorrln.PerInstanceMemories.HwTqChATraLpFil.FilSt /end MEASUREMENT
/begin MEASUREMENT HwTqCorrln.HwTqChB.Val "MICROSAR RTE" FLOAT32_IEEE NO_COMPU_METHOD 0 0 -3.402823466e+38 3.402823466e+38 ECU_ADDRESS 0 SYMBOL_LINK "Rte_HwTqArbn_HwTqChB_Val" 0 DISPLAY_IDENTIFIER HwTqCorrln.ReceiverPorts.HwTqChB.Val /end MEASUREMENT
/begin MEASUREMENT HwTqCorrln.HwTqChBCmnModCmpLpFil.FilGain "MICROSAR RTE" FLOAT32_IEEE NO_COMPU_METHOD 0 0 -3.402823466e+38 3.402823466e+38 ECU_ADDRESS 0 SYMBOL_LINK "Rte_HwTqCorrln_HwTqChBCmnModCmpLpFil.FilGain" 0 DISPLAY_IDENTIFIER HwTqCorrln.PerInstanceMemories.HwTqChBCmnModCmpLpFil.FilGain /end MEASUREMENT
/begin MEASUREMENT HwTqCorrln.HwTqChBCmnModCmpLpFil.FilSt "MICROSAR RTE" FLOAT32_IEEE NO_COMPU_METHOD 0 0 -3.402823466e+38 3.402823466e+38 ECU_ADDRESS 0 SYMBOL_LINK "Rte_HwTqCorrln_HwTqChBCmnModCmpLpFil.FilSt" 0 DISPLAY_IDENTIFIER HwTqCorrln.PerInstanceMemories.HwTqChBCmnModCmpLpFil.FilSt /end MEASUREMENT
/begin MEASUREMENT HwTqCorrln.HwTqChBCmnModCmpLpFilSt "MICROSAR RTE" FLOAT32_IEEE NO_COMPU_METHOD 0 0 -3.402823466e+38 3.402823466e+38 ECU_ADDRESS 0 SYMBOL_LINK "Rte_HwTqCorrln_HwTqChBCmnModCmpLpFilSt" 0 DISPLAY_IDENTIFIER HwTqCorrln.PerInstanceMemories.HwTqChBCmnModCmpLpFilSt /end MEASUREMENT
/begin MEASUREMENT HwTqCorrln.HwTqChBCorrlnTraErr.Val "MICROSAR RTE" FLOAT32_IEEE NO_COMPU_METHOD 0 0 -3.402823466e+38 3.402823466e+38 ECU_ADDRESS 0 SYMBOL_LINK "Rte_HwTqCorrln_HwTqChBCorrlnTraErr_Val" 0 DISPLAY_IDENTIFIER HwTqCorrln.SenderPorts.HwTqChBCorrlnTraErr.Val /end MEASUREMENT
/begin MEASUREMENT HwTqCorrln.HwTqChBImdtCorrlnChk "MICROSAR RTE" UBYTE RTE_CM_BOOLEAN 0 0 0 255 ECU_ADDRESS 0 SYMBOL_LINK "Rte_HwTqCorrln_HwTqChBImdtCorrlnChk" 0 DISPLAY_IDENTIFIER HwTqCorrln.PerInstanceMemories.HwTqChBImdtCorrlnChk /end MEASUREMENT
/begin MEASUREMENT HwTqCorrln.HwTqChBStabStLpFil.FilGain "MICROSAR RTE" FLOAT32_IEEE NO_COMPU_METHOD 0 0 -3.402823466e+38 3.402823466e+38 ECU_ADDRESS 0 SYMBOL_LINK "Rte_HwTqCorrln_HwTqChBStabStLpFil.FilGain" 0 DISPLAY_IDENTIFIER HwTqCorrln.PerInstanceMemories.HwTqChBStabStLpFil.FilGain /end MEASUREMENT
/begin MEASUREMENT HwTqCorrln.HwTqChBStabStLpFil.FilSt "MICROSAR RTE" FLOAT32_IEEE NO_COMPU_METHOD 0 0 -3.402823466e+38 3.402823466e+38 ECU_ADDRESS 0 SYMBOL_LINK "Rte_HwTqCorrln_HwTqChBStabStLpFil.FilSt" 0 DISPLAY_IDENTIFIER HwTqCorrln.PerInstanceMemories.HwTqChBStabStLpFil.FilSt /end MEASUREMENT
/begin MEASUREMENT HwTqCorrln.HwTqChBTraLpFil.FilGain "MICROSAR RTE" FLOAT32_IEEE NO_COMPU_METHOD 0 0 -3.402823466e+38 3.402823466e+38 ECU_ADDRESS 0 SYMBOL_LINK "Rte_HwTqCorrln_HwTqChBTraLpFil.FilGain" 0 DISPLAY_IDENTIFIER HwTqCorrln.PerInstanceMemories.HwTqChBTraLpFil.FilGain /end MEASUREMENT
/begin MEASUREMENT HwTqCorrln.HwTqChBTraLpFil.FilSt "MICROSAR RTE" FLOAT32_IEEE NO_COMPU_METHOD 0 0 -3.402823466e+38 3.402823466e+38 ECU_ADDRESS 0 SYMBOL_LINK "Rte_HwTqCorrln_HwTqChBTraLpFil.FilSt" 0 DISPLAY_IDENTIFIER HwTqCorrln.PerInstanceMemories.HwTqChBTraLpFil.FilSt /end MEASUREMENT
/begin MEASUREMENT HwTqCorrln.HwTqCorrlnSts.Val "MICROSAR RTE" UBYTE NO_COMPU_METHOD 0 0 0 255 ECU_ADDRESS 0 SYMBOL_LINK "Rte_HwTqCorrln_HwTqCorrlnSts_Val" 0 DISPLAY_IDENTIFIER HwTqCorrln.SenderPorts.HwTqCorrlnSts.Val /end MEASUREMENT
/begin MEASUREMENT HwTqCorrln.HwTqD.Val "MICROSAR RTE" FLOAT32_IEEE NO_COMPU_METHOD 0 0 -3.402823466e+38 3.402823466e+38 ECU_ADDRESS 0 SYMBOL_LINK "Rte_CDD_HwTq3Meas_HwTq3_Val" 0 DISPLAY_IDENTIFIER HwTqCorrln.ReceiverPorts.HwTqD.Val /end MEASUREMENT
/begin MEASUREMENT HwTqCorrln.HwTqDQlfr.Val "MICROSAR RTE" UBYTE RTE_CM_ENUM_SigQlfr1 0 0 0 255 ECU_ADDRESS 0 SYMBOL_LINK "Rte_CDD_HwTq3Meas_HwTq3Qlfr_Val" 0 DISPLAY_IDENTIFIER HwTqCorrln.ReceiverPorts.HwTqDQlfr.Val /end MEASUREMENT
/begin MEASUREMENT HwTqCorrln.HwTqDRollgCntr.Val "MICROSAR RTE" UBYTE NO_COMPU_METHOD 0 0 0 255 ECU_ADDRESS 0 SYMBOL_LINK "Rte_CDD_HwTq3Meas_HwTq3RollgCntr_Val" 0 DISPLAY_IDENTIFIER HwTqCorrln.ReceiverPorts.HwTqDRollgCntr.Val /end MEASUREMENT
/begin MEASUREMENT HwTqCorrln.HwTqDRollgCntrPrev "MICROSAR RTE" UBYTE NO_COMPU_METHOD 0 0 0 255 ECU_ADDRESS 0 SYMBOL_LINK "Rte_HwTqCorrln_HwTqDRollgCntrPrev" 0 DISPLAY_IDENTIFIER HwTqCorrln.PerInstanceMemories.HwTqDRollgCntrPrev /end MEASUREMENT
/begin MEASUREMENT HwTqCorrln.HwTqDStallCntrPrev "MICROSAR RTE" UBYTE NO_COMPU_METHOD 0 0 0 255 ECU_ADDRESS 0 SYMBOL_LINK "Rte_HwTqCorrln_HwTqDStallCntrPrev" 0 DISPLAY_IDENTIFIER HwTqCorrln.PerInstanceMemories.HwTqDStallCntrPrev /end MEASUREMENT
/begin MEASUREMENT HwTqCorrln.HwTqIdptSig.Val "MICROSAR RTE" UBYTE NO_COMPU_METHOD 0 0 0 255 ECU_ADDRESS 0 SYMBOL_LINK "Rte_HwTqCorrln_HwTqIdptSig_Val" 0 DISPLAY_IDENTIFIER HwTqCorrln.SenderPorts.HwTqIdptSig.Val /end MEASUREMENT
/begin MEASUREMENT HysCmp.AssiCmdBas.Val "MICROSAR RTE" FLOAT32_IEEE NO_COMPU_METHOD 0 0 -3.402823466e+38 3.402823466e+38 ECU_ADDRESS 0 SYMBOL_LINK "Rte_Assi_AssiCmdBas_Val" 0 DISPLAY_IDENTIFIER HysCmp.ReceiverPorts.AssiCmdBas.Val /end MEASUREMENT
/begin MEASUREMENT HysCmp.AssiCmdLpFil.FilGain "MICROSAR RTE" FLOAT32_IEEE NO_COMPU_METHOD 0 0 -3.402823466e+38 3.402823466e+38 ECU_ADDRESS 0 SYMBOL_LINK "Rte_HysCmp_AssiCmdLpFil.FilGain" 0 DISPLAY_IDENTIFIER HysCmp.PerInstanceMemories.AssiCmdLpFil.FilGain /end MEASUREMENT
/begin MEASUREMENT HysCmp.AssiCmdLpFil.FilSt "MICROSAR RTE" FLOAT32_IEEE NO_COMPU_METHOD 0 0 -3.402823466e+38 3.402823466e+38 ECU_ADDRESS 0 SYMBOL_LINK "Rte_HysCmp_AssiCmdLpFil.FilSt" 0 DISPLAY_IDENTIFIER HysCmp.PerInstanceMemories.AssiCmdLpFil.FilSt /end MEASUREMENT
/begin MEASUREMENT HysCmp.AssiMechT.Val "MICROSAR RTE" FLOAT32_IEEE NO_COMPU_METHOD 0 0 -3.402823466e+38 3.402823466e+38 ECU_ADDRESS 0 SYMBOL_LINK "Rte_TEstimn_AssiMechT_Val" 0 DISPLAY_IDENTIFIER HysCmp.ReceiverPorts.AssiMechT.Val /end MEASUREMENT
/begin MEASUREMENT HysCmp.FinalOutpLpFil.FilGain "MICROSAR RTE" FLOAT32_IEEE NO_COMPU_METHOD 0 0 -3.402823466e+38 3.402823466e+38 ECU_ADDRESS 0 SYMBOL_LINK "Rte_HysCmp_FinalOutpLpFil.FilGain" 0 DISPLAY_IDENTIFIER HysCmp.PerInstanceMemories.FinalOutpLpFil.FilGain /end MEASUREMENT
/begin MEASUREMENT HysCmp.FinalOutpLpFil.FilSt "MICROSAR RTE" FLOAT32_IEEE NO_COMPU_METHOD 0 0 -3.402823466e+38 3.402823466e+38 ECU_ADDRESS 0 SYMBOL_LINK "Rte_HysCmp_FinalOutpLpFil.FilSt" 0 DISPLAY_IDENTIFIER HysCmp.PerInstanceMemories.FinalOutpLpFil.FilSt /end MEASUREMENT
/begin MEASUREMENT HysCmp.HwTq.Val "MICROSAR RTE" FLOAT32_IEEE NO_COMPU_METHOD 0 0 -3.402823466e+38 3.402823466e+38 ECU_ADDRESS 0 SYMBOL_LINK "Rte_Swp_HwTqSwp_Val" 0 DISPLAY_IDENTIFIER HysCmp.ReceiverPorts.HwTq.Val /end MEASUREMENT
/begin MEASUREMENT HysCmp.HwTqLpFil.FilGain "MICROSAR RTE" FLOAT32_IEEE NO_COMPU_METHOD 0 0 -3.402823466e+38 3.402823466e+38 ECU_ADDRESS 0 SYMBOL_LINK "Rte_HysCmp_HwTqLpFil.FilGain" 0 DISPLAY_IDENTIFIER HysCmp.PerInstanceMemories.HwTqLpFil.FilGain /end MEASUREMENT
/begin MEASUREMENT HysCmp.HwTqLpFil.FilSt "MICROSAR RTE" FLOAT32_IEEE NO_COMPU_METHOD 0 0 -3.402823466e+38 3.402823466e+38 ECU_ADDRESS 0 SYMBOL_LINK "Rte_HysCmp_HwTqLpFil.FilSt" 0 DISPLAY_IDENTIFIER HysCmp.PerInstanceMemories.HwTqLpFil.FilSt /end MEASUREMENT
/begin MEASUREMENT HysCmp.HwTqOvrl.Val "MICROSAR RTE" FLOAT32_IEEE NO_COMPU_METHOD 0 0 -3.402823466e+38 3.402823466e+38 ECU_ADDRESS 0 SYMBOL_LINK "Rte_GmTqArbn_HwTqOvrl_Val" 0 DISPLAY_IDENTIFIER HysCmp.ReceiverPorts.HwTqOvrl.Val /end MEASUREMENT
/begin MEASUREMENT HysCmp.HysCmpCmd.Val "MICROSAR RTE" FLOAT32_IEEE NO_COMPU_METHOD 0 0 -3.402823466e+38 3.402823466e+38 ECU_ADDRESS 0 SYMBOL_LINK "Rte_HysCmp_HysCmpCmd_Val" 0 DISPLAY_IDENTIFIER HysCmp.SenderPorts.HysCmpCmd.Val /end MEASUREMENT
/begin MEASUREMENT HysCmp.HysCmpCmdDi.Logl "MICROSAR RTE" UBYTE RTE_CM_BOOLEAN 0 0 0 255 ECU_ADDRESS 0 SYMBOL_LINK "Rte_CmnMfgSrv_HysCmpCmdDi_Logl" 0 DISPLAY_IDENTIFIER HysCmp.ReceiverPorts.HysCmpCmdDi.Logl /end MEASUREMENT
/begin MEASUREMENT HysCmp.PrevAssiCmdFildVal "MICROSAR RTE" FLOAT32_IEEE NO_COMPU_METHOD 0 0 -3.402823466e+38 3.402823466e+38 ECU_ADDRESS 0 SYMBOL_LINK "Rte_HysCmp_PrevAssiCmdFildVal" 0 DISPLAY_IDENTIFIER HysCmp.PerInstanceMemories.PrevAssiCmdFildVal /end MEASUREMENT
/begin MEASUREMENT HysCmp.PrevHwTqFildVal "MICROSAR RTE" FLOAT32_IEEE NO_COMPU_METHOD 0 0 -3.402823466e+38 3.402823466e+38 ECU_ADDRESS 0 SYMBOL_LINK "Rte_HysCmp_PrevHwTqFildVal" 0 DISPLAY_IDENTIFIER HysCmp.PerInstanceMemories.PrevHwTqFildVal /end MEASUREMENT
/begin MEASUREMENT HysCmp.PrevRiseX "MICROSAR RTE" FLOAT32_IEEE NO_COMPU_METHOD 0 0 -3.402823466e+38 3.402823466e+38 ECU_ADDRESS 0 SYMBOL_LINK "Rte_HysCmp_PrevRiseX" 0 DISPLAY_IDENTIFIER HysCmp.PerInstanceMemories.PrevRiseX /end MEASUREMENT
/begin MEASUREMENT HysCmp.PrevRiseY "MICROSAR RTE" FLOAT32_IEEE NO_COMPU_METHOD 0 0 -3.402823466e+38 3.402823466e+38 ECU_ADDRESS 0 SYMBOL_LINK "Rte_HysCmp_PrevRiseY" 0 DISPLAY_IDENTIFIER HysCmp.PerInstanceMemories.PrevRiseY /end MEASUREMENT
/begin MEASUREMENT HysCmp.SysFricOffs.Val "MICROSAR RTE" FLOAT32_IEEE NO_COMPU_METHOD 0 0 -3.402823466e+38 3.402823466e+38 ECU_ADDRESS 0 SYMBOL_LINK "Rte_SysFricLrng_SysFricOffs_Val" 0 DISPLAY_IDENTIFIER HysCmp.ReceiverPorts.SysFricOffs.Val /end MEASUREMENT
/begin MEASUREMENT HysCmp.VehSpd.Val "MICROSAR RTE" FLOAT32_IEEE NO_COMPU_METHOD 0 0 -3.402823466e+38 3.402823466e+38 ECU_ADDRESS 0 SYMBOL_LINK "Rte_VehSigCdng_VehSpd_Val" 0 DISPLAY_IDENTIFIER HysCmp.ReceiverPorts.VehSpd.Val /end MEASUREMENT
/begin MEASUREMENT HysCmp.WhlImbRejctnAmp.Val "MICROSAR RTE" FLOAT32_IEEE NO_COMPU_METHOD 0 0 -3.402823466e+38 3.402823466e+38 ECU_ADDRESS 0 SYMBOL_LINK "Rte_WhlImbRejctn_WhlImbRejctnAmp_Val" 0 DISPLAY_IDENTIFIER HysCmp.ReceiverPorts.WhlImbRejctnAmp.Val /end MEASUREMENT
/begin MEASUREMENT HysCmp.dHysCmpAssiCmdFild "MICROSAR RTE" FLOAT32_IEEE NO_COMPU_METHOD 0 0 -3.402823466e+38 3.402823466e+38 ECU_ADDRESS 0 SYMBOL_LINK "Rte_HysCmp_dHysCmpAssiCmdFild" 0 DISPLAY_IDENTIFIER HysCmp.PerInstanceMemories.dHysCmpAssiCmdFild /end MEASUREMENT
/begin MEASUREMENT HysCmp.dHysCmpAvl "MICROSAR RTE" FLOAT32_IEEE NO_COMPU_METHOD 0 0 -3.402823466e+38 3.402823466e+38 ECU_ADDRESS 0 SYMBOL_LINK "Rte_HysCmp_dHysCmpAvl" 0 DISPLAY_IDENTIFIER HysCmp.PerInstanceMemories.dHysCmpAvl /end MEASUREMENT
/begin MEASUREMENT HysCmp.dHysCmpEffCmpTq "MICROSAR RTE" FLOAT32_IEEE NO_COMPU_METHOD 0 0 -3.402823466e+38 3.402823466e+38 ECU_ADDRESS 0 SYMBOL_LINK "Rte_HysCmp_dHysCmpEffCmpTq" 0 DISPLAY_IDENTIFIER HysCmp.PerInstanceMemories.dHysCmpEffCmpTq /end MEASUREMENT
/begin MEASUREMENT HysCmp.dHysCmpFric "MICROSAR RTE" FLOAT32_IEEE NO_COMPU_METHOD 0 0 -3.402823466e+38 3.402823466e+38 ECU_ADDRESS 0 SYMBOL_LINK "Rte_HysCmp_dHysCmpFric" 0 DISPLAY_IDENTIFIER HysCmp.PerInstanceMemories.dHysCmpFric /end MEASUREMENT
/begin MEASUREMENT HysCmp.dHysCmpHwTqFild "MICROSAR RTE" FLOAT32_IEEE NO_COMPU_METHOD 0 0 -3.402823466e+38 3.402823466e+38 ECU_ADDRESS 0 SYMBOL_LINK "Rte_HysCmp_dHysCmpHwTqFild" 0 DISPLAY_IDENTIFIER HysCmp.PerInstanceMemories.dHysCmpHwTqFild /end MEASUREMENT
/begin MEASUREMENT HysCmp.dHysCmpNegAvl "MICROSAR RTE" FLOAT32_IEEE NO_COMPU_METHOD 0 0 -3.402823466e+38 3.402823466e+38 ECU_ADDRESS 0 SYMBOL_LINK "Rte_HysCmp_dHysCmpNegAvl" 0 DISPLAY_IDENTIFIER HysCmp.PerInstanceMemories.dHysCmpNegAvl /end MEASUREMENT
/begin MEASUREMENT HysCmp.dHysCmpPosAvl "MICROSAR RTE" FLOAT32_IEEE NO_COMPU_METHOD 0 0 -3.402823466e+38 3.402823466e+38 ECU_ADDRESS 0 SYMBOL_LINK "Rte_HysCmp_dHysCmpPosAvl" 0 DISPLAY_IDENTIFIER HysCmp.PerInstanceMemories.dHysCmpPosAvl /end MEASUREMENT
/begin MEASUREMENT HysCmp.dHysCmpRawVal "MICROSAR RTE" FLOAT32_IEEE NO_COMPU_METHOD 0 0 -3.402823466e+38 3.402823466e+38 ECU_ADDRESS 0 SYMBOL_LINK "Rte_HysCmp_dHysCmpRawVal" 0 DISPLAY_IDENTIFIER HysCmp.PerInstanceMemories.dHysCmpRawVal /end MEASUREMENT
/begin MEASUREMENT HysCmp.dHysCmpRiseYFac "MICROSAR RTE" FLOAT32_IEEE NO_COMPU_METHOD 0 0 -3.402823466e+38 3.402823466e+38 ECU_ADDRESS 0 SYMBOL_LINK "Rte_HysCmp_dHysCmpRiseYFac" 0 DISPLAY_IDENTIFIER HysCmp.PerInstanceMemories.dHysCmpRiseYFac /end MEASUREMENT
/begin MEASUREMENT InertiaCmpVel.AssiCmdBas.Val "MICROSAR RTE" FLOAT32_IEEE NO_COMPU_METHOD 0 0 -3.402823466e+38 3.402823466e+38 ECU_ADDRESS 0 SYMBOL_LINK "Rte_Assi_AssiCmdBas_Val" 0 DISPLAY_IDENTIFIER InertiaCmpVel.ReceiverPorts.AssiCmdBas.Val /end MEASUREMENT
/begin MEASUREMENT InertiaCmpVel.DecelGain "MICROSAR RTE" FLOAT32_IEEE NO_COMPU_METHOD 0 0 -3.402823466e+38 3.402823466e+38 ECU_ADDRESS 0 SYMBOL_LINK "Rte_InertiaCmpVel_DecelGain" 0 DISPLAY_IDENTIFIER InertiaCmpVel.PerInstanceMemories.DecelGain /end MEASUREMENT
/begin MEASUREMENT InertiaCmpVel.HwTq.Val "MICROSAR RTE" FLOAT32_IEEE NO_COMPU_METHOD 0 0 -3.402823466e+38 3.402823466e+38 ECU_ADDRESS 0 SYMBOL_LINK "Rte_Swp_HwTqSwp_Val" 0 DISPLAY_IDENTIFIER InertiaCmpVel.ReceiverPorts.HwTq.Val /end MEASUREMENT
/begin MEASUREMENT InertiaCmpVel.InertiaCmpDecelGainDi.Logl "MICROSAR RTE" UBYTE RTE_CM_BOOLEAN 0 0 0 255 ECU_ADDRESS 0 SYMBOL_LINK "Rte_GmFctDiArbn_InertiaCmpDecelGainDi_Logl" 0 DISPLAY_IDENTIFIER InertiaCmpVel.ReceiverPorts.InertiaCmpDecelGainDi.Logl /end MEASUREMENT
/begin MEASUREMENT InertiaCmpVel.InertiaCmpVelCmd.Val "MICROSAR RTE" FLOAT32_IEEE NO_COMPU_METHOD 0 0 -3.402823466e+38 3.402823466e+38 ECU_ADDRESS 0 SYMBOL_LINK "Rte_InertiaCmpVel_InertiaCmpVelCmd_Val" 0 DISPLAY_IDENTIFIER InertiaCmpVel.SenderPorts.InertiaCmpVelCmd.Val /end MEASUREMENT
/begin MEASUREMENT InertiaCmpVel.InertiaCmpVelCmdDi.Logl "MICROSAR RTE" UBYTE RTE_CM_BOOLEAN 0 0 0 255 ECU_ADDRESS 0 SYMBOL_LINK "Rte_CmnMfgSrv_InertiaCmpVelCmdDi_Logl" 0 DISPLAY_IDENTIFIER InertiaCmpVel.ReceiverPorts.InertiaCmpVelCmdDi.Logl /end MEASUREMENT
/begin MEASUREMENT InertiaCmpVel.MotVelCrf.Val "MICROSAR RTE" FLOAT32_IEEE NO_COMPU_METHOD 0 0 -3.402823466e+38 3.402823466e+38 ECU_ADDRESS 0 SYMBOL_LINK "Rte_CDD_MotVel_MotVelCrf_Val" 0 DISPLAY_IDENTIFIER InertiaCmpVel.ReceiverPorts.MotVelCrf.Val /end MEASUREMENT
/begin MEASUREMENT InertiaCmpVel.NotchFilChk "MICROSAR RTE" UBYTE RTE_CM_BOOLEAN 0 0 0 255 ECU_ADDRESS 0 SYMBOL_LINK "Rte_InertiaCmpVel_NotchFilChk" 0 DISPLAY_IDENTIFIER InertiaCmpVel.PerInstanceMemories.NotchFilChk /end MEASUREMENT
/begin MEASUREMENT InertiaCmpVel.PreScagCmpCmdPrev1 "MICROSAR RTE" FLOAT32_IEEE NO_COMPU_METHOD 0 0 -3.402823466e+38 3.402823466e+38 ECU_ADDRESS 0 SYMBOL_LINK "Rte_InertiaCmpVel_PreScagCmpCmdPrev1" 0 DISPLAY_IDENTIFIER InertiaCmpVel.PerInstanceMemories.PreScagCmpCmdPrev1 /end MEASUREMENT
/begin MEASUREMENT InertiaCmpVel.PreScagCmpCmdPrev2 "MICROSAR RTE" FLOAT32_IEEE NO_COMPU_METHOD 0 0 -3.402823466e+38 3.402823466e+38 ECU_ADDRESS 0 SYMBOL_LINK "Rte_InertiaCmpVel_PreScagCmpCmdPrev2" 0 DISPLAY_IDENTIFIER InertiaCmpVel.PerInstanceMemories.PreScagCmpCmdPrev2 /end MEASUREMENT
/begin MEASUREMENT InertiaCmpVel.ScaDrvrVelPrev1 "MICROSAR RTE" FLOAT32_IEEE NO_COMPU_METHOD 0 0 -3.402823466e+38 3.402823466e+38 ECU_ADDRESS 0 SYMBOL_LINK "Rte_InertiaCmpVel_ScaDrvrVelPrev1" 0 DISPLAY_IDENTIFIER InertiaCmpVel.PerInstanceMemories.ScaDrvrVelPrev1 /end MEASUREMENT
/begin MEASUREMENT InertiaCmpVel.ScaDrvrVelPrev2 "MICROSAR RTE" FLOAT32_IEEE NO_COMPU_METHOD 0 0 -3.402823466e+38 3.402823466e+38 ECU_ADDRESS 0 SYMBOL_LINK "Rte_InertiaCmpVel_ScaDrvrVelPrev2" 0 DISPLAY_IDENTIFIER InertiaCmpVel.PerInstanceMemories.ScaDrvrVelPrev2 /end MEASUREMENT
/begin MEASUREMENT InertiaCmpVel.TqSnsrAgPrev "MICROSAR RTE" FLOAT32_IEEE NO_COMPU_METHOD 0 0 -3.402823466e+38 3.402823466e+38 ECU_ADDRESS 0 SYMBOL_LINK "Rte_InertiaCmpVel_TqSnsrAgPrev" 0 DISPLAY_IDENTIFIER InertiaCmpVel.PerInstanceMemories.TqSnsrAgPrev /end MEASUREMENT
/begin MEASUREMENT InertiaCmpVel.TqSnsrVelFil.FilGain "MICROSAR RTE" FLOAT32_IEEE NO_COMPU_METHOD 0 0 -3.402823466e+38 3.402823466e+38 ECU_ADDRESS 0 SYMBOL_LINK "Rte_InertiaCmpVel_TqSnsrVelFil.FilGain" 0 DISPLAY_IDENTIFIER InertiaCmpVel.PerInstanceMemories.TqSnsrVelFil.FilGain /end MEASUREMENT
/begin MEASUREMENT InertiaCmpVel.TqSnsrVelFil.FilSt "MICROSAR RTE" FLOAT32_IEEE NO_COMPU_METHOD 0 0 -3.402823466e+38 3.402823466e+38 ECU_ADDRESS 0 SYMBOL_LINK "Rte_InertiaCmpVel_TqSnsrVelFil.FilSt" 0 DISPLAY_IDENTIFIER InertiaCmpVel.PerInstanceMemories.TqSnsrVelFil.FilSt /end MEASUREMENT
/begin MEASUREMENT InertiaCmpVel.TqSnsrVelFilNotchSt.FilSt1 "MICROSAR RTE" FLOAT32_IEEE NO_COMPU_METHOD 0 0 -3.402823466e+38 3.402823466e+38 ECU_ADDRESS 0 SYMBOL_LINK "Rte_InertiaCmpVel_TqSnsrVelFilNotchSt.FilSt1" 0 DISPLAY_IDENTIFIER InertiaCmpVel.PerInstanceMemories.TqSnsrVelFilNotchSt.FilSt1 /end MEASUREMENT
/begin MEASUREMENT InertiaCmpVel.TqSnsrVelFilNotchSt.FilSt2 "MICROSAR RTE" FLOAT32_IEEE NO_COMPU_METHOD 0 0 -3.402823466e+38 3.402823466e+38 ECU_ADDRESS 0 SYMBOL_LINK "Rte_InertiaCmpVel_TqSnsrVelFilNotchSt.FilSt2" 0 DISPLAY_IDENTIFIER InertiaCmpVel.PerInstanceMemories.TqSnsrVelFilNotchSt.FilSt2 /end MEASUREMENT
/begin MEASUREMENT InertiaCmpVel.VehLgtA.Val "MICROSAR RTE" FLOAT32_IEEE NO_COMPU_METHOD 0 0 -3.402823466e+38 3.402823466e+38 ECU_ADDRESS 0 SYMBOL_LINK "Rte_VehSigCdng_VehLgtA_Val" 0 DISPLAY_IDENTIFIER InertiaCmpVel.ReceiverPorts.VehLgtA.Val /end MEASUREMENT
/begin MEASUREMENT InertiaCmpVel.VehSpd.Val "MICROSAR RTE" FLOAT32_IEEE NO_COMPU_METHOD 0 0 -3.402823466e+38 3.402823466e+38 ECU_ADDRESS 0 SYMBOL_LINK "Rte_VehSigCdng_VehSpd_Val" 0 DISPLAY_IDENTIFIER InertiaCmpVel.ReceiverPorts.VehSpd.Val /end MEASUREMENT
/begin MEASUREMENT InertiaCmpVel.WhlImbRejctnAmp.Val "MICROSAR RTE" FLOAT32_IEEE NO_COMPU_METHOD 0 0 -3.402823466e+38 3.402823466e+38 ECU_ADDRESS 0 SYMBOL_LINK "Rte_WhlImbRejctn_WhlImbRejctnAmp_Val" 0 DISPLAY_IDENTIFIER InertiaCmpVel.ReceiverPorts.WhlImbRejctnAmp.Val /end MEASUREMENT
/begin MEASUREMENT InertiaCmpVel.dInertiaCmpVelAssiBasdDampgCoeff "MICROSAR RTE" FLOAT32_IEEE NO_COMPU_METHOD 0 0 -3.402823466e+38 3.402823466e+38 ECU_ADDRESS 0 SYMBOL_LINK "Rte_InertiaCmpVel_dInertiaCmpVelAssiBasdDampgCoeff" 0 DISPLAY_IDENTIFIER InertiaCmpVel.PerInstanceMemories.dInertiaCmpVelAssiBasdDampgCoeff /end MEASUREMENT
/begin MEASUREMENT InertiaCmpVel.dInertiaCmpVelCalcdInertiaCmp "MICROSAR RTE" FLOAT32_IEEE NO_COMPU_METHOD 0 0 -3.402823466e+38 3.402823466e+38 ECU_ADDRESS 0 SYMBOL_LINK "Rte_InertiaCmpVel_dInertiaCmpVelCalcdInertiaCmp" 0 DISPLAY_IDENTIFIER InertiaCmpVel.PerInstanceMemories.dInertiaCmpVelCalcdInertiaCmp /end MEASUREMENT
/begin MEASUREMENT InertiaCmpVel.dInertiaCmpVelFilFrq "MICROSAR RTE" FLOAT32_IEEE NO_COMPU_METHOD 0 0 -3.402823466e+38 3.402823466e+38 ECU_ADDRESS 0 SYMBOL_LINK "Rte_InertiaCmpVel_dInertiaCmpVelFilFrq" 0 DISPLAY_IDENTIFIER InertiaCmpVel.PerInstanceMemories.dInertiaCmpVelFilFrq /end MEASUREMENT
/begin MEASUREMENT InertiaCmpVel.dInertiaCmpVelMotVelBasdOutpScag "MICROSAR RTE" FLOAT32_IEEE NO_COMPU_METHOD 0 0 -3.402823466e+38 3.402823466e+38 ECU_ADDRESS 0 SYMBOL_LINK "Rte_InertiaCmpVel_dInertiaCmpVelMotVelBasdOutpScag" 0 DISPLAY_IDENTIFIER InertiaCmpVel.PerInstanceMemories.dInertiaCmpVelMotVelBasdOutpScag /end MEASUREMENT
/begin MEASUREMENT InertiaCmpVel.dInertiaCmpVelNotScadDrvrVel "MICROSAR RTE" FLOAT32_IEEE NO_COMPU_METHOD 0 0 -3.402823466e+38 3.402823466e+38 ECU_ADDRESS 0 SYMBOL_LINK "Rte_InertiaCmpVel_dInertiaCmpVelNotScadDrvrVel" 0 DISPLAY_IDENTIFIER InertiaCmpVel.PerInstanceMemories.dInertiaCmpVelNotScadDrvrVel /end MEASUREMENT
/begin MEASUREMENT InertiaCmpVel.dInertiaCmpVelNotchBlndVal "MICROSAR RTE" FLOAT32_IEEE NO_COMPU_METHOD 0 0 -3.402823466e+38 3.402823466e+38 ECU_ADDRESS 0 SYMBOL_LINK "Rte_InertiaCmpVel_dInertiaCmpVelNotchBlndVal" 0 DISPLAY_IDENTIFIER InertiaCmpVel.PerInstanceMemories.dInertiaCmpVelNotchBlndVal /end MEASUREMENT
/begin MEASUREMENT InertiaCmpVel.dInertiaCmpVelNotchInpVal "MICROSAR RTE" FLOAT32_IEEE NO_COMPU_METHOD 0 0 -3.402823466e+38 3.402823466e+38 ECU_ADDRESS 0 SYMBOL_LINK "Rte_InertiaCmpVel_dInertiaCmpVelNotchInpVal" 0 DISPLAY_IDENTIFIER InertiaCmpVel.PerInstanceMemories.dInertiaCmpVelNotchInpVal /end MEASUREMENT
/begin MEASUREMENT InertiaCmpVel.dInertiaCmpVelNotchOutpVal "MICROSAR RTE" FLOAT32_IEEE NO_COMPU_METHOD 0 0 -3.402823466e+38 3.402823466e+38 ECU_ADDRESS 0 SYMBOL_LINK "Rte_InertiaCmpVel_dInertiaCmpVelNotchOutpVal" 0 DISPLAY_IDENTIFIER InertiaCmpVel.PerInstanceMemories.dInertiaCmpVelNotchOutpVal /end MEASUREMENT
/begin MEASUREMENT InertiaCmpVel.dInertiaCmpVelRawDecelGain "MICROSAR RTE" FLOAT32_IEEE NO_COMPU_METHOD 0 0 -3.402823466e+38 3.402823466e+38 ECU_ADDRESS 0 SYMBOL_LINK "Rte_InertiaCmpVel_dInertiaCmpVelRawDecelGain" 0 DISPLAY_IDENTIFIER InertiaCmpVel.PerInstanceMemories.dInertiaCmpVelRawDecelGain /end MEASUREMENT
/begin MEASUREMENT InertiaCmpVel.dInertiaCmpVelScadDrvrVel "MICROSAR RTE" FLOAT32_IEEE NO_COMPU_METHOD 0 0 -3.402823466e+38 3.402823466e+38 ECU_ADDRESS 0 SYMBOL_LINK "Rte_InertiaCmpVel_dInertiaCmpVelScadDrvrVel" 0 DISPLAY_IDENTIFIER InertiaCmpVel.PerInstanceMemories.dInertiaCmpVelScadDrvrVel /end MEASUREMENT
/begin MEASUREMENT InertiaCmpVel.dInertiaCmpVelTqSnsrVelFildVal "MICROSAR RTE" FLOAT32_IEEE NO_COMPU_METHOD 0 0 -3.402823466e+38 3.402823466e+38 ECU_ADDRESS 0 SYMBOL_LINK "Rte_InertiaCmpVel_dInertiaCmpVelTqSnsrVelFildVal" 0 DISPLAY_IDENTIFIER InertiaCmpVel.PerInstanceMemories.dInertiaCmpVelTqSnsrVelFildVal /end MEASUREMENT
/begin MEASUREMENT LimrCdng.EotAssiSca.Val "MICROSAR RTE" FLOAT32_IEEE NO_COMPU_METHOD 0 0 -3.402823466e+38 3.402823466e+38 ECU_ADDRESS 0 SYMBOL_LINK "Rte_EotProtn_EotAssiSca_Val" 0 DISPLAY_IDENTIFIER LimrCdng.ReceiverPorts.EotAssiSca.Val /end MEASUREMENT
/begin MEASUREMENT LimrCdng.EotAssiScaCdnd.Val "MICROSAR RTE" FLOAT32_IEEE NO_COMPU_METHOD 0 0 -3.402823466e+38 3.402823466e+38 ECU_ADDRESS 0 SYMBOL_LINK "Rte_LimrCdng_EotAssiScaCdnd_Val" 0 DISPLAY_IDENTIFIER LimrCdng.SenderPorts.EotAssiScaCdnd.Val /end MEASUREMENT
/begin MEASUREMENT LimrCdng.EotMotTqLim.Val "MICROSAR RTE" FLOAT32_IEEE NO_COMPU_METHOD 0 0 -3.402823466e+38 3.402823466e+38 ECU_ADDRESS 0 SYMBOL_LINK "Rte_EotProtn_EotMotTqLim_Val" 0 DISPLAY_IDENTIFIER LimrCdng.ReceiverPorts.EotMotTqLim.Val /end MEASUREMENT
/begin MEASUREMENT LimrCdng.EotMotTqLimCdnd.Val "MICROSAR RTE" FLOAT32_IEEE NO_COMPU_METHOD 0 0 -3.402823466e+38 3.402823466e+38 ECU_ADDRESS 0 SYMBOL_LINK "Rte_LimrCdng_EotMotTqLimCdnd_Val" 0 DISPLAY_IDENTIFIER LimrCdng.SenderPorts.EotMotTqLimCdnd.Val /end MEASUREMENT
/begin MEASUREMENT LimrCdng.PrevEotAssiScaCdnd "MICROSAR RTE" FLOAT32_IEEE NO_COMPU_METHOD 0 0 -3.402823466e+38 3.402823466e+38 ECU_ADDRESS 0 SYMBOL_LINK "Rte_LimrCdng_PrevEotAssiScaCdnd" 0 DISPLAY_IDENTIFIER LimrCdng.PerInstanceMemories.PrevEotAssiScaCdnd /end MEASUREMENT
/begin MEASUREMENT LimrCdng.PrevEotMotTqLimCdnd "MICROSAR RTE" FLOAT32_IEEE NO_COMPU_METHOD 0 0 -3.402823466e+38 3.402823466e+38 ECU_ADDRESS 0 SYMBOL_LINK "Rte_LimrCdng_PrevEotMotTqLimCdnd" 0 DISPLAY_IDENTIFIER LimrCdng.PerInstanceMemories.PrevEotMotTqLimCdnd /end MEASUREMENT
/begin MEASUREMENT LimrCdng.PrevStallMotTqLimCdnd "MICROSAR RTE" FLOAT32_IEEE NO_COMPU_METHOD 0 0 -3.402823466e+38 3.402823466e+38 ECU_ADDRESS 0 SYMBOL_LINK "Rte_LimrCdng_PrevStallMotTqLimCdnd" 0 DISPLAY_IDENTIFIER LimrCdng.PerInstanceMemories.PrevStallMotTqLimCdnd /end MEASUREMENT
/begin MEASUREMENT LimrCdng.PrevSysMotTqCmdScaCdnd "MICROSAR RTE" FLOAT32_IEEE NO_COMPU_METHOD 0 0 -3.402823466e+38 3.402823466e+38 ECU_ADDRESS 0 SYMBOL_LINK "Rte_LimrCdng_PrevSysMotTqCmdScaCdnd" 0 DISPLAY_IDENTIFIER LimrCdng.PerInstanceMemories.PrevSysMotTqCmdScaCdnd /end MEASUREMENT
/begin MEASUREMENT LimrCdng.PrevThermMotTqLimCdnd "MICROSAR RTE" FLOAT32_IEEE NO_COMPU_METHOD 0 0 -3.402823466e+38 3.402823466e+38 ECU_ADDRESS 0 SYMBOL_LINK "Rte_LimrCdng_PrevThermMotTqLimCdnd" 0 DISPLAY_IDENTIFIER LimrCdng.PerInstanceMemories.PrevThermMotTqLimCdnd /end MEASUREMENT
/begin MEASUREMENT LimrCdng.PrevVehSpdMotTqLimCdnd "MICROSAR RTE" FLOAT32_IEEE NO_COMPU_METHOD 0 0 -3.402823466e+38 3.402823466e+38 ECU_ADDRESS 0 SYMBOL_LINK "Rte_LimrCdng_PrevVehSpdMotTqLimCdnd" 0 DISPLAY_IDENTIFIER LimrCdng.PerInstanceMemories.PrevVehSpdMotTqLimCdnd /end MEASUREMENT
/begin MEASUREMENT LimrCdng.StallMotTqLim.Val "MICROSAR RTE" FLOAT32_IEEE NO_COMPU_METHOD 0 0 -3.402823466e+38 3.402823466e+38 ECU_ADDRESS 0 SYMBOL_LINK "Rte_HiLoadStallLimr_StallMotTqLim_Val" 0 DISPLAY_IDENTIFIER LimrCdng.ReceiverPorts.StallMotTqLim.Val /end MEASUREMENT
/begin MEASUREMENT LimrCdng.StallMotTqLimCdnd.Val "MICROSAR RTE" FLOAT32_IEEE NO_COMPU_METHOD 0 0 -3.402823466e+38 3.402823466e+38 ECU_ADDRESS 0 SYMBOL_LINK "Rte_LimrCdng_StallMotTqLimCdnd_Val" 0 DISPLAY_IDENTIFIER LimrCdng.SenderPorts.StallMotTqLimCdnd.Val /end MEASUREMENT
/begin MEASUREMENT LimrCdng.SysMotTqCmdSca.Val "MICROSAR RTE" FLOAT32_IEEE NO_COMPU_METHOD 0 0 -3.402823466e+38 3.402823466e+38 ECU_ADDRESS 0 SYMBOL_LINK "Rte_StOutpCtrl_SysMotTqCmdSca_Val" 0 DISPLAY_IDENTIFIER LimrCdng.ReceiverPorts.SysMotTqCmdSca.Val /end MEASUREMENT
/begin MEASUREMENT LimrCdng.SysMotTqCmdScaCdnd.Val "MICROSAR RTE" FLOAT32_IEEE NO_COMPU_METHOD 0 0 -3.402823466e+38 3.402823466e+38 ECU_ADDRESS 0 SYMBOL_LINK "Rte_LimrCdng_SysMotTqCmdScaCdnd_Val" 0 DISPLAY_IDENTIFIER LimrCdng.SenderPorts.SysMotTqCmdScaCdnd.Val /end MEASUREMENT
/begin MEASUREMENT LimrCdng.ThermMotTqLim.Val "MICROSAR RTE" FLOAT32_IEEE NO_COMPU_METHOD 0 0 -3.402823466e+38 3.402823466e+38 ECU_ADDRESS 0 SYMBOL_LINK "Rte_DutyCycThermProtn_ThermMotTqLim_Val" 0 DISPLAY_IDENTIFIER LimrCdng.ReceiverPorts.ThermMotTqLim.Val /end MEASUREMENT
/begin MEASUREMENT LimrCdng.ThermMotTqLimCdnd.Val "MICROSAR RTE" FLOAT32_IEEE NO_COMPU_METHOD 0 0 -3.402823466e+38 3.402823466e+38 ECU_ADDRESS 0 SYMBOL_LINK "Rte_LimrCdng_ThermMotTqLimCdnd_Val" 0 DISPLAY_IDENTIFIER LimrCdng.SenderPorts.ThermMotTqLimCdnd.Val /end MEASUREMENT
/begin MEASUREMENT LimrCdng.VehSpd.Val "MICROSAR RTE" FLOAT32_IEEE NO_COMPU_METHOD 0 0 -3.402823466e+38 3.402823466e+38 ECU_ADDRESS 0 SYMBOL_LINK "Rte_VehSigCdng_VehSpd_Val" 0 DISPLAY_IDENTIFIER LimrCdng.ReceiverPorts.VehSpd.Val /end MEASUREMENT
/begin MEASUREMENT LimrCdng.VehSpdMotTqLim.Val "MICROSAR RTE" FLOAT32_IEEE NO_COMPU_METHOD 0 0 -3.402823466e+38 3.402823466e+38 ECU_ADDRESS 0 SYMBOL_LINK "Rte_VehSpdLimr_VehSpdMotTqLim_Val" 0 DISPLAY_IDENTIFIER LimrCdng.ReceiverPorts.VehSpdMotTqLim.Val /end MEASUREMENT
/begin MEASUREMENT LimrCdng.VehSpdMotTqLimCdnd.Val "MICROSAR RTE" FLOAT32_IEEE NO_COMPU_METHOD 0 0 -3.402823466e+38 3.402823466e+38 ECU_ADDRESS 0 SYMBOL_LINK "Rte_LimrCdng_VehSpdMotTqLimCdnd_Val" 0 DISPLAY_IDENTIFIER LimrCdng.SenderPorts.VehSpdMotTqLimCdnd.Val /end MEASUREMENT
/begin MEASUREMENT LoaMgr.CurrMeasIdptSig.Val "MICROSAR RTE" UBYTE NO_COMPU_METHOD 0 0 0 255 ECU_ADDRESS 0 SYMBOL_LINK "Rte_CurrMeasCorrln_CurrMeasIdptSig_Val" 0 DISPLAY_IDENTIFIER LoaMgr.ReceiverPorts.CurrMeasIdptSig.Val /end MEASUREMENT
/begin MEASUREMENT LoaMgr.CurrMeasLoaMtgtnEna.Logl "MICROSAR RTE" UBYTE RTE_CM_BOOLEAN 0 0 0 255 ECU_ADDRESS 0 SYMBOL_LINK "Rte_LoaMgr_CurrMeasLoaMtgtnEna_Logl" 0 DISPLAY_IDENTIFIER LoaMgr.SenderPorts.CurrMeasLoaMtgtnEna.Logl /end MEASUREMENT
/begin MEASUREMENT LoaMgr.DiagcStsIvtr1Inactv.Logl "MICROSAR RTE" UBYTE RTE_CM_BOOLEAN 0 0 0 255 ECU_ADDRESS 0 SYMBOL_LINK "Rte_DiagcMgr_DiagcStsIvtr1Inactv_Logl" 0 DISPLAY_IDENTIFIER LoaMgr.ReceiverPorts.DiagcStsIvtr1Inactv.Logl /end MEASUREMENT
/begin MEASUREMENT LoaMgr.DiagcStsIvtr2Inactv.Logl "MICROSAR RTE" UBYTE RTE_CM_BOOLEAN 0 0 0 255 ECU_ADDRESS 0 SYMBOL_LINK "Rte_DiagcMgr_DiagcStsIvtr2Inactv_Logl" 0 DISPLAY_IDENTIFIER LoaMgr.ReceiverPorts.DiagcStsIvtr2Inactv.Logl /end MEASUREMENT
/begin MEASUREMENT LoaMgr.HwTqIdptSig.Val "MICROSAR RTE" UBYTE NO_COMPU_METHOD 0 0 0 255 ECU_ADDRESS 0 SYMBOL_LINK "Rte_HwTqCorrln_HwTqIdptSig_Val" 0 DISPLAY_IDENTIFIER LoaMgr.ReceiverPorts.HwTqIdptSig.Val /end MEASUREMENT
/begin MEASUREMENT LoaMgr.HwTqLoaMtgtnEna.Logl "MICROSAR RTE" UBYTE RTE_CM_BOOLEAN 0 0 0 255 ECU_ADDRESS 0 SYMBOL_LINK "Rte_LoaMgr_HwTqLoaMtgtnEna_Logl" 0 DISPLAY_IDENTIFIER LoaMgr.SenderPorts.HwTqLoaMtgtnEna.Logl /end MEASUREMENT
/begin MEASUREMENT LoaMgr.IvtrLoaMtgtnEna.Logl "MICROSAR RTE" UBYTE RTE_CM_BOOLEAN 0 0 0 255 ECU_ADDRESS 0 SYMBOL_LINK "Rte_LoaMgr_IvtrLoaMtgtnEna_Logl" 0 DISPLAY_IDENTIFIER LoaMgr.SenderPorts.IvtrLoaMtgtnEna.Logl /end MEASUREMENT
/begin MEASUREMENT LoaMgr.LoaRateLim.Val "MICROSAR RTE" FLOAT32_IEEE NO_COMPU_METHOD 0 0 -3.402823466e+38 3.402823466e+38 ECU_ADDRESS 0 SYMBOL_LINK "Rte_LoaMgr_LoaRateLim_Val" 0 DISPLAY_IDENTIFIER LoaMgr.SenderPorts.LoaRateLim.Val /end MEASUREMENT
/begin MEASUREMENT LoaMgr.LoaSca.Val "MICROSAR RTE" FLOAT32_IEEE NO_COMPU_METHOD 0 0 -3.402823466e+38 3.402823466e+38 ECU_ADDRESS 0 SYMBOL_LINK "Rte_LoaMgr_LoaSca_Val" 0 DISPLAY_IDENTIFIER LoaMgr.SenderPorts.LoaSca.Val /end MEASUREMENT
/begin MEASUREMENT LoaMgr.LoaScaDi.Logl "MICROSAR RTE" UBYTE RTE_CM_BOOLEAN 0 0 0 255 ECU_ADDRESS 0 SYMBOL_LINK "Rte_CmnMfgSrv_LoaScaDi_Logl" 0 DISPLAY_IDENTIFIER LoaMgr.ReceiverPorts.LoaScaDi.Logl /end MEASUREMENT
/begin MEASUREMENT LoaMgr.LoaSt.Val "MICROSAR RTE" UBYTE RTE_CM_ENUM_LoaSt1 0 0 0 255 ECU_ADDRESS 0 SYMBOL_LINK "Rte_LoaMgr_LoaSt_Val" 0 DISPLAY_IDENTIFIER LoaMgr.SenderPorts.LoaSt.Val /end MEASUREMENT
/begin MEASUREMENT LoaMgr.MotAgLoaMtgtnEna.Logl "MICROSAR RTE" UBYTE RTE_CM_BOOLEAN 0 0 0 255 ECU_ADDRESS 0 SYMBOL_LINK "Rte_LoaMgr_MotAgLoaMtgtnEna_Logl" 0 DISPLAY_IDENTIFIER LoaMgr.SenderPorts.MotAgLoaMtgtnEna.Logl /end MEASUREMENT
/begin MEASUREMENT LoaMgr.MotAgMeclIdptSig.Val "MICROSAR RTE" UBYTE NO_COMPU_METHOD 0 0 0 255 ECU_ADDRESS 0 SYMBOL_LINK "Rte_MotAgCorrln_MotAgMeclIdptSig_Val" 0 DISPLAY_IDENTIFIER LoaMgr.ReceiverPorts.MotAgMeclIdptSig.Val /end MEASUREMENT
/begin MEASUREMENT LoaMgr.MotAgSnsrlsAvl.Logl "MICROSAR RTE" UBYTE RTE_CM_BOOLEAN 0 0 0 255 ECU_ADDRESS 0 SYMBOL_LINK "Rte_LoaMgr_MotAgSnsrlsAvl_Logl" 0 DISPLAY_IDENTIFIER LoaMgr.ReceiverPorts.MotAgSnsrlsAvl.Logl /end MEASUREMENT
/begin MEASUREMENT LoaMgr.PrevCurrMeasIdptSigResp "MICROSAR RTE" UBYTE NO_COMPU_METHOD 0 0 0 255 ECU_ADDRESS 0 SYMBOL_LINK "Rte_LoaMgr_PrevCurrMeasIdptSigResp" 0 DISPLAY_IDENTIFIER LoaMgr.PerInstanceMemories.PrevCurrMeasIdptSigResp /end MEASUREMENT
/begin MEASUREMENT LoaMgr.PrevCurrMeasIdptSigVal "MICROSAR RTE" UBYTE NO_COMPU_METHOD 0 0 0 255 ECU_ADDRESS 0 SYMBOL_LINK "Rte_LoaMgr_PrevCurrMeasIdptSigVal" 0 DISPLAY_IDENTIFIER LoaMgr.PerInstanceMemories.PrevCurrMeasIdptSigVal /end MEASUREMENT
/begin MEASUREMENT LoaMgr.PrevCurrMeasLoaStSwMtgtnEna "MICROSAR RTE" UBYTE RTE_CM_BOOLEAN 0 0 0 255 ECU_ADDRESS 0 SYMBOL_LINK "Rte_LoaMgr_PrevCurrMeasLoaStSwMtgtnEna" 0 DISPLAY_IDENTIFIER LoaMgr.PerInstanceMemories.PrevCurrMeasLoaStSwMtgtnEna /end MEASUREMENT
/begin MEASUREMENT LoaMgr.PrevHwTqIdptSigResp "MICROSAR RTE" UBYTE NO_COMPU_METHOD 0 0 0 255 ECU_ADDRESS 0 SYMBOL_LINK "Rte_LoaMgr_PrevHwTqIdptSigResp" 0 DISPLAY_IDENTIFIER LoaMgr.PerInstanceMemories.PrevHwTqIdptSigResp /end MEASUREMENT
/begin MEASUREMENT LoaMgr.PrevHwTqIdptSigVal "MICROSAR RTE" UBYTE NO_COMPU_METHOD 0 0 0 255 ECU_ADDRESS 0 SYMBOL_LINK "Rte_LoaMgr_PrevHwTqIdptSigVal" 0 DISPLAY_IDENTIFIER LoaMgr.PerInstanceMemories.PrevHwTqIdptSigVal /end MEASUREMENT
/begin MEASUREMENT LoaMgr.PrevHwTqLoaStSwMtgtnEna "MICROSAR RTE" UBYTE RTE_CM_BOOLEAN 0 0 0 255 ECU_ADDRESS 0 SYMBOL_LINK "Rte_LoaMgr_PrevHwTqLoaStSwMtgtnEna" 0 DISPLAY_IDENTIFIER LoaMgr.PerInstanceMemories.PrevHwTqLoaStSwMtgtnEna /end MEASUREMENT
/begin MEASUREMENT LoaMgr.PrevIvtrIdptSigResp "MICROSAR RTE" UBYTE NO_COMPU_METHOD 0 0 0 255 ECU_ADDRESS 0 SYMBOL_LINK "Rte_LoaMgr_PrevIvtrIdptSigResp" 0 DISPLAY_IDENTIFIER LoaMgr.PerInstanceMemories.PrevIvtrIdptSigResp /end MEASUREMENT
/begin MEASUREMENT LoaMgr.PrevIvtrIdptSigVal "MICROSAR RTE" UBYTE NO_COMPU_METHOD 0 0 0 255 ECU_ADDRESS 0 SYMBOL_LINK "Rte_LoaMgr_PrevIvtrIdptSigVal" 0 DISPLAY_IDENTIFIER LoaMgr.PerInstanceMemories.PrevIvtrIdptSigVal /end MEASUREMENT
/begin MEASUREMENT LoaMgr.PrevIvtrLoaStSwMtgtnEna "MICROSAR RTE" UBYTE RTE_CM_BOOLEAN 0 0 0 255 ECU_ADDRESS 0 SYMBOL_LINK "Rte_LoaMgr_PrevIvtrLoaStSwMtgtnEna" 0 DISPLAY_IDENTIFIER LoaMgr.PerInstanceMemories.PrevIvtrLoaStSwMtgtnEna /end MEASUREMENT
/begin MEASUREMENT LoaMgr.PrevMotAgLoaMtgtnEna "MICROSAR RTE" UBYTE RTE_CM_BOOLEAN 0 0 0 255 ECU_ADDRESS 0 SYMBOL_LINK "Rte_LoaMgr_PrevMotAgLoaMtgtnEna" 0 DISPLAY_IDENTIFIER LoaMgr.PerInstanceMemories.PrevMotAgLoaMtgtnEna /end MEASUREMENT
/begin MEASUREMENT LoaMgr.PrevMotAgLoaStSwMtgtnEna "MICROSAR RTE" UBYTE RTE_CM_BOOLEAN 0 0 0 255 ECU_ADDRESS 0 SYMBOL_LINK "Rte_LoaMgr_PrevMotAgLoaStSwMtgtnEna" 0 DISPLAY_IDENTIFIER LoaMgr.PerInstanceMemories.PrevMotAgLoaStSwMtgtnEna /end MEASUREMENT
/begin MEASUREMENT LoaMgr.PrevMotAgMeclIdptSigResp "MICROSAR RTE" UBYTE NO_COMPU_METHOD 0 0 0 255 ECU_ADDRESS 0 SYMBOL_LINK "Rte_LoaMgr_PrevMotAgMeclIdptSigResp" 0 DISPLAY_IDENTIFIER LoaMgr.PerInstanceMemories.PrevMotAgMeclIdptSigResp /end MEASUREMENT
/begin MEASUREMENT LoaMgr.PrevMotAgMeclIdptSigVal "MICROSAR RTE" UBYTE NO_COMPU_METHOD 0 0 0 255 ECU_ADDRESS 0 SYMBOL_LINK "Rte_LoaMgr_PrevMotAgMeclIdptSigVal" 0 DISPLAY_IDENTIFIER LoaMgr.PerInstanceMemories.PrevMotAgMeclIdptSigVal /end MEASUREMENT
/begin MEASUREMENT LoaMgr.PrevVltgModSrc "MICROSAR RTE" UBYTE NO_COMPU_METHOD 0 0 0 255 ECU_ADDRESS 0 SYMBOL_LINK "Rte_LoaMgr_PrevVltgModSrc" 0 DISPLAY_IDENTIFIER LoaMgr.PerInstanceMemories.PrevVltgModSrc /end MEASUREMENT
/begin GROUP HwTqArbn.HwTqArbnTqAStallCntrPrev "MICROSAR RTE" /begin SUB_GROUP /end SUB_GROUP /begin FUNCTION_LIST /end FUNCTION_LIST /begin REF_CHARACTERISTIC /end REF_CHARACTERISTIC /begin REF_MEASUREMENT HwTqArbn.HwTqArbnTqAStallCntrPrev /end REF_MEASUREMENT /end GROUP
/begin GROUP HwTqArbn.HwTqArbnTqBRollgCntrPrev "MICROSAR RTE" /begin SUB_GROUP /end SUB_GROUP /begin FUNCTION_LIST /end FUNCTION_LIST /begin REF_CHARACTERISTIC /end REF_CHARACTERISTIC /begin REF_MEASUREMENT HwTqArbn.HwTqArbnTqBRollgCntrPrev /end REF_MEASUREMENT /end GROUP
/begin GROUP HwTqArbn.HwTqArbnTqBStallCntrPrev "MICROSAR RTE" /begin SUB_GROUP /end SUB_GROUP /begin FUNCTION_LIST /end FUNCTION_LIST /begin REF_CHARACTERISTIC /end REF_CHARACTERISTIC /begin REF_MEASUREMENT HwTqArbn.HwTqArbnTqBStallCntrPrev /end REF_MEASUREMENT /end GROUP
/begin GROUP HwTqArbn.HwTqArbnTqCRollgCntrPrev "MICROSAR RTE" /begin SUB_GROUP /end SUB_GROUP /begin FUNCTION_LIST /end FUNCTION_LIST /begin REF_CHARACTERISTIC /end REF_CHARACTERISTIC /begin REF_MEASUREMENT HwTqArbn.HwTqArbnTqCRollgCntrPrev /end REF_MEASUREMENT /end GROUP
/begin GROUP HwTqArbn.HwTqArbnTqCStallCntrPrev "MICROSAR RTE" /begin SUB_GROUP /end SUB_GROUP /begin FUNCTION_LIST /end FUNCTION_LIST /begin REF_CHARACTERISTIC /end REF_CHARACTERISTIC /begin REF_MEASUREMENT HwTqArbn.HwTqArbnTqCStallCntrPrev /end REF_MEASUREMENT /end GROUP
/begin GROUP HwTqArbn.HwTqArbnTqDRollgCntrPrev "MICROSAR RTE" /begin SUB_GROUP /end SUB_GROUP /begin FUNCTION_LIST /end FUNCTION_LIST /begin REF_CHARACTERISTIC /end REF_CHARACTERISTIC /begin REF_MEASUREMENT HwTqArbn.HwTqArbnTqDRollgCntrPrev /end REF_MEASUREMENT /end GROUP
/begin GROUP HwTqArbn.HwTqArbnTqDStallCntrPrev "MICROSAR RTE" /begin SUB_GROUP /end SUB_GROUP /begin FUNCTION_LIST /end FUNCTION_LIST /begin REF_CHARACTERISTIC /end REF_CHARACTERISTIC /begin REF_MEASUREMENT HwTqArbn.HwTqArbnTqDStallCntrPrev /end REF_MEASUREMENT /end GROUP
/begin GROUP HwTqArbn.HwTqB.Val "MICROSAR RTE" /begin SUB_GROUP /end SUB_GROUP /begin FUNCTION_LIST /end FUNCTION_LIST /begin REF_CHARACTERISTIC /end REF_CHARACTERISTIC /begin REF_MEASUREMENT HwTqArbn.HwTqB.Val /end REF_MEASUREMENT /end GROUP
/begin GROUP HwTqArbn.HwTqBQlfr.Val "MICROSAR RTE" /begin SUB_GROUP /end SUB_GROUP /begin FUNCTION_LIST /end FUNCTION_LIST /begin REF_CHARACTERISTIC /end REF_CHARACTERISTIC /begin REF_MEASUREMENT HwTqArbn.HwTqBQlfr.Val /end REF_MEASUREMENT /end GROUP
/begin GROUP HwTqArbn.HwTqBRollgCntr.Val "MICROSAR RTE" /begin SUB_GROUP /end SUB_GROUP /begin FUNCTION_LIST /end FUNCTION_LIST /begin REF_CHARACTERISTIC /end REF_CHARACTERISTIC /begin REF_MEASUREMENT HwTqArbn.HwTqBRollgCntr.Val /end REF_MEASUREMENT /end GROUP
/begin GROUP HwTqArbn.HwTqC.Val "MICROSAR RTE" /begin SUB_GROUP /end SUB_GROUP /begin FUNCTION_LIST /end FUNCTION_LIST /begin REF_CHARACTERISTIC /end REF_CHARACTERISTIC /begin REF_MEASUREMENT HwTqArbn.HwTqC.Val /end REF_MEASUREMENT /end GROUP
/begin GROUP HwTqArbn.HwTqCQlfr.Val "MICROSAR RTE" /begin SUB_GROUP /end SUB_GROUP /begin FUNCTION_LIST /end FUNCTION_LIST /begin REF_CHARACTERISTIC /end REF_CHARACTERISTIC /begin REF_MEASUREMENT HwTqArbn.HwTqCQlfr.Val /end REF_MEASUREMENT /end GROUP
/begin GROUP HwTqArbn.HwTqCRollgCntr.Val "MICROSAR RTE" /begin SUB_GROUP /end SUB_GROUP /begin FUNCTION_LIST /end FUNCTION_LIST /begin REF_CHARACTERISTIC /end REF_CHARACTERISTIC /begin REF_MEASUREMENT HwTqArbn.HwTqCRollgCntr.Val /end REF_MEASUREMENT /end GROUP
/begin GROUP HwTqArbn.HwTqChA.Val "MICROSAR RTE" /begin SUB_GROUP /end SUB_GROUP /begin FUNCTION_LIST /end FUNCTION_LIST /begin REF_CHARACTERISTIC /end REF_CHARACTERISTIC /begin REF_MEASUREMENT HwTqArbn.HwTqChA.Val /end REF_MEASUREMENT /end GROUP
/begin GROUP HwTqArbn.HwTqChB.Val "MICROSAR RTE" /begin SUB_GROUP /end SUB_GROUP /begin FUNCTION_LIST /end FUNCTION_LIST /begin REF_CHARACTERISTIC /end REF_CHARACTERISTIC /begin REF_MEASUREMENT HwTqArbn.HwTqChB.Val /end REF_MEASUREMENT /end GROUP
/begin GROUP HwTqArbn.HwTqCorrlnSts.Val "MICROSAR RTE" /begin SUB_GROUP /end SUB_GROUP /begin FUNCTION_LIST /end FUNCTION_LIST /begin REF_CHARACTERISTIC /end REF_CHARACTERISTIC /begin REF_MEASUREMENT HwTqArbn.HwTqCorrlnSts.Val /end REF_MEASUREMENT /end GROUP
/begin GROUP HwTqArbn.HwTqD.Val "MICROSAR RTE" /begin SUB_GROUP /end SUB_GROUP /begin FUNCTION_LIST /end FUNCTION_LIST /begin REF_CHARACTERISTIC /end REF_CHARACTERISTIC /begin REF_MEASUREMENT HwTqArbn.HwTqD.Val /end REF_MEASUREMENT /end GROUP
/begin GROUP HwTqArbn.HwTqDQlfr.Val "MICROSAR RTE" /begin SUB_GROUP /end SUB_GROUP /begin FUNCTION_LIST /end FUNCTION_LIST /begin REF_CHARACTERISTIC /end REF_CHARACTERISTIC /begin REF_MEASUREMENT HwTqArbn.HwTqDQlfr.Val /end REF_MEASUREMENT /end GROUP
/begin GROUP HwTqArbn.HwTqDRollgCntr.Val "MICROSAR RTE" /begin SUB_GROUP /end SUB_GROUP /begin FUNCTION_LIST /end FUNCTION_LIST /begin REF_CHARACTERISTIC /end REF_CHARACTERISTIC /begin REF_MEASUREMENT HwTqArbn.HwTqDRollgCntr.Val /end REF_MEASUREMENT /end GROUP
/begin GROUP HwTqArbn.PerInstanceMemories "MICROSAR RTE"
 /begin SUB_GROUP HwTqArbn.HwTqArbnTqARollgCntrPrev HwTqArbn.HwTqArbnTqAStallCntrPrev HwTqArbn.HwTqArbnTqBRollgCntrPrev HwTqArbn.HwTqArbnTqBStallCntrPrev HwTqArbn.HwTqArbnTqCRollgCntrPrev HwTqArbn.HwTqArbnTqCStallCntrPrev HwTqArbn.HwTqArbnTqDRollgCntrPrev HwTqArbn.HwTqArbnTqDStallCntrPrev HwTqArbn.dHwTqArbnChAAvl HwTqArbn.dHwTqArbnChBAvl /end SUB_GROUP
 /begin FUNCTION_LIST /end FUNCTION_LIST
 /begin REF_CHARACTERISTIC /end REF_CHARACTERISTIC
 /begin REF_MEASUREMENT /end REF_MEASUREMENT
/end GROUP
/begin GROUP HwTqArbn.ReceiverPorts "MICROSAR RTE"
 /begin SUB_GROUP HwTqArbn.HwTqA.Val HwTqArbn.HwTqAQlfr.Val HwTqArbn.HwTqARollgCntr.Val HwTqArbn.HwTqB.Val HwTqArbn.HwTqBQlfr.Val HwTqArbn.HwTqBRollgCntr.Val HwTqArbn.HwTqC.Val HwTqArbn.HwTqCQlfr.Val HwTqArbn.HwTqCRollgCntr.Val HwTqArbn.HwTqCorrlnSts.Val HwTqArbn.HwTqD.Val HwTqArbn.HwTqDQlfr.Val HwTqArbn.HwTqDRollgCntr.Val /end SUB_GROUP
 /begin FUNCTION_LIST /end FUNCTION_LIST
 /begin REF_CHARACTERISTIC /end REF_CHARACTERISTIC
 /begin REF_MEASUREMENT /end REF_MEASUREMENT
/end GROUP
/begin GROUP HwTqArbn.SenderPorts "MICROSAR RTE"
 /begin SUB_GROUP HwTqArbn.HwTq.Val HwTqArbn.HwTqChA.Val HwTqArbn.HwTqChB.Val /end SUB_GROUP
 /begin FUNCTION_LIST /end FUNCTION_LIST
 /begin REF_CHARACTERISTIC /end REF_CHARACTERISTIC
 /begin REF_MEASUREMENT /end REF_MEASUREMENT
/end GROUP
/begin GROUP HwTqArbn.dHwTqArbnChAAvl "MICROSAR RTE" /begin SUB_GROUP /end SUB_GROUP /begin FUNCTION_LIST /end FUNCTION_LIST /begin REF_CHARACTERISTIC /end REF_CHARACTERISTIC /begin REF_MEASUREMENT HwTqArbn.dHwTqArbnChAAvl /end REF_MEASUREMENT /end GROUP
/begin GROUP HwTqArbn.dHwTqArbnChBAvl "MICROSAR RTE" /begin SUB_GROUP /end SUB_GROUP /begin FUNCTION_LIST /end FUNCTION_LIST /begin REF_CHARACTERISTIC /end REF_CHARACTERISTIC /begin REF_MEASUREMENT HwTqArbn.dHwTqArbnChBAvl /end REF_MEASUREMENT /end GROUP
/begin GROUP HwTqCorrln "MICROSAR RTE"
 /begin SUB_GROUP HwTqCorrln.CalibrationParameters HwTqCorrln.CalibrationPorts HwTqCorrln.PerInstanceMemories HwTqCorrln.ReceiverPorts HwTqCorrln.SenderPorts /end SUB_GROUP
 /begin FUNCTION_LIST /end FUNCTION_LIST
 /begin REF_CHARACTERISTIC /end REF_CHARACTERISTIC
 /begin REF_MEASUREMENT /end REF_MEASUREMENT
/end GROUP
/begin GROUP HwTqCorrln.CalibrationParameters "MICROSAR RTE"
 /begin SUB_GROUP HwTqCorrln.HwTqChACmnModCmpLpFilStDft HwTqCorrln.HwTqChBCmnModCmpLpFilStDft /end SUB_GROUP
 /begin FUNCTION_LIST /end FUNCTION_LIST
 /begin REF_CHARACTERISTIC /end REF_CHARACTERISTIC
 /begin REF_MEASUREMENT /end REF_MEASUREMENT
/end GROUP
/begin GROUP HwTqCorrln.CalibrationPorts "MICROSAR RTE"
 /begin SUB_GROUP HwTqCorrln.HwTqCorrlnChACmnModCmpLpFilActvnThd.Val HwTqCorrln.HwTqCorrlnChACmnModCmpLpFilFrq.Val HwTqCorrln.HwTqCorrlnChACmnModCmpLpFilOutpLim.Val HwTqCorrln.HwTqCorrlnChAImdtCorrlnChkFailThd.Val HwTqCorrln.HwTqCorrlnChAImdtCorrlnChkPassThd.Val HwTqCorrln.HwTqCorrlnChAStabStClrFltThd.Val HwTqCorrln.HwTqCorrlnChAStabStLpFilFrq.Val HwTqCorrln.HwTqCorrlnChAStabStSetFltThd.Val HwTqCorrln.HwTqCorrlnChATqSumMaxLim.Val HwTqCorrln.HwTqCorrlnChATraLpFilX.Ary1D HwTqCorrln.HwTqCorrlnChATraLpFilY.Ary1D HwTqCorrln.HwTqCorrlnChATraSumClrFltThd.Val HwTqCorrln.HwTqCorrlnChATraSumSetFltThd.Val HwTqCorrln.HwTqCorrlnChBCmnModCmpLpFilActvnThd.Val HwTqCorrln.HwTqCorrlnChBCmnModCmpLpFilFrq.Val HwTqCorrln.HwTqCorrlnChBCmnModCmpLpFilOutpLim.Val HwTqCorrln.HwTqCorrlnChBImdtCorrlnChkFailThd.Val HwTqCorrln.HwTqCorrlnChBImdtCorrlnChkPassThd.Val HwTqCorrln.HwTqCorrlnChBStabStClrFltThd.Val HwTqCorrln.HwTqCorrlnChBStabStLpFilFrq.Val HwTqCorrln.HwTqCorrlnChBStabStSetFltThd.Val HwTqCorrln.HwTqCorrlnChBTqSumMaxLim.Val HwTqCorrln.HwTqCorrlnChBTraLpFilX.Ary1D HwTqCorrln.HwTqCorrlnChBTraLpFilY.Ary1D HwTqCorrln.HwTqCorrlnChBTraSumClrFltThd.Val HwTqCorrln.HwTqCorrlnChBTraSumSetFltThd.Val HwTqCorrln.HwTqCorrlnMaxStallTqA.Val HwTqCorrln.HwTqCorrlnMaxStallTqB.Val HwTqCorrln.HwTqCorrlnMaxStallTqC.Val HwTqCorrln.HwTqCorrlnMaxStallTqD.Val /end SUB_GROUP
 /begin FUNCTION_LIST /end FUNCTION_LIST
 /begin REF_CHARACTERISTIC /end REF_CHARACTERISTIC
 /begin REF_MEASUREMENT /end REF_MEASUREMENT
/end GROUP
/begin GROUP HwTqCorrln.HwTqA.Val "MICROSAR RTE" /begin SUB_GROUP /end SUB_GROUP /begin FUNCTION_LIST /end FUNCTION_LIST /begin REF_CHARACTERISTIC /end REF_CHARACTERISTIC /begin REF_MEASUREMENT HwTqCorrln.HwTqA.Val /end REF_MEASUREMENT /end GROUP
/begin GROUP HwTqCorrln.HwTqAQlfr.Val "MICROSAR RTE" /begin SUB_GROUP /end SUB_GROUP /begin FUNCTION_LIST /end FUNCTION_LIST /begin REF_CHARACTERISTIC /end REF_CHARACTERISTIC /begin REF_MEASUREMENT HwTqCorrln.HwTqAQlfr.Val /end REF_MEASUREMENT /end GROUP
/begin GROUP HwTqCorrln.HwTqARollgCntr.Val "MICROSAR RTE" /begin SUB_GROUP /end SUB_GROUP /begin FUNCTION_LIST /end FUNCTION_LIST /begin REF_CHARACTERISTIC /end REF_CHARACTERISTIC /begin REF_MEASUREMENT HwTqCorrln.HwTqARollgCntr.Val /end REF_MEASUREMENT /end GROUP
/begin GROUP HwTqCorrln.HwTqARollgCntrPrev "MICROSAR RTE" /begin SUB_GROUP /end SUB_GROUP /begin FUNCTION_LIST /end FUNCTION_LIST /begin REF_CHARACTERISTIC /end REF_CHARACTERISTIC /begin REF_MEASUREMENT HwTqCorrln.HwTqARollgCntrPrev /end REF_MEASUREMENT /end GROUP
/begin GROUP HwTqCorrln.HwTqAStallCntrPrev "MICROSAR RTE" /begin SUB_GROUP /end SUB_GROUP /begin FUNCTION_LIST /end FUNCTION_LIST /begin REF_CHARACTERISTIC /end REF_CHARACTERISTIC /begin REF_MEASUREMENT HwTqCorrln.HwTqAStallCntrPrev /end REF_MEASUREMENT /end GROUP
/begin GROUP HwTqCorrln.HwTqB.Val "MICROSAR RTE" /begin SUB_GROUP /end SUB_GROUP /begin FUNCTION_LIST /end FUNCTION_LIST /begin REF_CHARACTERISTIC /end REF_CHARACTERISTIC /begin REF_MEASUREMENT HwTqCorrln.HwTqB.Val /end REF_MEASUREMENT /end GROUP
/begin GROUP HwTqCorrln.HwTqBQlfr.Val "MICROSAR RTE" /begin SUB_GROUP /end SUB_GROUP /begin FUNCTION_LIST /end FUNCTION_LIST /begin REF_CHARACTERISTIC /end REF_CHARACTERISTIC /begin REF_MEASUREMENT HwTqCorrln.HwTqBQlfr.Val /end REF_MEASUREMENT /end GROUP
/begin GROUP HwTqCorrln.HwTqBRollgCntr.Val "MICROSAR RTE" /begin SUB_GROUP /end SUB_GROUP /begin FUNCTION_LIST /end FUNCTION_LIST /begin REF_CHARACTERISTIC /end REF_CHARACTERISTIC /begin REF_MEASUREMENT HwTqCorrln.HwTqBRollgCntr.Val /end REF_MEASUREMENT /end GROUP
/begin GROUP HwTqCorrln.HwTqBRollgCntrPrev "MICROSAR RTE" /begin SUB_GROUP /end SUB_GROUP /begin FUNCTION_LIST /end FUNCTION_LIST /begin REF_CHARACTERISTIC /end REF_CHARACTERISTIC /begin REF_MEASUREMENT HwTqCorrln.HwTqBRollgCntrPrev /end REF_MEASUREMENT /end GROUP
/begin GROUP HwTqCorrln.HwTqBStallCntrPrev "MICROSAR RTE" /begin SUB_GROUP /end SUB_GROUP /begin FUNCTION_LIST /end FUNCTION_LIST /begin REF_CHARACTERISTIC /end REF_CHARACTERISTIC /begin REF_MEASUREMENT HwTqCorrln.HwTqBStallCntrPrev /end REF_MEASUREMENT /end GROUP
/begin GROUP HwTqCorrln.HwTqC.Val "MICROSAR RTE" /begin SUB_GROUP /end SUB_GROUP /begin FUNCTION_LIST /end FUNCTION_LIST /begin REF_CHARACTERISTIC /end REF_CHARACTERISTIC /begin REF_MEASUREMENT HwTqCorrln.HwTqC.Val /end REF_MEASUREMENT /end GROUP
/begin GROUP HwTqCorrln.HwTqCQlfr.Val "MICROSAR RTE" /begin SUB_GROUP /end SUB_GROUP /begin FUNCTION_LIST /end FUNCTION_LIST /begin REF_CHARACTERISTIC /end REF_CHARACTERISTIC /begin REF_MEASUREMENT HwTqCorrln.HwTqCQlfr.Val /end REF_MEASUREMENT /end GROUP
/begin GROUP HwTqCorrln.HwTqCRollgCntr.Val "MICROSAR RTE" /begin SUB_GROUP /end SUB_GROUP /begin FUNCTION_LIST /end FUNCTION_LIST /begin REF_CHARACTERISTIC /end REF_CHARACTERISTIC /begin REF_MEASUREMENT HwTqCorrln.HwTqCRollgCntr.Val /end REF_MEASUREMENT /end GROUP
/begin GROUP HwTqCorrln.HwTqCRollgCntrPrev "MICROSAR RTE" /begin SUB_GROUP /end SUB_GROUP /begin FUNCTION_LIST /end FUNCTION_LIST /begin REF_CHARACTERISTIC /end REF_CHARACTERISTIC /begin REF_MEASUREMENT HwTqCorrln.HwTqCRollgCntrPrev /end REF_MEASUREMENT /end GROUP
/begin GROUP HwTqCorrln.HwTqCStallCntrPrev "MICROSAR RTE" /begin SUB_GROUP /end SUB_GROUP /begin FUNCTION_LIST /end FUNCTION_LIST /begin REF_CHARACTERISTIC /end REF_CHARACTERISTIC /begin REF_MEASUREMENT HwTqCorrln.HwTqCStallCntrPrev /end REF_MEASUREMENT /end GROUP
/begin GROUP HwTqCorrln.HwTqChA.Val "MICROSAR RTE" /begin SUB_GROUP /end SUB_GROUP /begin FUNCTION_LIST /end FUNCTION_LIST /begin REF_CHARACTERISTIC /end REF_CHARACTERISTIC /begin REF_MEASUREMENT HwTqCorrln.HwTqChA.Val /end REF_MEASUREMENT /end GROUP
/begin GROUP HwTqCorrln.HwTqChACmnModCmpLpFil "MICROSAR RTE" /begin SUB_GROUP /end SUB_GROUP /begin FUNCTION_LIST /end FUNCTION_LIST /begin REF_CHARACTERISTIC /end REF_CHARACTERISTIC
 /begin REF_MEASUREMENT HwTqCorrln.HwTqChACmnModCmpLpFil.FilGain HwTqCorrln.HwTqChACmnModCmpLpFil.FilSt /end REF_MEASUREMENT
/end GROUP
/begin GROUP HwTqCorrln.HwTqChACmnModCmpLpFilSt "MICROSAR RTE" /begin SUB_GROUP /end SUB_GROUP /begin FUNCTION_LIST /end FUNCTION_LIST /begin REF_CHARACTERISTIC /end REF_CHARACTERISTIC /begin REF_MEASUREMENT HwTqCorrln.HwTqChACmnModCmpLpFilSt /end REF_MEASUREMENT /end GROUP
/begin GROUP HwTqCorrln.HwTqChACmnModCmpLpFilStDft "MICROSAR RTE" /begin SUB_GROUP /end SUB_GROUP /begin FUNCTION_LIST /end FUNCTION_LIST /begin REF_CHARACTERISTIC HwTqCorrln.HwTqChACmnModCmpLpFilStDft /end REF_CHARACTERISTIC /begin REF_MEASUREMENT /end REF_MEASUREMENT /end GROUP
/begin GROUP HwTqCorrln.HwTqChACorrlnTraErr.Val "MICROSAR RTE" /begin SUB_GROUP /end SUB_GROUP /begin FUNCTION_LIST /end FUNCTION_LIST /begin REF_CHARACTERISTIC /end REF_CHARACTERISTIC /begin REF_MEASUREMENT HwTqCorrln.HwTqChACorrlnTraErr.Val /end REF_MEASUREMENT /end GROUP
/begin GROUP HwTqCorrln.HwTqChAImdtCorrlnChk "MICROSAR RTE" /begin SUB_GROUP /end SUB_GROUP /begin FUNCTION_LIST /end FUNCTION_LIST /begin REF_CHARACTERISTIC /end REF_CHARACTERISTIC /begin REF_MEASUREMENT HwTqCorrln.HwTqChAImdtCorrlnChk /end REF_MEASUREMENT /end GROUP
/begin GROUP HwTqCorrln.HwTqChAStabStLpFil "MICROSAR RTE" /begin SUB_GROUP /end SUB_GROUP /begin FUNCTION_LIST /end FUNCTION_LIST /begin REF_CHARACTERISTIC /end REF_CHARACTERISTIC
 /begin REF_MEASUREMENT HwTqCorrln.HwTqChAStabStLpFil.FilGain HwTqCorrln.HwTqChAStabStLpFil.FilSt /end REF_MEASUREMENT
/end GROUP
/begin GROUP HwTqCorrln.HwTqChATraLpFil "MICROSAR RTE" /begin SUB_GROUP /end SUB_GROUP /begin FUNCTION_LIST /end FUNCTION_LIST /begin REF_CHARACTERISTIC /end REF_CHARACTERISTIC
 /begin REF_MEASUREMENT HwTqCorrln.HwTqChATraLpFil.FilGain HwTqCorrln.HwTqChATraLpFil.FilSt /end REF_MEASUREMENT
/end GROUP
/begin GROUP HwTqCorrln.HwTqChB.Val "MICROSAR RTE" /begin SUB_GROUP /end SUB_GROUP /begin FUNCTION_LIST /end FUNCTION_LIST /begin REF_CHARACTERISTIC /end REF_CHARACTERISTIC /begin REF_MEASUREMENT HwTqCorrln.HwTqChB.Val /end REF_MEASUREMENT /end GROUP
/begin GROUP HwTqCorrln.HwTqChBCmnModCmpLpFil "MICROSAR RTE" /begin SUB_GROUP /end SUB_GROUP /begin FUNCTION_LIST /end FUNCTION_LIST /begin REF_CHARACTERISTIC /end REF_CHARACTERISTIC
 /begin REF_MEASUREMENT HwTqCorrln.HwTqChBCmnModCmpLpFil.FilGain HwTqCorrln.HwTqChBCmnModCmpLpFil.FilSt /end REF_MEASUREMENT
/end GROUP
/begin GROUP HwTqCorrln.HwTqChBCmnModCmpLpFilSt "MICROSAR RTE" /begin SUB_GROUP /end SUB_GROUP /begin FUNCTION_LIST /end FUNCTION_LIST /begin REF_CHARACTERISTIC /end REF_CHARACTERISTIC /begin REF_MEASUREMENT HwTqCorrln.HwTqChBCmnModCmpLpFilSt /end REF_MEASUREMENT /end GROUP
/begin GROUP HwTqCorrln.HwTqChBCmnModCmpLpFilStDft "MICROSAR RTE" /begin SUB_GROUP /end SUB_GROUP /begin FUNCTION_LIST /end FUNCTION_LIST /begin REF_CHARACTERISTIC HwTqCorrln.HwTqChBCmnModCmpLpFilStDft /end REF_CHARACTERISTIC /begin REF_MEASUREMENT /end REF_MEASUREMENT /end GROUP
/begin GROUP HwTqCorrln.HwTqChBCorrlnTraErr.Val "MICROSAR RTE" /begin SUB_GROUP /end SUB_GROUP /begin FUNCTION_LIST /end FUNCTION_LIST /begin REF_CHARACTERISTIC /end REF_CHARACTERISTIC /begin REF_MEASUREMENT HwTqCorrln.HwTqChBCorrlnTraErr.Val /end REF_MEASUREMENT /end GROUP
/begin GROUP HwTqCorrln.HwTqChBImdtCorrlnChk "MICROSAR RTE" /begin SUB_GROUP /end SUB_GROUP /begin FUNCTION_LIST /end FUNCTION_LIST /begin REF_CHARACTERISTIC /end REF_CHARACTERISTIC /begin REF_MEASUREMENT HwTqCorrln.HwTqChBImdtCorrlnChk /end REF_MEASUREMENT /end GROUP
/begin GROUP HwTqCorrln.HwTqChBStabStLpFil "MICROSAR RTE" /begin SUB_GROUP /end SUB_GROUP /begin FUNCTION_LIST /end FUNCTION_LIST /begin REF_CHARACTERISTIC /end REF_CHARACTERISTIC
 /begin REF_MEASUREMENT HwTqCorrln.HwTqChBStabStLpFil.FilGain HwTqCorrln.HwTqChBStabStLpFil.FilSt /end REF_MEASUREMENT
/end GROUP
/begin GROUP HwTqCorrln.HwTqChBTraLpFil "MICROSAR RTE" /begin SUB_GROUP /end SUB_GROUP /begin FUNCTION_LIST /end FUNCTION_LIST /begin REF_CHARACTERISTIC /end REF_CHARACTERISTIC
 /begin REF_MEASUREMENT HwTqCorrln.HwTqChBTraLpFil.FilGain HwTqCorrln.HwTqChBTraLpFil.FilSt /end REF_MEASUREMENT
/end GROUP
/begin GROUP HwTqCorrln.HwTqCorrlnChACmnModCmpLpFilActvnThd.Val "MICROSAR RTE" /begin SUB_GROUP /end SUB_GROUP /begin FUNCTION_LIST /end FUNCTION_LIST /begin REF_CHARACTERISTIC HwTqCorrln.HwTqCorrlnChACmnModCmpLpFilActvnThd.Val /end REF_CHARACTERISTIC /begin REF_MEASUREMENT /end REF_MEASUREMENT /end GROUP
/begin GROUP HwTqCorrln.HwTqCorrlnChACmnModCmpLpFilFrq.Val "MICROSAR RTE" /begin SUB_GROUP /end SUB_GROUP /begin FUNCTION_LIST /end FUNCTION_LIST /begin REF_CHARACTERISTIC HwTqCorrln.HwTqCorrlnChACmnModCmpLpFilFrq.Val /end REF_CHARACTERISTIC /begin REF_MEASUREMENT /end REF_MEASUREMENT /end GROUP
/begin GROUP HwTqCorrln.HwTqCorrlnChACmnModCmpLpFilOutpLim.Val "MICROSAR RTE" /begin SUB_GROUP /end SUB_GROUP /begin FUNCTION_LIST /end FUNCTION_LIST /begin REF_CHARACTERISTIC HwTqCorrln.HwTqCorrlnChACmnModCmpLpFilOutpLim.Val /end REF_CHARACTERISTIC /begin REF_MEASUREMENT /end REF_MEASUREMENT /end GROUP
/begin GROUP HwTqCorrln.HwTqCorrlnChAImdtCorrlnChkFailThd.Val "MICROSAR RTE" /begin SUB_GROUP /end SUB_GROUP /begin FUNCTION_LIST /end FUNCTION_LIST /begin REF_CHARACTERISTIC HwTqCorrln.HwTqCorrlnChAImdtCorrlnChkFailThd.Val /end REF_CHARACTERISTIC /begin REF_MEASUREMENT /end REF_MEASUREMENT /end GROUP
/begin GROUP HwTqCorrln.HwTqCorrlnChAImdtCorrlnChkPassThd.Val "MICROSAR RTE" /begin SUB_GROUP /end SUB_GROUP /begin FUNCTION_LIST /end FUNCTION_LIST /begin REF_CHARACTERISTIC HwTqCorrln.HwTqCorrlnChAImdtCorrlnChkPassThd.Val /end REF_CHARACTERISTIC /begin REF_MEASUREMENT /end REF_MEASUREMENT /end GROUP
/begin GROUP HwTqCorrln.HwTqCorrlnChAStabStClrFltThd.Val "MICROSAR RTE" /begin SUB_GROUP /end SUB_GROUP /begin FUNCTION_LIST /end FUNCTION_LIST /begin REF_CHARACTERISTIC HwTqCorrln.HwTqCorrlnChAStabStClrFltThd.Val /end REF_CHARACTERISTIC /begin REF_MEASUREMENT /end REF_MEASUREMENT /end GROUP
/begin GROUP HwTqCorrln.HwTqCorrlnChAStabStLpFilFrq.Val "MICROSAR RTE" /begin SUB_GROUP /end SUB_GROUP /begin FUNCTION_LIST /end FUNCTION_LIST /begin REF_CHARACTERISTIC HwTqCorrln.HwTqCorrlnChAStabStLpFilFrq.Val /end REF_CHARACTERISTIC /begin REF_MEASUREMENT /end REF_MEASUREMENT /end GROUP
/begin GROUP HwTqCorrln.HwTqCorrlnChAStabStSetFltThd.Val "MICROSAR RTE" /begin SUB_GROUP /end SUB_GROUP /begin FUNCTION_LIST /end FUNCTION_LIST /begin REF_CHARACTERISTIC HwTqCorrln.HwTqCorrlnChAStabStSetFltThd.Val /end REF_CHARACTERISTIC /begin REF_MEASUREMENT /end REF_MEASUREMENT /end GROUP
/begin GROUP HwTqCorrln.HwTqCorrlnChATqSumMaxLim.Val "MICROSAR RTE" /begin SUB_GROUP /end SUB_GROUP /begin FUNCTION_LIST /end FUNCTION_LIST /begin REF_CHARACTERISTIC HwTqCorrln.HwTqCorrlnChATqSumMaxLim.Val /end REF_CHARACTERISTIC /begin REF_MEASUREMENT /end REF_MEASUREMENT /end GROUP
/begin GROUP HwTqCorrln.HwTqCorrlnChATraLpFilX.Ary1D "MICROSAR RTE" /begin SUB_GROUP /end SUB_GROUP /begin FUNCTION_LIST /end FUNCTION_LIST /begin REF_CHARACTERISTIC HwTqCorrln.HwTqCorrlnChATraLpFilX.Ary1D /end REF_CHARACTERISTIC /begin REF_MEASUREMENT /end REF_MEASUREMENT /end GROUP
/begin GROUP HwTqCorrln.HwTqCorrlnChATraLpFilY.Ary1D "MICROSAR RTE" /begin SUB_GROUP /end SUB_GROUP /begin FUNCTION_LIST /end FUNCTION_LIST /begin REF_CHARACTERISTIC HwTqCorrln.HwTqCorrlnChATraLpFilY.Ary1D /end REF_CHARACTERISTIC /begin REF_MEASUREMENT /end REF_MEASUREMENT /end GROUP
/begin GROUP HwTqCorrln.HwTqCorrlnChATraSumClrFltThd.Val "MICROSAR RTE" /begin SUB_GROUP /end SUB_GROUP /begin FUNCTION_LIST /end FUNCTION_LIST /begin REF_CHARACTERISTIC HwTqCorrln.HwTqCorrlnChATraSumClrFltThd.Val /end REF_CHARACTERISTIC /begin REF_MEASUREMENT /end REF_MEASUREMENT /end GROUP
/begin GROUP HwTqCorrln.HwTqCorrlnChATraSumSetFltThd.Val "MICROSAR RTE" /begin SUB_GROUP /end SUB_GROUP /begin FUNCTION_LIST /end FUNCTION_LIST /begin REF_CHARACTERISTIC HwTqCorrln.HwTqCorrlnChATraSumSetFltThd.Val /end REF_CHARACTERISTIC /begin REF_MEASUREMENT /end REF_MEASUREMENT /end GROUP
/begin GROUP HwTqCorrln.HwTqCorrlnChBCmnModCmpLpFilActvnThd.Val "MICROSAR RTE" /begin SUB_GROUP /end SUB_GROUP /begin FUNCTION_LIST /end FUNCTION_LIST /begin REF_CHARACTERISTIC HwTqCorrln.HwTqCorrlnChBCmnModCmpLpFilActvnThd.Val /end REF_CHARACTERISTIC /begin REF_MEASUREMENT /end REF_MEASUREMENT /end GROUP
/begin GROUP HwTqCorrln.HwTqCorrlnChBCmnModCmpLpFilFrq.Val "MICROSAR RTE" /begin SUB_GROUP /end SUB_GROUP /begin FUNCTION_LIST /end FUNCTION_LIST /begin REF_CHARACTERISTIC HwTqCorrln.HwTqCorrlnChBCmnModCmpLpFilFrq.Val /end REF_CHARACTERISTIC /begin REF_MEASUREMENT /end REF_MEASUREMENT /end GROUP
/begin GROUP HwTqCorrln.HwTqCorrlnChBCmnModCmpLpFilOutpLim.Val "MICROSAR RTE" /begin SUB_GROUP /end SUB_GROUP /begin FUNCTION_LIST /end FUNCTION_LIST /begin REF_CHARACTERISTIC HwTqCorrln.HwTqCorrlnChBCmnModCmpLpFilOutpLim.Val /end REF_CHARACTERISTIC /begin REF_MEASUREMENT /end REF_MEASUREMENT /end GROUP
/begin GROUP HwTqCorrln.HwTqCorrlnChBImdtCorrlnChkFailThd.Val "MICROSAR RTE" /begin SUB_GROUP /end SUB_GROUP /begin FUNCTION_LIST /end FUNCTION_LIST /begin REF_CHARACTERISTIC HwTqCorrln.HwTqCorrlnChBImdtCorrlnChkFailThd.Val /end REF_CHARACTERISTIC /begin REF_MEASUREMENT /end REF_MEASUREMENT /end GROUP
/begin GROUP HwTqCorrln.HwTqCorrlnChBImdtCorrlnChkPassThd.Val "MICROSAR RTE" /begin SUB_GROUP /end SUB_GROUP /begin FUNCTION_LIST /end FUNCTION_LIST /begin REF_CHARACTERISTIC HwTqCorrln.HwTqCorrlnChBImdtCorrlnChkPassThd.Val /end REF_CHARACTERISTIC /begin REF_MEASUREMENT /end REF_MEASUREMENT /end GROUP
/begin GROUP HwTqCorrln.HwTqCorrlnChBStabStClrFltThd.Val "MICROSAR RTE" /begin SUB_GROUP /end SUB_GROUP /begin FUNCTION_LIST /end FUNCTION_LIST /begin REF_CHARACTERISTIC HwTqCorrln.HwTqCorrlnChBStabStClrFltThd.Val /end REF_CHARACTERISTIC /begin REF_MEASUREMENT /end REF_MEASUREMENT /end GROUP
/begin GROUP HwTqCorrln.HwTqCorrlnChBStabStLpFilFrq.Val "MICROSAR RTE" /begin SUB_GROUP /end SUB_GROUP /begin FUNCTION_LIST /end FUNCTION_LIST /begin REF_CHARACTERISTIC HwTqCorrln.HwTqCorrlnChBStabStLpFilFrq.Val /end REF_CHARACTERISTIC /begin REF_MEASUREMENT /end REF_MEASUREMENT /end GROUP
/begin GROUP HwTqCorrln.HwTqCorrlnChBStabStSetFltThd.Val "MICROSAR RTE" /begin SUB_GROUP /end SUB_GROUP /begin FUNCTION_LIST /end FUNCTION_LIST /begin REF_CHARACTERISTIC HwTqCorrln.HwTqCorrlnChBStabStSetFltThd.Val /end REF_CHARACTERISTIC /begin REF_MEASUREMENT /end REF_MEASUREMENT /end GROUP
/begin GROUP HwTqCorrln.HwTqCorrlnChBTqSumMaxLim.Val "MICROSAR RTE" /begin SUB_GROUP /end SUB_GROUP /begin FUNCTION_LIST /end FUNCTION_LIST /begin REF_CHARACTERISTIC HwTqCorrln.HwTqCorrlnChBTqSumMaxLim.Val /end REF_CHARACTERISTIC /begin REF_MEASUREMENT /end REF_MEASUREMENT /end GROUP
/begin GROUP HwTqCorrln.HwTqCorrlnChBTraLpFilX.Ary1D "MICROSAR RTE" /begin SUB_GROUP /end SUB_GROUP /begin FUNCTION_LIST /end FUNCTION_LIST /begin REF_CHARACTERISTIC HwTqCorrln.HwTqCorrlnChBTraLpFilX.Ary1D /end REF_CHARACTERISTIC /begin REF_MEASUREMENT /end REF_MEASUREMENT /end GROUP
/begin GROUP HwTqCorrln.HwTqCorrlnChBTraLpFilY.Ary1D "MICROSAR RTE" /begin SUB_GROUP /end SUB_GROUP /begin FUNCTION_LIST /end FUNCTION_LIST /begin REF_CHARACTERISTIC HwTqCorrln.HwTqCorrlnChBTraLpFilY.Ary1D /end REF_CHARACTERISTIC /begin REF_MEASUREMENT /end REF_MEASUREMENT /end GROUP
/begin GROUP HwTqCorrln.HwTqCorrlnChBTraSumClrFltThd.Val "MICROSAR RTE" /begin SUB_GROUP /end SUB_GROUP /begin FUNCTION_LIST /end FUNCTION_LIST /begin REF_CHARACTERISTIC HwTqCorrln.HwTqCorrlnChBTraSumClrFltThd.Val /end REF_CHARACTERISTIC /begin REF_MEASUREMENT /end REF_MEASUREMENT /end GROUP
/begin GROUP HwTqCorrln.HwTqCorrlnChBTraSumSetFltThd.Val "MICROSAR RTE" /begin SUB_GROUP /end SUB_GROUP /begin FUNCTION_LIST /end FUNCTION_LIST /begin REF_CHARACTERISTIC HwTqCorrln.HwTqCorrlnChBTraSumSetFltThd.Val /end REF_CHARACTERISTIC /begin REF_MEASUREMENT /end REF_MEASUREMENT /end GROUP
/begin GROUP HwTqCorrln.HwTqCorrlnMaxStallTqA.Val "MICROSAR RTE" /begin SUB_GROUP /end SUB_GROUP /begin FUNCTION_LIST /end FUNCTION_LIST /begin REF_CHARACTERISTIC HwTqCorrln.HwTqCorrlnMaxStallTqA.Val /end REF_CHARACTERISTIC /begin REF_MEASUREMENT /end REF_MEASUREMENT /end GROUP
/begin GROUP HwTqCorrln.HwTqCorrlnMaxStallTqB.Val "MICROSAR RTE" /begin SUB_GROUP /end SUB_GROUP /begin FUNCTION_LIST /end FUNCTION_LIST /begin REF_CHARACTERISTIC HwTqCorrln.HwTqCorrlnMaxStallTqB.Val /end REF_CHARACTERISTIC /begin REF_MEASUREMENT /end REF_MEASUREMENT /end GROUP
/begin GROUP HwTqCorrln.HwTqCorrlnMaxStallTqC.Val "MICROSAR RTE" /begin SUB_GROUP /end SUB_GROUP /begin FUNCTION_LIST /end FUNCTION_LIST /begin REF_CHARACTERISTIC HwTqCorrln.HwTqCorrlnMaxStallTqC.Val /end REF_CHARACTERISTIC /begin REF_MEASUREMENT /end REF_MEASUREMENT /end GROUP
/begin GROUP HwTqCorrln.HwTqCorrlnMaxStallTqD.Val "MICROSAR RTE" /begin SUB_GROUP /end SUB_GROUP /begin FUNCTION_LIST /end FUNCTION_LIST /begin REF_CHARACTERISTIC HwTqCorrln.HwTqCorrlnMaxStallTqD.Val /end REF_CHARACTERISTIC /begin REF_MEASUREMENT /end REF_MEASUREMENT /end GROUP
/begin GROUP HwTqCorrln.HwTqCorrlnSts.Val "MICROSAR RTE" /begin SUB_GROUP /end SUB_GROUP /begin FUNCTION_LIST /end FUNCTION_LIST /begin REF_CHARACTERISTIC /end REF_CHARACTERISTIC /begin REF_MEASUREMENT HwTqCorrln.HwTqCorrlnSts.Val /end REF_MEASUREMENT /end GROUP
/begin GROUP HwTqCorrln.HwTqD.Val "MICROSAR RTE" /begin SUB_GROUP /end SUB_GROUP /begin FUNCTION_LIST /end FUNCTION_LIST /begin REF_CHARACTERISTIC /end REF_CHARACTERISTIC /begin REF_MEASUREMENT HwTqCorrln.HwTqD.Val /end REF_MEASUREMENT /end GROUP
/begin GROUP HwTqCorrln.HwTqDQlfr.Val "MICROSAR RTE" /begin SUB_GROUP /end SUB_GROUP /begin FUNCTION_LIST /end FUNCTION_LIST /begin REF_CHARACTERISTIC /end REF_CHARACTERISTIC /begin REF_MEASUREMENT HwTqCorrln.HwTqDQlfr.Val /end REF_MEASUREMENT /end GROUP
/begin GROUP HwTqCorrln.HwTqDRollgCntr.Val "MICROSAR RTE" /begin SUB_GROUP /end SUB_GROUP /begin FUNCTION_LIST /end FUNCTION_LIST /begin REF_CHARACTERISTIC /end REF_CHARACTERISTIC /begin REF_MEASUREMENT HwTqCorrln.HwTqDRollgCntr.Val /end REF_MEASUREMENT /end GROUP
/begin GROUP HwTqCorrln.HwTqDRollgCntrPrev "MICROSAR RTE" /begin SUB_GROUP /end SUB_GROUP /begin FUNCTION_LIST /end FUNCTION_LIST /begin REF_CHARACTERISTIC /end REF_CHARACTERISTIC /begin REF_MEASUREMENT HwTqCorrln.HwTqDRollgCntrPrev /end REF_MEASUREMENT /end GROUP
/begin GROUP HwTqCorrln.HwTqDStallCntrPrev "MICROSAR RTE" /begin SUB_GROUP /end SUB_GROUP /begin FUNCTION_LIST /end FUNCTION_LIST /begin REF_CHARACTERISTIC /end REF_CHARACTERISTIC /begin REF_MEASUREMENT HwTqCorrln.HwTqDStallCntrPrev /end REF_MEASUREMENT /end GROUP
/begin GROUP HwTqCorrln.HwTqIdptSig.Val "MICROSAR RTE" /begin SUB_GROUP /end SUB_GROUP /begin FUNCTION_LIST /end FUNCTION_LIST /begin REF_CHARACTERISTIC /end REF_CHARACTERISTIC /begin REF_MEASUREMENT HwTqCorrln.HwTqIdptSig.Val /end REF_MEASUREMENT /end GROUP
/begin GROUP HwTqCorrln.PerInstanceMemories "MICROSAR RTE"
 /begin SUB_GROUP HwTqCorrln.HwTqARollgCntrPrev HwTqCorrln.HwTqAStallCntrPrev HwTqCorrln.HwTqBRollgCntrPrev HwTqCorrln.HwTqBStallCntrPrev HwTqCorrln.HwTqCRollgCntrPrev HwTqCorrln.HwTqCStallCntrPrev HwTqCorrln.HwTqChACmnModCmpLpFil HwTqCorrln.HwTqChACmnModCmpLpFilSt HwTqCorrln.HwTqChAImdtCorrlnChk HwTqCorrln.HwTqChAStabStLpFil HwTqCorrln.HwTqChATraLpFil HwTqCorrln.HwTqChBCmnModCmpLpFil HwTqCorrln.HwTqChBCmnModCmpLpFilSt HwTqCorrln.HwTqChBImdtCorrlnChk HwTqCorrln.HwTqChBStabStLpFil HwTqCorrln.HwTqChBTraLpFil HwTqCorrln.HwTqDRollgCntrPrev HwTqCorrln.HwTqDStallCntrPrev /end SUB_GROUP
 /begin FUNCTION_LIST /end FUNCTION_LIST
 /begin REF_CHARACTERISTIC /end REF_CHARACTERISTIC
 /begin REF_MEASUREMENT /end REF_MEASUREMENT
/end GROUP
/begin GROUP HwTqCorrln.ReceiverPorts "MICROSAR RTE"
 /begin SUB_GROUP HwTqCorrln.HwTqA.Val HwTqCorrln.HwTqAQlfr.Val HwTqCorrln.HwTqARollgCntr.Val HwTqCorrln.HwTqB.Val HwTqCorrln.HwTqBQlfr.Val HwTqCorrln.HwTqBRollgCntr.Val HwTqCorrln.HwTqC.Val HwTqCorrln.HwTqCQlfr.Val HwTqCorrln.HwTqCRollgCntr.Val HwTqCorrln.HwTqChA.Val HwTqCorrln.HwTqChB.Val HwTqCorrln.HwTqD.Val HwTqCorrln.HwTqDQlfr.Val HwTqCorrln.HwTqDRollgCntr.Val /end SUB_GROUP
 /begin FUNCTION_LIST /end FUNCTION_LIST
 /begin REF_CHARACTERISTIC /end REF_CHARACTERISTIC
 /begin REF_MEASUREMENT /end REF_MEASUREMENT
/end GROUP
/begin GROUP HwTqCorrln.SenderPorts "MICROSAR RTE"
 /begin SUB_GROUP HwTqCorrln.HwTqChACorrlnTraErr.Val HwTqCorrln.HwTqChBCorrlnTraErr.Val HwTqCorrln.HwTqCorrlnSts.Val HwTqCorrln.HwTqIdptSig.Val /end SUB_GROUP
 /begin FUNCTION_LIST /end FUNCTION_LIST
 /begin REF_CHARACTERISTIC /end REF_CHARACTERISTIC
 /begin REF_MEASUREMENT /end REF_MEASUREMENT
/end GROUP
/begin GROUP HysCmp "MICROSAR RTE"
 /begin SUB_GROUP HysCmp.CalibrationPorts HysCmp.PerInstanceMemories HysCmp.ReceiverPorts HysCmp.SenderPorts /end SUB_GROUP
 /begin FUNCTION_LIST /end FUNCTION_LIST
 /begin REF_CHARACTERISTIC /end REF_CHARACTERISTIC
 /begin REF_MEASUREMENT /end REF_MEASUREMENT
/end GROUP
/begin GROUP HysCmp.AssiCmdBas.Val "MICROSAR RTE" /begin SUB_GROUP /end SUB_GROUP /begin FUNCTION_LIST /end FUNCTION_LIST /begin REF_CHARACTERISTIC /end REF_CHARACTERISTIC /begin REF_MEASUREMENT HysCmp.AssiCmdBas.Val /end REF_MEASUREMENT /end GROUP
/begin GROUP HysCmp.AssiCmdLpFil "MICROSAR RTE" /begin SUB_GROUP /end SUB_GROUP /begin FUNCTION_LIST /end FUNCTION_LIST /begin REF_CHARACTERISTIC /end REF_CHARACTERISTIC /begin REF_MEASUREMENT HysCmp.AssiCmdLpFil.FilGain HysCmp.AssiCmdLpFil.FilSt /end REF_MEASUREMENT /end GROUP
/begin GROUP HysCmp.AssiMechT.Val "MICROSAR RTE" /begin SUB_GROUP /end SUB_GROUP /begin FUNCTION_LIST /end FUNCTION_LIST /begin REF_CHARACTERISTIC /end REF_CHARACTERISTIC /begin REF_MEASUREMENT HysCmp.AssiMechT.Val /end REF_MEASUREMENT /end GROUP
/begin GROUP HysCmp.CalibrationPorts "MICROSAR RTE"
 /begin SUB_GROUP HysCmp.HysCmpAssiCmdLpFilFrq.Val HysCmp.HysCmpAssiInpLim.Val HysCmp.HysCmpEffLossY.Ary1D HysCmp.HysCmpEffOffsY.Ary1D HysCmp.HysCmpFinalOutpLpFilFrq.Val HysCmp.HysCmpFricTScaX.Ary1D HysCmp.HysCmpFricTScaY.Ary1D HysCmp.HysCmpFricWhlImbRejctnBlndX.Ary1D HysCmp.HysCmpFricWhlImbRejctnBlndY.Ary1D HysCmp.HysCmpFricWhlImbRejctnOffY.Ary1D HysCmp.HysCmpFricWhlImbRejctnOnY.Ary1D HysCmp.HysCmpHwTqLpFilFrq.Val HysCmp.HysCmpHwTqScaX.Ary2D HysCmp.HysCmpHwTqScaY.Ary2D HysCmp.HysCmpHysSatnY.Ary1D HysCmp.HysCmpNegHysCmpScaX.Ary1D HysCmp.HysCmpNegHysCmpScaY.Ary1D HysCmp.HysCmpNegHysCmpX.Ary1D HysCmp.HysCmpNegHysCmpY.Ary1D HysCmp.HysCmpOutpLim.Val HysCmp.HysCmpRevGain.Val HysCmp.HysCmpRiseX.Ary1D HysCmp.HysCmpRiseY.Ary1D HysCmp.SysGlbPrmSysTqRat.Val HysCmp.SysGlbPrmVehSpdBilnrSeln.Ary1D /end SUB_GROUP
 /begin FUNCTION_LIST /end FUNCTION_LIST
 /begin REF_CHARACTERISTIC /end REF_CHARACTERISTIC
 /begin REF_MEASUREMENT /end REF_MEASUREMENT
/end GROUP
/begin GROUP HysCmp.FinalOutpLpFil "MICROSAR RTE" /begin SUB_GROUP /end SUB_GROUP /begin FUNCTION_LIST /end FUNCTION_LIST /begin REF_CHARACTERISTIC /end REF_CHARACTERISTIC /begin REF_MEASUREMENT HysCmp.FinalOutpLpFil.FilGain HysCmp.FinalOutpLpFil.FilSt /end REF_MEASUREMENT /end GROUP
/begin GROUP HysCmp.HwTq.Val "MICROSAR RTE" /begin SUB_GROUP /end SUB_GROUP /begin FUNCTION_LIST /end FUNCTION_LIST /begin REF_CHARACTERISTIC /end REF_CHARACTERISTIC /begin REF_MEASUREMENT HysCmp.HwTq.Val /end REF_MEASUREMENT /end GROUP
/begin GROUP HysCmp.HwTqLpFil "MICROSAR RTE" /begin SUB_GROUP /end SUB_GROUP /begin FUNCTION_LIST /end FUNCTION_LIST /begin REF_CHARACTERISTIC /end REF_CHARACTERISTIC /begin REF_MEASUREMENT HysCmp.HwTqLpFil.FilGain HysCmp.HwTqLpFil.FilSt /end REF_MEASUREMENT /end GROUP
/begin GROUP HysCmp.HwTqOvrl.Val "MICROSAR RTE" /begin SUB_GROUP /end SUB_GROUP /begin FUNCTION_LIST /end FUNCTION_LIST /begin REF_CHARACTERISTIC /end REF_CHARACTERISTIC /begin REF_MEASUREMENT HysCmp.HwTqOvrl.Val /end REF_MEASUREMENT /end GROUP
/begin GROUP HysCmp.HysCmpAssiCmdLpFilFrq.Val "MICROSAR RTE" /begin SUB_GROUP /end SUB_GROUP /begin FUNCTION_LIST /end FUNCTION_LIST /begin REF_CHARACTERISTIC HysCmp.HysCmpAssiCmdLpFilFrq.Val /end REF_CHARACTERISTIC /begin REF_MEASUREMENT /end REF_MEASUREMENT /end GROUP
/begin GROUP HysCmp.HysCmpAssiInpLim.Val "MICROSAR RTE" /begin SUB_GROUP /end SUB_GROUP /begin FUNCTION_LIST /end FUNCTION_LIST /begin REF_CHARACTERISTIC HysCmp.HysCmpAssiInpLim.Val /end REF_CHARACTERISTIC /begin REF_MEASUREMENT /end REF_MEASUREMENT /end GROUP
/begin GROUP HysCmp.HysCmpCmd.Val "MICROSAR RTE" /begin SUB_GROUP /end SUB_GROUP /begin FUNCTION_LIST /end FUNCTION_LIST /begin REF_CHARACTERISTIC /end REF_CHARACTERISTIC /begin REF_MEASUREMENT HysCmp.HysCmpCmd.Val /end REF_MEASUREMENT /end GROUP
/begin GROUP HysCmp.HysCmpCmdDi.Logl "MICROSAR RTE" /begin SUB_GROUP /end SUB_GROUP /begin FUNCTION_LIST /end FUNCTION_LIST /begin REF_CHARACTERISTIC /end REF_CHARACTERISTIC /begin REF_MEASUREMENT HysCmp.HysCmpCmdDi.Logl /end REF_MEASUREMENT /end GROUP
/begin GROUP HysCmp.HysCmpEffLossY.Ary1D "MICROSAR RTE" /begin SUB_GROUP /end SUB_GROUP /begin FUNCTION_LIST /end FUNCTION_LIST /begin REF_CHARACTERISTIC HysCmp.HysCmpEffLossY.Ary1D /end REF_CHARACTERISTIC /begin REF_MEASUREMENT /end REF_MEASUREMENT /end GROUP
/begin GROUP HysCmp.HysCmpEffOffsY.Ary1D "MICROSAR RTE" /begin SUB_GROUP /end SUB_GROUP /begin FUNCTION_LIST /end FUNCTION_LIST /begin REF_CHARACTERISTIC HysCmp.HysCmpEffOffsY.Ary1D /end REF_CHARACTERISTIC /begin REF_MEASUREMENT /end REF_MEASUREMENT /end GROUP
/begin GROUP HysCmp.HysCmpFinalOutpLpFilFrq.Val "MICROSAR RTE" /begin SUB_GROUP /end SUB_GROUP /begin FUNCTION_LIST /end FUNCTION_LIST /begin REF_CHARACTERISTIC HysCmp.HysCmpFinalOutpLpFilFrq.Val /end REF_CHARACTERISTIC /begin REF_MEASUREMENT /end REF_MEASUREMENT /end GROUP
/begin GROUP HysCmp.HysCmpFricTScaX.Ary1D "MICROSAR RTE" /begin SUB_GROUP /end SUB_GROUP /begin FUNCTION_LIST /end FUNCTION_LIST /begin REF_CHARACTERISTIC HysCmp.HysCmpFricTScaX.Ary1D /end REF_CHARACTERISTIC /begin REF_MEASUREMENT /end REF_MEASUREMENT /end GROUP
/begin GROUP HysCmp.HysCmpFricTScaY.Ary1D "MICROSAR RTE" /begin SUB_GROUP /end SUB_GROUP /begin FUNCTION_LIST /end FUNCTION_LIST /begin REF_CHARACTERISTIC HysCmp.HysCmpFricTScaY.Ary1D /end REF_CHARACTERISTIC /begin REF_MEASUREMENT /end REF_MEASUREMENT /end GROUP
/begin GROUP HysCmp.HysCmpFricWhlImbRejctnBlndX.Ary1D "MICROSAR RTE" /begin SUB_GROUP /end SUB_GROUP /begin FUNCTION_LIST /end FUNCTION_LIST /begin REF_CHARACTERISTIC HysCmp.HysCmpFricWhlImbRejctnBlndX.Ary1D /end REF_CHARACTERISTIC /begin REF_MEASUREMENT /end REF_MEASUREMENT /end GROUP
/begin GROUP HysCmp.HysCmpFricWhlImbRejctnBlndY.Ary1D "MICROSAR RTE" /begin SUB_GROUP /end SUB_GROUP /begin FUNCTION_LIST /end FUNCTION_LIST /begin REF_CHARACTERISTIC HysCmp.HysCmpFricWhlImbRejctnBlndY.Ary1D /end REF_CHARACTERISTIC /begin REF_MEASUREMENT /end REF_MEASUREMENT /end GROUP
/begin GROUP HysCmp.HysCmpFricWhlImbRejctnOffY.Ary1D "MICROSAR RTE" /begin SUB_GROUP /end SUB_GROUP /begin FUNCTION_LIST /end FUNCTION_LIST /begin REF_CHARACTERISTIC HysCmp.HysCmpFricWhlImbRejctnOffY.Ary1D /end REF_CHARACTERISTIC /begin REF_MEASUREMENT /end REF_MEASUREMENT /end GROUP
/begin GROUP HysCmp.HysCmpFricWhlImbRejctnOnY.Ary1D "MICROSAR RTE" /begin SUB_GROUP /end SUB_GROUP /begin FUNCTION_LIST /end FUNCTION_LIST /begin REF_CHARACTERISTIC HysCmp.HysCmpFricWhlImbRejctnOnY.Ary1D /end REF_CHARACTERISTIC /begin REF_MEASUREMENT /end REF_MEASUREMENT /end GROUP
/begin GROUP HysCmp.HysCmpHwTqLpFilFrq.Val "MICROSAR RTE" /begin SUB_GROUP /end SUB_GROUP /begin FUNCTION_LIST /end FUNCTION_LIST /begin REF_CHARACTERISTIC HysCmp.HysCmpHwTqLpFilFrq.Val /end REF_CHARACTERISTIC /begin REF_MEASUREMENT /end REF_MEASUREMENT /end GROUP
/begin GROUP HysCmp.HysCmpHwTqScaX.Ary2D "MICROSAR RTE" /begin SUB_GROUP /end SUB_GROUP /begin FUNCTION_LIST /end FUNCTION_LIST /begin REF_CHARACTERISTIC HysCmp.HysCmpHwTqScaX.Ary2D /end REF_CHARACTERISTIC /begin REF_MEASUREMENT /end REF_MEASUREMENT /end GROUP
/begin GROUP HysCmp.HysCmpHwTqScaY.Ary2D "MICROSAR RTE" /begin SUB_GROUP /end SUB_GROUP /begin FUNCTION_LIST /end FUNCTION_LIST /begin REF_CHARACTERISTIC HysCmp.HysCmpHwTqScaY.Ary2D /end REF_CHARACTERISTIC /begin REF_MEASUREMENT /end REF_MEASUREMENT /end GROUP
/begin GROUP HysCmp.HysCmpHysSatnY.Ary1D "MICROSAR RTE" /begin SUB_GROUP /end SUB_GROUP /begin FUNCTION_LIST /end FUNCTION_LIST /begin REF_CHARACTERISTIC HysCmp.HysCmpHysSatnY.Ary1D /end REF_CHARACTERISTIC /begin REF_MEASUREMENT /end REF_MEASUREMENT /end GROUP
/begin GROUP HysCmp.HysCmpNegHysCmpScaX.Ary1D "MICROSAR RTE" /begin SUB_GROUP /end SUB_GROUP /begin FUNCTION_LIST /end FUNCTION_LIST /begin REF_CHARACTERISTIC HysCmp.HysCmpNegHysCmpScaX.Ary1D /end REF_CHARACTERISTIC /begin REF_MEASUREMENT /end REF_MEASUREMENT /end GROUP
/begin GROUP HysCmp.HysCmpNegHysCmpScaY.Ary1D "MICROSAR RTE" /begin SUB_GROUP /end SUB_GROUP /begin FUNCTION_LIST /end FUNCTION_LIST /begin REF_CHARACTERISTIC HysCmp.HysCmpNegHysCmpScaY.Ary1D /end REF_CHARACTERISTIC /begin REF_MEASUREMENT /end REF_MEASUREMENT /end GROUP
/begin GROUP HysCmp.HysCmpNegHysCmpX.Ary1D "MICROSAR RTE" /begin SUB_GROUP /end SUB_GROUP /begin FUNCTION_LIST /end FUNCTION_LIST /begin REF_CHARACTERISTIC HysCmp.HysCmpNegHysCmpX.Ary1D /end REF_CHARACTERISTIC /begin REF_MEASUREMENT /end REF_MEASUREMENT /end GROUP
/begin GROUP HysCmp.HysCmpNegHysCmpY.Ary1D "MICROSAR RTE" /begin SUB_GROUP /end SUB_GROUP /begin FUNCTION_LIST /end FUNCTION_LIST /begin REF_CHARACTERISTIC HysCmp.HysCmpNegHysCmpY.Ary1D /end REF_CHARACTERISTIC /begin REF_MEASUREMENT /end REF_MEASUREMENT /end GROUP
/begin GROUP HysCmp.HysCmpOutpLim.Val "MICROSAR RTE" /begin SUB_GROUP /end SUB_GROUP /begin FUNCTION_LIST /end FUNCTION_LIST /begin REF_CHARACTERISTIC HysCmp.HysCmpOutpLim.Val /end REF_CHARACTERISTIC /begin REF_MEASUREMENT /end REF_MEASUREMENT /end GROUP
/begin GROUP HysCmp.HysCmpRevGain.Val "MICROSAR RTE" /begin SUB_GROUP /end SUB_GROUP /begin FUNCTION_LIST /end FUNCTION_LIST /begin REF_CHARACTERISTIC HysCmp.HysCmpRevGain.Val /end REF_CHARACTERISTIC /begin REF_MEASUREMENT /end REF_MEASUREMENT /end GROUP
/begin GROUP HysCmp.HysCmpRiseX.Ary1D "MICROSAR RTE" /begin SUB_GROUP /end SUB_GROUP /begin FUNCTION_LIST /end FUNCTION_LIST /begin REF_CHARACTERISTIC HysCmp.HysCmpRiseX.Ary1D /end REF_CHARACTERISTIC /begin REF_MEASUREMENT /end REF_MEASUREMENT /end GROUP
/begin GROUP HysCmp.HysCmpRiseY.Ary1D "MICROSAR RTE" /begin SUB_GROUP /end SUB_GROUP /begin FUNCTION_LIST /end FUNCTION_LIST /begin REF_CHARACTERISTIC HysCmp.HysCmpRiseY.Ary1D /end REF_CHARACTERISTIC /begin REF_MEASUREMENT /end REF_MEASUREMENT /end GROUP
/begin GROUP HysCmp.PerInstanceMemories "MICROSAR RTE"
 /begin SUB_GROUP HysCmp.AssiCmdLpFil HysCmp.FinalOutpLpFil HysCmp.HwTqLpFil HysCmp.PrevAssiCmdFildVal HysCmp.PrevHwTqFildVal HysCmp.PrevRiseX HysCmp.PrevRiseY HysCmp.dHysCmpAssiCmdFild HysCmp.dHysCmpAvl HysCmp.dHysCmpEffCmpTq HysCmp.dHysCmpFric HysCmp.dHysCmpHwTqFild HysCmp.dHysCmpNegAvl HysCmp.dHysCmpPosAvl HysCmp.dHysCmpRawVal HysCmp.dHysCmpRiseYFac /end SUB_GROUP
 /begin FUNCTION_LIST /end FUNCTION_LIST
 /begin REF_CHARACTERISTIC /end REF_CHARACTERISTIC
 /begin REF_MEASUREMENT /end REF_MEASUREMENT
/end GROUP
/begin GROUP HysCmp.PrevAssiCmdFildVal "MICROSAR RTE" /begin SUB_GROUP /end SUB_GROUP /begin FUNCTION_LIST /end FUNCTION_LIST /begin REF_CHARACTERISTIC /end REF_CHARACTERISTIC /begin REF_MEASUREMENT HysCmp.PrevAssiCmdFildVal /end REF_MEASUREMENT /end GROUP
/begin GROUP HysCmp.PrevHwTqFildVal "MICROSAR RTE" /begin SUB_GROUP /end SUB_GROUP /begin FUNCTION_LIST /end FUNCTION_LIST /begin REF_CHARACTERISTIC /end REF_CHARACTERISTIC /begin REF_MEASUREMENT HysCmp.PrevHwTqFildVal /end REF_MEASUREMENT /end GROUP
/begin GROUP HysCmp.PrevRiseX "MICROSAR RTE" /begin SUB_GROUP /end SUB_GROUP /begin FUNCTION_LIST /end FUNCTION_LIST /begin REF_CHARACTERISTIC /end REF_CHARACTERISTIC /begin REF_MEASUREMENT HysCmp.PrevRiseX /end REF_MEASUREMENT /end GROUP
/begin GROUP HysCmp.PrevRiseY "MICROSAR RTE" /begin SUB_GROUP /end SUB_GROUP /begin FUNCTION_LIST /end FUNCTION_LIST /begin REF_CHARACTERISTIC /end REF_CHARACTERISTIC /begin REF_MEASUREMENT HysCmp.PrevRiseY /end REF_MEASUREMENT /end GROUP
/begin GROUP HysCmp.ReceiverPorts "MICROSAR RTE"
 /begin SUB_GROUP HysCmp.AssiCmdBas.Val HysCmp.AssiMechT.Val HysCmp.HwTq.Val HysCmp.HwTqOvrl.Val HysCmp.HysCmpCmdDi.Logl HysCmp.SysFricOffs.Val HysCmp.VehSpd.Val HysCmp.WhlImbRejctnAmp.Val /end SUB_GROUP
 /begin FUNCTION_LIST /end FUNCTION_LIST
 /begin REF_CHARACTERISTIC /end REF_CHARACTERISTIC
 /begin REF_MEASUREMENT /end REF_MEASUREMENT
/end GROUP
/begin GROUP HysCmp.SenderPorts "MICROSAR RTE" /begin SUB_GROUP HysCmp.HysCmpCmd.Val /end SUB_GROUP /begin FUNCTION_LIST /end FUNCTION_LIST /begin REF_CHARACTERISTIC /end REF_CHARACTERISTIC /begin REF_MEASUREMENT /end REF_MEASUREMENT /end GROUP
/begin GROUP HysCmp.SysFricOffs.Val "MICROSAR RTE" /begin SUB_GROUP /end SUB_GROUP /begin FUNCTION_LIST /end FUNCTION_LIST /begin REF_CHARACTERISTIC /end REF_CHARACTERISTIC /begin REF_MEASUREMENT HysCmp.SysFricOffs.Val /end REF_MEASUREMENT /end GROUP
/begin GROUP HysCmp.SysGlbPrmSysTqRat.Val "MICROSAR RTE" /begin SUB_GROUP /end SUB_GROUP /begin FUNCTION_LIST /end FUNCTION_LIST /begin REF_CHARACTERISTIC HysCmp.SysGlbPrmSysTqRat.Val /end REF_CHARACTERISTIC /begin REF_MEASUREMENT /end REF_MEASUREMENT /end GROUP
/begin GROUP HysCmp.SysGlbPrmVehSpdBilnrSeln.Ary1D "MICROSAR RTE" /begin SUB_GROUP /end SUB_GROUP /begin FUNCTION_LIST /end FUNCTION_LIST /begin REF_CHARACTERISTIC HysCmp.SysGlbPrmVehSpdBilnrSeln.Ary1D /end REF_CHARACTERISTIC /begin REF_MEASUREMENT /end REF_MEASUREMENT /end GROUP
/begin GROUP HysCmp.VehSpd.Val "MICROSAR RTE" /begin SUB_GROUP /end SUB_GROUP /begin FUNCTION_LIST /end FUNCTION_LIST /begin REF_CHARACTERISTIC /end REF_CHARACTERISTIC /begin REF_MEASUREMENT HysCmp.VehSpd.Val /end REF_MEASUREMENT /end GROUP
/begin GROUP HysCmp.WhlImbRejctnAmp.Val "MICROSAR RTE" /begin SUB_GROUP /end SUB_GROUP /begin FUNCTION_LIST /end FUNCTION_LIST /begin REF_CHARACTERISTIC /end REF_CHARACTERISTIC /begin REF_MEASUREMENT HysCmp.WhlImbRejctnAmp.Val /end REF_MEASUREMENT /end GROUP
/begin GROUP HysCmp.dHysCmpAssiCmdFild "MICROSAR RTE" /begin SUB_GROUP /end SUB_GROUP /begin FUNCTION_LIST /end FUNCTION_LIST /begin REF_CHARACTERISTIC /end REF_CHARACTERISTIC /begin REF_MEASUREMENT HysCmp.dHysCmpAssiCmdFild /end REF_MEASUREMENT /end GROUP
/begin GROUP HysCmp.dHysCmpAvl "MICROSAR RTE" /begin SUB_GROUP /end SUB_GROUP /begin FUNCTION_LIST /end FUNCTION_LIST /begin REF_CHARACTERISTIC /end REF_CHARACTERISTIC /begin REF_MEASUREMENT HysCmp.dHysCmpAvl /end REF_MEASUREMENT /end GROUP
/begin GROUP HysCmp.dHysCmpEffCmpTq "MICROSAR RTE" /begin SUB_GROUP /end SUB_GROUP /begin FUNCTION_LIST /end FUNCTION_LIST /begin REF_CHARACTERISTIC /end REF_CHARACTERISTIC /begin REF_MEASUREMENT HysCmp.dHysCmpEffCmpTq /end REF_MEASUREMENT /end GROUP
/begin GROUP HysCmp.dHysCmpFric "MICROSAR RTE" /begin SUB_GROUP /end SUB_GROUP /begin FUNCTION_LIST /end FUNCTION_LIST /begin REF_CHARACTERISTIC /end REF_CHARACTERISTIC /begin REF_MEASUREMENT HysCmp.dHysCmpFric /end REF_MEASUREMENT /end GROUP
/begin GROUP HysCmp.dHysCmpHwTqFild "MICROSAR RTE" /begin SUB_GROUP /end SUB_GROUP /begin FUNCTION_LIST /end FUNCTION_LIST /begin REF_CHARACTERISTIC /end REF_CHARACTERISTIC /begin REF_MEASUREMENT HysCmp.dHysCmpHwTqFild /end REF_MEASUREMENT /end GROUP
/begin GROUP HysCmp.dHysCmpNegAvl "MICROSAR RTE" /begin SUB_GROUP /end SUB_GROUP /begin FUNCTION_LIST /end FUNCTION_LIST /begin REF_CHARACTERISTIC /end REF_CHARACTERISTIC /begin REF_MEASUREMENT HysCmp.dHysCmpNegAvl /end REF_MEASUREMENT /end GROUP
/begin GROUP HysCmp.dHysCmpPosAvl "MICROSAR RTE" /begin SUB_GROUP /end SUB_GROUP /begin FUNCTION_LIST /end FUNCTION_LIST /begin REF_CHARACTERISTIC /end REF_CHARACTERISTIC /begin REF_MEASUREMENT HysCmp.dHysCmpPosAvl /end REF_MEASUREMENT /end GROUP
/begin GROUP HysCmp.dHysCmpRawVal "MICROSAR RTE" /begin SUB_GROUP /end SUB_GROUP /begin FUNCTION_LIST /end FUNCTION_LIST /begin REF_CHARACTERISTIC /end REF_CHARACTERISTIC /begin REF_MEASUREMENT HysCmp.dHysCmpRawVal /end REF_MEASUREMENT /end GROUP
/begin GROUP HysCmp.dHysCmpRiseYFac "MICROSAR RTE" /begin SUB_GROUP /end SUB_GROUP /begin FUNCTION_LIST /end FUNCTION_LIST /begin REF_CHARACTERISTIC /end REF_CHARACTERISTIC /begin REF_MEASUREMENT HysCmp.dHysCmpRiseYFac /end REF_MEASUREMENT /end GROUP
/begin GROUP InertiaCmpVel "MICROSAR RTE"
 /begin SUB_GROUP InertiaCmpVel.CalibrationPorts InertiaCmpVel.PerInstanceMemories InertiaCmpVel.ReceiverPorts InertiaCmpVel.SenderPorts /end SUB_GROUP
 /begin FUNCTION_LIST /end FUNCTION_LIST
 /begin REF_CHARACTERISTIC /end REF_CHARACTERISTIC
 /begin REF_MEASUREMENT /end REF_MEASUREMENT
/end GROUP
/begin GROUP InertiaCmpVel.AssiCmdBas.Val "MICROSAR RTE" /begin SUB_GROUP /end SUB_GROUP /begin FUNCTION_LIST /end FUNCTION_LIST /begin REF_CHARACTERISTIC /end REF_CHARACTERISTIC /begin REF_MEASUREMENT InertiaCmpVel.AssiCmdBas.Val /end REF_MEASUREMENT /end GROUP
/begin GROUP InertiaCmpVel.CalibrationPorts "MICROSAR RTE"
 /begin SUB_GROUP InertiaCmpVel.InertiaCmpVelAssiBasdDampgCoeffX.Ary1D InertiaCmpVel.InertiaCmpVelAssiBasdDampgRollgWhlImbRejctnOnY.Ary1D InertiaCmpVel.InertiaCmpVelAssiBasdDampgRollgY.Ary1D InertiaCmpVel.InertiaCmpVelAssiBasdDampgStatY.Ary1D InertiaCmpVel.InertiaCmpVelCmdScaY.Ary1D InertiaCmpVel.InertiaCmpVelDampgDecelGain.Val InertiaCmpVel.InertiaCmpVelDampgDecelGainFallSlew.Val InertiaCmpVel.InertiaCmpVelDampgDecelGainRisngSlewX.Ary1D InertiaCmpVel.InertiaCmpVelDampgDecelGainRisngSlewY.Ary1D InertiaCmpVel.InertiaCmpVelDampgFilFrq.Ary1D InertiaCmpVel.InertiaCmpVelDampgFilFrqWhlImbRejctnOn.Ary1D InertiaCmpVel.InertiaCmpVelDampgGainOffThd.Val InertiaCmpVel.InertiaCmpVelDampgGainOnThd.Val InertiaCmpVel.InertiaCmpVelDampgSpdBlndY.Ary1D InertiaCmpVel.InertiaCmpVelDampgWhlImbRejctnBlndX.Ary1D InertiaCmpVel.InertiaCmpVelDampgWhlImbRejctnBlndY.Ary1D InertiaCmpVel.InertiaCmpVelDecelGainEnaCal.Logl InertiaCmpVel.InertiaCmpVelMotInertia.Val InertiaCmpVel.InertiaCmpVelMotVelBasdOutpScagX.Ary1D InertiaCmpVel.InertiaCmpVelMotVelBasdOutpScagY.Ary1D InertiaCmpVel.InertiaCmpVelNotchBlndY.Ary1D InertiaCmpVel.InertiaCmpVelNotchFilStruct.Rec InertiaCmpVel.InertiaCmpVelTqSnsrVelFilFrq.Val InertiaCmpVel.InertiaCmpVelTqSnsrVelSca.Ary1D InertiaCmpVel.SysGlbPrmSysKineRat.Val InertiaCmpVel.SysGlbPrmTorsBarStfn.Val InertiaCmpVel.SysGlbPrmVehSpdBilnrSeln.Ary1D /end SUB_GROUP
 /begin FUNCTION_LIST /end FUNCTION_LIST
 /begin REF_CHARACTERISTIC /end REF_CHARACTERISTIC
 /begin REF_MEASUREMENT /end REF_MEASUREMENT
/end GROUP
/begin GROUP InertiaCmpVel.DecelGain "MICROSAR RTE" /begin SUB_GROUP /end SUB_GROUP /begin FUNCTION_LIST /end FUNCTION_LIST /begin REF_CHARACTERISTIC /end REF_CHARACTERISTIC /begin REF_MEASUREMENT InertiaCmpVel.DecelGain /end REF_MEASUREMENT /end GROUP
/begin GROUP InertiaCmpVel.HwTq.Val "MICROSAR RTE" /begin SUB_GROUP /end SUB_GROUP /begin FUNCTION_LIST /end FUNCTION_LIST /begin REF_CHARACTERISTIC /end REF_CHARACTERISTIC /begin REF_MEASUREMENT InertiaCmpVel.HwTq.Val /end REF_MEASUREMENT /end GROUP
/begin GROUP InertiaCmpVel.InertiaCmpDecelGainDi.Logl "MICROSAR RTE" /begin SUB_GROUP /end SUB_GROUP /begin FUNCTION_LIST /end FUNCTION_LIST /begin REF_CHARACTERISTIC /end REF_CHARACTERISTIC /begin REF_MEASUREMENT InertiaCmpVel.InertiaCmpDecelGainDi.Logl /end REF_MEASUREMENT /end GROUP
/begin GROUP InertiaCmpVel.InertiaCmpVelAssiBasdDampgCoeffX.Ary1D "MICROSAR RTE" /begin SUB_GROUP /end SUB_GROUP /begin FUNCTION_LIST /end FUNCTION_LIST /begin REF_CHARACTERISTIC InertiaCmpVel.InertiaCmpVelAssiBasdDampgCoeffX.Ary1D /end REF_CHARACTERISTIC /begin REF_MEASUREMENT /end REF_MEASUREMENT /end GROUP
/begin GROUP InertiaCmpVel.InertiaCmpVelAssiBasdDampgRollgWhlImbRejctnOnY.Ary1D "MICROSAR RTE" /begin SUB_GROUP /end SUB_GROUP /begin FUNCTION_LIST /end FUNCTION_LIST
 /begin REF_CHARACTERISTIC InertiaCmpVel.InertiaCmpVelAssiBasdDampgRollgWhlImbRejctnOnY.Ary1D /end REF_CHARACTERISTIC
 /begin REF_MEASUREMENT /end REF_MEASUREMENT
/end GROUP
/begin GROUP InertiaCmpVel.InertiaCmpVelAssiBasdDampgRollgY.Ary1D "MICROSAR RTE" /begin SUB_GROUP /end SUB_GROUP /begin FUNCTION_LIST /end FUNCTION_LIST /begin REF_CHARACTERISTIC InertiaCmpVel.InertiaCmpVelAssiBasdDampgRollgY.Ary1D /end REF_CHARACTERISTIC /begin REF_MEASUREMENT /end REF_MEASUREMENT /end GROUP
/begin GROUP InertiaCmpVel.InertiaCmpVelAssiBasdDampgStatY.Ary1D "MICROSAR RTE" /begin SUB_GROUP /end SUB_GROUP /begin FUNCTION_LIST /end FUNCTION_LIST /begin REF_CHARACTERISTIC InertiaCmpVel.InertiaCmpVelAssiBasdDampgStatY.Ary1D /end REF_CHARACTERISTIC /begin REF_MEASUREMENT /end REF_MEASUREMENT /end GROUP
/begin GROUP InertiaCmpVel.InertiaCmpVelCmd.Val "MICROSAR RTE" /begin SUB_GROUP /end SUB_GROUP /begin FUNCTION_LIST /end FUNCTION_LIST /begin REF_CHARACTERISTIC /end REF_CHARACTERISTIC /begin REF_MEASUREMENT InertiaCmpVel.InertiaCmpVelCmd.Val /end REF_MEASUREMENT /end GROUP
/begin GROUP InertiaCmpVel.InertiaCmpVelCmdDi.Logl "MICROSAR RTE" /begin SUB_GROUP /end SUB_GROUP /begin FUNCTION_LIST /end FUNCTION_LIST /begin REF_CHARACTERISTIC /end REF_CHARACTERISTIC /begin REF_MEASUREMENT InertiaCmpVel.InertiaCmpVelCmdDi.Logl /end REF_MEASUREMENT /end GROUP
/begin GROUP InertiaCmpVel.InertiaCmpVelCmdScaY.Ary1D "MICROSAR RTE" /begin SUB_GROUP /end SUB_GROUP /begin FUNCTION_LIST /end FUNCTION_LIST /begin REF_CHARACTERISTIC InertiaCmpVel.InertiaCmpVelCmdScaY.Ary1D /end REF_CHARACTERISTIC /begin REF_MEASUREMENT /end REF_MEASUREMENT /end GROUP
/begin GROUP InertiaCmpVel.InertiaCmpVelDampgDecelGain.Val "MICROSAR RTE" /begin SUB_GROUP /end SUB_GROUP /begin FUNCTION_LIST /end FUNCTION_LIST /begin REF_CHARACTERISTIC InertiaCmpVel.InertiaCmpVelDampgDecelGain.Val /end REF_CHARACTERISTIC /begin REF_MEASUREMENT /end REF_MEASUREMENT /end GROUP
/begin GROUP InertiaCmpVel.InertiaCmpVelDampgDecelGainFallSlew.Val "MICROSAR RTE" /begin SUB_GROUP /end SUB_GROUP /begin FUNCTION_LIST /end FUNCTION_LIST /begin REF_CHARACTERISTIC InertiaCmpVel.InertiaCmpVelDampgDecelGainFallSlew.Val /end REF_CHARACTERISTIC /begin REF_MEASUREMENT /end REF_MEASUREMENT /end GROUP
/begin GROUP InertiaCmpVel.InertiaCmpVelDampgDecelGainRisngSlewX.Ary1D "MICROSAR RTE" /begin SUB_GROUP /end SUB_GROUP /begin FUNCTION_LIST /end FUNCTION_LIST /begin REF_CHARACTERISTIC InertiaCmpVel.InertiaCmpVelDampgDecelGainRisngSlewX.Ary1D /end REF_CHARACTERISTIC /begin REF_MEASUREMENT /end REF_MEASUREMENT /end GROUP
/begin GROUP InertiaCmpVel.InertiaCmpVelDampgDecelGainRisngSlewY.Ary1D "MICROSAR RTE" /begin SUB_GROUP /end SUB_GROUP /begin FUNCTION_LIST /end FUNCTION_LIST /begin REF_CHARACTERISTIC InertiaCmpVel.InertiaCmpVelDampgDecelGainRisngSlewY.Ary1D /end REF_CHARACTERISTIC /begin REF_MEASUREMENT /end REF_MEASUREMENT /end GROUP
/begin GROUP InertiaCmpVel.InertiaCmpVelDampgFilFrq.Ary1D "MICROSAR RTE" /begin SUB_GROUP /end SUB_GROUP /begin FUNCTION_LIST /end FUNCTION_LIST /begin REF_CHARACTERISTIC InertiaCmpVel.InertiaCmpVelDampgFilFrq.Ary1D /end REF_CHARACTERISTIC /begin REF_MEASUREMENT /end REF_MEASUREMENT /end GROUP
/begin GROUP InertiaCmpVel.InertiaCmpVelDampgFilFrqWhlImbRejctnOn.Ary1D "MICROSAR RTE" /begin SUB_GROUP /end SUB_GROUP /begin FUNCTION_LIST /end FUNCTION_LIST /begin REF_CHARACTERISTIC InertiaCmpVel.InertiaCmpVelDampgFilFrqWhlImbRejctnOn.Ary1D /end REF_CHARACTERISTIC /begin REF_MEASUREMENT /end REF_MEASUREMENT /end GROUP
/begin GROUP InertiaCmpVel.InertiaCmpVelDampgGainOffThd.Val "MICROSAR RTE" /begin SUB_GROUP /end SUB_GROUP /begin FUNCTION_LIST /end FUNCTION_LIST /begin REF_CHARACTERISTIC InertiaCmpVel.InertiaCmpVelDampgGainOffThd.Val /end REF_CHARACTERISTIC /begin REF_MEASUREMENT /end REF_MEASUREMENT /end GROUP
/begin GROUP InertiaCmpVel.InertiaCmpVelDampgGainOnThd.Val "MICROSAR RTE" /begin SUB_GROUP /end SUB_GROUP /begin FUNCTION_LIST /end FUNCTION_LIST /begin REF_CHARACTERISTIC InertiaCmpVel.InertiaCmpVelDampgGainOnThd.Val /end REF_CHARACTERISTIC /begin REF_MEASUREMENT /end REF_MEASUREMENT /end GROUP
/begin GROUP InertiaCmpVel.InertiaCmpVelDampgSpdBlndY.Ary1D "MICROSAR RTE" /begin SUB_GROUP /end SUB_GROUP /begin FUNCTION_LIST /end FUNCTION_LIST /begin REF_CHARACTERISTIC InertiaCmpVel.InertiaCmpVelDampgSpdBlndY.Ary1D /end REF_CHARACTERISTIC /begin REF_MEASUREMENT /end REF_MEASUREMENT /end GROUP
/begin GROUP InertiaCmpVel.InertiaCmpVelDampgWhlImbRejctnBlndX.Ary1D "MICROSAR RTE" /begin SUB_GROUP /end SUB_GROUP /begin FUNCTION_LIST /end FUNCTION_LIST /begin REF_CHARACTERISTIC InertiaCmpVel.InertiaCmpVelDampgWhlImbRejctnBlndX.Ary1D /end REF_CHARACTERISTIC /begin REF_MEASUREMENT /end REF_MEASUREMENT /end GROUP
/begin GROUP InertiaCmpVel.InertiaCmpVelDampgWhlImbRejctnBlndY.Ary1D "MICROSAR RTE" /begin SUB_GROUP /end SUB_GROUP /begin FUNCTION_LIST /end FUNCTION_LIST /begin REF_CHARACTERISTIC InertiaCmpVel.InertiaCmpVelDampgWhlImbRejctnBlndY.Ary1D /end REF_CHARACTERISTIC /begin REF_MEASUREMENT /end REF_MEASUREMENT /end GROUP
/begin GROUP InertiaCmpVel.InertiaCmpVelDecelGainEnaCal.Logl "MICROSAR RTE" /begin SUB_GROUP /end SUB_GROUP /begin FUNCTION_LIST /end FUNCTION_LIST /begin REF_CHARACTERISTIC InertiaCmpVel.InertiaCmpVelDecelGainEnaCal.Logl /end REF_CHARACTERISTIC /begin REF_MEASUREMENT /end REF_MEASUREMENT /end GROUP
/begin GROUP InertiaCmpVel.InertiaCmpVelMotInertia.Val "MICROSAR RTE" /begin SUB_GROUP /end SUB_GROUP /begin FUNCTION_LIST /end FUNCTION_LIST /begin REF_CHARACTERISTIC InertiaCmpVel.InertiaCmpVelMotInertia.Val /end REF_CHARACTERISTIC /begin REF_MEASUREMENT /end REF_MEASUREMENT /end GROUP
/begin GROUP InertiaCmpVel.InertiaCmpVelMotVelBasdOutpScagX.Ary1D "MICROSAR RTE" /begin SUB_GROUP /end SUB_GROUP /begin FUNCTION_LIST /end FUNCTION_LIST /begin REF_CHARACTERISTIC InertiaCmpVel.InertiaCmpVelMotVelBasdOutpScagX.Ary1D /end REF_CHARACTERISTIC /begin REF_MEASUREMENT /end REF_MEASUREMENT /end GROUP
/begin GROUP InertiaCmpVel.InertiaCmpVelMotVelBasdOutpScagY.Ary1D "MICROSAR RTE" /begin SUB_GROUP /end SUB_GROUP /begin FUNCTION_LIST /end FUNCTION_LIST /begin REF_CHARACTERISTIC InertiaCmpVel.InertiaCmpVelMotVelBasdOutpScagY.Ary1D /end REF_CHARACTERISTIC /begin REF_MEASUREMENT /end REF_MEASUREMENT /end GROUP
/begin GROUP InertiaCmpVel.InertiaCmpVelNotchBlndY.Ary1D "MICROSAR RTE" /begin SUB_GROUP /end SUB_GROUP /begin FUNCTION_LIST /end FUNCTION_LIST /begin REF_CHARACTERISTIC InertiaCmpVel.InertiaCmpVelNotchBlndY.Ary1D /end REF_CHARACTERISTIC /begin REF_MEASUREMENT /end REF_MEASUREMENT /end GROUP
/begin GROUP InertiaCmpVel.InertiaCmpVelNotchFilStruct.Rec "MICROSAR RTE" /begin SUB_GROUP /end SUB_GROUP /begin FUNCTION_LIST /end FUNCTION_LIST
 /begin REF_CHARACTERISTIC InertiaCmpVel.InertiaCmpVelNotchFilStruct.Rec.FilGainA1 InertiaCmpVel.InertiaCmpVelNotchFilStruct.Rec.FilGainA2 InertiaCmpVel.InertiaCmpVelNotchFilStruct.Rec.FilGainB0 InertiaCmpVel.InertiaCmpVelNotchFilStruct.Rec.FilGainB1 InertiaCmpVel.InertiaCmpVelNotchFilStruct.Rec.FilGainB2 /end REF_CHARACTERISTIC
 /begin REF_MEASUREMENT /end REF_MEASUREMENT
/end GROUP
/begin GROUP InertiaCmpVel.InertiaCmpVelTqSnsrVelFilFrq.Val "MICROSAR RTE" /begin SUB_GROUP /end SUB_GROUP /begin FUNCTION_LIST /end FUNCTION_LIST /begin REF_CHARACTERISTIC InertiaCmpVel.InertiaCmpVelTqSnsrVelFilFrq.Val /end REF_CHARACTERISTIC /begin REF_MEASUREMENT /end REF_MEASUREMENT /end GROUP
/begin GROUP InertiaCmpVel.InertiaCmpVelTqSnsrVelSca.Ary1D "MICROSAR RTE" /begin SUB_GROUP /end SUB_GROUP /begin FUNCTION_LIST /end FUNCTION_LIST /begin REF_CHARACTERISTIC InertiaCmpVel.InertiaCmpVelTqSnsrVelSca.Ary1D /end REF_CHARACTERISTIC /begin REF_MEASUREMENT /end REF_MEASUREMENT /end GROUP
/begin GROUP InertiaCmpVel.MotVelCrf.Val "MICROSAR RTE" /begin SUB_GROUP /end SUB_GROUP /begin FUNCTION_LIST /end FUNCTION_LIST /begin REF_CHARACTERISTIC /end REF_CHARACTERISTIC /begin REF_MEASUREMENT InertiaCmpVel.MotVelCrf.Val /end REF_MEASUREMENT /end GROUP
/begin GROUP InertiaCmpVel.NotchFilChk "MICROSAR RTE" /begin SUB_GROUP /end SUB_GROUP /begin FUNCTION_LIST /end FUNCTION_LIST /begin REF_CHARACTERISTIC /end REF_CHARACTERISTIC /begin REF_MEASUREMENT InertiaCmpVel.NotchFilChk /end REF_MEASUREMENT /end GROUP
/begin GROUP InertiaCmpVel.PerInstanceMemories "MICROSAR RTE"
 /begin SUB_GROUP InertiaCmpVel.DecelGain InertiaCmpVel.NotchFilChk InertiaCmpVel.PreScagCmpCmdPrev1 InertiaCmpVel.PreScagCmpCmdPrev2 InertiaCmpVel.ScaDrvrVelPrev1 InertiaCmpVel.ScaDrvrVelPrev2 InertiaCmpVel.TqSnsrAgPrev InertiaCmpVel.TqSnsrVelFil InertiaCmpVel.TqSnsrVelFilNotchSt InertiaCmpVel.dInertiaCmpVelAssiBasdDampgCoeff InertiaCmpVel.dInertiaCmpVelCalcdInertiaCmp InertiaCmpVel.dInertiaCmpVelFilFrq InertiaCmpVel.dInertiaCmpVelMotVelBasdOutpScag InertiaCmpVel.dInertiaCmpVelNotScadDrvrVel InertiaCmpVel.dInertiaCmpVelNotchBlndVal InertiaCmpVel.dInertiaCmpVelNotchInpVal InertiaCmpVel.dInertiaCmpVelNotchOutpVal InertiaCmpVel.dInertiaCmpVelRawDecelGain InertiaCmpVel.dInertiaCmpVelScadDrvrVel InertiaCmpVel.dInertiaCmpVelTqSnsrVelFildVal /end SUB_GROUP
 /begin FUNCTION_LIST /end FUNCTION_LIST
 /begin REF_CHARACTERISTIC /end REF_CHARACTERISTIC
 /begin REF_MEASUREMENT /end REF_MEASUREMENT
/end GROUP
/begin GROUP InertiaCmpVel.PreScagCmpCmdPrev1 "MICROSAR RTE" /begin SUB_GROUP /end SUB_GROUP /begin FUNCTION_LIST /end FUNCTION_LIST /begin REF_CHARACTERISTIC /end REF_CHARACTERISTIC /begin REF_MEASUREMENT InertiaCmpVel.PreScagCmpCmdPrev1 /end REF_MEASUREMENT /end GROUP
/begin GROUP InertiaCmpVel.PreScagCmpCmdPrev2 "MICROSAR RTE" /begin SUB_GROUP /end SUB_GROUP /begin FUNCTION_LIST /end FUNCTION_LIST /begin REF_CHARACTERISTIC /end REF_CHARACTERISTIC /begin REF_MEASUREMENT InertiaCmpVel.PreScagCmpCmdPrev2 /end REF_MEASUREMENT /end GROUP
/begin GROUP InertiaCmpVel.ReceiverPorts "MICROSAR RTE"
 /begin SUB_GROUP InertiaCmpVel.AssiCmdBas.Val InertiaCmpVel.HwTq.Val InertiaCmpVel.InertiaCmpDecelGainDi.Logl InertiaCmpVel.InertiaCmpVelCmdDi.Logl InertiaCmpVel.MotVelCrf.Val InertiaCmpVel.VehLgtA.Val InertiaCmpVel.VehSpd.Val InertiaCmpVel.WhlImbRejctnAmp.Val /end SUB_GROUP
 /begin FUNCTION_LIST /end FUNCTION_LIST
 /begin REF_CHARACTERISTIC /end REF_CHARACTERISTIC
 /begin REF_MEASUREMENT /end REF_MEASUREMENT
/end GROUP
/begin GROUP InertiaCmpVel.ScaDrvrVelPrev1 "MICROSAR RTE" /begin SUB_GROUP /end SUB_GROUP /begin FUNCTION_LIST /end FUNCTION_LIST /begin REF_CHARACTERISTIC /end REF_CHARACTERISTIC /begin REF_MEASUREMENT InertiaCmpVel.ScaDrvrVelPrev1 /end REF_MEASUREMENT /end GROUP
/begin GROUP InertiaCmpVel.ScaDrvrVelPrev2 "MICROSAR RTE" /begin SUB_GROUP /end SUB_GROUP /begin FUNCTION_LIST /end FUNCTION_LIST /begin REF_CHARACTERISTIC /end REF_CHARACTERISTIC /begin REF_MEASUREMENT InertiaCmpVel.ScaDrvrVelPrev2 /end REF_MEASUREMENT /end GROUP
/begin GROUP InertiaCmpVel.SenderPorts "MICROSAR RTE" /begin SUB_GROUP InertiaCmpVel.InertiaCmpVelCmd.Val /end SUB_GROUP /begin FUNCTION_LIST /end FUNCTION_LIST /begin REF_CHARACTERISTIC /end REF_CHARACTERISTIC /begin REF_MEASUREMENT /end REF_MEASUREMENT /end GROUP
/begin GROUP InertiaCmpVel.SysGlbPrmSysKineRat.Val "MICROSAR RTE" /begin SUB_GROUP /end SUB_GROUP /begin FUNCTION_LIST /end FUNCTION_LIST /begin REF_CHARACTERISTIC InertiaCmpVel.SysGlbPrmSysKineRat.Val /end REF_CHARACTERISTIC /begin REF_MEASUREMENT /end REF_MEASUREMENT /end GROUP
/begin GROUP InertiaCmpVel.SysGlbPrmTorsBarStfn.Val "MICROSAR RTE" /begin SUB_GROUP /end SUB_GROUP /begin FUNCTION_LIST /end FUNCTION_LIST /begin REF_CHARACTERISTIC InertiaCmpVel.SysGlbPrmTorsBarStfn.Val /end REF_CHARACTERISTIC /begin REF_MEASUREMENT /end REF_MEASUREMENT /end GROUP
/begin GROUP InertiaCmpVel.SysGlbPrmVehSpdBilnrSeln.Ary1D "MICROSAR RTE" /begin SUB_GROUP /end SUB_GROUP /begin FUNCTION_LIST /end FUNCTION_LIST /begin REF_CHARACTERISTIC InertiaCmpVel.SysGlbPrmVehSpdBilnrSeln.Ary1D /end REF_CHARACTERISTIC /begin REF_MEASUREMENT /end REF_MEASUREMENT /end GROUP
/begin GROUP InertiaCmpVel.TqSnsrAgPrev "MICROSAR RTE" /begin SUB_GROUP /end SUB_GROUP /begin FUNCTION_LIST /end FUNCTION_LIST /begin REF_CHARACTERISTIC /end REF_CHARACTERISTIC /begin REF_MEASUREMENT InertiaCmpVel.TqSnsrAgPrev /end REF_MEASUREMENT /end GROUP
/begin GROUP InertiaCmpVel.TqSnsrVelFil "MICROSAR RTE" /begin SUB_GROUP /end SUB_GROUP /begin FUNCTION_LIST /end FUNCTION_LIST /begin REF_CHARACTERISTIC /end REF_CHARACTERISTIC
 /begin REF_MEASUREMENT InertiaCmpVel.TqSnsrVelFil.FilGain InertiaCmpVel.TqSnsrVelFil.FilSt /end REF_MEASUREMENT
/end GROUP
/begin GROUP InertiaCmpVel.TqSnsrVelFilNotchSt "MICROSAR RTE" /begin SUB_GROUP /end SUB_GROUP /begin FUNCTION_LIST /end FUNCTION_LIST /begin REF_CHARACTERISTIC /end REF_CHARACTERISTIC
 /begin REF_MEASUREMENT InertiaCmpVel.TqSnsrVelFilNotchSt.FilSt1 InertiaCmpVel.TqSnsrVelFilNotchSt.FilSt2 /end REF_MEASUREMENT
/end GROUP
/begin GROUP InertiaCmpVel.VehLgtA.Val "MICROSAR RTE" /begin SUB_GROUP /end SUB_GROUP /begin FUNCTION_LIST /end FUNCTION_LIST /begin REF_CHARACTERISTIC /end REF_CHARACTERISTIC /begin REF_MEASUREMENT InertiaCmpVel.VehLgtA.Val /end REF_MEASUREMENT /end GROUP
/begin GROUP InertiaCmpVel.VehSpd.Val "MICROSAR RTE" /begin SUB_GROUP /end SUB_GROUP /begin FUNCTION_LIST /end FUNCTION_LIST /begin REF_CHARACTERISTIC /end REF_CHARACTERISTIC /begin REF_MEASUREMENT InertiaCmpVel.VehSpd.Val /end REF_MEASUREMENT /end GROUP
/begin GROUP InertiaCmpVel.WhlImbRejctnAmp.Val "MICROSAR RTE" /begin SUB_GROUP /end SUB_GROUP /begin FUNCTION_LIST /end FUNCTION_LIST /begin REF_CHARACTERISTIC /end REF_CHARACTERISTIC /begin REF_MEASUREMENT InertiaCmpVel.WhlImbRejctnAmp.Val /end REF_MEASUREMENT /end GROUP
/begin GROUP InertiaCmpVel.dInertiaCmpVelAssiBasdDampgCoeff "MICROSAR RTE" /begin SUB_GROUP /end SUB_GROUP /begin FUNCTION_LIST /end FUNCTION_LIST /begin REF_CHARACTERISTIC /end REF_CHARACTERISTIC /begin REF_MEASUREMENT InertiaCmpVel.dInertiaCmpVelAssiBasdDampgCoeff /end REF_MEASUREMENT /end GROUP
/begin GROUP InertiaCmpVel.dInertiaCmpVelCalcdInertiaCmp "MICROSAR RTE" /begin SUB_GROUP /end SUB_GROUP /begin FUNCTION_LIST /end FUNCTION_LIST /begin REF_CHARACTERISTIC /end REF_CHARACTERISTIC /begin REF_MEASUREMENT InertiaCmpVel.dInertiaCmpVelCalcdInertiaCmp /end REF_MEASUREMENT /end GROUP
/begin GROUP InertiaCmpVel.dInertiaCmpVelFilFrq "MICROSAR RTE" /begin SUB_GROUP /end SUB_GROUP /begin FUNCTION_LIST /end FUNCTION_LIST /begin REF_CHARACTERISTIC /end REF_CHARACTERISTIC /begin REF_MEASUREMENT InertiaCmpVel.dInertiaCmpVelFilFrq /end REF_MEASUREMENT /end GROUP
/begin GROUP InertiaCmpVel.dInertiaCmpVelMotVelBasdOutpScag "MICROSAR RTE" /begin SUB_GROUP /end SUB_GROUP /begin FUNCTION_LIST /end FUNCTION_LIST /begin REF_CHARACTERISTIC /end REF_CHARACTERISTIC /begin REF_MEASUREMENT InertiaCmpVel.dInertiaCmpVelMotVelBasdOutpScag /end REF_MEASUREMENT /end GROUP
/begin GROUP InertiaCmpVel.dInertiaCmpVelNotScadDrvrVel "MICROSAR RTE" /begin SUB_GROUP /end SUB_GROUP /begin FUNCTION_LIST /end FUNCTION_LIST /begin REF_CHARACTERISTIC /end REF_CHARACTERISTIC /begin REF_MEASUREMENT InertiaCmpVel.dInertiaCmpVelNotScadDrvrVel /end REF_MEASUREMENT /end GROUP
/begin GROUP InertiaCmpVel.dInertiaCmpVelNotchBlndVal "MICROSAR RTE" /begin SUB_GROUP /end SUB_GROUP /begin FUNCTION_LIST /end FUNCTION_LIST /begin REF_CHARACTERISTIC /end REF_CHARACTERISTIC /begin REF_MEASUREMENT InertiaCmpVel.dInertiaCmpVelNotchBlndVal /end REF_MEASUREMENT /end GROUP
/begin GROUP InertiaCmpVel.dInertiaCmpVelNotchInpVal "MICROSAR RTE" /begin SUB_GROUP /end SUB_GROUP /begin FUNCTION_LIST /end FUNCTION_LIST /begin REF_CHARACTERISTIC /end REF_CHARACTERISTIC /begin REF_MEASUREMENT InertiaCmpVel.dInertiaCmpVelNotchInpVal /end REF_MEASUREMENT /end GROUP
/begin GROUP InertiaCmpVel.dInertiaCmpVelNotchOutpVal "MICROSAR RTE" /begin SUB_GROUP /end SUB_GROUP /begin FUNCTION_LIST /end FUNCTION_LIST /begin REF_CHARACTERISTIC /end REF_CHARACTERISTIC /begin REF_MEASUREMENT InertiaCmpVel.dInertiaCmpVelNotchOutpVal /end REF_MEASUREMENT /end GROUP
/begin GROUP InertiaCmpVel.dInertiaCmpVelRawDecelGain "MICROSAR RTE" /begin SUB_GROUP /end SUB_GROUP /begin FUNCTION_LIST /end FUNCTION_LIST /begin REF_CHARACTERISTIC /end REF_CHARACTERISTIC /begin REF_MEASUREMENT InertiaCmpVel.dInertiaCmpVelRawDecelGain /end REF_MEASUREMENT /end GROUP
/begin GROUP InertiaCmpVel.dInertiaCmpVelScadDrvrVel "MICROSAR RTE" /begin SUB_GROUP /end SUB_GROUP /begin FUNCTION_LIST /end FUNCTION_LIST /begin REF_CHARACTERISTIC /end REF_CHARACTERISTIC /begin REF_MEASUREMENT InertiaCmpVel.dInertiaCmpVelScadDrvrVel /end REF_MEASUREMENT /end GROUP
/begin GROUP InertiaCmpVel.dInertiaCmpVelTqSnsrVelFildVal "MICROSAR RTE" /begin SUB_GROUP /end SUB_GROUP /begin FUNCTION_LIST /end FUNCTION_LIST /begin REF_CHARACTERISTIC /end REF_CHARACTERISTIC /begin REF_MEASUREMENT InertiaCmpVel.dInertiaCmpVelTqSnsrVelFildVal /end REF_MEASUREMENT /end GROUP
/begin GROUP LimrCdng "MICROSAR RTE"
 /begin SUB_GROUP LimrCdng.CalibrationPorts LimrCdng.PerInstanceMemories LimrCdng.ReceiverPorts LimrCdng.SenderPorts /end SUB_GROUP
 /begin FUNCTION_LIST /end FUNCTION_LIST
 /begin REF_CHARACTERISTIC /end REF_CHARACTERISTIC
 /begin REF_MEASUREMENT /end REF_MEASUREMENT
/end GROUP
/begin GROUP LimrCdng.CalibrationPorts "MICROSAR RTE"
 /begin SUB_GROUP LimrCdng.LimrCdngGainDecSlew.Val LimrCdng.LimrCdngGainIncSlewX.Ary1D LimrCdng.LimrCdngGainIncSlewY.Ary1D LimrCdng.LimrCdngTqDecSlew.Val LimrCdng.LimrCdngTqIncSlewX.Ary1D LimrCdng.LimrCdngTqIncSlewY.Ary1D /end SUB_GROUP
 /begin FUNCTION_LIST /end FUNCTION_LIST
 /begin REF_CHARACTERISTIC /end REF_CHARACTERISTIC
 /begin REF_MEASUREMENT /end REF_MEASUREMENT
/end GROUP
/begin GROUP LimrCdng.EotAssiSca.Val "MICROSAR RTE" /begin SUB_GROUP /end SUB_GROUP /begin FUNCTION_LIST /end FUNCTION_LIST /begin REF_CHARACTERISTIC /end REF_CHARACTERISTIC /begin REF_MEASUREMENT LimrCdng.EotAssiSca.Val /end REF_MEASUREMENT /end GROUP
/begin GROUP LimrCdng.EotAssiScaCdnd.Val "MICROSAR RTE" /begin SUB_GROUP /end SUB_GROUP /begin FUNCTION_LIST /end FUNCTION_LIST /begin REF_CHARACTERISTIC /end REF_CHARACTERISTIC /begin REF_MEASUREMENT LimrCdng.EotAssiScaCdnd.Val /end REF_MEASUREMENT /end GROUP
/begin GROUP LimrCdng.EotMotTqLim.Val "MICROSAR RTE" /begin SUB_GROUP /end SUB_GROUP /begin FUNCTION_LIST /end FUNCTION_LIST /begin REF_CHARACTERISTIC /end REF_CHARACTERISTIC /begin REF_MEASUREMENT LimrCdng.EotMotTqLim.Val /end REF_MEASUREMENT /end GROUP
/begin GROUP LimrCdng.EotMotTqLimCdnd.Val "MICROSAR RTE" /begin SUB_GROUP /end SUB_GROUP /begin FUNCTION_LIST /end FUNCTION_LIST /begin REF_CHARACTERISTIC /end REF_CHARACTERISTIC /begin REF_MEASUREMENT LimrCdng.EotMotTqLimCdnd.Val /end REF_MEASUREMENT /end GROUP
/begin GROUP LimrCdng.LimrCdngGainDecSlew.Val "MICROSAR RTE" /begin SUB_GROUP /end SUB_GROUP /begin FUNCTION_LIST /end FUNCTION_LIST /begin REF_CHARACTERISTIC LimrCdng.LimrCdngGainDecSlew.Val /end REF_CHARACTERISTIC /begin REF_MEASUREMENT /end REF_MEASUREMENT /end GROUP
/begin GROUP LimrCdng.LimrCdngGainIncSlewX.Ary1D "MICROSAR RTE" /begin SUB_GROUP /end SUB_GROUP /begin FUNCTION_LIST /end FUNCTION_LIST /begin REF_CHARACTERISTIC LimrCdng.LimrCdngGainIncSlewX.Ary1D /end REF_CHARACTERISTIC /begin REF_MEASUREMENT /end REF_MEASUREMENT /end GROUP
/begin GROUP LimrCdng.LimrCdngGainIncSlewY.Ary1D "MICROSAR RTE" /begin SUB_GROUP /end SUB_GROUP /begin FUNCTION_LIST /end FUNCTION_LIST /begin REF_CHARACTERISTIC LimrCdng.LimrCdngGainIncSlewY.Ary1D /end REF_CHARACTERISTIC /begin REF_MEASUREMENT /end REF_MEASUREMENT /end GROUP
/begin GROUP LimrCdng.LimrCdngTqDecSlew.Val "MICROSAR RTE" /begin SUB_GROUP /end SUB_GROUP /begin FUNCTION_LIST /end FUNCTION_LIST /begin REF_CHARACTERISTIC LimrCdng.LimrCdngTqDecSlew.Val /end REF_CHARACTERISTIC /begin REF_MEASUREMENT /end REF_MEASUREMENT /end GROUP
/begin GROUP LimrCdng.LimrCdngTqIncSlewX.Ary1D "MICROSAR RTE" /begin SUB_GROUP /end SUB_GROUP /begin FUNCTION_LIST /end FUNCTION_LIST /begin REF_CHARACTERISTIC LimrCdng.LimrCdngTqIncSlewX.Ary1D /end REF_CHARACTERISTIC /begin REF_MEASUREMENT /end REF_MEASUREMENT /end GROUP
/begin GROUP LimrCdng.LimrCdngTqIncSlewY.Ary1D "MICROSAR RTE" /begin SUB_GROUP /end SUB_GROUP /begin FUNCTION_LIST /end FUNCTION_LIST /begin REF_CHARACTERISTIC LimrCdng.LimrCdngTqIncSlewY.Ary1D /end REF_CHARACTERISTIC /begin REF_MEASUREMENT /end REF_MEASUREMENT /end GROUP
/begin GROUP LimrCdng.PerInstanceMemories "MICROSAR RTE"
 /begin SUB_GROUP LimrCdng.PrevEotAssiScaCdnd LimrCdng.PrevEotMotTqLimCdnd LimrCdng.PrevStallMotTqLimCdnd LimrCdng.PrevSysMotTqCmdScaCdnd LimrCdng.PrevThermMotTqLimCdnd LimrCdng.PrevVehSpdMotTqLimCdnd /end SUB_GROUP
 /begin FUNCTION_LIST /end FUNCTION_LIST
 /begin REF_CHARACTERISTIC /end REF_CHARACTERISTIC
 /begin REF_MEASUREMENT /end REF_MEASUREMENT
/end GROUP
/begin GROUP LimrCdng.PrevEotAssiScaCdnd "MICROSAR RTE" /begin SUB_GROUP /end SUB_GROUP /begin FUNCTION_LIST /end FUNCTION_LIST /begin REF_CHARACTERISTIC /end REF_CHARACTERISTIC /begin REF_MEASUREMENT LimrCdng.PrevEotAssiScaCdnd /end REF_MEASUREMENT /end GROUP
/begin GROUP LimrCdng.PrevEotMotTqLimCdnd "MICROSAR RTE" /begin SUB_GROUP /end SUB_GROUP /begin FUNCTION_LIST /end FUNCTION_LIST /begin REF_CHARACTERISTIC /end REF_CHARACTERISTIC /begin REF_MEASUREMENT LimrCdng.PrevEotMotTqLimCdnd /end REF_MEASUREMENT /end GROUP
/begin GROUP LimrCdng.PrevStallMotTqLimCdnd "MICROSAR RTE" /begin SUB_GROUP /end SUB_GROUP /begin FUNCTION_LIST /end FUNCTION_LIST /begin REF_CHARACTERISTIC /end REF_CHARACTERISTIC /begin REF_MEASUREMENT LimrCdng.PrevStallMotTqLimCdnd /end REF_MEASUREMENT /end GROUP
/begin GROUP LimrCdng.PrevSysMotTqCmdScaCdnd "MICROSAR RTE" /begin SUB_GROUP /end SUB_GROUP /begin FUNCTION_LIST /end FUNCTION_LIST /begin REF_CHARACTERISTIC /end REF_CHARACTERISTIC /begin REF_MEASUREMENT LimrCdng.PrevSysMotTqCmdScaCdnd /end REF_MEASUREMENT /end GROUP
/begin GROUP LimrCdng.PrevThermMotTqLimCdnd "MICROSAR RTE" /begin SUB_GROUP /end SUB_GROUP /begin FUNCTION_LIST /end FUNCTION_LIST /begin REF_CHARACTERISTIC /end REF_CHARACTERISTIC /begin REF_MEASUREMENT LimrCdng.PrevThermMotTqLimCdnd /end REF_MEASUREMENT /end GROUP
/begin GROUP LimrCdng.PrevVehSpdMotTqLimCdnd "MICROSAR RTE" /begin SUB_GROUP /end SUB_GROUP /begin FUNCTION_LIST /end FUNCTION_LIST /begin REF_CHARACTERISTIC /end REF_CHARACTERISTIC /begin REF_MEASUREMENT LimrCdng.PrevVehSpdMotTqLimCdnd /end REF_MEASUREMENT /end GROUP
/begin GROUP LimrCdng.ReceiverPorts "MICROSAR RTE"
 /begin SUB_GROUP LimrCdng.EotAssiSca.Val LimrCdng.EotMotTqLim.Val LimrCdng.StallMotTqLim.Val LimrCdng.SysMotTqCmdSca.Val LimrCdng.ThermMotTqLim.Val LimrCdng.VehSpd.Val LimrCdng.VehSpdMotTqLim.Val /end SUB_GROUP
 /begin FUNCTION_LIST /end FUNCTION_LIST
 /begin REF_CHARACTERISTIC /end REF_CHARACTERISTIC
 /begin REF_MEASUREMENT /end REF_MEASUREMENT
/end GROUP
/begin GROUP LimrCdng.SenderPorts "MICROSAR RTE"
 /begin SUB_GROUP LimrCdng.EotAssiScaCdnd.Val LimrCdng.EotMotTqLimCdnd.Val LimrCdng.StallMotTqLimCdnd.Val LimrCdng.SysMotTqCmdScaCdnd.Val LimrCdng.ThermMotTqLimCdnd.Val LimrCdng.VehSpdMotTqLimCdnd.Val /end SUB_GROUP
 /begin FUNCTION_LIST /end FUNCTION_LIST
 /begin REF_CHARACTERISTIC /end REF_CHARACTERISTIC
 /begin REF_MEASUREMENT /end REF_MEASUREMENT
/end GROUP
/begin GROUP LimrCdng.StallMotTqLim.Val "MICROSAR RTE" /begin SUB_GROUP /end SUB_GROUP /begin FUNCTION_LIST /end FUNCTION_LIST /begin REF_CHARACTERISTIC /end REF_CHARACTERISTIC /begin REF_MEASUREMENT LimrCdng.StallMotTqLim.Val /end REF_MEASUREMENT /end GROUP
/begin GROUP LimrCdng.StallMotTqLimCdnd.Val "MICROSAR RTE" /begin SUB_GROUP /end SUB_GROUP /begin FUNCTION_LIST /end FUNCTION_LIST /begin REF_CHARACTERISTIC /end REF_CHARACTERISTIC /begin REF_MEASUREMENT LimrCdng.StallMotTqLimCdnd.Val /end REF_MEASUREMENT /end GROUP
/begin GROUP LimrCdng.SysMotTqCmdSca.Val "MICROSAR RTE" /begin SUB_GROUP /end SUB_GROUP /begin FUNCTION_LIST /end FUNCTION_LIST /begin REF_CHARACTERISTIC /end REF_CHARACTERISTIC /begin REF_MEASUREMENT LimrCdng.SysMotTqCmdSca.Val /end REF_MEASUREMENT /end GROUP
/begin GROUP LimrCdng.SysMotTqCmdScaCdnd.Val "MICROSAR RTE" /begin SUB_GROUP /end SUB_GROUP /begin FUNCTION_LIST /end FUNCTION_LIST /begin REF_CHARACTERISTIC /end REF_CHARACTERISTIC /begin REF_MEASUREMENT LimrCdng.SysMotTqCmdScaCdnd.Val /end REF_MEASUREMENT /end GROUP
/begin GROUP LimrCdng.ThermMotTqLim.Val "MICROSAR RTE" /begin SUB_GROUP /end SUB_GROUP /begin FUNCTION_LIST /end FUNCTION_LIST /begin REF_CHARACTERISTIC /end REF_CHARACTERISTIC /begin REF_MEASUREMENT LimrCdng.ThermMotTqLim.Val /end REF_MEASUREMENT /end GROUP
/begin GROUP LimrCdng.ThermMotTqLimCdnd.Val "MICROSAR RTE" /begin SUB_GROUP /end SUB_GROUP /begin FUNCTION_LIST /end FUNCTION_LIST /begin REF_CHARACTERISTIC /end REF_CHARACTERISTIC /begin REF_MEASUREMENT LimrCdng.ThermMotTqLimCdnd.Val /end REF_MEASUREMENT /end GROUP
/begin GROUP LimrCdng.VehSpd.Val "MICROSAR RTE" /begin SUB_GROUP /end SUB_GROUP /begin FUNCTION_LIST /end FUNCTION_LIST /begin REF_CHARACTERISTIC /end REF_CHARACTERISTIC /begin REF_MEASUREMENT LimrCdng.VehSpd.Val /end REF_MEASUREMENT /end GROUP
/begin GROUP LimrCdng.VehSpdMotTqLim.Val "MICROSAR RTE" /begin SUB_GROUP /end SUB_GROUP /begin FUNCTION_LIST /end FUNCTION_LIST /begin REF_CHARACTERISTIC /end REF_CHARACTERISTIC /begin REF_MEASUREMENT LimrCdng.VehSpdMotTqLim.Val /end REF_MEASUREMENT /end GROUP
/begin GROUP LimrCdng.VehSpdMotTqLimCdnd.Val "MICROSAR RTE" /begin SUB_GROUP /end SUB_GROUP /begin FUNCTION_LIST /end FUNCTION_LIST /begin REF_CHARACTERISTIC /end REF_CHARACTERISTIC /begin REF_MEASUREMENT LimrCdng.VehSpdMotTqLimCdnd.Val /end REF_MEASUREMENT /end GROUP
/begin GROUP LoaMgr "MICROSAR RTE"
 /begin SUB_GROUP LoaMgr.CalibrationPorts LoaMgr.PerInstanceMemories LoaMgr.ReceiverPorts LoaMgr.SenderPorts /end SUB_GROUP
 /begin FUNCTION_LIST /end FUNCTION_LIST
 /begin REF_CHARACTERISTIC /end REF_CHARACTERISTIC
 /begin REF_MEASUREMENT /end REF_MEASUREMENT
/end GROUP
/begin GROUP LoaMgr.CalibrationPorts "MICROSAR RTE"
 /begin SUB_GROUP LoaMgr.LoaMgrCurrIvtrMtgtnRate.Val LoaMgr.LoaMgrCurrIvtrMtgtnSca.Val LoaMgr.LoaMgrCurrIvtrMtgtnScaZeroEna.Logl LoaMgr.LoaMgrCurrMeasIdptSig0Resp.Val LoaMgr.LoaMgrCurrMeasIdptSig1Resp.Val LoaMgr.LoaMgrCurrMeasIdptSig2Resp.Val LoaMgr.LoaMgrCurrMeasIdptSigFltThd.Val LoaMgr.LoaMgrCurrMeasMtgtnRate.Val LoaMgr.LoaMgrCurrMeasMtgtnSca.Val LoaMgr.LoaMgrCurrMeasMtgtnScaZeroEna.Logl LoaMgr.LoaMgrFadeOutStRate.Val LoaMgr.LoaMgrHwTqIdptSig0NoTqLoaResp.Val LoaMgr.LoaMgrHwTqIdptSig1NoTqLoaResp.Val LoaMgr.LoaMgrHwTqIdptSig2Resp.Val LoaMgr.LoaMgrHwTqIdptSig4Resp.Val LoaMgr.LoaMgrHwTqIdptSigFltThd.Val LoaMgr.LoaMgrHwTqLoaAvlResp.Val LoaMgr.LoaMgrIvtrIdptSig0Resp.Val LoaMgr.LoaMgrIvtrIdptSig1Resp.Val LoaMgr.LoaMgrIvtrIdptSig2Resp.Val LoaMgr.LoaMgrIvtrIdptSigFltThd.Val LoaMgr.LoaMgrIvtrMtgtnRate.Val LoaMgr.LoaMgrIvtrMtgtnSca.Val LoaMgr.LoaMgrIvtrMtgtnScaZeroEna.Logl LoaMgr.LoaMgrLimdStRate.Val LoaMgr.LoaMgrLimdStSca.Val LoaMgr.LoaMgrMotAgAvlSnsrlsResp.Val LoaMgr.LoaMgrMotAgIdptSig0NoSnsrlsResp.Val LoaMgr.LoaMgrMotAgIdptSig1NoSnsrlsResp.Val LoaMgr.LoaMgrMotAgIdptSig2Resp.Val LoaMgr.LoaMgrMotAgIdptSig3Resp.Val LoaMgr.LoaMgrMotAgIdptSigFltThd.Val LoaMgr.LoaMgrMotAgMtgtnRate.Val LoaMgr.LoaMgrMotAgMtgtnSca.Val LoaMgr.LoaMgrMotAgMtgtnScaZeroEna.Logl /end SUB_GROUP
 /begin FUNCTION_LIST /end FUNCTION_LIST
 /begin REF_CHARACTERISTIC /end REF_CHARACTERISTIC
 /begin REF_MEASUREMENT /end REF_MEASUREMENT
/end GROUP
/begin GROUP LoaMgr.CurrMeasIdptSig.Val "MICROSAR RTE" /begin SUB_GROUP /end SUB_GROUP /begin FUNCTION_LIST /end FUNCTION_LIST /begin REF_CHARACTERISTIC /end REF_CHARACTERISTIC /begin REF_MEASUREMENT LoaMgr.CurrMeasIdptSig.Val /end REF_MEASUREMENT /end GROUP
/begin GROUP LoaMgr.CurrMeasLoaMtgtnEna.Logl "MICROSAR RTE" /begin SUB_GROUP /end SUB_GROUP /begin FUNCTION_LIST /end FUNCTION_LIST /begin REF_CHARACTERISTIC /end REF_CHARACTERISTIC /begin REF_MEASUREMENT LoaMgr.CurrMeasLoaMtgtnEna.Logl /end REF_MEASUREMENT /end GROUP
/begin GROUP LoaMgr.DiagcStsIvtr1Inactv.Logl "MICROSAR RTE" /begin SUB_GROUP /end SUB_GROUP /begin FUNCTION_LIST /end FUNCTION_LIST /begin REF_CHARACTERISTIC /end REF_CHARACTERISTIC /begin REF_MEASUREMENT LoaMgr.DiagcStsIvtr1Inactv.Logl /end REF_MEASUREMENT /end GROUP
/begin GROUP LoaMgr.DiagcStsIvtr2Inactv.Logl "MICROSAR RTE" /begin SUB_GROUP /end SUB_GROUP /begin FUNCTION_LIST /end FUNCTION_LIST /begin REF_CHARACTERISTIC /end REF_CHARACTERISTIC /begin REF_MEASUREMENT LoaMgr.DiagcStsIvtr2Inactv.Logl /end REF_MEASUREMENT /end GROUP
/begin GROUP LoaMgr.HwTqIdptSig.Val "MICROSAR RTE" /begin SUB_GROUP /end SUB_GROUP /begin FUNCTION_LIST /end FUNCTION_LIST /begin REF_CHARACTERISTIC /end REF_CHARACTERISTIC /begin REF_MEASUREMENT LoaMgr.HwTqIdptSig.Val /end REF_MEASUREMENT /end GROUP
/begin GROUP LoaMgr.HwTqLoaMtgtnEna.Logl "MICROSAR RTE" /begin SUB_GROUP /end SUB_GROUP /begin FUNCTION_LIST /end FUNCTION_LIST /begin REF_CHARACTERISTIC /end REF_CHARACTERISTIC /begin REF_MEASUREMENT LoaMgr.HwTqLoaMtgtnEna.Logl /end REF_MEASUREMENT /end GROUP
/begin GROUP LoaMgr.IvtrLoaMtgtnEna.Logl "MICROSAR RTE" /begin SUB_GROUP /end SUB_GROUP /begin FUNCTION_LIST /end FUNCTION_LIST /begin REF_CHARACTERISTIC /end REF_CHARACTERISTIC /begin REF_MEASUREMENT LoaMgr.IvtrLoaMtgtnEna.Logl /end REF_MEASUREMENT /end GROUP
/begin GROUP LoaMgr.LoaMgrCurrIvtrMtgtnRate.Val "MICROSAR RTE" /begin SUB_GROUP /end SUB_GROUP /begin FUNCTION_LIST /end FUNCTION_LIST /begin REF_CHARACTERISTIC LoaMgr.LoaMgrCurrIvtrMtgtnRate.Val /end REF_CHARACTERISTIC /begin REF_MEASUREMENT /end REF_MEASUREMENT /end GROUP
/begin GROUP LoaMgr.LoaMgrCurrIvtrMtgtnSca.Val "MICROSAR RTE" /begin SUB_GROUP /end SUB_GROUP /begin FUNCTION_LIST /end FUNCTION_LIST /begin REF_CHARACTERISTIC LoaMgr.LoaMgrCurrIvtrMtgtnSca.Val /end REF_CHARACTERISTIC /begin REF_MEASUREMENT /end REF_MEASUREMENT /end GROUP
/begin GROUP LoaMgr.LoaMgrCurrIvtrMtgtnScaZeroEna.Logl "MICROSAR RTE" /begin SUB_GROUP /end SUB_GROUP /begin FUNCTION_LIST /end FUNCTION_LIST /begin REF_CHARACTERISTIC LoaMgr.LoaMgrCurrIvtrMtgtnScaZeroEna.Logl /end REF_CHARACTERISTIC /begin REF_MEASUREMENT /end REF_MEASUREMENT /end GROUP
/begin GROUP LoaMgr.LoaMgrCurrMeasIdptSig0Resp.Val "MICROSAR RTE" /begin SUB_GROUP /end SUB_GROUP /begin FUNCTION_LIST /end FUNCTION_LIST /begin REF_CHARACTERISTIC LoaMgr.LoaMgrCurrMeasIdptSig0Resp.Val /end REF_CHARACTERISTIC /begin REF_MEASUREMENT /end REF_MEASUREMENT /end GROUP
/begin GROUP LoaMgr.LoaMgrCurrMeasIdptSig1Resp.Val "MICROSAR RTE" /begin SUB_GROUP /end SUB_GROUP /begin FUNCTION_LIST /end FUNCTION_LIST /begin REF_CHARACTERISTIC LoaMgr.LoaMgrCurrMeasIdptSig1Resp.Val /end REF_CHARACTERISTIC /begin REF_MEASUREMENT /end REF_MEASUREMENT /end GROUP
/begin GROUP LoaMgr.LoaMgrCurrMeasIdptSig2Resp.Val "MICROSAR RTE" /begin SUB_GROUP /end SUB_GROUP /begin FUNCTION_LIST /end FUNCTION_LIST /begin REF_CHARACTERISTIC LoaMgr.LoaMgrCurrMeasIdptSig2Resp.Val /end REF_CHARACTERISTIC /begin REF_MEASUREMENT /end REF_MEASUREMENT /end GROUP
/begin GROUP LoaMgr.LoaMgrCurrMeasIdptSigFltThd.Val "MICROSAR RTE" /begin SUB_GROUP /end SUB_GROUP /begin FUNCTION_LIST /end FUNCTION_LIST /begin REF_CHARACTERISTIC LoaMgr.LoaMgrCurrMeasIdptSigFltThd.Val /end REF_CHARACTERISTIC /begin REF_MEASUREMENT /end REF_MEASUREMENT /end GROUP
/begin GROUP LoaMgr.LoaMgrCurrMeasMtgtnRate.Val "MICROSAR RTE" /begin SUB_GROUP /end SUB_GROUP /begin FUNCTION_LIST /end FUNCTION_LIST /begin REF_CHARACTERISTIC LoaMgr.LoaMgrCurrMeasMtgtnRate.Val /end REF_CHARACTERISTIC /begin REF_MEASUREMENT /end REF_MEASUREMENT /end GROUP
/begin GROUP LoaMgr.LoaMgrCurrMeasMtgtnSca.Val "MICROSAR RTE" /begin SUB_GROUP /end SUB_GROUP /begin FUNCTION_LIST /end FUNCTION_LIST /begin REF_CHARACTERISTIC LoaMgr.LoaMgrCurrMeasMtgtnSca.Val /end REF_CHARACTERISTIC /begin REF_MEASUREMENT /end REF_MEASUREMENT /end GROUP
/begin GROUP LoaMgr.LoaMgrCurrMeasMtgtnScaZeroEna.Logl "MICROSAR RTE" /begin SUB_GROUP /end SUB_GROUP /begin FUNCTION_LIST /end FUNCTION_LIST /begin REF_CHARACTERISTIC LoaMgr.LoaMgrCurrMeasMtgtnScaZeroEna.Logl /end REF_CHARACTERISTIC /begin REF_MEASUREMENT /end REF_MEASUREMENT /end GROUP
/begin GROUP LoaMgr.LoaMgrFadeOutStRate.Val "MICROSAR RTE" /begin SUB_GROUP /end SUB_GROUP /begin FUNCTION_LIST /end FUNCTION_LIST /begin REF_CHARACTERISTIC LoaMgr.LoaMgrFadeOutStRate.Val /end REF_CHARACTERISTIC /begin REF_MEASUREMENT /end REF_MEASUREMENT /end GROUP
/begin GROUP LoaMgr.LoaMgrHwTqIdptSig0NoTqLoaResp.Val "MICROSAR RTE" /begin SUB_GROUP /end SUB_GROUP /begin FUNCTION_LIST /end FUNCTION_LIST /begin REF_CHARACTERISTIC LoaMgr.LoaMgrHwTqIdptSig0NoTqLoaResp.Val /end REF_CHARACTERISTIC /begin REF_MEASUREMENT /end REF_MEASUREMENT /end GROUP
/begin GROUP LoaMgr.LoaMgrHwTqIdptSig1NoTqLoaResp.Val "MICROSAR RTE" /begin SUB_GROUP /end SUB_GROUP /begin FUNCTION_LIST /end FUNCTION_LIST /begin REF_CHARACTERISTIC LoaMgr.LoaMgrHwTqIdptSig1NoTqLoaResp.Val /end REF_CHARACTERISTIC /begin REF_MEASUREMENT /end REF_MEASUREMENT /end GROUP
/begin GROUP LoaMgr.LoaMgrHwTqIdptSig2Resp.Val "MICROSAR RTE" /begin SUB_GROUP /end SUB_GROUP /begin FUNCTION_LIST /end FUNCTION_LIST /begin REF_CHARACTERISTIC LoaMgr.LoaMgrHwTqIdptSig2Resp.Val /end REF_CHARACTERISTIC /begin REF_MEASUREMENT /end REF_MEASUREMENT /end GROUP
/begin GROUP LoaMgr.LoaMgrHwTqIdptSig4Resp.Val "MICROSAR RTE" /begin SUB_GROUP /end SUB_GROUP /begin FUNCTION_LIST /end FUNCTION_LIST /begin REF_CHARACTERISTIC LoaMgr.LoaMgrHwTqIdptSig4Resp.Val /end REF_CHARACTERISTIC /begin REF_MEASUREMENT /end REF_MEASUREMENT /end GROUP
/begin GROUP LoaMgr.LoaMgrHwTqIdptSigFltThd.Val "MICROSAR RTE" /begin SUB_GROUP /end SUB_GROUP /begin FUNCTION_LIST /end FUNCTION_LIST /begin REF_CHARACTERISTIC LoaMgr.LoaMgrHwTqIdptSigFltThd.Val /end REF_CHARACTERISTIC /begin REF_MEASUREMENT /end REF_MEASUREMENT /end GROUP
/begin GROUP LoaMgr.LoaMgrHwTqLoaAvlResp.Val "MICROSAR RTE" /begin SUB_GROUP /end SUB_GROUP /begin FUNCTION_LIST /end FUNCTION_LIST /begin REF_CHARACTERISTIC LoaMgr.LoaMgrHwTqLoaAvlResp.Val /end REF_CHARACTERISTIC /begin REF_MEASUREMENT /end REF_MEASUREMENT /end GROUP
/begin GROUP LoaMgr.LoaMgrIvtrIdptSig0Resp.Val "MICROSAR RTE" /begin SUB_GROUP /end SUB_GROUP /begin FUNCTION_LIST /end FUNCTION_LIST /begin REF_CHARACTERISTIC LoaMgr.LoaMgrIvtrIdptSig0Resp.Val /end REF_CHARACTERISTIC /begin REF_MEASUREMENT /end REF_MEASUREMENT /end GROUP
/begin GROUP LoaMgr.LoaMgrIvtrIdptSig1Resp.Val "MICROSAR RTE" /begin SUB_GROUP /end SUB_GROUP /begin FUNCTION_LIST /end FUNCTION_LIST /begin REF_CHARACTERISTIC LoaMgr.LoaMgrIvtrIdptSig1Resp.Val /end REF_CHARACTERISTIC /begin REF_MEASUREMENT /end REF_MEASUREMENT /end GROUP
/begin GROUP LoaMgr.LoaMgrIvtrIdptSig2Resp.Val "MICROSAR RTE" /begin SUB_GROUP /end SUB_GROUP /begin FUNCTION_LIST /end FUNCTION_LIST /begin REF_CHARACTERISTIC LoaMgr.LoaMgrIvtrIdptSig2Resp.Val /end REF_CHARACTERISTIC /begin REF_MEASUREMENT /end REF_MEASUREMENT /end GROUP
/begin GROUP LoaMgr.LoaMgrIvtrIdptSigFltThd.Val "MICROSAR RTE" /begin SUB_GROUP /end SUB_GROUP /begin FUNCTION_LIST /end FUNCTION_LIST /begin REF_CHARACTERISTIC LoaMgr.LoaMgrIvtrIdptSigFltThd.Val /end REF_CHARACTERISTIC /begin REF_MEASUREMENT /end REF_MEASUREMENT /end GROUP
/begin GROUP LoaMgr.LoaMgrIvtrMtgtnRate.Val "MICROSAR RTE" /begin SUB_GROUP /end SUB_GROUP /begin FUNCTION_LIST /end FUNCTION_LIST /begin REF_CHARACTERISTIC LoaMgr.LoaMgrIvtrMtgtnRate.Val /end REF_CHARACTERISTIC /begin REF_MEASUREMENT /end REF_MEASUREMENT /end GROUP
/begin GROUP LoaMgr.LoaMgrIvtrMtgtnSca.Val "MICROSAR RTE" /begin SUB_GROUP /end SUB_GROUP /begin FUNCTION_LIST /end FUNCTION_LIST /begin REF_CHARACTERISTIC LoaMgr.LoaMgrIvtrMtgtnSca.Val /end REF_CHARACTERISTIC /begin REF_MEASUREMENT /end REF_MEASUREMENT /end GROUP
/begin GROUP LoaMgr.LoaMgrIvtrMtgtnScaZeroEna.Logl "MICROSAR RTE" /begin SUB_GROUP /end SUB_GROUP /begin FUNCTION_LIST /end FUNCTION_LIST /begin REF_CHARACTERISTIC LoaMgr.LoaMgrIvtrMtgtnScaZeroEna.Logl /end REF_CHARACTERISTIC /begin REF_MEASUREMENT /end REF_MEASUREMENT /end GROUP
/begin GROUP LoaMgr.LoaMgrLimdStRate.Val "MICROSAR RTE" /begin SUB_GROUP /end SUB_GROUP /begin FUNCTION_LIST /end FUNCTION_LIST /begin REF_CHARACTERISTIC LoaMgr.LoaMgrLimdStRate.Val /end REF_CHARACTERISTIC /begin REF_MEASUREMENT /end REF_MEASUREMENT /end GROUP
/begin GROUP LoaMgr.LoaMgrLimdStSca.Val "MICROSAR RTE" /begin SUB_GROUP /end SUB_GROUP /begin FUNCTION_LIST /end FUNCTION_LIST /begin REF_CHARACTERISTIC LoaMgr.LoaMgrLimdStSca.Val /end REF_CHARACTERISTIC /begin REF_MEASUREMENT /end REF_MEASUREMENT /end GROUP
/begin GROUP LoaMgr.LoaMgrMotAgAvlSnsrlsResp.Val "MICROSAR RTE" /begin SUB_GROUP /end SUB_GROUP /begin FUNCTION_LIST /end FUNCTION_LIST /begin REF_CHARACTERISTIC LoaMgr.LoaMgrMotAgAvlSnsrlsResp.Val /end REF_CHARACTERISTIC /begin REF_MEASUREMENT /end REF_MEASUREMENT /end GROUP
/begin GROUP LoaMgr.LoaMgrMotAgIdptSig0NoSnsrlsResp.Val "MICROSAR RTE" /begin SUB_GROUP /end SUB_GROUP /begin FUNCTION_LIST /end FUNCTION_LIST /begin REF_CHARACTERISTIC LoaMgr.LoaMgrMotAgIdptSig0NoSnsrlsResp.Val /end REF_CHARACTERISTIC /begin REF_MEASUREMENT /end REF_MEASUREMENT /end GROUP
/begin GROUP LoaMgr.LoaMgrMotAgIdptSig1NoSnsrlsResp.Val "MICROSAR RTE" /begin SUB_GROUP /end SUB_GROUP /begin FUNCTION_LIST /end FUNCTION_LIST /begin REF_CHARACTERISTIC LoaMgr.LoaMgrMotAgIdptSig1NoSnsrlsResp.Val /end REF_CHARACTERISTIC /begin REF_MEASUREMENT /end REF_MEASUREMENT /end GROUP
/begin GROUP LoaMgr.LoaMgrMotAgIdptSig2Resp.Val "MICROSAR RTE" /begin SUB_GROUP /end SUB_GROUP /begin FUNCTION_LIST /end FUNCTION_LIST /begin REF_CHARACTERISTIC LoaMgr.LoaMgrMotAgIdptSig2Resp.Val /end REF_CHARACTERISTIC /begin REF_MEASUREMENT /end REF_MEASUREMENT /end GROUP
/begin GROUP LoaMgr.LoaMgrMotAgIdptSig3Resp.Val "MICROSAR RTE" /begin SUB_GROUP /end SUB_GROUP /begin FUNCTION_LIST /end FUNCTION_LIST /begin REF_CHARACTERISTIC LoaMgr.LoaMgrMotAgIdptSig3Resp.Val /end REF_CHARACTERISTIC /begin REF_MEASUREMENT /end REF_MEASUREMENT /end GROUP
/begin GROUP LoaMgr.LoaMgrMotAgIdptSigFltThd.Val "MICROSAR RTE" /begin SUB_GROUP /end SUB_GROUP /begin FUNCTION_LIST /end FUNCTION_LIST /begin REF_CHARACTERISTIC LoaMgr.LoaMgrMotAgIdptSigFltThd.Val /end REF_CHARACTERISTIC /begin REF_MEASUREMENT /end REF_MEASUREMENT /end GROUP
/begin GROUP LoaMgr.LoaMgrMotAgMtgtnRate.Val "MICROSAR RTE" /begin SUB_GROUP /end SUB_GROUP /begin FUNCTION_LIST /end FUNCTION_LIST /begin REF_CHARACTERISTIC LoaMgr.LoaMgrMotAgMtgtnRate.Val /end REF_CHARACTERISTIC /begin REF_MEASUREMENT /end REF_MEASUREMENT /end GROUP
/begin GROUP LoaMgr.LoaMgrMotAgMtgtnSca.Val "MICROSAR RTE" /begin SUB_GROUP /end SUB_GROUP /begin FUNCTION_LIST /end FUNCTION_LIST /begin REF_CHARACTERISTIC LoaMgr.LoaMgrMotAgMtgtnSca.Val /end REF_CHARACTERISTIC /begin REF_MEASUREMENT /end REF_MEASUREMENT /end GROUP
/begin GROUP LoaMgr.LoaMgrMotAgMtgtnScaZeroEna.Logl "MICROSAR RTE" /begin SUB_GROUP /end SUB_GROUP /begin FUNCTION_LIST /end FUNCTION_LIST /begin REF_CHARACTERISTIC LoaMgr.LoaMgrMotAgMtgtnScaZeroEna.Logl /end REF_CHARACTERISTIC /begin REF_MEASUREMENT /end REF_MEASUREMENT /end GROUP
/begin GROUP LoaMgr.LoaRateLim.Val "MICROSAR RTE" /begin SUB_GROUP /end SUB_GROUP /begin FUNCTION_LIST /end FUNCTION_LIST /begin REF_CHARACTERISTIC /end REF_CHARACTERISTIC /begin REF_MEASUREMENT LoaMgr.LoaRateLim.Val /end REF_MEASUREMENT /end GROUP
/begin GROUP LoaMgr.LoaSca.Val "MICROSAR RTE" /begin SUB_GROUP /end SUB_GROUP /begin FUNCTION_LIST /end FUNCTION_LIST /begin REF_CHARACTERISTIC /end REF_CHARACTERISTIC /begin REF_MEASUREMENT LoaMgr.LoaSca.Val /end REF_MEASUREMENT /end GROUP
/begin GROUP LoaMgr.LoaScaDi.Logl "MICROSAR RTE" /begin SUB_GROUP /end SUB_GROUP /begin FUNCTION_LIST /end FUNCTION_LIST /begin REF_CHARACTERISTIC /end REF_CHARACTERISTIC /begin REF_MEASUREMENT LoaMgr.LoaScaDi.Logl /end REF_MEASUREMENT /end GROUP
/begin GROUP LoaMgr.LoaSt.Val "MICROSAR RTE" /begin SUB_GROUP /end SUB_GROUP /begin FUNCTION_LIST /end FUNCTION_LIST /begin REF_CHARACTERISTIC /end REF_CHARACTERISTIC /begin REF_MEASUREMENT LoaMgr.LoaSt.Val /end REF_MEASUREMENT /end GROUP
/begin GROUP LoaMgr.MotAgLoaMtgtnEna.Logl "MICROSAR RTE" /begin SUB_GROUP /end SUB_GROUP /begin FUNCTION_LIST /end FUNCTION_LIST /begin REF_CHARACTERISTIC /end REF_CHARACTERISTIC /begin REF_MEASUREMENT LoaMgr.MotAgLoaMtgtnEna.Logl /end REF_MEASUREMENT /end GROUP
/begin GROUP LoaMgr.MotAgMeclIdptSig.Val "MICROSAR RTE" /begin SUB_GROUP /end SUB_GROUP /begin FUNCTION_LIST /end FUNCTION_LIST /begin REF_CHARACTERISTIC /end REF_CHARACTERISTIC /begin REF_MEASUREMENT LoaMgr.MotAgMeclIdptSig.Val /end REF_MEASUREMENT /end GROUP
/begin GROUP LoaMgr.MotAgSnsrlsAvl.Logl "MICROSAR RTE" /begin SUB_GROUP /end SUB_GROUP /begin FUNCTION_LIST /end FUNCTION_LIST /begin REF_CHARACTERISTIC /end REF_CHARACTERISTIC /begin REF_MEASUREMENT LoaMgr.MotAgSnsrlsAvl.Logl /end REF_MEASUREMENT /end GROUP
/begin GROUP LoaMgr.PerInstanceMemories "MICROSAR RTE"
 /begin SUB_GROUP LoaMgr.PrevCurrMeasIdptSigResp LoaMgr.PrevCurrMeasIdptSigVal LoaMgr.PrevCurrMeasLoaStSwMtgtnEna LoaMgr.PrevHwTqIdptSigResp LoaMgr.PrevHwTqIdptSigVal LoaMgr.PrevHwTqLoaStSwMtgtnEna LoaMgr.PrevIvtrIdptSigResp LoaMgr.PrevIvtrIdptSigVal LoaMgr.PrevIvtrLoaStSwMtgtnEna LoaMgr.PrevMotAgLoaMtgtnEna LoaMgr.PrevMotAgLoaStSwMtgtnEna LoaMgr.PrevMotAgMeclIdptSigResp LoaMgr.PrevMotAgMeclIdptSigVal LoaMgr.PrevVltgModSrc /end SUB_GROUP
 /begin FUNCTION_LIST /end FUNCTION_LIST
 /begin REF_CHARACTERISTIC /end REF_CHARACTERISTIC
 /begin REF_MEASUREMENT /end REF_MEASUREMENT
/end GROUP
/begin GROUP LoaMgr.PrevCurrMeasIdptSigResp "MICROSAR RTE" /begin SUB_GROUP /end SUB_GROUP /begin FUNCTION_LIST /end FUNCTION_LIST /begin REF_CHARACTERISTIC /end REF_CHARACTERISTIC /begin REF_MEASUREMENT LoaMgr.PrevCurrMeasIdptSigResp /end REF_MEASUREMENT /end GROUP
/begin GROUP LoaMgr.PrevCurrMeasIdptSigVal "MICROSAR RTE" /begin SUB_GROUP /end SUB_GROUP /begin FUNCTION_LIST /end FUNCTION_LIST /begin REF_CHARACTERISTIC /end REF_CHARACTERISTIC /begin REF_MEASUREMENT LoaMgr.PrevCurrMeasIdptSigVal /end REF_MEASUREMENT /end GROUP
/begin GROUP LoaMgr.PrevCurrMeasLoaStSwMtgtnEna "MICROSAR RTE" /begin SUB_GROUP /end SUB_GROUP /begin FUNCTION_LIST /end FUNCTION_LIST /begin REF_CHARACTERISTIC /end REF_CHARACTERISTIC /begin REF_MEASUREMENT LoaMgr.PrevCurrMeasLoaStSwMtgtnEna /end REF_MEASUREMENT /end GROUP
/begin GROUP LoaMgr.PrevHwTqIdptSigResp "MICROSAR RTE" /begin SUB_GROUP /end SUB_GROUP /begin FUNCTION_LIST /end FUNCTION_LIST /begin REF_CHARACTERISTIC /end REF_CHARACTERISTIC /begin REF_MEASUREMENT LoaMgr.PrevHwTqIdptSigResp /end REF_MEASUREMENT /end GROUP
/begin GROUP LoaMgr.PrevHwTqIdptSigVal "MICROSAR RTE" /begin SUB_GROUP /end SUB_GROUP /begin FUNCTION_LIST /end FUNCTION_LIST /begin REF_CHARACTERISTIC /end REF_CHARACTERISTIC /begin REF_MEASUREMENT LoaMgr.PrevHwTqIdptSigVal /end REF_MEASUREMENT /end GROUP
/begin GROUP LoaMgr.PrevHwTqLoaStSwMtgtnEna "MICROSAR RTE" /begin SUB_GROUP /end SUB_GROUP /begin FUNCTION_LIST /end FUNCTION_LIST /begin REF_CHARACTERISTIC /end REF_CHARACTERISTIC /begin REF_MEASUREMENT LoaMgr.PrevHwTqLoaStSwMtgtnEna /end REF_MEASUREMENT /end GROUP
/begin GROUP LoaMgr.PrevIvtrIdptSigResp "MICROSAR RTE" /begin SUB_GROUP /end SUB_GROUP /begin FUNCTION_LIST /end FUNCTION_LIST /begin REF_CHARACTERISTIC /end REF_CHARACTERISTIC /begin REF_MEASUREMENT LoaMgr.PrevIvtrIdptSigResp /end REF_MEASUREMENT /end GROUP
/begin GROUP LoaMgr.PrevIvtrIdptSigVal "MICROSAR RTE" /begin SUB_GROUP /end SUB_GROUP /begin FUNCTION_LIST /end FUNCTION_LIST /begin REF_CHARACTERISTIC /end REF_CHARACTERISTIC /begin REF_MEASUREMENT LoaMgr.PrevIvtrIdptSigVal /end REF_MEASUREMENT /end GROUP
/begin GROUP LoaMgr.PrevIvtrLoaStSwMtgtnEna "MICROSAR RTE" /begin SUB_GROUP /end SUB_GROUP /begin FUNCTION_LIST /end FUNCTION_LIST /begin REF_CHARACTERISTIC /end REF_CHARACTERISTIC /begin REF_MEASUREMENT LoaMgr.PrevIvtrLoaStSwMtgtnEna /end REF_MEASUREMENT /end GROUP
/begin GROUP LoaMgr.PrevMotAgLoaMtgtnEna "MICROSAR RTE" /begin SUB_GROUP /end SUB_GROUP /begin FUNCTION_LIST /end FUNCTION_LIST /begin REF_CHARACTERISTIC /end REF_CHARACTERISTIC /begin REF_MEASUREMENT LoaMgr.PrevMotAgLoaMtgtnEna /end REF_MEASUREMENT /end GROUP
/begin GROUP LoaMgr.PrevMotAgLoaStSwMtgtnEna "MICROSAR RTE" /begin SUB_GROUP /end SUB_GROUP /begin FUNCTION_LIST /end FUNCTION_LIST /begin REF_CHARACTERISTIC /end REF_CHARACTERISTIC /begin REF_MEASUREMENT LoaMgr.PrevMotAgLoaStSwMtgtnEna /end REF_MEASUREMENT /end GROUP
/begin GROUP LoaMgr.PrevMotAgMeclIdptSigResp "MICROSAR RTE" /begin SUB_GROUP /end SUB_GROUP /begin FUNCTION_LIST /end FUNCTION_LIST /begin REF_CHARACTERISTIC /end REF_CHARACTERISTIC /begin REF_MEASUREMENT LoaMgr.PrevMotAgMeclIdptSigResp /end REF_MEASUREMENT /end GROUP
/begin GROUP LoaMgr.PrevMotAgMeclIdptSigVal "MICROSAR RTE" /begin SUB_GROUP /end SUB_GROUP /begin FUNCTION_LIST /end FUNCTION_LIST /begin REF_CHARACTERISTIC /end REF_CHARACTERISTIC /begin REF_MEASUREMENT LoaMgr.PrevMotAgMeclIdptSigVal /end REF_MEASUREMENT /end GROUP
/begin GROUP LoaMgr.PrevVltgModSrc "MICROSAR RTE" /begin SUB_GROUP /end SUB_GROUP /begin FUNCTION_LIST /end FUNCTION_LIST /begin REF_CHARACTERISTIC /end REF_CHARACTERISTIC /begin REF_MEASUREMENT LoaMgr.PrevVltgModSrc /end REF_MEASUREMENT /end GROUP
/begin GROUP LoaMgr.ReceiverPorts "MICROSAR RTE"
 /begin SUB_GROUP LoaMgr.CurrMeasIdptSig.Val LoaMgr.DiagcStsIvtr1Inactv.Logl LoaMgr.DiagcStsIvtr2Inactv.Logl LoaMgr.HwTqIdptSig.Val LoaMgr.LoaScaDi.Logl LoaMgr.MotAgMeclIdptSig.Val LoaMgr.MotAgSnsrlsAvl.Logl LoaMgr.TqLoaAvl.Logl /end SUB_GROUP
 /begin FUNCTION_LIST /end FUNCTION_LIST
 /begin REF_CHARACTERISTIC /end REF_CHARACTERISTIC
 /begin REF_MEASUREMENT /end REF_MEASUREMENT
/end GROUP
/begin GROUP LoaMgr.SenderPorts "MICROSAR RTE"
 /begin SUB_GROUP LoaMgr.CurrMeasLoaMtgtnEna.Logl LoaMgr.HwTqLoaMtgtnEna.Logl LoaMgr.IvtrLoaMtgtnEna.Logl LoaMgr.LoaRateLim.Val LoaMgr.LoaSca.Val LoaMgr.LoaSt.Val LoaMgr.MotAgLoaMtgtnEna.Logl /end SUB_GROUP
 /begin FUNCTION_LIST /end FUNCTION_LIST
 /begin REF_CHARACTERISTIC /end REF_CHARACTERISTIC
 /begin REF_MEASUREMENT /end REF_MEASUREMENT
/end GROUP
/**********************************************************************************************************************
* RECORD_LAYOUT
*********************************************************************************************************************/
/begin RECORD_LAYOUT RTE_RL_UBYTE FNC_VALUES 1 UBYTE ROW_DIR DIRECT /end RECORD_LAYOUT
/begin RECORD_LAYOUT RTE_RL_UWORD FNC_VALUES 1 UWORD ROW_DIR DIRECT /end RECORD_LAYOUT
/begin RECORD_LAYOUT RTE_RL_SWORD FNC_VALUES 1 SWORD ROW_DIR DIRECT /end RECORD_LAYOUT
/begin RECORD_LAYOUT RTE_RL_FLOAT32_IEEE FNC_VALUES 1 FLOAT32_IEEE ROW_DIR DIRECT /end RECORD_LAYOUT
/begin RECORD_LAYOUT RTE_RL_BOOLEAN FNC_VALUES 1 UBYTE ROW_DIR DIRECT /end RECORD_LAYOUT
/**********************************************************************************************************************
* COMPU_METHOD / COMPU_VTAB_RANGE
*********************************************************************************************************************/
/begin COMPU_METHOD RTE_CM_BOOLEAN "" TAB_VERB "%3.1" "" COMPU_TAB_REF RTE_CM_BOOLEAN /end COMPU_METHOD
/begin COMPU_VTAB_RANGE RTE_CM_BOOLEAN "" 2 0 0 "false" 1 255 "true" /end COMPU_VTAB_RANGE
/begin COMPU_METHOD RTE_CM_ENUM_SigQlfr1 "" TAB_VERB "%.1" "" COMPU_TAB_REF RTE_CM_ENUM_SigQlfr1 /end COMPU_METHOD
/begin COMPU_VTAB_RANGE RTE_CM_ENUM_SigQlfr1 "" 3 0 0 "SIGQLFR_NORES" 1 1 "SIGQLFR_PASSD" 2 2 "SIGQLFR_FAILD" /end COMPU_VTAB_RANGE
/begin COMPU_METHOD RTE_CM_ENUM_LoaSt1 "" TAB_VERB "%.1" "" COMPU_TAB_REF RTE_CM_ENUM_LoaSt1 /end COMPU_METHOD
/begin COMPU_VTAB_RANGE RTE_CM_ENUM_LoaSt1 "" 6 0 0 "LOAST_NORM" 1 1 "LOAST_LIMD" 2 2 "LOAST_SWBASDMTGTN" 3 3 "LOAST_FADEOUT" 4 4 "LOAST_CTRLDSHTDWNREQD" 5 5 "LOAST_IMDTSHTDWNREQD" /end COMPU_VTAB_RANGE
