/*
COPYRIGHT
This software is copyright protected and proprietary to Vector Informatik GmbH.
Vector Informatik GmbH grants to you only those rights as set out in the license conditions.
License:  Unlimited license CBD1400351 for Nexteer Automotive Corporation
*/
/begin CHARACTERISTIC CalRegn01Cmn.GmMsg34ABusChassisExpStuckTiOut.Val "MICROSAR RTE" VALUE 0x0 RTE_RL_UWORD 0 NO_COMPU_METHOD 0 65535 SYMBOL_LINK "Rte_CalprmRom_CalRegn01Cmn_DEFAULT_RTE_CALPRM_GROUP.GmMsg34ABusChassisExpStuckTiOut_Val" 0 DISPLAY_IDENTIFIER CalRegn01Cmn.CalibrationPorts.GmMsg34ABusChassisExpStuckTiOut.Val /end CHARACTERISTIC
/begin CHARACTERISTIC CalRegn01Cmn.GmMsg34ABusHiSpdInvldTiOut.Val "MICROSAR RTE" VALUE 0x0 RTE_RL_UWORD 0 NO_COMPU_METHOD 0 65535 SYMBOL_LINK "Rte_CalprmRom_CalRegn01Cmn_DEFAULT_RTE_CALPRM_GROUP.GmMsg34ABusHiSpdInvldTiOut_Val" 0 DISPLAY_IDENTIFIER CalRegn01Cmn.CalibrationPorts.GmMsg34ABusHiSpdInvldTiOut.Val /end CHARACTERISTIC
/begin CHARACTERISTIC CalRegn01Cmn.GmMsg34ABusHiSpdMissTiOut.Val "MICROSAR RTE" VALUE 0x0 RTE_RL_UWORD 0 NO_COMPU_METHOD 0 65535 SYMBOL_LINK "Rte_CalprmRom_CalRegn01Cmn_DEFAULT_RTE_CALPRM_GROUP.GmMsg34ABusHiSpdMissTiOut_Val" 0 DISPLAY_IDENTIFIER CalRegn01Cmn.CalibrationPorts.GmMsg34ABusHiSpdMissTiOut.Val /end CHARACTERISTIC
/begin CHARACTERISTIC CalRegn01Cmn.GmMsg34ABusHiSpdStuckTiOut.Val "MICROSAR RTE" VALUE 0x0 RTE_RL_UWORD 0 NO_COMPU_METHOD 0 65535 SYMBOL_LINK "Rte_CalprmRom_CalRegn01Cmn_DEFAULT_RTE_CALPRM_GROUP.GmMsg34ABusHiSpdStuckTiOut_Val" 0 DISPLAY_IDENTIFIER CalRegn01Cmn.CalibrationPorts.GmMsg34ABusHiSpdStuckTiOut.Val /end CHARACTERISTIC
/begin CHARACTERISTIC CalRegn01Cmn.GmMsg3F1BusHiSpdAmbTDft.Val "MICROSAR RTE" VALUE 0x0 RTE_RL_FLOAT32_IEEE 0 NO_COMPU_METHOD -3.402823466e+38 3.402823466e+38 SYMBOL_LINK "Rte_CalprmRom_CalRegn01Cmn_DEFAULT_RTE_CALPRM_GROUP.GmMsg3F1BusHiSpdAmbTDft_Val" 0 DISPLAY_IDENTIFIER CalRegn01Cmn.CalibrationPorts.GmMsg3F1BusHiSpdAmbTDft.Val /end CHARACTERISTIC
/begin CHARACTERISTIC CalRegn01Cmn.GmMsg3F1BusHiSpdInvldTiOut.Val "MICROSAR RTE" VALUE 0x0 RTE_RL_UWORD 0 NO_COMPU_METHOD 0 65535 SYMBOL_LINK "Rte_CalprmRom_CalRegn01Cmn_DEFAULT_RTE_CALPRM_GROUP.GmMsg3F1BusHiSpdInvldTiOut_Val" 0 DISPLAY_IDENTIFIER CalRegn01Cmn.CalibrationPorts.GmMsg3F1BusHiSpdInvldTiOut.Val /end CHARACTERISTIC
/begin CHARACTERISTIC CalRegn01Cmn.GmMsg3F1BusHiSpdMissTiOut.Val "MICROSAR RTE" VALUE 0x0 RTE_RL_UWORD 0 NO_COMPU_METHOD 0 65535 SYMBOL_LINK "Rte_CalprmRom_CalRegn01Cmn_DEFAULT_RTE_CALPRM_GROUP.GmMsg3F1BusHiSpdMissTiOut_Val" 0 DISPLAY_IDENTIFIER CalRegn01Cmn.CalibrationPorts.GmMsg3F1BusHiSpdMissTiOut.Val /end CHARACTERISTIC
/begin CHARACTERISTIC CalRegn01Cmn.GmMsg4D1BusHiSpdEngOilTDft.Val "MICROSAR RTE" VALUE 0x0 RTE_RL_FLOAT32_IEEE 0 NO_COMPU_METHOD -3.402823466e+38 3.402823466e+38 SYMBOL_LINK "Rte_CalprmRom_CalRegn01Cmn_DEFAULT_RTE_CALPRM_GROUP.GmMsg4D1BusHiSpdEngOilTDft_Val" 0 DISPLAY_IDENTIFIER CalRegn01Cmn.CalibrationPorts.GmMsg4D1BusHiSpdEngOilTDft.Val /end CHARACTERISTIC
/begin CHARACTERISTIC CalRegn01Cmn.GmMsg4D1BusHiSpdInvldTiOut.Val "MICROSAR RTE" VALUE 0x0 RTE_RL_UWORD 0 NO_COMPU_METHOD 0 65535 SYMBOL_LINK "Rte_CalprmRom_CalRegn01Cmn_DEFAULT_RTE_CALPRM_GROUP.GmMsg4D1BusHiSpdInvldTiOut_Val" 0 DISPLAY_IDENTIFIER CalRegn01Cmn.CalibrationPorts.GmMsg4D1BusHiSpdInvldTiOut.Val /end CHARACTERISTIC
/begin CHARACTERISTIC CalRegn01Cmn.GmMsg4D1BusHiSpdMissTiOut.Val "MICROSAR RTE" VALUE 0x0 RTE_RL_UWORD 0 NO_COMPU_METHOD 0 65535 SYMBOL_LINK "Rte_CalprmRom_CalRegn01Cmn_DEFAULT_RTE_CALPRM_GROUP.GmMsg4D1BusHiSpdMissTiOut_Val" 0 DISPLAY_IDENTIFIER CalRegn01Cmn.CalibrationPorts.GmMsg4D1BusHiSpdMissTiOut.Val /end CHARACTERISTIC
/begin CHARACTERISTIC CalRegn01Cmn.GmMsg500BusHiSpdMissTiOut.Val "MICROSAR RTE" VALUE 0x0 RTE_RL_UWORD 0 NO_COMPU_METHOD 0 65535 SYMBOL_LINK "Rte_CalprmRom_CalRegn01Cmn_DEFAULT_RTE_CALPRM_GROUP.GmMsg500BusHiSpdMissTiOut_Val" 0 DISPLAY_IDENTIFIER CalRegn01Cmn.CalibrationPorts.GmMsg500BusHiSpdMissTiOut.Val /end CHARACTERISTIC
/begin CHARACTERISTIC CalRegn01Cmn.GmMsg500BusHiSpdWhlPlsPerRevDft.Val "MICROSAR RTE" VALUE 0x0 RTE_RL_UBYTE 0 NO_COMPU_METHOD 0 255 SYMBOL_LINK "Rte_CalprmRom_CalRegn01Cmn_DEFAULT_RTE_CALPRM_GROUP.GmMsg500BusHiSpdWhlPlsPerRevDft_Val" 0 DISPLAY_IDENTIFIER CalRegn01Cmn.CalibrationPorts.GmMsg500BusHiSpdWhlPlsPerRevDft.Val /end CHARACTERISTIC
/begin CHARACTERISTIC CalRegn01Cmn.GmMsg500BusHiSpdWhlRotlStsTiStampReslDft.Val "MICROSAR RTE" VALUE 0x0 RTE_RL_FLOAT32_IEEE 0 NO_COMPU_METHOD -3.402823466e+38 3.402823466e+38 SYMBOL_LINK "Rte_CalprmRom_CalRegn01Cmn_DEFAULT_RTE_CALPRM_GROUP.GmMsg500BusHiSpdWhlRotlStsTiStampReslDft_Val" 0 DISPLAY_IDENTIFIER CalRegn01Cmn.CalibrationPorts.GmMsg500BusHiSpdWhlRotlStsTiStampReslDft.Val /end CHARACTERISTIC
/begin CHARACTERISTIC CalRegn01Cmn.HiFrqAssiPahFwlOverLimDiagcFailStep.Val "MICROSAR RTE" VALUE 0x0 RTE_RL_UWORD 0 NO_COMPU_METHOD 0 65535 SYMBOL_LINK "Rte_CalprmRom_CalRegn01Cmn_DEFAULT_RTE_CALPRM_GROUP.HiFrqAssiPahFwlOverLimDiagcFailStep_Val" 0 DISPLAY_IDENTIFIER CalRegn01Cmn.CalibrationPorts.HiFrqAssiPahFwlOverLimDiagcFailStep.Val /end CHARACTERISTIC
/begin CHARACTERISTIC CalRegn01Cmn.HiFrqAssiPahFwlOverLimDiagcPassStep.Val "MICROSAR RTE" VALUE 0x0 RTE_RL_UWORD 0 NO_COMPU_METHOD 0 65535 SYMBOL_LINK "Rte_CalprmRom_CalRegn01Cmn_DEFAULT_RTE_CALPRM_GROUP.HiFrqAssiPahFwlOverLimDiagcPassStep_Val" 0 DISPLAY_IDENTIFIER CalRegn01Cmn.CalibrationPorts.HiFrqAssiPahFwlOverLimDiagcPassStep.Val /end CHARACTERISTIC
/begin CHARACTERISTIC CalRegn01Cmn.HwAgArbnHwAgMaxStall.Val "MICROSAR RTE" VALUE 0x0 RTE_RL_UBYTE 0 NO_COMPU_METHOD 0 255 SYMBOL_LINK "Rte_CalprmRom_CalRegn01Cmn_DEFAULT_RTE_CALPRM_GROUP.HwAgArbnHwAgMaxStall_Val" 0 DISPLAY_IDENTIFIER CalRegn01Cmn.CalibrationPorts.HwAgArbnHwAgMaxStall.Val /end CHARACTERISTIC
/begin CHARACTERISTIC CalRegn01Cmn.HwAgCorrlnHwAgAbsltDif.Val "MICROSAR RTE" VALUE 0x0 RTE_RL_FLOAT32_IEEE 0 NO_COMPU_METHOD -3.402823466e+38 3.402823466e+38 SYMBOL_LINK "Rte_CalprmRom_CalRegn01Cmn_DEFAULT_RTE_CALPRM_GROUP.HwAgCorrlnHwAgAbsltDif_Val" 0 DISPLAY_IDENTIFIER CalRegn01Cmn.CalibrationPorts.HwAgCorrlnHwAgAbsltDif.Val /end CHARACTERISTIC
/begin CHARACTERISTIC CalRegn01Cmn.HwAgCorrlnHwAgMaxStall.Val "MICROSAR RTE" VALUE 0x0 RTE_RL_UBYTE 0 NO_COMPU_METHOD 0 255 SYMBOL_LINK "Rte_CalprmRom_CalRegn01Cmn_DEFAULT_RTE_CALPRM_GROUP.HwAgCorrlnHwAgMaxStall_Val" 0 DISPLAY_IDENTIFIER CalRegn01Cmn.CalibrationPorts.HwAgCorrlnHwAgMaxStall.Val /end CHARACTERISTIC
/begin CHARACTERISTIC CalRegn01Cmn.HwAgCorrlnNtc0x092FailStep.Val "MICROSAR RTE" VALUE 0x0 RTE_RL_UWORD 0 NO_COMPU_METHOD 0 65535 SYMBOL_LINK "Rte_CalprmRom_CalRegn01Cmn_DEFAULT_RTE_CALPRM_GROUP.HwAgCorrlnNtc0x092FailStep_Val" 0 DISPLAY_IDENTIFIER CalRegn01Cmn.CalibrationPorts.HwAgCorrlnNtc0x092FailStep.Val /end CHARACTERISTIC
/begin CHARACTERISTIC CalRegn01Cmn.HwAgCorrlnNtc0x092PassStep.Val "MICROSAR RTE" VALUE 0x0 RTE_RL_UWORD 0 NO_COMPU_METHOD 0 65535 SYMBOL_LINK "Rte_CalprmRom_CalRegn01Cmn_DEFAULT_RTE_CALPRM_GROUP.HwAgCorrlnNtc0x092PassStep_Val" 0 DISPLAY_IDENTIFIER CalRegn01Cmn.CalibrationPorts.HwAgCorrlnNtc0x092PassStep.Val /end CHARACTERISTIC
/begin CHARACTERISTIC CalRegn01Cmn.HwAgSnsrlsCorrdPinionAgHwConf.Val "MICROSAR RTE" VALUE 0x0 RTE_RL_FLOAT32_IEEE 0 NO_COMPU_METHOD -3.402823466e+38 3.402823466e+38 SYMBOL_LINK "Rte_CalprmRom_CalRegn01Cmn_DEFAULT_RTE_CALPRM_GROUP.HwAgSnsrlsCorrdPinionAgHwConf_Val" 0 DISPLAY_IDENTIFIER CalRegn01Cmn.CalibrationPorts.HwAgSnsrlsCorrdPinionAgHwConf.Val /end CHARACTERISTIC
/begin CHARACTERISTIC CalRegn01Cmn.HwAgSnsrlsFCentrHwConf.Val "MICROSAR RTE" VALUE 0x0 RTE_RL_FLOAT32_IEEE 0 NO_COMPU_METHOD -3.402823466e+38 3.402823466e+38 SYMBOL_LINK "Rte_CalprmRom_CalRegn01Cmn_DEFAULT_RTE_CALPRM_GROUP.HwAgSnsrlsFCentrHwConf_Val" 0 DISPLAY_IDENTIFIER CalRegn01Cmn.CalibrationPorts.HwAgSnsrlsFCentrHwConf.Val /end CHARACTERISTIC
/begin CHARACTERISTIC CalRegn01Cmn.HwAgSnsrlsPinionTqFilFrq.Val "MICROSAR RTE" VALUE 0x0 RTE_RL_FLOAT32_IEEE 0 NO_COMPU_METHOD -3.402823466e+38 3.402823466e+38 SYMBOL_LINK "Rte_CalprmRom_CalRegn01Cmn_DEFAULT_RTE_CALPRM_GROUP.HwAgSnsrlsPinionTqFilFrq_Val" 0 DISPLAY_IDENTIFIER CalRegn01Cmn.CalibrationPorts.HwAgSnsrlsPinionTqFilFrq.Val /end CHARACTERISTIC
/begin CHARACTERISTIC CalRegn01Cmn.HwAgSnsrlsRelHwAgFil1Frq.Val "MICROSAR RTE" VALUE 0x0 RTE_RL_FLOAT32_IEEE 0 NO_COMPU_METHOD -3.402823466e+38 3.402823466e+38 SYMBOL_LINK "Rte_CalprmRom_CalRegn01Cmn_DEFAULT_RTE_CALPRM_GROUP.HwAgSnsrlsRelHwAgFil1Frq_Val" 0 DISPLAY_IDENTIFIER CalRegn01Cmn.CalibrationPorts.HwAgSnsrlsRelHwAgFil1Frq.Val /end CHARACTERISTIC
/begin CHARACTERISTIC CalRegn01Cmn.HwAgSnsrlsRelHwAgFil2Frq.Val "MICROSAR RTE" VALUE 0x0 RTE_RL_FLOAT32_IEEE 0 NO_COMPU_METHOD -3.402823466e+38 3.402823466e+38 SYMBOL_LINK "Rte_CalprmRom_CalRegn01Cmn_DEFAULT_RTE_CALPRM_GROUP.HwAgSnsrlsRelHwAgFil2Frq_Val" 0 DISPLAY_IDENTIFIER CalRegn01Cmn.CalibrationPorts.HwAgSnsrlsRelHwAgFil2Frq.Val /end CHARACTERISTIC
/begin CHARACTERISTIC CalRegn01Cmn.HwAgSnsrlsSmotngCoeff.Val "MICROSAR RTE" VALUE 0x0 RTE_RL_FLOAT32_IEEE 0 NO_COMPU_METHOD -3.402823466e+38 3.402823466e+38 SYMBOL_LINK "Rte_CalprmRom_CalRegn01Cmn_DEFAULT_RTE_CALPRM_GROUP.HwAgSnsrlsSmotngCoeff_Val" 0 DISPLAY_IDENTIFIER CalRegn01Cmn.CalibrationPorts.HwAgSnsrlsSmotngCoeff.Val /end CHARACTERISTIC
/begin CHARACTERISTIC CalRegn01Cmn.HwAgSnsrlsSmotngStepThd.Val "MICROSAR RTE" VALUE 0x0 RTE_RL_FLOAT32_IEEE 0 NO_COMPU_METHOD -3.402823466e+38 3.402823466e+38 SYMBOL_LINK "Rte_CalprmRom_CalRegn01Cmn_DEFAULT_RTE_CALPRM_GROUP.HwAgSnsrlsSmotngStepThd_Val" 0 DISPLAY_IDENTIFIER CalRegn01Cmn.CalibrationPorts.HwAgSnsrlsSmotngStepThd.Val /end CHARACTERISTIC
/begin CHARACTERISTIC CalRegn01Cmn.HwAgSnsrlsStordPinionConf.Val "MICROSAR RTE" VALUE 0x0 RTE_RL_FLOAT32_IEEE 0 NO_COMPU_METHOD -3.402823466e+38 3.402823466e+38 SYMBOL_LINK "Rte_CalprmRom_CalRegn01Cmn_DEFAULT_RTE_CALPRM_GROUP.HwAgSnsrlsStordPinionConf_Val" 0 DISPLAY_IDENTIFIER CalRegn01Cmn.CalibrationPorts.HwAgSnsrlsStordPinionConf.Val /end CHARACTERISTIC
/begin CHARACTERISTIC CalRegn01Cmn.HwAgSnsrlsStordPinionConfThd.Val "MICROSAR RTE" VALUE 0x0 RTE_RL_FLOAT32_IEEE 0 NO_COMPU_METHOD -3.402823466e+38 3.402823466e+38 SYMBOL_LINK "Rte_CalprmRom_CalRegn01Cmn_DEFAULT_RTE_CALPRM_GROUP.HwAgSnsrlsStordPinionConfThd_Val" 0 DISPLAY_IDENTIFIER CalRegn01Cmn.CalibrationPorts.HwAgSnsrlsStordPinionConfThd.Val /end CHARACTERISTIC
/begin CHARACTERISTIC CalRegn01Cmn.HwAgSnsrlsVehDynDifThd.Val "MICROSAR RTE" VALUE 0x0 RTE_RL_FLOAT32_IEEE 0 NO_COMPU_METHOD -3.402823466e+38 3.402823466e+38 SYMBOL_LINK "Rte_CalprmRom_CalRegn01Cmn_DEFAULT_RTE_CALPRM_GROUP.HwAgSnsrlsVehDynDifThd_Val" 0 DISPLAY_IDENTIFIER CalRegn01Cmn.CalibrationPorts.HwAgSnsrlsVehDynDifThd.Val /end CHARACTERISTIC
/begin CHARACTERISTIC CalRegn01Cmn.HwAgSnsrlsVehDynHwConf.Val "MICROSAR RTE" VALUE 0x0 RTE_RL_FLOAT32_IEEE 0 NO_COMPU_METHOD -3.402823466e+38 3.402823466e+38 SYMBOL_LINK "Rte_CalprmRom_CalRegn01Cmn_DEFAULT_RTE_CALPRM_GROUP.HwAgSnsrlsVehDynHwConf_Val" 0 DISPLAY_IDENTIFIER CalRegn01Cmn.CalibrationPorts.HwAgSnsrlsVehDynHwConf.Val /end CHARACTERISTIC
/begin CHARACTERISTIC CalRegn01Cmn.HwAgSnsrlsVehDynMotVelThd.Val "MICROSAR RTE" VALUE 0x0 RTE_RL_FLOAT32_IEEE 0 NO_COMPU_METHOD -3.402823466e+38 3.402823466e+38 SYMBOL_LINK "Rte_CalprmRom_CalRegn01Cmn_DEFAULT_RTE_CALPRM_GROUP.HwAgSnsrlsVehDynMotVelThd_Val" 0 DISPLAY_IDENTIFIER CalRegn01Cmn.CalibrationPorts.HwAgSnsrlsVehDynMotVelThd.Val /end CHARACTERISTIC
/begin CHARACTERISTIC CalRegn01Cmn.HwAgSnsrlsVehDynPinionTqThd.Val "MICROSAR RTE" VALUE 0x0 RTE_RL_FLOAT32_IEEE 0 NO_COMPU_METHOD -3.402823466e+38 3.402823466e+38 SYMBOL_LINK "Rte_CalprmRom_CalRegn01Cmn_DEFAULT_RTE_CALPRM_GROUP.HwAgSnsrlsVehDynPinionTqThd_Val" 0 DISPLAY_IDENTIFIER CalRegn01Cmn.CalibrationPorts.HwAgSnsrlsVehDynPinionTqThd.Val /end CHARACTERISTIC
/begin CHARACTERISTIC CalRegn01Cmn.HwAgSnsrlsVehDynTmr1Thd.Val "MICROSAR RTE" VALUE 0x0 RTE_RL_ULONG 0 NO_COMPU_METHOD 0 4294967295 SYMBOL_LINK "Rte_CalprmRom_CalRegn01Cmn_DEFAULT_RTE_CALPRM_GROUP.HwAgSnsrlsVehDynTmr1Thd_Val" 0 DISPLAY_IDENTIFIER CalRegn01Cmn.CalibrationPorts.HwAgSnsrlsVehDynTmr1Thd.Val /end CHARACTERISTIC
/begin CHARACTERISTIC CalRegn01Cmn.HwAgSnsrlsVehDynTmr2Thd.Val "MICROSAR RTE" VALUE 0x0 RTE_RL_ULONG 0 NO_COMPU_METHOD 0 4294967295 SYMBOL_LINK "Rte_CalprmRom_CalRegn01Cmn_DEFAULT_RTE_CALPRM_GROUP.HwAgSnsrlsVehDynTmr2Thd_Val" 0 DISPLAY_IDENTIFIER CalRegn01Cmn.CalibrationPorts.HwAgSnsrlsVehDynTmr2Thd.Val /end CHARACTERISTIC
/begin CHARACTERISTIC CalRegn01Cmn.HwAgSnsrlsWhlFrqThd.Val "MICROSAR RTE" VALUE 0x0 RTE_RL_FLOAT32_IEEE 0 NO_COMPU_METHOD -3.402823466e+38 3.402823466e+38 SYMBOL_LINK "Rte_CalprmRom_CalRegn01Cmn_DEFAULT_RTE_CALPRM_GROUP.HwAgSnsrlsWhlFrqThd_Val" 0 DISPLAY_IDENTIFIER CalRegn01Cmn.CalibrationPorts.HwAgSnsrlsWhlFrqThd.Val /end CHARACTERISTIC
/begin CHARACTERISTIC CalRegn01Cmn.HwAgSnsrlsWhlSpdHwAgCoeff1.Val "MICROSAR RTE" VALUE 0x0 RTE_RL_FLOAT32_IEEE 0 NO_COMPU_METHOD -3.402823466e+38 3.402823466e+38 SYMBOL_LINK "Rte_CalprmRom_CalRegn01Cmn_DEFAULT_RTE_CALPRM_GROUP.HwAgSnsrlsWhlSpdHwAgCoeff1_Val" 0 DISPLAY_IDENTIFIER CalRegn01Cmn.CalibrationPorts.HwAgSnsrlsWhlSpdHwAgCoeff1.Val /end CHARACTERISTIC
/begin CHARACTERISTIC CalRegn01Cmn.HwAgSnsrlsWhlSpdHwAgCoeff2.Val "MICROSAR RTE" VALUE 0x0 RTE_RL_FLOAT32_IEEE 0 NO_COMPU_METHOD -3.402823466e+38 3.402823466e+38 SYMBOL_LINK "Rte_CalprmRom_CalRegn01Cmn_DEFAULT_RTE_CALPRM_GROUP.HwAgSnsrlsWhlSpdHwAgCoeff2_Val" 0 DISPLAY_IDENTIFIER CalRegn01Cmn.CalibrationPorts.HwAgSnsrlsWhlSpdHwAgCoeff2.Val /end CHARACTERISTIC
/begin CHARACTERISTIC CalRegn01Cmn.HwAgSnsrlsWhlSpdHwAgThd.Val "MICROSAR RTE" VALUE 0x0 RTE_RL_FLOAT32_IEEE 0 NO_COMPU_METHOD -3.402823466e+38 3.402823466e+38 SYMBOL_LINK "Rte_CalprmRom_CalRegn01Cmn_DEFAULT_RTE_CALPRM_GROUP.HwAgSnsrlsWhlSpdHwAgThd_Val" 0 DISPLAY_IDENTIFIER CalRegn01Cmn.CalibrationPorts.HwAgSnsrlsWhlSpdHwAgThd.Val /end CHARACTERISTIC
/begin CHARACTERISTIC CalRegn01Cmn.HwAgSnsrlsWhlSpdHwConf.Val "MICROSAR RTE" VALUE 0x0 RTE_RL_FLOAT32_IEEE 0 NO_COMPU_METHOD -3.402823466e+38 3.402823466e+38 SYMBOL_LINK "Rte_CalprmRom_CalRegn01Cmn_DEFAULT_RTE_CALPRM_GROUP.HwAgSnsrlsWhlSpdHwConf_Val" 0 DISPLAY_IDENTIFIER CalRegn01Cmn.CalibrationPorts.HwAgSnsrlsWhlSpdHwConf.Val /end CHARACTERISTIC
/begin CHARACTERISTIC CalRegn01Cmn.HwAgSnsrlsWhlSpdRatThd.Val "MICROSAR RTE" VALUE 0x0 RTE_RL_FLOAT32_IEEE 0 NO_COMPU_METHOD -3.402823466e+38 3.402823466e+38 SYMBOL_LINK "Rte_CalprmRom_CalRegn01Cmn_DEFAULT_RTE_CALPRM_GROUP.HwAgSnsrlsWhlSpdRatThd_Val" 0 DISPLAY_IDENTIFIER CalRegn01Cmn.CalibrationPorts.HwAgSnsrlsWhlSpdRatThd.Val /end CHARACTERISTIC
/begin CHARACTERISTIC CalRegn01Cmn.HwAgSnsrlsWhlSpdTmrThd.Val "MICROSAR RTE" VALUE 0x0 RTE_RL_ULONG 0 NO_COMPU_METHOD 0 4294967295 SYMBOL_LINK "Rte_CalprmRom_CalRegn01Cmn_DEFAULT_RTE_CALPRM_GROUP.HwAgSnsrlsWhlSpdTmrThd_Val" 0 DISPLAY_IDENTIFIER CalRegn01Cmn.CalibrationPorts.HwAgSnsrlsWhlSpdTmrThd.Val /end CHARACTERISTIC
/begin CHARACTERISTIC CalRegn01Cmn.HwAgSnsrlsWhlSpdVehSpdThd.Val "MICROSAR RTE" VALUE 0x0 RTE_RL_FLOAT32_IEEE 0 NO_COMPU_METHOD -3.402823466e+38 3.402823466e+38 SYMBOL_LINK "Rte_CalprmRom_CalRegn01Cmn_DEFAULT_RTE_CALPRM_GROUP.HwAgSnsrlsWhlSpdVehSpdThd_Val" 0 DISPLAY_IDENTIFIER CalRegn01Cmn.CalibrationPorts.HwAgSnsrlsWhlSpdVehSpdThd.Val /end CHARACTERISTIC
/begin CHARACTERISTIC CalRegn01Cmn.HwAgSysArbnHwAgConf1Snsr.Val "MICROSAR RTE" VALUE 0x0 RTE_RL_FLOAT32_IEEE 0 NO_COMPU_METHOD -3.402823466e+38 3.402823466e+38 SYMBOL_LINK "Rte_CalprmRom_CalRegn01Cmn_DEFAULT_RTE_CALPRM_GROUP.HwAgSysArbnHwAgConf1Snsr_Val" 0 DISPLAY_IDENTIFIER CalRegn01Cmn.CalibrationPorts.HwAgSysArbnHwAgConf1Snsr.Val /end CHARACTERISTIC
/begin CHARACTERISTIC CalRegn01Cmn.HwAgSysArbnHwAgConf2Snsr.Val "MICROSAR RTE" VALUE 0x0 RTE_RL_FLOAT32_IEEE 0 NO_COMPU_METHOD -3.402823466e+38 3.402823466e+38 SYMBOL_LINK "Rte_CalprmRom_CalRegn01Cmn_DEFAULT_RTE_CALPRM_GROUP.HwAgSysArbnHwAgConf2Snsr_Val" 0 DISPLAY_IDENTIFIER CalRegn01Cmn.CalibrationPorts.HwAgSysArbnHwAgConf2Snsr.Val /end CHARACTERISTIC
/begin CHARACTERISTIC CalRegn01Cmn.HwAgSysArbnHwAgConfNoSnsr.Val "MICROSAR RTE" VALUE 0x0 RTE_RL_FLOAT32_IEEE 0 NO_COMPU_METHOD -3.402823466e+38 3.402823466e+38 SYMBOL_LINK "Rte_CalprmRom_CalRegn01Cmn_DEFAULT_RTE_CALPRM_GROUP.HwAgSysArbnHwAgConfNoSnsr_Val" 0 DISPLAY_IDENTIFIER CalRegn01Cmn.CalibrationPorts.HwAgSysArbnHwAgConfNoSnsr.Val /end CHARACTERISTIC
/begin CHARACTERISTIC CalRegn01Cmn.HwAgSysArbnHwAgCorrdCorrlnThd.Val "MICROSAR RTE" VALUE 0x0 RTE_RL_FLOAT32_IEEE 0 NO_COMPU_METHOD -3.402823466e+38 3.402823466e+38 SYMBOL_LINK "Rte_CalprmRom_CalRegn01Cmn_DEFAULT_RTE_CALPRM_GROUP.HwAgSysArbnHwAgCorrdCorrlnThd_Val" 0 DISPLAY_IDENTIFIER CalRegn01Cmn.CalibrationPorts.HwAgSysArbnHwAgCorrdCorrlnThd.Val /end CHARACTERISTIC
/begin CHARACTERISTIC CalRegn01Cmn.HwAgSysArbnHwAgCorrlnFailDebStep.Val "MICROSAR RTE" VALUE 0x0 RTE_RL_UWORD 0 NO_COMPU_METHOD 0 65535 SYMBOL_LINK "Rte_CalprmRom_CalRegn01Cmn_DEFAULT_RTE_CALPRM_GROUP.HwAgSysArbnHwAgCorrlnFailDebStep_Val" 0 DISPLAY_IDENTIFIER CalRegn01Cmn.CalibrationPorts.HwAgSysArbnHwAgCorrlnFailDebStep.Val /end CHARACTERISTIC
/begin CHARACTERISTIC CalRegn01Cmn.HwAgSysArbnHwAgCorrlnPassDebStep.Val "MICROSAR RTE" VALUE 0x0 RTE_RL_UWORD 0 NO_COMPU_METHOD 0 65535 SYMBOL_LINK "Rte_CalprmRom_CalRegn01Cmn_DEFAULT_RTE_CALPRM_GROUP.HwAgSysArbnHwAgCorrlnPassDebStep_Val" 0 DISPLAY_IDENTIFIER CalRegn01Cmn.CalibrationPorts.HwAgSysArbnHwAgCorrlnPassDebStep.Val /end CHARACTERISTIC
/begin CHARACTERISTIC CalRegn01Cmn.HwAgSysArbnHwAgCorrlnRng.Val "MICROSAR RTE" VALUE 0x0 RTE_RL_FLOAT32_IEEE 0 NO_COMPU_METHOD -3.402823466e+38 3.402823466e+38 SYMBOL_LINK "Rte_CalprmRom_CalRegn01Cmn_DEFAULT_RTE_CALPRM_GROUP.HwAgSysArbnHwAgCorrlnRng_Val" 0 DISPLAY_IDENTIFIER CalRegn01Cmn.CalibrationPorts.HwAgSysArbnHwAgCorrlnRng.Val /end CHARACTERISTIC
/begin CHARACTERISTIC CalRegn01Cmn.HwAgSysArbnHwAgSlewRate.Val "MICROSAR RTE" VALUE 0x0 RTE_RL_FLOAT32_IEEE 0 NO_COMPU_METHOD -3.402823466e+38 3.402823466e+38 SYMBOL_LINK "Rte_CalprmRom_CalRegn01Cmn_DEFAULT_RTE_CALPRM_GROUP.HwAgSysArbnHwAgSlewRate_Val" 0 DISPLAY_IDENTIFIER CalRegn01Cmn.CalibrationPorts.HwAgSysArbnHwAgSlewRate.Val /end CHARACTERISTIC
/begin CHARACTERISTIC CalRegn01Cmn.HwAgSysArbnHwAgSnsrlsCorrlnThd.Val "MICROSAR RTE" VALUE 0x0 RTE_RL_FLOAT32_IEEE 0 NO_COMPU_METHOD -3.402823466e+38 3.402823466e+38 SYMBOL_LINK "Rte_CalprmRom_CalRegn01Cmn_DEFAULT_RTE_CALPRM_GROUP.HwAgSysArbnHwAgSnsrlsCorrlnThd_Val" 0 DISPLAY_IDENTIFIER CalRegn01Cmn.CalibrationPorts.HwAgSysArbnHwAgSnsrlsCorrlnThd.Val /end CHARACTERISTIC
/begin CHARACTERISTIC CalRegn01Cmn.HwAgSysArbnHwAgSnsrlsKineThd.Val "MICROSAR RTE" VALUE 0x0 RTE_RL_FLOAT32_IEEE 0 NO_COMPU_METHOD -3.402823466e+38 3.402823466e+38 SYMBOL_LINK "Rte_CalprmRom_CalRegn01Cmn_DEFAULT_RTE_CALPRM_GROUP.HwAgSysArbnHwAgSnsrlsKineThd_Val" 0 DISPLAY_IDENTIFIER CalRegn01Cmn.CalibrationPorts.HwAgSysArbnHwAgSnsrlsKineThd.Val /end CHARACTERISTIC
/begin CHARACTERISTIC CalRegn01Cmn.HwAgSysArbnHwAgToMotAgCorrlnElpdTiLim.Val "MICROSAR RTE" VALUE 0x0 RTE_RL_ULONG 0 NO_COMPU_METHOD 0 4294967295 SYMBOL_LINK "Rte_CalprmRom_CalRegn01Cmn_DEFAULT_RTE_CALPRM_GROUP.HwAgSysArbnHwAgToMotAgCorrlnElpdTiLim_Val" 0 DISPLAY_IDENTIFIER CalRegn01Cmn.CalibrationPorts.HwAgSysArbnHwAgToMotAgCorrlnElpdTiLim.Val /end CHARACTERISTIC
/begin CHARACTERISTIC CalRegn01Cmn.HwAgSysArbnSerlComHwAgCorrdConf.Val "MICROSAR RTE" VALUE 0x0 RTE_RL_FLOAT32_IEEE 0 NO_COMPU_METHOD -3.402823466e+38 3.402823466e+38 SYMBOL_LINK "Rte_CalprmRom_CalRegn01Cmn_DEFAULT_RTE_CALPRM_GROUP.HwAgSysArbnSerlComHwAgCorrdConf_Val" 0 DISPLAY_IDENTIFIER CalRegn01Cmn.CalibrationPorts.HwAgSysArbnSerlComHwAgCorrdConf.Val /end CHARACTERISTIC
/begin CHARACTERISTIC CalRegn01Cmn.HwAgSysArbnSerlComHwAgSnsrlsConf.Val "MICROSAR RTE" VALUE 0x0 RTE_RL_FLOAT32_IEEE 0 NO_COMPU_METHOD -3.402823466e+38 3.402823466e+38 SYMBOL_LINK "Rte_CalprmRom_CalRegn01Cmn_DEFAULT_RTE_CALPRM_GROUP.HwAgSysArbnSerlComHwAgSnsrlsConf_Val" 0 DISPLAY_IDENTIFIER CalRegn01Cmn.CalibrationPorts.HwAgSysArbnSerlComHwAgSnsrlsConf.Val /end CHARACTERISTIC
/begin CHARACTERISTIC CalRegn01Cmn.HwAgSysArbnSlewRateTmr.Val "MICROSAR RTE" VALUE 0x0 RTE_RL_FLOAT32_IEEE 0 NO_COMPU_METHOD -3.402823466e+38 3.402823466e+38 SYMBOL_LINK "Rte_CalprmRom_CalRegn01Cmn_DEFAULT_RTE_CALPRM_GROUP.HwAgSysArbnSlewRateTmr_Val" 0 DISPLAY_IDENTIFIER CalRegn01Cmn.CalibrationPorts.HwAgSysArbnSlewRateTmr.Val /end CHARACTERISTIC
/begin CHARACTERISTIC CalRegn01Cmn.HwAgTrajGennAMax.Val "MICROSAR RTE" VALUE 0x0 RTE_RL_FLOAT32_IEEE 0 NO_COMPU_METHOD -3.402823466e+38 3.402823466e+38 SYMBOL_LINK "Rte_CalprmRom_CalRegn01Cmn_DEFAULT_RTE_CALPRM_GROUP.HwAgTrajGennAMax_Val" 0 DISPLAY_IDENTIFIER CalRegn01Cmn.CalibrationPorts.HwAgTrajGennAMax.Val /end CHARACTERISTIC
/begin CHARACTERISTIC CalRegn01Cmn.HwAgTrajGennAgMax.Val "MICROSAR RTE" VALUE 0x0 RTE_RL_FLOAT32_IEEE 0 NO_COMPU_METHOD -3.402823466e+38 3.402823466e+38 SYMBOL_LINK "Rte_CalprmRom_CalRegn01Cmn_DEFAULT_RTE_CALPRM_GROUP.HwAgTrajGennAgMax_Val" 0 DISPLAY_IDENTIFIER CalRegn01Cmn.CalibrationPorts.HwAgTrajGennAgMax.Val /end CHARACTERISTIC
/begin CHARACTERISTIC CalRegn01Cmn.HwAgTrajGennVelMax.Val "MICROSAR RTE" VALUE 0x0 RTE_RL_FLOAT32_IEEE 0 NO_COMPU_METHOD -3.402823466e+38 3.402823466e+38 SYMBOL_LINK "Rte_CalprmRom_CalRegn01Cmn_DEFAULT_RTE_CALPRM_GROUP.HwAgTrajGennVelMax_Val" 0 DISPLAY_IDENTIFIER CalRegn01Cmn.CalibrationPorts.HwAgTrajGennVelMax.Val /end CHARACTERISTIC
/begin CHARACTERISTIC CalRegn01Cmn.HwTq2MeasHwTq2PrtclFltFailStep.Val "MICROSAR RTE" VALUE 0x0 RTE_RL_UWORD 0 NO_COMPU_METHOD 0 65535 SYMBOL_LINK "Rte_CalprmRom_CalRegn01Cmn_DEFAULT_RTE_CALPRM_GROUP.HwTq2MeasHwTq2PrtclFltFailStep_Val" 0 DISPLAY_IDENTIFIER CalRegn01Cmn.CalibrationPorts.HwTq2MeasHwTq2PrtclFltFailStep.Val /end CHARACTERISTIC
/begin CHARACTERISTIC CalRegn01Cmn.HwTq2MeasHwTq2PrtclFltPassStep.Val "MICROSAR RTE" VALUE 0x0 RTE_RL_UWORD 0 NO_COMPU_METHOD 0 65535 SYMBOL_LINK "Rte_CalprmRom_CalRegn01Cmn_DEFAULT_RTE_CALPRM_GROUP.HwTq2MeasHwTq2PrtclFltPassStep_Val" 0 DISPLAY_IDENTIFIER CalRegn01Cmn.CalibrationPorts.HwTq2MeasHwTq2PrtclFltPassStep.Val /end CHARACTERISTIC
/begin CHARACTERISTIC CalRegn01Cmn.HwTq3MeasHwTq3PrtclFltFailStep.Val "MICROSAR RTE" VALUE 0x0 RTE_RL_UWORD 0 NO_COMPU_METHOD 0 65535 SYMBOL_LINK "Rte_CalprmRom_CalRegn01Cmn_DEFAULT_RTE_CALPRM_GROUP.HwTq3MeasHwTq3PrtclFltFailStep_Val" 0 DISPLAY_IDENTIFIER CalRegn01Cmn.CalibrationPorts.HwTq3MeasHwTq3PrtclFltFailStep.Val /end CHARACTERISTIC
/begin CHARACTERISTIC CalRegn01Cmn.HwTq3MeasHwTq3PrtclFltPassStep.Val "MICROSAR RTE" VALUE 0x0 RTE_RL_UWORD 0 NO_COMPU_METHOD 0 65535 SYMBOL_LINK "Rte_CalprmRom_CalRegn01Cmn_DEFAULT_RTE_CALPRM_GROUP.HwTq3MeasHwTq3PrtclFltPassStep_Val" 0 DISPLAY_IDENTIFIER CalRegn01Cmn.CalibrationPorts.HwTq3MeasHwTq3PrtclFltPassStep.Val /end CHARACTERISTIC
/begin CHARACTERISTIC CalRegn01Cmn.HwTqArbnMaxStallTqA.Val "MICROSAR RTE" VALUE 0x0 RTE_RL_UBYTE 0 NO_COMPU_METHOD 0 255 SYMBOL_LINK "Rte_CalprmRom_CalRegn01Cmn_DEFAULT_RTE_CALPRM_GROUP.HwTqArbnMaxStallTqA_Val" 0 DISPLAY_IDENTIFIER CalRegn01Cmn.CalibrationPorts.HwTqArbnMaxStallTqA.Val /end CHARACTERISTIC
/begin CHARACTERISTIC CalRegn01Cmn.HwTqArbnMaxStallTqB.Val "MICROSAR RTE" VALUE 0x0 RTE_RL_UBYTE 0 NO_COMPU_METHOD 0 255 SYMBOL_LINK "Rte_CalprmRom_CalRegn01Cmn_DEFAULT_RTE_CALPRM_GROUP.HwTqArbnMaxStallTqB_Val" 0 DISPLAY_IDENTIFIER CalRegn01Cmn.CalibrationPorts.HwTqArbnMaxStallTqB.Val /end CHARACTERISTIC
/begin CHARACTERISTIC CalRegn01Cmn.HwTqArbnMaxStallTqC.Val "MICROSAR RTE" VALUE 0x0 RTE_RL_UBYTE 0 NO_COMPU_METHOD 0 255 SYMBOL_LINK "Rte_CalprmRom_CalRegn01Cmn_DEFAULT_RTE_CALPRM_GROUP.HwTqArbnMaxStallTqC_Val" 0 DISPLAY_IDENTIFIER CalRegn01Cmn.CalibrationPorts.HwTqArbnMaxStallTqC.Val /end CHARACTERISTIC
/begin CHARACTERISTIC CalRegn01Cmn.HwTqArbnMaxStallTqD.Val "MICROSAR RTE" VALUE 0x0 RTE_RL_UBYTE 0 NO_COMPU_METHOD 0 255 SYMBOL_LINK "Rte_CalprmRom_CalRegn01Cmn_DEFAULT_RTE_CALPRM_GROUP.HwTqArbnMaxStallTqD_Val" 0 DISPLAY_IDENTIFIER CalRegn01Cmn.CalibrationPorts.HwTqArbnMaxStallTqD.Val /end CHARACTERISTIC
/begin CHARACTERISTIC CalRegn01Cmn.HwTqCorrlnChACmnModCmpLpFilActvnThd.Val "MICROSAR RTE" VALUE 0x0 RTE_RL_FLOAT32_IEEE 0 NO_COMPU_METHOD -3.402823466e+38 3.402823466e+38 SYMBOL_LINK "Rte_CalprmRom_CalRegn01Cmn_DEFAULT_RTE_CALPRM_GROUP.HwTqCorrlnChACmnModCmpLpFilActvnThd_Val" 0 DISPLAY_IDENTIFIER CalRegn01Cmn.CalibrationPorts.HwTqCorrlnChACmnModCmpLpFilActvnThd.Val /end CHARACTERISTIC
/begin CHARACTERISTIC CalRegn01Cmn.HwTqCorrlnChACmnModCmpLpFilFrq.Val "MICROSAR RTE" VALUE 0x0 RTE_RL_FLOAT32_IEEE 0 NO_COMPU_METHOD -3.402823466e+38 3.402823466e+38 SYMBOL_LINK "Rte_CalprmRom_CalRegn01Cmn_DEFAULT_RTE_CALPRM_GROUP.HwTqCorrlnChACmnModCmpLpFilFrq_Val" 0 DISPLAY_IDENTIFIER CalRegn01Cmn.CalibrationPorts.HwTqCorrlnChACmnModCmpLpFilFrq.Val /end CHARACTERISTIC
/begin CHARACTERISTIC CalRegn01Cmn.HwTqCorrlnChACmnModCmpLpFilOutpLim.Val "MICROSAR RTE" VALUE 0x0 RTE_RL_FLOAT32_IEEE 0 NO_COMPU_METHOD -3.402823466e+38 3.402823466e+38 SYMBOL_LINK "Rte_CalprmRom_CalRegn01Cmn_DEFAULT_RTE_CALPRM_GROUP.HwTqCorrlnChACmnModCmpLpFilOutpLim_Val" 0 DISPLAY_IDENTIFIER CalRegn01Cmn.CalibrationPorts.HwTqCorrlnChACmnModCmpLpFilOutpLim.Val /end CHARACTERISTIC
/begin CHARACTERISTIC CalRegn01Cmn.HwTqCorrlnChAImdtCorrlnChkFailThd.Val "MICROSAR RTE" VALUE 0x0 RTE_RL_FLOAT32_IEEE 0 NO_COMPU_METHOD -3.402823466e+38 3.402823466e+38 SYMBOL_LINK "Rte_CalprmRom_CalRegn01Cmn_DEFAULT_RTE_CALPRM_GROUP.HwTqCorrlnChAImdtCorrlnChkFailThd_Val" 0 DISPLAY_IDENTIFIER CalRegn01Cmn.CalibrationPorts.HwTqCorrlnChAImdtCorrlnChkFailThd.Val /end CHARACTERISTIC
/begin CHARACTERISTIC CalRegn01Cmn.HwTqCorrlnChAImdtCorrlnChkPassThd.Val "MICROSAR RTE" VALUE 0x0 RTE_RL_FLOAT32_IEEE 0 NO_COMPU_METHOD -3.402823466e+38 3.402823466e+38 SYMBOL_LINK "Rte_CalprmRom_CalRegn01Cmn_DEFAULT_RTE_CALPRM_GROUP.HwTqCorrlnChAImdtCorrlnChkPassThd_Val" 0 DISPLAY_IDENTIFIER CalRegn01Cmn.CalibrationPorts.HwTqCorrlnChAImdtCorrlnChkPassThd.Val /end CHARACTERISTIC
/begin CHARACTERISTIC CalRegn01Cmn.HwTqCorrlnChAStabStClrFltThd.Val "MICROSAR RTE" VALUE 0x0 RTE_RL_FLOAT32_IEEE 0 NO_COMPU_METHOD -3.402823466e+38 3.402823466e+38 SYMBOL_LINK "Rte_CalprmRom_CalRegn01Cmn_DEFAULT_RTE_CALPRM_GROUP.HwTqCorrlnChAStabStClrFltThd_Val" 0 DISPLAY_IDENTIFIER CalRegn01Cmn.CalibrationPorts.HwTqCorrlnChAStabStClrFltThd.Val /end CHARACTERISTIC
/begin CHARACTERISTIC CalRegn01Cmn.HwTqCorrlnChAStabStLpFilFrq.Val "MICROSAR RTE" VALUE 0x0 RTE_RL_FLOAT32_IEEE 0 NO_COMPU_METHOD -3.402823466e+38 3.402823466e+38 SYMBOL_LINK "Rte_CalprmRom_CalRegn01Cmn_DEFAULT_RTE_CALPRM_GROUP.HwTqCorrlnChAStabStLpFilFrq_Val" 0 DISPLAY_IDENTIFIER CalRegn01Cmn.CalibrationPorts.HwTqCorrlnChAStabStLpFilFrq.Val /end CHARACTERISTIC
/begin CHARACTERISTIC CalRegn01Cmn.HwTqCorrlnChAStabStSetFltThd.Val "MICROSAR RTE" VALUE 0x0 RTE_RL_FLOAT32_IEEE 0 NO_COMPU_METHOD -3.402823466e+38 3.402823466e+38 SYMBOL_LINK "Rte_CalprmRom_CalRegn01Cmn_DEFAULT_RTE_CALPRM_GROUP.HwTqCorrlnChAStabStSetFltThd_Val" 0 DISPLAY_IDENTIFIER CalRegn01Cmn.CalibrationPorts.HwTqCorrlnChAStabStSetFltThd.Val /end CHARACTERISTIC
/begin CHARACTERISTIC CalRegn01Cmn.HwTqCorrlnChATqSumMaxLim.Val "MICROSAR RTE" VALUE 0x0 RTE_RL_FLOAT32_IEEE 0 NO_COMPU_METHOD -3.402823466e+38 3.402823466e+38 SYMBOL_LINK "Rte_CalprmRom_CalRegn01Cmn_DEFAULT_RTE_CALPRM_GROUP.HwTqCorrlnChATqSumMaxLim_Val" 0 DISPLAY_IDENTIFIER CalRegn01Cmn.CalibrationPorts.HwTqCorrlnChATqSumMaxLim.Val /end CHARACTERISTIC
/begin CHARACTERISTIC CalRegn01Cmn.HwTqCorrlnChATraLpFilX.Ary1D "MICROSAR RTE" VAL_BLK 0x0 RTE_RL_UWORD 0 NO_COMPU_METHOD 0 65535 MATRIX_DIM 17 1 1 SYMBOL_LINK "Rte_CalprmRom_CalRegn01Cmn_DEFAULT_RTE_CALPRM_GROUP.HwTqCorrlnChATraLpFilX_Ary1D" 0 DISPLAY_IDENTIFIER CalRegn01Cmn.CalibrationPorts.HwTqCorrlnChATraLpFilX.Ary1D /end CHARACTERISTIC
/begin CHARACTERISTIC CalRegn01Cmn.HwTqCorrlnChATraLpFilY.Ary1D "MICROSAR RTE" VAL_BLK 0x0 RTE_RL_UWORD 0 NO_COMPU_METHOD 0 65535 MATRIX_DIM 17 1 1 SYMBOL_LINK "Rte_CalprmRom_CalRegn01Cmn_DEFAULT_RTE_CALPRM_GROUP.HwTqCorrlnChATraLpFilY_Ary1D" 0 DISPLAY_IDENTIFIER CalRegn01Cmn.CalibrationPorts.HwTqCorrlnChATraLpFilY.Ary1D /end CHARACTERISTIC
/begin CHARACTERISTIC CalRegn01Cmn.HwTqCorrlnChATraSumClrFltThd.Val "MICROSAR RTE" VALUE 0x0 RTE_RL_FLOAT32_IEEE 0 NO_COMPU_METHOD -3.402823466e+38 3.402823466e+38 SYMBOL_LINK "Rte_CalprmRom_CalRegn01Cmn_DEFAULT_RTE_CALPRM_GROUP.HwTqCorrlnChATraSumClrFltThd_Val" 0 DISPLAY_IDENTIFIER CalRegn01Cmn.CalibrationPorts.HwTqCorrlnChATraSumClrFltThd.Val /end CHARACTERISTIC
/begin CHARACTERISTIC CalRegn01Cmn.HwTqCorrlnChATraSumSetFltThd.Val "MICROSAR RTE" VALUE 0x0 RTE_RL_FLOAT32_IEEE 0 NO_COMPU_METHOD -3.402823466e+38 3.402823466e+38 SYMBOL_LINK "Rte_CalprmRom_CalRegn01Cmn_DEFAULT_RTE_CALPRM_GROUP.HwTqCorrlnChATraSumSetFltThd_Val" 0 DISPLAY_IDENTIFIER CalRegn01Cmn.CalibrationPorts.HwTqCorrlnChATraSumSetFltThd.Val /end CHARACTERISTIC
/begin CHARACTERISTIC CalRegn01Cmn.HwTqCorrlnChBCmnModCmpLpFilActvnThd.Val "MICROSAR RTE" VALUE 0x0 RTE_RL_FLOAT32_IEEE 0 NO_COMPU_METHOD -3.402823466e+38 3.402823466e+38 SYMBOL_LINK "Rte_CalprmRom_CalRegn01Cmn_DEFAULT_RTE_CALPRM_GROUP.HwTqCorrlnChBCmnModCmpLpFilActvnThd_Val" 0 DISPLAY_IDENTIFIER CalRegn01Cmn.CalibrationPorts.HwTqCorrlnChBCmnModCmpLpFilActvnThd.Val /end CHARACTERISTIC
/begin CHARACTERISTIC CalRegn01Cmn.HwTqCorrlnChBCmnModCmpLpFilFrq.Val "MICROSAR RTE" VALUE 0x0 RTE_RL_FLOAT32_IEEE 0 NO_COMPU_METHOD -3.402823466e+38 3.402823466e+38 SYMBOL_LINK "Rte_CalprmRom_CalRegn01Cmn_DEFAULT_RTE_CALPRM_GROUP.HwTqCorrlnChBCmnModCmpLpFilFrq_Val" 0 DISPLAY_IDENTIFIER CalRegn01Cmn.CalibrationPorts.HwTqCorrlnChBCmnModCmpLpFilFrq.Val /end CHARACTERISTIC
/begin CHARACTERISTIC CalRegn01Cmn.HwTqCorrlnChBCmnModCmpLpFilOutpLim.Val "MICROSAR RTE" VALUE 0x0 RTE_RL_FLOAT32_IEEE 0 NO_COMPU_METHOD -3.402823466e+38 3.402823466e+38 SYMBOL_LINK "Rte_CalprmRom_CalRegn01Cmn_DEFAULT_RTE_CALPRM_GROUP.HwTqCorrlnChBCmnModCmpLpFilOutpLim_Val" 0 DISPLAY_IDENTIFIER CalRegn01Cmn.CalibrationPorts.HwTqCorrlnChBCmnModCmpLpFilOutpLim.Val /end CHARACTERISTIC
/begin CHARACTERISTIC CalRegn01Cmn.HwTqCorrlnChBImdtCorrlnChkFailThd.Val "MICROSAR RTE" VALUE 0x0 RTE_RL_FLOAT32_IEEE 0 NO_COMPU_METHOD -3.402823466e+38 3.402823466e+38 SYMBOL_LINK "Rte_CalprmRom_CalRegn01Cmn_DEFAULT_RTE_CALPRM_GROUP.HwTqCorrlnChBImdtCorrlnChkFailThd_Val" 0 DISPLAY_IDENTIFIER CalRegn01Cmn.CalibrationPorts.HwTqCorrlnChBImdtCorrlnChkFailThd.Val /end CHARACTERISTIC
/begin CHARACTERISTIC CalRegn01Cmn.HwTqCorrlnChBImdtCorrlnChkPassThd.Val "MICROSAR RTE" VALUE 0x0 RTE_RL_FLOAT32_IEEE 0 NO_COMPU_METHOD -3.402823466e+38 3.402823466e+38 SYMBOL_LINK "Rte_CalprmRom_CalRegn01Cmn_DEFAULT_RTE_CALPRM_GROUP.HwTqCorrlnChBImdtCorrlnChkPassThd_Val" 0 DISPLAY_IDENTIFIER CalRegn01Cmn.CalibrationPorts.HwTqCorrlnChBImdtCorrlnChkPassThd.Val /end CHARACTERISTIC
/begin CHARACTERISTIC CalRegn01Cmn.HwTqCorrlnChBStabStClrFltThd.Val "MICROSAR RTE" VALUE 0x0 RTE_RL_FLOAT32_IEEE 0 NO_COMPU_METHOD -3.402823466e+38 3.402823466e+38 SYMBOL_LINK "Rte_CalprmRom_CalRegn01Cmn_DEFAULT_RTE_CALPRM_GROUP.HwTqCorrlnChBStabStClrFltThd_Val" 0 DISPLAY_IDENTIFIER CalRegn01Cmn.CalibrationPorts.HwTqCorrlnChBStabStClrFltThd.Val /end CHARACTERISTIC
/begin CHARACTERISTIC CalRegn01Cmn.HwTqCorrlnChBStabStLpFilFrq.Val "MICROSAR RTE" VALUE 0x0 RTE_RL_FLOAT32_IEEE 0 NO_COMPU_METHOD -3.402823466e+38 3.402823466e+38 SYMBOL_LINK "Rte_CalprmRom_CalRegn01Cmn_DEFAULT_RTE_CALPRM_GROUP.HwTqCorrlnChBStabStLpFilFrq_Val" 0 DISPLAY_IDENTIFIER CalRegn01Cmn.CalibrationPorts.HwTqCorrlnChBStabStLpFilFrq.Val /end CHARACTERISTIC
/begin CHARACTERISTIC CalRegn01Cmn.HwTqCorrlnChBStabStSetFltThd.Val "MICROSAR RTE" VALUE 0x0 RTE_RL_FLOAT32_IEEE 0 NO_COMPU_METHOD -3.402823466e+38 3.402823466e+38 SYMBOL_LINK "Rte_CalprmRom_CalRegn01Cmn_DEFAULT_RTE_CALPRM_GROUP.HwTqCorrlnChBStabStSetFltThd_Val" 0 DISPLAY_IDENTIFIER CalRegn01Cmn.CalibrationPorts.HwTqCorrlnChBStabStSetFltThd.Val /end CHARACTERISTIC
/begin CHARACTERISTIC CalRegn01Cmn.HwTqCorrlnChBTqSumMaxLim.Val "MICROSAR RTE" VALUE 0x0 RTE_RL_FLOAT32_IEEE 0 NO_COMPU_METHOD -3.402823466e+38 3.402823466e+38 SYMBOL_LINK "Rte_CalprmRom_CalRegn01Cmn_DEFAULT_RTE_CALPRM_GROUP.HwTqCorrlnChBTqSumMaxLim_Val" 0 DISPLAY_IDENTIFIER CalRegn01Cmn.CalibrationPorts.HwTqCorrlnChBTqSumMaxLim.Val /end CHARACTERISTIC
/begin CHARACTERISTIC CalRegn01Cmn.HwTqCorrlnChBTraLpFilX.Ary1D "MICROSAR RTE" VAL_BLK 0x0 RTE_RL_UWORD 0 NO_COMPU_METHOD 0 65535 MATRIX_DIM 17 1 1 SYMBOL_LINK "Rte_CalprmRom_CalRegn01Cmn_DEFAULT_RTE_CALPRM_GROUP.HwTqCorrlnChBTraLpFilX_Ary1D" 0 DISPLAY_IDENTIFIER CalRegn01Cmn.CalibrationPorts.HwTqCorrlnChBTraLpFilX.Ary1D /end CHARACTERISTIC
/begin CHARACTERISTIC CalRegn01Cmn.HwTqCorrlnChBTraLpFilY.Ary1D "MICROSAR RTE" VAL_BLK 0x0 RTE_RL_UWORD 0 NO_COMPU_METHOD 0 65535 MATRIX_DIM 17 1 1 SYMBOL_LINK "Rte_CalprmRom_CalRegn01Cmn_DEFAULT_RTE_CALPRM_GROUP.HwTqCorrlnChBTraLpFilY_Ary1D" 0 DISPLAY_IDENTIFIER CalRegn01Cmn.CalibrationPorts.HwTqCorrlnChBTraLpFilY.Ary1D /end CHARACTERISTIC
/begin CHARACTERISTIC CalRegn01Cmn.HwTqCorrlnChBTraSumClrFltThd.Val "MICROSAR RTE" VALUE 0x0 RTE_RL_FLOAT32_IEEE 0 NO_COMPU_METHOD -3.402823466e+38 3.402823466e+38 SYMBOL_LINK "Rte_CalprmRom_CalRegn01Cmn_DEFAULT_RTE_CALPRM_GROUP.HwTqCorrlnChBTraSumClrFltThd_Val" 0 DISPLAY_IDENTIFIER CalRegn01Cmn.CalibrationPorts.HwTqCorrlnChBTraSumClrFltThd.Val /end CHARACTERISTIC
/begin CHARACTERISTIC CalRegn01Cmn.HwTqCorrlnChBTraSumSetFltThd.Val "MICROSAR RTE" VALUE 0x0 RTE_RL_FLOAT32_IEEE 0 NO_COMPU_METHOD -3.402823466e+38 3.402823466e+38 SYMBOL_LINK "Rte_CalprmRom_CalRegn01Cmn_DEFAULT_RTE_CALPRM_GROUP.HwTqCorrlnChBTraSumSetFltThd_Val" 0 DISPLAY_IDENTIFIER CalRegn01Cmn.CalibrationPorts.HwTqCorrlnChBTraSumSetFltThd.Val /end CHARACTERISTIC
/begin CHARACTERISTIC CalRegn01Cmn.HwTqCorrlnMaxStallTqA.Val "MICROSAR RTE" VALUE 0x0 RTE_RL_UBYTE 0 NO_COMPU_METHOD 0 255 SYMBOL_LINK "Rte_CalprmRom_CalRegn01Cmn_DEFAULT_RTE_CALPRM_GROUP.HwTqCorrlnMaxStallTqA_Val" 0 DISPLAY_IDENTIFIER CalRegn01Cmn.CalibrationPorts.HwTqCorrlnMaxStallTqA.Val /end CHARACTERISTIC
/begin CHARACTERISTIC CalRegn01Cmn.HwTqCorrlnMaxStallTqB.Val "MICROSAR RTE" VALUE 0x0 RTE_RL_UBYTE 0 NO_COMPU_METHOD 0 255 SYMBOL_LINK "Rte_CalprmRom_CalRegn01Cmn_DEFAULT_RTE_CALPRM_GROUP.HwTqCorrlnMaxStallTqB_Val" 0 DISPLAY_IDENTIFIER CalRegn01Cmn.CalibrationPorts.HwTqCorrlnMaxStallTqB.Val /end CHARACTERISTIC
/begin CHARACTERISTIC CalRegn01Cmn.HwTqCorrlnMaxStallTqC.Val "MICROSAR RTE" VALUE 0x0 RTE_RL_UBYTE 0 NO_COMPU_METHOD 0 255 SYMBOL_LINK "Rte_CalprmRom_CalRegn01Cmn_DEFAULT_RTE_CALPRM_GROUP.HwTqCorrlnMaxStallTqC_Val" 0 DISPLAY_IDENTIFIER CalRegn01Cmn.CalibrationPorts.HwTqCorrlnMaxStallTqC.Val /end CHARACTERISTIC
/begin CHARACTERISTIC CalRegn01Cmn.HwTqCorrlnMaxStallTqD.Val "MICROSAR RTE" VALUE 0x0 RTE_RL_UBYTE 0 NO_COMPU_METHOD 0 255 SYMBOL_LINK "Rte_CalprmRom_CalRegn01Cmn_DEFAULT_RTE_CALPRM_GROUP.HwTqCorrlnMaxStallTqD_Val" 0 DISPLAY_IDENTIFIER CalRegn01Cmn.CalibrationPorts.HwTqCorrlnMaxStallTqD.Val /end CHARACTERISTIC
/begin CHARACTERISTIC CalRegn01Cmn.LoaMgrCurrIvtrMtgtnRate.Val "MICROSAR RTE" VALUE 0x0 RTE_RL_FLOAT32_IEEE 0 NO_COMPU_METHOD -3.402823466e+38 3.402823466e+38 SYMBOL_LINK "Rte_CalprmRom_CalRegn01Cmn_DEFAULT_RTE_CALPRM_GROUP.LoaMgrCurrIvtrMtgtnRate_Val" 0 DISPLAY_IDENTIFIER CalRegn01Cmn.CalibrationPorts.LoaMgrCurrIvtrMtgtnRate.Val /end CHARACTERISTIC
/begin CHARACTERISTIC CalRegn01Cmn.LoaMgrCurrIvtrMtgtnSca.Val "MICROSAR RTE" VALUE 0x0 RTE_RL_FLOAT32_IEEE 0 NO_COMPU_METHOD -3.402823466e+38 3.402823466e+38 SYMBOL_LINK "Rte_CalprmRom_CalRegn01Cmn_DEFAULT_RTE_CALPRM_GROUP.LoaMgrCurrIvtrMtgtnSca_Val" 0 DISPLAY_IDENTIFIER CalRegn01Cmn.CalibrationPorts.LoaMgrCurrIvtrMtgtnSca.Val /end CHARACTERISTIC
/begin CHARACTERISTIC CalRegn01Cmn.LoaMgrCurrIvtrMtgtnScaZeroEna.Logl "MICROSAR RTE" VALUE 0x0 RTE_RL_BOOLEAN 0 RTE_CM_BOOLEAN 0 255 SYMBOL_LINK "Rte_CalprmRom_CalRegn01Cmn_DEFAULT_RTE_CALPRM_GROUP.LoaMgrCurrIvtrMtgtnScaZeroEna_Logl" 0 DISPLAY_IDENTIFIER CalRegn01Cmn.CalibrationPorts.LoaMgrCurrIvtrMtgtnScaZeroEna.Logl /end CHARACTERISTIC
/begin CHARACTERISTIC CalRegn01Cmn.LoaMgrCurrMeasIdptSig0Resp.Val "MICROSAR RTE" VALUE 0x0 RTE_RL_UBYTE 0 NO_COMPU_METHOD 0 255 SYMBOL_LINK "Rte_CalprmRom_CalRegn01Cmn_DEFAULT_RTE_CALPRM_GROUP.LoaMgrCurrMeasIdptSig0Resp_Val" 0 DISPLAY_IDENTIFIER CalRegn01Cmn.CalibrationPorts.LoaMgrCurrMeasIdptSig0Resp.Val /end CHARACTERISTIC
/begin CHARACTERISTIC CalRegn01Cmn.LoaMgrCurrMeasIdptSig1Resp.Val "MICROSAR RTE" VALUE 0x0 RTE_RL_UBYTE 0 NO_COMPU_METHOD 0 255 SYMBOL_LINK "Rte_CalprmRom_CalRegn01Cmn_DEFAULT_RTE_CALPRM_GROUP.LoaMgrCurrMeasIdptSig1Resp_Val" 0 DISPLAY_IDENTIFIER CalRegn01Cmn.CalibrationPorts.LoaMgrCurrMeasIdptSig1Resp.Val /end CHARACTERISTIC
/begin CHARACTERISTIC CalRegn01Cmn.LoaMgrCurrMeasIdptSig2Resp.Val "MICROSAR RTE" VALUE 0x0 RTE_RL_UBYTE 0 NO_COMPU_METHOD 0 255 SYMBOL_LINK "Rte_CalprmRom_CalRegn01Cmn_DEFAULT_RTE_CALPRM_GROUP.LoaMgrCurrMeasIdptSig2Resp_Val" 0 DISPLAY_IDENTIFIER CalRegn01Cmn.CalibrationPorts.LoaMgrCurrMeasIdptSig2Resp.Val /end CHARACTERISTIC
/begin CHARACTERISTIC CalRegn01Cmn.LoaMgrCurrMeasIdptSigFltThd.Val "MICROSAR RTE" VALUE 0x0 RTE_RL_UBYTE 0 NO_COMPU_METHOD 0 255 SYMBOL_LINK "Rte_CalprmRom_CalRegn01Cmn_DEFAULT_RTE_CALPRM_GROUP.LoaMgrCurrMeasIdptSigFltThd_Val" 0 DISPLAY_IDENTIFIER CalRegn01Cmn.CalibrationPorts.LoaMgrCurrMeasIdptSigFltThd.Val /end CHARACTERISTIC
/begin CHARACTERISTIC CalRegn01Cmn.LoaMgrCurrMeasMtgtnRate.Val "MICROSAR RTE" VALUE 0x0 RTE_RL_FLOAT32_IEEE 0 NO_COMPU_METHOD -3.402823466e+38 3.402823466e+38 SYMBOL_LINK "Rte_CalprmRom_CalRegn01Cmn_DEFAULT_RTE_CALPRM_GROUP.LoaMgrCurrMeasMtgtnRate_Val" 0 DISPLAY_IDENTIFIER CalRegn01Cmn.CalibrationPorts.LoaMgrCurrMeasMtgtnRate.Val /end CHARACTERISTIC
/begin CHARACTERISTIC CalRegn01Cmn.LoaMgrCurrMeasMtgtnSca.Val "MICROSAR RTE" VALUE 0x0 RTE_RL_FLOAT32_IEEE 0 NO_COMPU_METHOD -3.402823466e+38 3.402823466e+38 SYMBOL_LINK "Rte_CalprmRom_CalRegn01Cmn_DEFAULT_RTE_CALPRM_GROUP.LoaMgrCurrMeasMtgtnSca_Val" 0 DISPLAY_IDENTIFIER CalRegn01Cmn.CalibrationPorts.LoaMgrCurrMeasMtgtnSca.Val /end CHARACTERISTIC
/begin CHARACTERISTIC CalRegn01Cmn.LoaMgrCurrMeasMtgtnScaZeroEna.Logl "MICROSAR RTE" VALUE 0x0 RTE_RL_BOOLEAN 0 RTE_CM_BOOLEAN 0 255 SYMBOL_LINK "Rte_CalprmRom_CalRegn01Cmn_DEFAULT_RTE_CALPRM_GROUP.LoaMgrCurrMeasMtgtnScaZeroEna_Logl" 0 DISPLAY_IDENTIFIER CalRegn01Cmn.CalibrationPorts.LoaMgrCurrMeasMtgtnScaZeroEna.Logl /end CHARACTERISTIC
/begin CHARACTERISTIC CalRegn01Cmn.LoaMgrFadeOutStRate.Val "MICROSAR RTE" VALUE 0x0 RTE_RL_FLOAT32_IEEE 0 NO_COMPU_METHOD -3.402823466e+38 3.402823466e+38 SYMBOL_LINK "Rte_CalprmRom_CalRegn01Cmn_DEFAULT_RTE_CALPRM_GROUP.LoaMgrFadeOutStRate_Val" 0 DISPLAY_IDENTIFIER CalRegn01Cmn.CalibrationPorts.LoaMgrFadeOutStRate.Val /end CHARACTERISTIC
/begin CHARACTERISTIC CalRegn01Cmn.LoaMgrHwTqIdptSig0NoTqLoaResp.Val "MICROSAR RTE" VALUE 0x0 RTE_RL_UBYTE 0 NO_COMPU_METHOD 0 255 SYMBOL_LINK "Rte_CalprmRom_CalRegn01Cmn_DEFAULT_RTE_CALPRM_GROUP.LoaMgrHwTqIdptSig0NoTqLoaResp_Val" 0 DISPLAY_IDENTIFIER CalRegn01Cmn.CalibrationPorts.LoaMgrHwTqIdptSig0NoTqLoaResp.Val /end CHARACTERISTIC
/begin CHARACTERISTIC CalRegn01Cmn.LoaMgrHwTqIdptSig1NoTqLoaResp.Val "MICROSAR RTE" VALUE 0x0 RTE_RL_UBYTE 0 NO_COMPU_METHOD 0 255 SYMBOL_LINK "Rte_CalprmRom_CalRegn01Cmn_DEFAULT_RTE_CALPRM_GROUP.LoaMgrHwTqIdptSig1NoTqLoaResp_Val" 0 DISPLAY_IDENTIFIER CalRegn01Cmn.CalibrationPorts.LoaMgrHwTqIdptSig1NoTqLoaResp.Val /end CHARACTERISTIC
/begin CHARACTERISTIC CalRegn01Cmn.LoaMgrHwTqIdptSig2Resp.Val "MICROSAR RTE" VALUE 0x0 RTE_RL_UBYTE 0 NO_COMPU_METHOD 0 255 SYMBOL_LINK "Rte_CalprmRom_CalRegn01Cmn_DEFAULT_RTE_CALPRM_GROUP.LoaMgrHwTqIdptSig2Resp_Val" 0 DISPLAY_IDENTIFIER CalRegn01Cmn.CalibrationPorts.LoaMgrHwTqIdptSig2Resp.Val /end CHARACTERISTIC
/begin CHARACTERISTIC CalRegn01Cmn.LoaMgrHwTqIdptSig4Resp.Val "MICROSAR RTE" VALUE 0x0 RTE_RL_UBYTE 0 NO_COMPU_METHOD 0 255 SYMBOL_LINK "Rte_CalprmRom_CalRegn01Cmn_DEFAULT_RTE_CALPRM_GROUP.LoaMgrHwTqIdptSig4Resp_Val" 0 DISPLAY_IDENTIFIER CalRegn01Cmn.CalibrationPorts.LoaMgrHwTqIdptSig4Resp.Val /end CHARACTERISTIC
/begin CHARACTERISTIC CalRegn01Cmn.LoaMgrHwTqIdptSigFltThd.Val "MICROSAR RTE" VALUE 0x0 RTE_RL_UBYTE 0 NO_COMPU_METHOD 0 255 SYMBOL_LINK "Rte_CalprmRom_CalRegn01Cmn_DEFAULT_RTE_CALPRM_GROUP.LoaMgrHwTqIdptSigFltThd_Val" 0 DISPLAY_IDENTIFIER CalRegn01Cmn.CalibrationPorts.LoaMgrHwTqIdptSigFltThd.Val /end CHARACTERISTIC
/begin CHARACTERISTIC CalRegn01Cmn.LoaMgrHwTqLoaAvlResp.Val "MICROSAR RTE" VALUE 0x0 RTE_RL_UBYTE 0 NO_COMPU_METHOD 0 255 SYMBOL_LINK "Rte_CalprmRom_CalRegn01Cmn_DEFAULT_RTE_CALPRM_GROUP.LoaMgrHwTqLoaAvlResp_Val" 0 DISPLAY_IDENTIFIER CalRegn01Cmn.CalibrationPorts.LoaMgrHwTqLoaAvlResp.Val /end CHARACTERISTIC
/begin CHARACTERISTIC CalRegn01Cmn.LoaMgrIvtrIdptSig0Resp.Val "MICROSAR RTE" VALUE 0x0 RTE_RL_UBYTE 0 NO_COMPU_METHOD 0 255 SYMBOL_LINK "Rte_CalprmRom_CalRegn01Cmn_DEFAULT_RTE_CALPRM_GROUP.LoaMgrIvtrIdptSig0Resp_Val" 0 DISPLAY_IDENTIFIER CalRegn01Cmn.CalibrationPorts.LoaMgrIvtrIdptSig0Resp.Val /end CHARACTERISTIC
/begin CHARACTERISTIC CalRegn01Cmn.LoaMgrIvtrIdptSig1Resp.Val "MICROSAR RTE" VALUE 0x0 RTE_RL_UBYTE 0 NO_COMPU_METHOD 0 255 SYMBOL_LINK "Rte_CalprmRom_CalRegn01Cmn_DEFAULT_RTE_CALPRM_GROUP.LoaMgrIvtrIdptSig1Resp_Val" 0 DISPLAY_IDENTIFIER CalRegn01Cmn.CalibrationPorts.LoaMgrIvtrIdptSig1Resp.Val /end CHARACTERISTIC
/begin CHARACTERISTIC CalRegn01Cmn.LoaMgrIvtrIdptSig2Resp.Val "MICROSAR RTE" VALUE 0x0 RTE_RL_UBYTE 0 NO_COMPU_METHOD 0 255 SYMBOL_LINK "Rte_CalprmRom_CalRegn01Cmn_DEFAULT_RTE_CALPRM_GROUP.LoaMgrIvtrIdptSig2Resp_Val" 0 DISPLAY_IDENTIFIER CalRegn01Cmn.CalibrationPorts.LoaMgrIvtrIdptSig2Resp.Val /end CHARACTERISTIC
/begin CHARACTERISTIC CalRegn01Cmn.LoaMgrIvtrIdptSigFltThd.Val "MICROSAR RTE" VALUE 0x0 RTE_RL_UBYTE 0 NO_COMPU_METHOD 0 255 SYMBOL_LINK "Rte_CalprmRom_CalRegn01Cmn_DEFAULT_RTE_CALPRM_GROUP.LoaMgrIvtrIdptSigFltThd_Val" 0 DISPLAY_IDENTIFIER CalRegn01Cmn.CalibrationPorts.LoaMgrIvtrIdptSigFltThd.Val /end CHARACTERISTIC
/begin CHARACTERISTIC CalRegn01Cmn.LoaMgrIvtrMtgtnRate.Val "MICROSAR RTE" VALUE 0x0 RTE_RL_FLOAT32_IEEE 0 NO_COMPU_METHOD -3.402823466e+38 3.402823466e+38 SYMBOL_LINK "Rte_CalprmRom_CalRegn01Cmn_DEFAULT_RTE_CALPRM_GROUP.LoaMgrIvtrMtgtnRate_Val" 0 DISPLAY_IDENTIFIER CalRegn01Cmn.CalibrationPorts.LoaMgrIvtrMtgtnRate.Val /end CHARACTERISTIC
/begin CHARACTERISTIC CalRegn01Cmn.LoaMgrIvtrMtgtnSca.Val "MICROSAR RTE" VALUE 0x0 RTE_RL_FLOAT32_IEEE 0 NO_COMPU_METHOD -3.402823466e+38 3.402823466e+38 SYMBOL_LINK "Rte_CalprmRom_CalRegn01Cmn_DEFAULT_RTE_CALPRM_GROUP.LoaMgrIvtrMtgtnSca_Val" 0 DISPLAY_IDENTIFIER CalRegn01Cmn.CalibrationPorts.LoaMgrIvtrMtgtnSca.Val /end CHARACTERISTIC
/begin CHARACTERISTIC CalRegn01Cmn.LoaMgrIvtrMtgtnScaZeroEna.Logl "MICROSAR RTE" VALUE 0x0 RTE_RL_BOOLEAN 0 RTE_CM_BOOLEAN 0 255 SYMBOL_LINK "Rte_CalprmRom_CalRegn01Cmn_DEFAULT_RTE_CALPRM_GROUP.LoaMgrIvtrMtgtnScaZeroEna_Logl" 0 DISPLAY_IDENTIFIER CalRegn01Cmn.CalibrationPorts.LoaMgrIvtrMtgtnScaZeroEna.Logl /end CHARACTERISTIC
/begin CHARACTERISTIC CalRegn01Cmn.LoaMgrLimdStRate.Val "MICROSAR RTE" VALUE 0x0 RTE_RL_FLOAT32_IEEE 0 NO_COMPU_METHOD -3.402823466e+38 3.402823466e+38 SYMBOL_LINK "Rte_CalprmRom_CalRegn01Cmn_DEFAULT_RTE_CALPRM_GROUP.LoaMgrLimdStRate_Val" 0 DISPLAY_IDENTIFIER CalRegn01Cmn.CalibrationPorts.LoaMgrLimdStRate.Val /end CHARACTERISTIC
/begin CHARACTERISTIC CalRegn01Cmn.LoaMgrLimdStSca.Val "MICROSAR RTE" VALUE 0x0 RTE_RL_FLOAT32_IEEE 0 NO_COMPU_METHOD -3.402823466e+38 3.402823466e+38 SYMBOL_LINK "Rte_CalprmRom_CalRegn01Cmn_DEFAULT_RTE_CALPRM_GROUP.LoaMgrLimdStSca_Val" 0 DISPLAY_IDENTIFIER CalRegn01Cmn.CalibrationPorts.LoaMgrLimdStSca.Val /end CHARACTERISTIC
/begin CHARACTERISTIC CalRegn01Cmn.LoaMgrMotAgAvlSnsrlsResp.Val "MICROSAR RTE" VALUE 0x0 RTE_RL_UBYTE 0 NO_COMPU_METHOD 0 255 SYMBOL_LINK "Rte_CalprmRom_CalRegn01Cmn_DEFAULT_RTE_CALPRM_GROUP.LoaMgrMotAgAvlSnsrlsResp_Val" 0 DISPLAY_IDENTIFIER CalRegn01Cmn.CalibrationPorts.LoaMgrMotAgAvlSnsrlsResp.Val /end CHARACTERISTIC
/begin CHARACTERISTIC CalRegn01Cmn.LoaMgrMotAgIdptSig0NoSnsrlsResp.Val "MICROSAR RTE" VALUE 0x0 RTE_RL_UBYTE 0 NO_COMPU_METHOD 0 255 SYMBOL_LINK "Rte_CalprmRom_CalRegn01Cmn_DEFAULT_RTE_CALPRM_GROUP.LoaMgrMotAgIdptSig0NoSnsrlsResp_Val" 0 DISPLAY_IDENTIFIER CalRegn01Cmn.CalibrationPorts.LoaMgrMotAgIdptSig0NoSnsrlsResp.Val /end CHARACTERISTIC
/begin CHARACTERISTIC CalRegn01Cmn.LoaMgrMotAgIdptSig1NoSnsrlsResp.Val "MICROSAR RTE" VALUE 0x0 RTE_RL_UBYTE 0 NO_COMPU_METHOD 0 255 SYMBOL_LINK "Rte_CalprmRom_CalRegn01Cmn_DEFAULT_RTE_CALPRM_GROUP.LoaMgrMotAgIdptSig1NoSnsrlsResp_Val" 0 DISPLAY_IDENTIFIER CalRegn01Cmn.CalibrationPorts.LoaMgrMotAgIdptSig1NoSnsrlsResp.Val /end CHARACTERISTIC
/begin CHARACTERISTIC CalRegn01Cmn.LoaMgrMotAgIdptSig2Resp.Val "MICROSAR RTE" VALUE 0x0 RTE_RL_UBYTE 0 NO_COMPU_METHOD 0 255 SYMBOL_LINK "Rte_CalprmRom_CalRegn01Cmn_DEFAULT_RTE_CALPRM_GROUP.LoaMgrMotAgIdptSig2Resp_Val" 0 DISPLAY_IDENTIFIER CalRegn01Cmn.CalibrationPorts.LoaMgrMotAgIdptSig2Resp.Val /end CHARACTERISTIC
/begin CHARACTERISTIC CalRegn01Cmn.LoaMgrMotAgIdptSig3Resp.Val "MICROSAR RTE" VALUE 0x0 RTE_RL_UBYTE 0 NO_COMPU_METHOD 0 255 SYMBOL_LINK "Rte_CalprmRom_CalRegn01Cmn_DEFAULT_RTE_CALPRM_GROUP.LoaMgrMotAgIdptSig3Resp_Val" 0 DISPLAY_IDENTIFIER CalRegn01Cmn.CalibrationPorts.LoaMgrMotAgIdptSig3Resp.Val /end CHARACTERISTIC
/begin CHARACTERISTIC CalRegn01Cmn.LoaMgrMotAgIdptSigFltThd.Val "MICROSAR RTE" VALUE 0x0 RTE_RL_UBYTE 0 NO_COMPU_METHOD 0 255 SYMBOL_LINK "Rte_CalprmRom_CalRegn01Cmn_DEFAULT_RTE_CALPRM_GROUP.LoaMgrMotAgIdptSigFltThd_Val" 0 DISPLAY_IDENTIFIER CalRegn01Cmn.CalibrationPorts.LoaMgrMotAgIdptSigFltThd.Val /end CHARACTERISTIC
/begin CHARACTERISTIC CalRegn01Cmn.LoaMgrMotAgMtgtnRate.Val "MICROSAR RTE" VALUE 0x0 RTE_RL_FLOAT32_IEEE 0 NO_COMPU_METHOD -3.402823466e+38 3.402823466e+38 SYMBOL_LINK "Rte_CalprmRom_CalRegn01Cmn_DEFAULT_RTE_CALPRM_GROUP.LoaMgrMotAgMtgtnRate_Val" 0 DISPLAY_IDENTIFIER CalRegn01Cmn.CalibrationPorts.LoaMgrMotAgMtgtnRate.Val /end CHARACTERISTIC
/begin CHARACTERISTIC CalRegn01Cmn.LoaMgrMotAgMtgtnSca.Val "MICROSAR RTE" VALUE 0x0 RTE_RL_FLOAT32_IEEE 0 NO_COMPU_METHOD -3.402823466e+38 3.402823466e+38 SYMBOL_LINK "Rte_CalprmRom_CalRegn01Cmn_DEFAULT_RTE_CALPRM_GROUP.LoaMgrMotAgMtgtnSca_Val" 0 DISPLAY_IDENTIFIER CalRegn01Cmn.CalibrationPorts.LoaMgrMotAgMtgtnSca.Val /end CHARACTERISTIC
/begin CHARACTERISTIC CalRegn01Cmn.LoaMgrMotAgMtgtnScaZeroEna.Logl "MICROSAR RTE" VALUE 0x0 RTE_RL_BOOLEAN 0 RTE_CM_BOOLEAN 0 255 SYMBOL_LINK "Rte_CalprmRom_CalRegn01Cmn_DEFAULT_RTE_CALPRM_GROUP.LoaMgrMotAgMtgtnScaZeroEna_Logl" 0 DISPLAY_IDENTIFIER CalRegn01Cmn.CalibrationPorts.LoaMgrMotAgMtgtnScaZeroEna.Logl /end CHARACTERISTIC
/begin CHARACTERISTIC CalRegn01Cmn.MotAg2MeasOffs.Val "MICROSAR RTE" VALUE 0x0 RTE_RL_FLOAT32_IEEE 0 NO_COMPU_METHOD -3.402823466e+38 3.402823466e+38 SYMBOL_LINK "Rte_CalprmRom_CalRegn01Cmn_DEFAULT_RTE_CALPRM_GROUP.MotAg2MeasOffs_Val" 0 DISPLAY_IDENTIFIER CalRegn01Cmn.CalibrationPorts.MotAg2MeasOffs.Val /end CHARACTERISTIC
/begin CHARACTERISTIC CalRegn01Cmn.MotCtrlPrmEstimnFetRNom.Val "MICROSAR RTE" VALUE 0x0 RTE_RL_FLOAT32_IEEE 0 NO_COMPU_METHOD 0.0 0.1 SYMBOL_LINK "Rte_CalprmRom_CalRegn01Cmn_DEFAULT_RTE_CALPRM_GROUP.MotCtrlPrmEstimnFetRNom_Val" 0 DISPLAY_IDENTIFIER CalRegn01Cmn.CalibrationPorts.MotCtrlPrmEstimnFetRNom.Val /end CHARACTERISTIC
/begin CHARACTERISTIC CalRegn01Cmn.MotCtrlPrmEstimnFetThermCoeff.Val "MICROSAR RTE" VALUE 0x0 RTE_RL_FLOAT32_IEEE 0 NO_COMPU_METHOD 0.0 0.006 SYMBOL_LINK "Rte_CalprmRom_CalRegn01Cmn_DEFAULT_RTE_CALPRM_GROUP.MotCtrlPrmEstimnFetThermCoeff_Val" 0 DISPLAY_IDENTIFIER CalRegn01Cmn.CalibrationPorts.MotCtrlPrmEstimnFetThermCoeff.Val /end CHARACTERISTIC
/begin CHARACTERISTIC CalRegn01Cmn.MotCtrlPrmEstimnMagThermCoeff.Val "MICROSAR RTE" VALUE 0x0 RTE_RL_FLOAT32_IEEE 0 NO_COMPU_METHOD -0.0015 0.0 SYMBOL_LINK "Rte_CalprmRom_CalRegn01Cmn_DEFAULT_RTE_CALPRM_GROUP.MotCtrlPrmEstimnMagThermCoeff_Val" 0 DISPLAY_IDENTIFIER CalRegn01Cmn.CalibrationPorts.MotCtrlPrmEstimnMagThermCoeff.Val /end CHARACTERISTIC
/begin CHARACTERISTIC CalRegn01Cmn.MotCtrlPrmEstimnMotBackEmfConHiLim.Val "MICROSAR RTE" VALUE 0x0 RTE_RL_FLOAT32_IEEE 0 NO_COMPU_METHOD 0.025 0.075 SYMBOL_LINK "Rte_CalprmRom_CalRegn01Cmn_DEFAULT_RTE_CALPRM_GROUP.MotCtrlPrmEstimnMotBackEmfConHiLim_Val" 0 DISPLAY_IDENTIFIER CalRegn01Cmn.CalibrationPorts.MotCtrlPrmEstimnMotBackEmfConHiLim.Val /end CHARACTERISTIC
/begin CHARACTERISTIC CalRegn01Cmn.MotCtrlPrmEstimnMotBackEmfConLoLim.Val "MICROSAR RTE" VALUE 0x0 RTE_RL_FLOAT32_IEEE 0 NO_COMPU_METHOD 0.025 0.075 SYMBOL_LINK "Rte_CalprmRom_CalRegn01Cmn_DEFAULT_RTE_CALPRM_GROUP.MotCtrlPrmEstimnMotBackEmfConLoLim_Val" 0 DISPLAY_IDENTIFIER CalRegn01Cmn.CalibrationPorts.MotCtrlPrmEstimnMotBackEmfConLoLim.Val /end CHARACTERISTIC
/begin CHARACTERISTIC CalRegn01Cmn.MotCtrlPrmEstimnMotBackEmfConNom.Val "MICROSAR RTE" VALUE 0x0 RTE_RL_FLOAT32_IEEE 0 NO_COMPU_METHOD 0.025 0.075 SYMBOL_LINK "Rte_CalprmRom_CalRegn01Cmn_DEFAULT_RTE_CALPRM_GROUP.MotCtrlPrmEstimnMotBackEmfConNom_Val" 0 DISPLAY_IDENTIFIER CalRegn01Cmn.CalibrationPorts.MotCtrlPrmEstimnMotBackEmfConNom.Val /end CHARACTERISTIC
/begin CHARACTERISTIC CalRegn01Cmn.MotCtrlPrmEstimnMotBackEmfConSatnScaIvtrLoaMtgtn.Val "MICROSAR RTE" VALUE 0x0 RTE_RL_FLOAT32_IEEE 0 NO_COMPU_METHOD -3.402823466e+38 3.402823466e+38 SYMBOL_LINK "Rte_CalprmRom_CalRegn01Cmn_DEFAULT_RTE_CALPRM_GROUP.MotCtrlPrmEstimnMotBackEmfConSatnScaIvtrLoaMtgtn_Val" 0 DISPLAY_IDENTIFIER CalRegn01Cmn.CalibrationPorts.MotCtrlPrmEstimnMotBackEmfConSatnScaIvtrLoaMtgtn.Val /end CHARACTERISTIC
/begin CHARACTERISTIC CalRegn01Cmn.MotCtrlPrmEstimnMotBackEmfConSatnX.Ary1D "MICROSAR RTE" VAL_BLK 0x0 RTE_RL_UWORD 0 RTE_CM_Curr8 0 200 MATRIX_DIM 16 1 1 SYMBOL_LINK "Rte_CalprmRom_CalRegn01Cmn_DEFAULT_RTE_CALPRM_GROUP.MotCtrlPrmEstimnMotBackEmfConSatnX_Ary1D" 0 DISPLAY_IDENTIFIER CalRegn01Cmn.CalibrationPorts.MotCtrlPrmEstimnMotBackEmfConSatnX.Ary1D /end CHARACTERISTIC
/begin CHARACTERISTIC CalRegn01Cmn.MotCtrlPrmEstimnMotBackEmfConSatnY.Ary1D "MICROSAR RTE" VAL_BLK 0x0 RTE_RL_UWORD 0 RTE_CM_Uls11 0 2 MATRIX_DIM 16 1 1 SYMBOL_LINK "Rte_CalprmRom_CalRegn01Cmn_DEFAULT_RTE_CALPRM_GROUP.MotCtrlPrmEstimnMotBackEmfConSatnY_Ary1D" 0 DISPLAY_IDENTIFIER CalRegn01Cmn.CalibrationPorts.MotCtrlPrmEstimnMotBackEmfConSatnY.Ary1D /end CHARACTERISTIC
/begin CHARACTERISTIC CalRegn01Cmn.MotCtrlPrmEstimnMotCurrDaxInduSatnBilnrSeln.Ary1D "MICROSAR RTE" VAL_BLK 0x0 RTE_RL_UWORD 0 RTE_CM_Curr8 0 200 MATRIX_DIM 6 1 1 SYMBOL_LINK "Rte_CalprmRom_CalRegn01Cmn_DEFAULT_RTE_CALPRM_GROUP.MotCtrlPrmEstimnMotCurrDaxInduSatnBilnrSeln_Ary1D" 0 DISPLAY_IDENTIFIER CalRegn01Cmn.CalibrationPorts.MotCtrlPrmEstimnMotCurrDaxInduSatnBilnrSeln.Ary1D /end CHARACTERISTIC
/begin CHARACTERISTIC CalRegn01Cmn.MotCtrlPrmEstimnMotCurrQaxInduSatnX.Ary1D "MICROSAR RTE" VAL_BLK 0x0 RTE_RL_UWORD 0 RTE_CM_Curr8 0 200 MATRIX_DIM 7 1 1 SYMBOL_LINK "Rte_CalprmRom_CalRegn01Cmn_DEFAULT_RTE_CALPRM_GROUP.MotCtrlPrmEstimnMotCurrQaxInduSatnX_Ary1D" 0 DISPLAY_IDENTIFIER CalRegn01Cmn.CalibrationPorts.MotCtrlPrmEstimnMotCurrQaxInduSatnX.Ary1D /end CHARACTERISTIC
/begin CHARACTERISTIC CalRegn01Cmn.MotCtrlPrmEstimnMotInduDaxHiLim.Val "MICROSAR RTE" VALUE 0x0 RTE_RL_FLOAT32_IEEE 0 NO_COMPU_METHOD 0.00003 0.00041 SYMBOL_LINK "Rte_CalprmRom_CalRegn01Cmn_DEFAULT_RTE_CALPRM_GROUP.MotCtrlPrmEstimnMotInduDaxHiLim_Val" 0 DISPLAY_IDENTIFIER CalRegn01Cmn.CalibrationPorts.MotCtrlPrmEstimnMotInduDaxHiLim.Val /end CHARACTERISTIC
/begin CHARACTERISTIC CalRegn01Cmn.MotCtrlPrmEstimnMotInduDaxIvtrLoaMtgtn.Val "MICROSAR RTE" VALUE 0x0 RTE_RL_FLOAT32_IEEE 0 NO_COMPU_METHOD -3.402823466e+38 3.402823466e+38 SYMBOL_LINK "Rte_CalprmRom_CalRegn01Cmn_DEFAULT_RTE_CALPRM_GROUP.MotCtrlPrmEstimnMotInduDaxIvtrLoaMtgtn_Val" 0 DISPLAY_IDENTIFIER CalRegn01Cmn.CalibrationPorts.MotCtrlPrmEstimnMotInduDaxIvtrLoaMtgtn.Val /end CHARACTERISTIC
/begin CHARACTERISTIC CalRegn01Cmn.MotCtrlPrmEstimnMotInduDaxLoLim.Val "MICROSAR RTE" VALUE 0x0 RTE_RL_FLOAT32_IEEE 0 NO_COMPU_METHOD 0.00003 0.00041 SYMBOL_LINK "Rte_CalprmRom_CalRegn01Cmn_DEFAULT_RTE_CALPRM_GROUP.MotCtrlPrmEstimnMotInduDaxLoLim_Val" 0 DISPLAY_IDENTIFIER CalRegn01Cmn.CalibrationPorts.MotCtrlPrmEstimnMotInduDaxLoLim.Val /end CHARACTERISTIC
/begin CHARACTERISTIC CalRegn01Cmn.MotCtrlPrmEstimnMotInduDaxNom.Val "MICROSAR RTE" VALUE 0x0 RTE_RL_FLOAT32_IEEE 0 NO_COMPU_METHOD 0.00003 0.00041 SYMBOL_LINK "Rte_CalprmRom_CalRegn01Cmn_DEFAULT_RTE_CALPRM_GROUP.MotCtrlPrmEstimnMotInduDaxNom_Val" 0 DISPLAY_IDENTIFIER CalRegn01Cmn.CalibrationPorts.MotCtrlPrmEstimnMotInduDaxNom.Val /end CHARACTERISTIC
/begin CHARACTERISTIC CalRegn01Cmn.MotCtrlPrmEstimnMotInduDaxSatnScaY.Ary2D "MICROSAR RTE" VAL_BLK 0x0 RTE_RL_UWORD 0 NO_COMPU_METHOD 0 65535 MATRIX_DIM 7 6 1 SYMBOL_LINK "Rte_CalprmRom_CalRegn01Cmn_DEFAULT_RTE_CALPRM_GROUP.MotCtrlPrmEstimnMotInduDaxSatnScaY_Ary2D" 0 DISPLAY_IDENTIFIER CalRegn01Cmn.CalibrationPorts.MotCtrlPrmEstimnMotInduDaxSatnScaY.Ary2D /end CHARACTERISTIC
/begin CHARACTERISTIC CalRegn01Cmn.MotCtrlPrmEstimnMotInduQaxHiLim.Val "MICROSAR RTE" VALUE 0x0 RTE_RL_FLOAT32_IEEE 0 NO_COMPU_METHOD 0.00003 0.00041 SYMBOL_LINK "Rte_CalprmRom_CalRegn01Cmn_DEFAULT_RTE_CALPRM_GROUP.MotCtrlPrmEstimnMotInduQaxHiLim_Val" 0 DISPLAY_IDENTIFIER CalRegn01Cmn.CalibrationPorts.MotCtrlPrmEstimnMotInduQaxHiLim.Val /end CHARACTERISTIC
/begin CHARACTERISTIC CalRegn01Cmn.MotCtrlPrmEstimnMotInduQaxIvtrLoaMtgtn.Val "MICROSAR RTE" VALUE 0x0 RTE_RL_FLOAT32_IEEE 0 NO_COMPU_METHOD -3.402823466e+38 3.402823466e+38 SYMBOL_LINK "Rte_CalprmRom_CalRegn01Cmn_DEFAULT_RTE_CALPRM_GROUP.MotCtrlPrmEstimnMotInduQaxIvtrLoaMtgtn_Val" 0 DISPLAY_IDENTIFIER CalRegn01Cmn.CalibrationPorts.MotCtrlPrmEstimnMotInduQaxIvtrLoaMtgtn.Val /end CHARACTERISTIC
/begin CHARACTERISTIC CalRegn01Cmn.MotCtrlPrmEstimnMotInduQaxLoLim.Val "MICROSAR RTE" VALUE 0x0 RTE_RL_FLOAT32_IEEE 0 NO_COMPU_METHOD 0.00003 0.00041 SYMBOL_LINK "Rte_CalprmRom_CalRegn01Cmn_DEFAULT_RTE_CALPRM_GROUP.MotCtrlPrmEstimnMotInduQaxLoLim_Val" 0 DISPLAY_IDENTIFIER CalRegn01Cmn.CalibrationPorts.MotCtrlPrmEstimnMotInduQaxLoLim.Val /end CHARACTERISTIC
/begin CHARACTERISTIC CalRegn01Cmn.MotCtrlPrmEstimnMotInduQaxNom.Val "MICROSAR RTE" VALUE 0x0 RTE_RL_FLOAT32_IEEE 0 NO_COMPU_METHOD 0.00003 0.00041 SYMBOL_LINK "Rte_CalprmRom_CalRegn01Cmn_DEFAULT_RTE_CALPRM_GROUP.MotCtrlPrmEstimnMotInduQaxNom_Val" 0 DISPLAY_IDENTIFIER CalRegn01Cmn.CalibrationPorts.MotCtrlPrmEstimnMotInduQaxNom.Val /end CHARACTERISTIC
/begin CHARACTERISTIC CalRegn01Cmn.MotCtrlPrmEstimnMotInduQaxSatnScaY.Ary2D "MICROSAR RTE" VAL_BLK 0x0 RTE_RL_UWORD 0 NO_COMPU_METHOD 0 65535 MATRIX_DIM 7 6 1 SYMBOL_LINK "Rte_CalprmRom_CalRegn01Cmn_DEFAULT_RTE_CALPRM_GROUP.MotCtrlPrmEstimnMotInduQaxSatnScaY_Ary2D" 0 DISPLAY_IDENTIFIER CalRegn01Cmn.CalibrationPorts.MotCtrlPrmEstimnMotInduQaxSatnScaY.Ary2D /end CHARACTERISTIC
/begin CHARACTERISTIC CalRegn01Cmn.MotCtrlPrmEstimnMotRHiLim.Val "MICROSAR RTE" VALUE 0x0 RTE_RL_FLOAT32_IEEE 0 NO_COMPU_METHOD 0.005 0.12565 SYMBOL_LINK "Rte_CalprmRom_CalRegn01Cmn_DEFAULT_RTE_CALPRM_GROUP.MotCtrlPrmEstimnMotRHiLim_Val" 0 DISPLAY_IDENTIFIER CalRegn01Cmn.CalibrationPorts.MotCtrlPrmEstimnMotRHiLim.Val /end CHARACTERISTIC
/begin CHARACTERISTIC CalRegn01Cmn.MotCtrlPrmEstimnMotRLoLim.Val "MICROSAR RTE" VALUE 0x0 RTE_RL_FLOAT32_IEEE 0 NO_COMPU_METHOD 0.005 0.12565 SYMBOL_LINK "Rte_CalprmRom_CalRegn01Cmn_DEFAULT_RTE_CALPRM_GROUP.MotCtrlPrmEstimnMotRLoLim_Val" 0 DISPLAY_IDENTIFIER CalRegn01Cmn.CalibrationPorts.MotCtrlPrmEstimnMotRLoLim.Val /end CHARACTERISTIC
/begin CHARACTERISTIC CalRegn01Cmn.MotCtrlPrmEstimnMotRNom.Val "MICROSAR RTE" VALUE 0x0 RTE_RL_FLOAT32_IEEE 0 NO_COMPU_METHOD 0.005 0.12565 SYMBOL_LINK "Rte_CalprmRom_CalRegn01Cmn_DEFAULT_RTE_CALPRM_GROUP.MotCtrlPrmEstimnMotRNom_Val" 0 DISPLAY_IDENTIFIER CalRegn01Cmn.CalibrationPorts.MotCtrlPrmEstimnMotRNom.Val /end CHARACTERISTIC
/begin CHARACTERISTIC CalRegn01Cmn.MotCtrlPrmEstimnMotWidgThermCoeff.Val "MICROSAR RTE" VALUE 0x0 RTE_RL_FLOAT32_IEEE 0 NO_COMPU_METHOD 0.0 0.0045 SYMBOL_LINK "Rte_CalprmRom_CalRegn01Cmn_DEFAULT_RTE_CALPRM_GROUP.MotCtrlPrmEstimnMotWidgThermCoeff_Val" 0 DISPLAY_IDENTIFIER CalRegn01Cmn.CalibrationPorts.MotCtrlPrmEstimnMotWidgThermCoeff.Val /end CHARACTERISTIC
/begin CHARACTERISTIC CalRegn01Cmn.MotCtrlPrmEstimnTNom.Val "MICROSAR RTE" VALUE 0x0 RTE_RL_FLOAT32_IEEE 0 NO_COMPU_METHOD -40.0 150.0 SYMBOL_LINK "Rte_CalprmRom_CalRegn01Cmn_DEFAULT_RTE_CALPRM_GROUP.MotCtrlPrmEstimnTNom_Val" 0 DISPLAY_IDENTIFIER CalRegn01Cmn.CalibrationPorts.MotCtrlPrmEstimnTNom.Val /end CHARACTERISTIC
/begin CHARACTERISTIC CalRegn01Cmn.MotCurrPeakEstimnCurrFilFrq.Val "MICROSAR RTE" VALUE 0x0 RTE_RL_FLOAT32_IEEE 0 NO_COMPU_METHOD -3.402823466e+38 3.402823466e+38 SYMBOL_LINK "Rte_CalprmRom_CalRegn01Cmn_DEFAULT_RTE_CALPRM_GROUP.MotCurrPeakEstimnCurrFilFrq_Val" 0 DISPLAY_IDENTIFIER CalRegn01Cmn.CalibrationPorts.MotCurrPeakEstimnCurrFilFrq.Val /end CHARACTERISTIC
/begin CHARACTERISTIC CalRegn01Cmn.MotCurrPeakEstimnCurrPeakEstimdFilFrq.Val "MICROSAR RTE" VALUE 0x0 RTE_RL_FLOAT32_IEEE 0 NO_COMPU_METHOD -3.402823466e+38 3.402823466e+38 SYMBOL_LINK "Rte_CalprmRom_CalRegn01Cmn_DEFAULT_RTE_CALPRM_GROUP.MotCurrPeakEstimnCurrPeakEstimdFilFrq_Val" 0 DISPLAY_IDENTIFIER CalRegn01Cmn.CalibrationPorts.MotCurrPeakEstimnCurrPeakEstimdFilFrq.Val /end CHARACTERISTIC
/begin CHARACTERISTIC CalRegn01Cmn.MotCurrRegCfgCtrlrDynGainVehSpdCutOff.Val "MICROSAR RTE" VALUE 0x0 RTE_RL_FLOAT32_IEEE 0 NO_COMPU_METHOD 0.0 255.0 SYMBOL_LINK "Rte_CalprmRom_CalRegn01Cmn_DEFAULT_RTE_CALPRM_GROUP.MotCurrRegCfgCtrlrDynGainVehSpdCutOff_Val" 0 DISPLAY_IDENTIFIER CalRegn01Cmn.CalibrationPorts.MotCurrRegCfgCtrlrDynGainVehSpdCutOff.Val /end CHARACTERISTIC
/begin CHARACTERISTIC CalRegn01Cmn.MotCurrRegCfgCurrLoopSecOrderTrfFctEna.Logl "MICROSAR RTE" VALUE 0x0 RTE_RL_BOOLEAN 0 RTE_CM_BOOLEAN 0 255 SYMBOL_LINK "Rte_CalprmRom_CalRegn01Cmn_DEFAULT_RTE_CALPRM_GROUP.MotCurrRegCfgCurrLoopSecOrderTrfFctEna_Logl" 0 DISPLAY_IDENTIFIER CalRegn01Cmn.CalibrationPorts.MotCurrRegCfgCurrLoopSecOrderTrfFctEna.Logl /end CHARACTERISTIC
/begin CHARACTERISTIC CalRegn01Cmn.MotCurrRegCfgIntglGainSampleTi.Val "MICROSAR RTE" VALUE 0x0 RTE_RL_FLOAT32_IEEE 0 NO_COMPU_METHOD 0.000091 0.000143 SYMBOL_LINK "Rte_CalprmRom_CalRegn01Cmn_DEFAULT_RTE_CALPRM_GROUP.MotCurrRegCfgIntglGainSampleTi_Val" 0 DISPLAY_IDENTIFIER CalRegn01Cmn.CalibrationPorts.MotCurrRegCfgIntglGainSampleTi.Val /end CHARACTERISTIC
/begin CHARACTERISTIC CalRegn01Cmn.MotCurrRegCfgMotAgCompuDly.Val "MICROSAR RTE" VALUE 0x0 RTE_RL_FLOAT32_IEEE 0 NO_COMPU_METHOD 0.0 0.0002 SYMBOL_LINK "Rte_CalprmRom_CalRegn01Cmn_DEFAULT_RTE_CALPRM_GROUP.MotCurrRegCfgMotAgCompuDly_Val" 0 DISPLAY_IDENTIFIER CalRegn01Cmn.CalibrationPorts.MotCurrRegCfgMotAgCompuDly.Val /end CHARACTERISTIC
/begin CHARACTERISTIC CalRegn01Cmn.MotCurrRegCfgMotClsdLoopBwDaxY.Ary1D "MICROSAR RTE" VAL_BLK 0x0 RTE_RL_UWORD 0 RTE_CM_Frq3 0 750 MATRIX_DIM 4 1 1 SYMBOL_LINK "Rte_CalprmRom_CalRegn01Cmn_DEFAULT_RTE_CALPRM_GROUP.MotCurrRegCfgMotClsdLoopBwDaxY_Ary1D" 0 DISPLAY_IDENTIFIER CalRegn01Cmn.CalibrationPorts.MotCurrRegCfgMotClsdLoopBwDaxY.Ary1D /end CHARACTERISTIC
/begin CHARACTERISTIC CalRegn01Cmn.MotCurrRegCfgMotClsdLoopBwQaxY.Ary1D "MICROSAR RTE" VAL_BLK 0x0 RTE_RL_UWORD 0 RTE_CM_Frq4 0 1000 MATRIX_DIM 4 1 1 SYMBOL_LINK "Rte_CalprmRom_CalRegn01Cmn_DEFAULT_RTE_CALPRM_GROUP.MotCurrRegCfgMotClsdLoopBwQaxY_Ary1D" 0 DISPLAY_IDENTIFIER CalRegn01Cmn.CalibrationPorts.MotCurrRegCfgMotClsdLoopBwQaxY.Ary1D /end CHARACTERISTIC
/begin CHARACTERISTIC CalRegn01Cmn.MotCurrRegCfgMotCtrlPrmSelnX.Ary1D "MICROSAR RTE" VAL_BLK 0x0 RTE_RL_UWORD 0 RTE_CM_Vel4 0 1350 MATRIX_DIM 4 1 1 SYMBOL_LINK "Rte_CalprmRom_CalRegn01Cmn_DEFAULT_RTE_CALPRM_GROUP.MotCurrRegCfgMotCtrlPrmSelnX_Ary1D" 0 DISPLAY_IDENTIFIER CalRegn01Cmn.CalibrationPorts.MotCurrRegCfgMotCtrlPrmSelnX.Ary1D /end CHARACTERISTIC
/begin CHARACTERISTIC CalRegn01Cmn.MotCurrRegCfgMotDampgRatDax.Val "MICROSAR RTE" VALUE 0x0 RTE_RL_FLOAT32_IEEE 0 NO_COMPU_METHOD 0.0 20.0 SYMBOL_LINK "Rte_CalprmRom_CalRegn01Cmn_DEFAULT_RTE_CALPRM_GROUP.MotCurrRegCfgMotDampgRatDax_Val" 0 DISPLAY_IDENTIFIER CalRegn01Cmn.CalibrationPorts.MotCurrRegCfgMotDampgRatDax.Val /end CHARACTERISTIC
/begin CHARACTERISTIC CalRegn01Cmn.MotCurrRegCfgMotDampgRatQax.Val "MICROSAR RTE" VALUE 0x0 RTE_RL_FLOAT32_IEEE 0 NO_COMPU_METHOD 0.0 20.0 SYMBOL_LINK "Rte_CalprmRom_CalRegn01Cmn_DEFAULT_RTE_CALPRM_GROUP.MotCurrRegCfgMotDampgRatQax_Val" 0 DISPLAY_IDENTIFIER CalRegn01Cmn.CalibrationPorts.MotCurrRegCfgMotDampgRatQax.Val /end CHARACTERISTIC
/begin CHARACTERISTIC CalRegn01Cmn.MotCurrRegCfgMotNatFrqDaxY.Ary1D "MICROSAR RTE" VAL_BLK 0x0 RTE_RL_UWORD 0 RTE_CM_Frq5 0 500 MATRIX_DIM 4 1 1 SYMBOL_LINK "Rte_CalprmRom_CalRegn01Cmn_DEFAULT_RTE_CALPRM_GROUP.MotCurrRegCfgMotNatFrqDaxY_Ary1D" 0 DISPLAY_IDENTIFIER CalRegn01Cmn.CalibrationPorts.MotCurrRegCfgMotNatFrqDaxY.Ary1D /end CHARACTERISTIC
/begin CHARACTERISTIC CalRegn01Cmn.MotCurrRegCfgMotNatFrqQaxY.Ary1D "MICROSAR RTE" VAL_BLK 0x0 RTE_RL_UWORD 0 RTE_CM_Frq6 0 400 MATRIX_DIM 4 1 1 SYMBOL_LINK "Rte_CalprmRom_CalRegn01Cmn_DEFAULT_RTE_CALPRM_GROUP.MotCurrRegCfgMotNatFrqQaxY_Ary1D" 0 DISPLAY_IDENTIFIER CalRegn01Cmn.CalibrationPorts.MotCurrRegCfgMotNatFrqQaxY.Ary1D /end CHARACTERISTIC
/begin CHARACTERISTIC CalRegn01Cmn.MotCurrRegCfgMotRVirtDax.Val "MICROSAR RTE" VALUE 0x0 RTE_RL_FLOAT32_IEEE 0 NO_COMPU_METHOD 0.0 0.2 SYMBOL_LINK "Rte_CalprmRom_CalRegn01Cmn_DEFAULT_RTE_CALPRM_GROUP.MotCurrRegCfgMotRVirtDax_Val" 0 DISPLAY_IDENTIFIER CalRegn01Cmn.CalibrationPorts.MotCurrRegCfgMotRVirtDax.Val /end CHARACTERISTIC
/begin CHARACTERISTIC CalRegn01Cmn.MotCurrRegCfgMotRVirtQax.Val "MICROSAR RTE" VALUE 0x0 RTE_RL_FLOAT32_IEEE 0 NO_COMPU_METHOD 0.0 0.2 SYMBOL_LINK "Rte_CalprmRom_CalRegn01Cmn_DEFAULT_RTE_CALPRM_GROUP.MotCurrRegCfgMotRVirtQax_Val" 0 DISPLAY_IDENTIFIER CalRegn01Cmn.CalibrationPorts.MotCurrRegCfgMotRVirtQax.Val /end CHARACTERISTIC
/begin CHARACTERISTIC CalRegn01Cmn.MotCurrRegCfgMotVelFilFrq.Val "MICROSAR RTE" VALUE 0x0 RTE_RL_FLOAT32_IEEE 0 NO_COMPU_METHOD 1.0 200.0 SYMBOL_LINK "Rte_CalprmRom_CalRegn01Cmn_DEFAULT_RTE_CALPRM_GROUP.MotCurrRegCfgMotVelFilFrq_Val" 0 DISPLAY_IDENTIFIER CalRegn01Cmn.CalibrationPorts.MotCurrRegCfgMotVelFilFrq.Val /end CHARACTERISTIC
/begin CHARACTERISTIC CalRegn01Cmn.MotCurrRegVltgLimrCurrLoaScarSlewRate.Val "MICROSAR RTE" VALUE 0x0 RTE_RL_FLOAT32_IEEE 0 NO_COMPU_METHOD 0.0 1000.0 SYMBOL_LINK "Rte_CalprmRom_CalRegn01Cmn_DEFAULT_RTE_CALPRM_GROUP.MotCurrRegVltgLimrCurrLoaScarSlewRate_Val" 0 DISPLAY_IDENTIFIER CalRegn01Cmn.CalibrationPorts.MotCurrRegVltgLimrCurrLoaScarSlewRate.Val /end CHARACTERISTIC
/begin CHARACTERISTIC CalRegn01Cmn.MotCurrRegVltgLimrDaxAntiWdupCoeff.Val "MICROSAR RTE" VALUE 0x0 RTE_RL_FLOAT32_IEEE 0 NO_COMPU_METHOD -25 25 SYMBOL_LINK "Rte_CalprmRom_CalRegn01Cmn_DEFAULT_RTE_CALPRM_GROUP.MotCurrRegVltgLimrDaxAntiWdupCoeff_Val" 0 DISPLAY_IDENTIFIER CalRegn01Cmn.CalibrationPorts.MotCurrRegVltgLimrDaxAntiWdupCoeff.Val /end CHARACTERISTIC
/begin CHARACTERISTIC CalRegn01Cmn.MotCurrRegVltgLimrDualEcuLoaScarSlewRate.Val "MICROSAR RTE" VALUE 0x0 RTE_RL_FLOAT32_IEEE 0 NO_COMPU_METHOD -3.402823466e+38 3.402823466e+38 SYMBOL_LINK "Rte_CalprmRom_CalRegn01Cmn_DEFAULT_RTE_CALPRM_GROUP.MotCurrRegVltgLimrDualEcuLoaScarSlewRate_Val" 0 DISPLAY_IDENTIFIER CalRegn01Cmn.CalibrationPorts.MotCurrRegVltgLimrDualEcuLoaScarSlewRate.Val /end CHARACTERISTIC
/begin CHARACTERISTIC CalRegn01Cmn.MotCurrRegVltgLimrIvtrLoaScarSlewRate.Val "MICROSAR RTE" VALUE 0x0 RTE_RL_FLOAT32_IEEE 0 NO_COMPU_METHOD 0.0 1000.0 SYMBOL_LINK "Rte_CalprmRom_CalRegn01Cmn_DEFAULT_RTE_CALPRM_GROUP.MotCurrRegVltgLimrIvtrLoaScarSlewRate_Val" 0 DISPLAY_IDENTIFIER CalRegn01Cmn.CalibrationPorts.MotCurrRegVltgLimrIvtrLoaScarSlewRate.Val /end CHARACTERISTIC
/begin CHARACTERISTIC CalRegn01Cmn.MotCurrRegVltgLimrMotCurrPredEna.Logl "MICROSAR RTE" VALUE 0x0 RTE_RL_BOOLEAN 0 RTE_CM_BOOLEAN 0 255 SYMBOL_LINK "Rte_CalprmRom_CalRegn01Cmn_DEFAULT_RTE_CALPRM_GROUP.MotCurrRegVltgLimrMotCurrPredEna_Logl" 0 DISPLAY_IDENTIFIER CalRegn01Cmn.CalibrationPorts.MotCurrRegVltgLimrMotCurrPredEna.Logl /end CHARACTERISTIC
/begin CHARACTERISTIC CalRegn01Cmn.MotCurrRegVltgLimrMotCurrPredTi.Val "MICROSAR RTE" VALUE 0x0 RTE_RL_FLOAT32_IEEE 0 NO_COMPU_METHOD -3.402823466e+38 3.402823466e+38 SYMBOL_LINK "Rte_CalprmRom_CalRegn01Cmn_DEFAULT_RTE_CALPRM_GROUP.MotCurrRegVltgLimrMotCurrPredTi_Val" 0 DISPLAY_IDENTIFIER CalRegn01Cmn.CalibrationPorts.MotCurrRegVltgLimrMotCurrPredTi.Val /end CHARACTERISTIC
/begin CHARACTERISTIC CalRegn01Cmn.MotCurrRegVltgLimrMotCurrQaxRefMdfnRplEna.Logl "MICROSAR RTE" VALUE 0x0 RTE_RL_BOOLEAN 0 RTE_CM_BOOLEAN 0 255 SYMBOL_LINK "Rte_CalprmRom_CalRegn01Cmn_DEFAULT_RTE_CALPRM_GROUP.MotCurrRegVltgLimrMotCurrQaxRefMdfnRplEna_Logl" 0 DISPLAY_IDENTIFIER CalRegn01Cmn.CalibrationPorts.MotCurrRegVltgLimrMotCurrQaxRefMdfnRplEna.Logl /end CHARACTERISTIC
/begin CHARACTERISTIC CalRegn01Cmn.MotCurrRegVltgLimrMotVltgBrdgFilEna.Logl "MICROSAR RTE" VALUE 0x0 RTE_RL_BOOLEAN 0 RTE_CM_BOOLEAN 0 255 SYMBOL_LINK "Rte_CalprmRom_CalRegn01Cmn_DEFAULT_RTE_CALPRM_GROUP.MotCurrRegVltgLimrMotVltgBrdgFilEna_Logl" 0 DISPLAY_IDENTIFIER CalRegn01Cmn.CalibrationPorts.MotCurrRegVltgLimrMotVltgBrdgFilEna.Logl /end CHARACTERISTIC
/begin CHARACTERISTIC CalRegn01Cmn.MotCurrRegVltgLimrMotVltgBrdgLpFilFrq.Val "MICROSAR RTE" VALUE 0x0 RTE_RL_FLOAT32_IEEE 0 NO_COMPU_METHOD -3.402823466e+38 3.402823466e+38 SYMBOL_LINK "Rte_CalprmRom_CalRegn01Cmn_DEFAULT_RTE_CALPRM_GROUP.MotCurrRegVltgLimrMotVltgBrdgLpFilFrq_Val" 0 DISPLAY_IDENTIFIER CalRegn01Cmn.CalibrationPorts.MotCurrRegVltgLimrMotVltgBrdgLpFilFrq.Val /end CHARACTERISTIC
/begin CHARACTERISTIC CalRegn01Cmn.MotCurrRegVltgLimrMotVltgDaxIntglHiLim.Val "MICROSAR RTE" VALUE 0x0 RTE_RL_FLOAT32_IEEE 0 NO_COMPU_METHOD -3.402823466e+38 3.402823466e+38 SYMBOL_LINK "Rte_CalprmRom_CalRegn01Cmn_DEFAULT_RTE_CALPRM_GROUP.MotCurrRegVltgLimrMotVltgDaxIntglHiLim_Val" 0 DISPLAY_IDENTIFIER CalRegn01Cmn.CalibrationPorts.MotCurrRegVltgLimrMotVltgDaxIntglHiLim.Val /end CHARACTERISTIC
/begin CHARACTERISTIC CalRegn01Cmn.MotCurrRegVltgLimrMotVltgDaxIntglLoLim.Val "MICROSAR RTE" VALUE 0x0 RTE_RL_FLOAT32_IEEE 0 NO_COMPU_METHOD -3.402823466e+38 3.402823466e+38 SYMBOL_LINK "Rte_CalprmRom_CalRegn01Cmn_DEFAULT_RTE_CALPRM_GROUP.MotCurrRegVltgLimrMotVltgDaxIntglLoLim_Val" 0 DISPLAY_IDENTIFIER CalRegn01Cmn.CalibrationPorts.MotCurrRegVltgLimrMotVltgDaxIntglLoLim.Val /end CHARACTERISTIC
/begin CHARACTERISTIC CalRegn01Cmn.MotCurrRegVltgLimrMotVltgQaxFfFilEna.Logl "MICROSAR RTE" VALUE 0x0 RTE_RL_BOOLEAN 0 RTE_CM_BOOLEAN 0 255 SYMBOL_LINK "Rte_CalprmRom_CalRegn01Cmn_DEFAULT_RTE_CALPRM_GROUP.MotCurrRegVltgLimrMotVltgQaxFfFilEna_Logl" 0 DISPLAY_IDENTIFIER CalRegn01Cmn.CalibrationPorts.MotCurrRegVltgLimrMotVltgQaxFfFilEna.Logl /end CHARACTERISTIC
/begin CHARACTERISTIC CalRegn01Cmn.MotCurrRegVltgLimrMotVltgQaxFfLpFilFrq.Val "MICROSAR RTE" VALUE 0x0 RTE_RL_FLOAT32_IEEE 0 NO_COMPU_METHOD -3.402823466e+38 3.402823466e+38 SYMBOL_LINK "Rte_CalprmRom_CalRegn01Cmn_DEFAULT_RTE_CALPRM_GROUP.MotCurrRegVltgLimrMotVltgQaxFfLpFilFrq_Val" 0 DISPLAY_IDENTIFIER CalRegn01Cmn.CalibrationPorts.MotCurrRegVltgLimrMotVltgQaxFfLpFilFrq.Val /end CHARACTERISTIC
/begin CHARACTERISTIC CalRegn01Cmn.MotCurrRegVltgLimrMotVltgQaxIntglHiLim.Val "MICROSAR RTE" VALUE 0x0 RTE_RL_FLOAT32_IEEE 0 NO_COMPU_METHOD -3.402823466e+38 3.402823466e+38 SYMBOL_LINK "Rte_CalprmRom_CalRegn01Cmn_DEFAULT_RTE_CALPRM_GROUP.MotCurrRegVltgLimrMotVltgQaxIntglHiLim_Val" 0 DISPLAY_IDENTIFIER CalRegn01Cmn.CalibrationPorts.MotCurrRegVltgLimrMotVltgQaxIntglHiLim.Val /end CHARACTERISTIC
/begin CHARACTERISTIC CalRegn01Cmn.MotCurrRegVltgLimrMotVltgQaxIntglLoLim.Val "MICROSAR RTE" VALUE 0x0 RTE_RL_FLOAT32_IEEE 0 NO_COMPU_METHOD -3.402823466e+38 3.402823466e+38 SYMBOL_LINK "Rte_CalprmRom_CalRegn01Cmn_DEFAULT_RTE_CALPRM_GROUP.MotCurrRegVltgLimrMotVltgQaxIntglLoLim_Val" 0 DISPLAY_IDENTIFIER CalRegn01Cmn.CalibrationPorts.MotCurrRegVltgLimrMotVltgQaxIntglLoLim.Val /end CHARACTERISTIC
/begin CHARACTERISTIC CalRegn01Cmn.MotCurrRegVltgLimrQaxAntiWdupCoeff.Val "MICROSAR RTE" VALUE 0x0 RTE_RL_FLOAT32_IEEE 0 NO_COMPU_METHOD -25 25 SYMBOL_LINK "Rte_CalprmRom_CalRegn01Cmn_DEFAULT_RTE_CALPRM_GROUP.MotCurrRegVltgLimrQaxAntiWdupCoeff_Val" 0 DISPLAY_IDENTIFIER CalRegn01Cmn.CalibrationPorts.MotCurrRegVltgLimrQaxAntiWdupCoeff.Val /end CHARACTERISTIC
/begin CHARACTERISTIC CalRegn01Cmn.MotCurrRegVltgLimrQaxAntiWdupScagDi.Logl "MICROSAR RTE" VALUE 0x0 RTE_RL_BOOLEAN 0 RTE_CM_BOOLEAN 0 255 SYMBOL_LINK "Rte_CalprmRom_CalRegn01Cmn_DEFAULT_RTE_CALPRM_GROUP.MotCurrRegVltgLimrQaxAntiWdupScagDi_Logl" 0 DISPLAY_IDENTIFIER CalRegn01Cmn.CalibrationPorts.MotCurrRegVltgLimrQaxAntiWdupScagDi.Logl /end CHARACTERISTIC
/begin CHARACTERISTIC CalRegn01Cmn.MotDrvDiagcErrFilFrq.Val "MICROSAR RTE" VALUE 0x0 RTE_RL_FLOAT32_IEEE 0 NO_COMPU_METHOD -3.402823466e+38 3.402823466e+38 SYMBOL_LINK "Rte_CalprmRom_CalRegn01Cmn_DEFAULT_RTE_CALPRM_GROUP.MotDrvDiagcErrFilFrq_Val" 0 DISPLAY_IDENTIFIER CalRegn01Cmn.CalibrationPorts.MotDrvDiagcErrFilFrq.Val /end CHARACTERISTIC
/begin CHARACTERISTIC CalRegn01Cmn.MotDrvDiagcErrOffs.Val "MICROSAR RTE" VALUE 0x0 RTE_RL_ULONG 0 NO_COMPU_METHOD 0 4294967295 SYMBOL_LINK "Rte_CalprmRom_CalRegn01Cmn_DEFAULT_RTE_CALPRM_GROUP.MotDrvDiagcErrOffs_Val" 0 DISPLAY_IDENTIFIER CalRegn01Cmn.CalibrationPorts.MotDrvDiagcErrOffs.Val /end CHARACTERISTIC
/begin CHARACTERISTIC CalRegn01Cmn.MotDrvDiagcErrThd.Val "MICROSAR RTE" VALUE 0x0 RTE_RL_ULONG 0 NO_COMPU_METHOD 0 4294967295 SYMBOL_LINK "Rte_CalprmRom_CalRegn01Cmn_DEFAULT_RTE_CALPRM_GROUP.MotDrvDiagcErrThd_Val" 0 DISPLAY_IDENTIFIER CalRegn01Cmn.CalibrationPorts.MotDrvDiagcErrThd.Val /end CHARACTERISTIC
/begin CHARACTERISTIC CalRegn01Cmn.MotQuadDetnMotDirHysInsts.Val "MICROSAR RTE" VALUE 0x0 RTE_RL_SLONG 0 RTE_CM_Ag6 0 6.25 SYMBOL_LINK "Rte_CalprmRom_CalRegn01Cmn_DEFAULT_RTE_CALPRM_GROUP.MotQuadDetnMotDirHysInsts_Val" 0 DISPLAY_IDENTIFIER CalRegn01Cmn.CalibrationPorts.MotQuadDetnMotDirHysInsts.Val /end CHARACTERISTIC
/begin CHARACTERISTIC CalRegn01Cmn.MotRefMdlCurrDaxBoostGain.Val "MICROSAR RTE" VALUE 0x0 RTE_RL_FLOAT32_IEEE 0 NO_COMPU_METHOD 0.0 1.0 SYMBOL_LINK "Rte_CalprmRom_CalRegn01Cmn_DEFAULT_RTE_CALPRM_GROUP.MotRefMdlCurrDaxBoostGain_Val" 0 DISPLAY_IDENTIFIER CalRegn01Cmn.CalibrationPorts.MotRefMdlCurrDaxBoostGain.Val /end CHARACTERISTIC
/begin CHARACTERISTIC CalRegn01Cmn.MotRefMdlCurrDaxBoostTqScaX.Ary1D "MICROSAR RTE" VAL_BLK 0x0 RTE_RL_UWORD 0 RTE_CM_Tq13 0 8.8 MATRIX_DIM 11 1 1 SYMBOL_LINK "Rte_CalprmRom_CalRegn01Cmn_DEFAULT_RTE_CALPRM_GROUP.MotRefMdlCurrDaxBoostTqScaX_Ary1D" 0 DISPLAY_IDENTIFIER CalRegn01Cmn.CalibrationPorts.MotRefMdlCurrDaxBoostTqScaX.Ary1D /end CHARACTERISTIC
/begin CHARACTERISTIC CalRegn01Cmn.MotRefMdlCurrDaxBoostTqScaY.Ary1D "MICROSAR RTE" VAL_BLK 0x0 RTE_RL_UWORD 0 RTE_CM_Uls15 0 1 MATRIX_DIM 11 1 1 SYMBOL_LINK "Rte_CalprmRom_CalRegn01Cmn_DEFAULT_RTE_CALPRM_GROUP.MotRefMdlCurrDaxBoostTqScaY_Ary1D" 0 DISPLAY_IDENTIFIER CalRegn01Cmn.CalibrationPorts.MotRefMdlCurrDaxBoostTqScaY.Ary1D /end CHARACTERISTIC
/begin CHARACTERISTIC CalRegn01Cmn.MotRefMdlCurrDaxQaxRefDelta.Ary1D "MICROSAR RTE" VAL_BLK 0x0 RTE_RL_FLOAT32_IEEE 0 NO_COMPU_METHOD -3.1415927 3.1415927 MATRIX_DIM 8 1 1 SYMBOL_LINK "Rte_CalprmRom_CalRegn01Cmn_DEFAULT_RTE_CALPRM_GROUP.MotRefMdlCurrDaxQaxRefDelta_Ary1D" 0 DISPLAY_IDENTIFIER CalRegn01Cmn.CalibrationPorts.MotRefMdlCurrDaxQaxRefDelta.Ary1D /end CHARACTERISTIC
/begin CHARACTERISTIC CalRegn01Cmn.MotRefMdlCurrItrnTolr.Val "MICROSAR RTE" VALUE 0x0 RTE_RL_FLOAT32_IEEE 0 NO_COMPU_METHOD 0.01 20.0 SYMBOL_LINK "Rte_CalprmRom_CalRegn01Cmn_DEFAULT_RTE_CALPRM_GROUP.MotRefMdlCurrItrnTolr_Val" 0 DISPLAY_IDENTIFIER CalRegn01Cmn.CalibrationPorts.MotRefMdlCurrItrnTolr.Val /end CHARACTERISTIC
/begin CHARACTERISTIC CalRegn01Cmn.MotRefMdlFbCtrlDi.Logl "MICROSAR RTE" VALUE 0x0 RTE_RL_BOOLEAN 0 RTE_CM_BOOLEAN 0 255 SYMBOL_LINK "Rte_CalprmRom_CalRegn01Cmn_DEFAULT_RTE_CALPRM_GROUP.MotRefMdlFbCtrlDi_Logl" 0 DISPLAY_IDENTIFIER CalRegn01Cmn.CalibrationPorts.MotRefMdlFbCtrlDi.Logl /end CHARACTERISTIC
/begin CHARACTERISTIC CalRegn01Cmn.MotRefMdlIvtrDeadTiBrdgVltgSca.Val "MICROSAR RTE" VALUE 0x0 RTE_RL_FLOAT32_IEEE 0 NO_COMPU_METHOD 0.98 1 SYMBOL_LINK "Rte_CalprmRom_CalRegn01Cmn_DEFAULT_RTE_CALPRM_GROUP.MotRefMdlIvtrDeadTiBrdgVltgSca_Val" 0 DISPLAY_IDENTIFIER CalRegn01Cmn.CalibrationPorts.MotRefMdlIvtrDeadTiBrdgVltgSca.Val /end CHARACTERISTIC
/begin CHARACTERISTIC CalRegn01Cmn.MotRefMdlMinCurrItrnLim.Val "MICROSAR RTE" VALUE 0x0 RTE_RL_UBYTE 0 NO_COMPU_METHOD 1.0 5.0 SYMBOL_LINK "Rte_CalprmRom_CalRegn01Cmn_DEFAULT_RTE_CALPRM_GROUP.MotRefMdlMinCurrItrnLim_Val" 0 DISPLAY_IDENTIFIER CalRegn01Cmn.CalibrationPorts.MotRefMdlMinCurrItrnLim.Val /end CHARACTERISTIC
/begin CHARACTERISTIC CalRegn01Cmn.MotRefMdlMotCurrDaxMaxSca.Val "MICROSAR RTE" VALUE 0x0 RTE_RL_FLOAT32_IEEE 0 NO_COMPU_METHOD 1.0 2.0 SYMBOL_LINK "Rte_CalprmRom_CalRegn01Cmn_DEFAULT_RTE_CALPRM_GROUP.MotRefMdlMotCurrDaxMaxSca_Val" 0 DISPLAY_IDENTIFIER CalRegn01Cmn.CalibrationPorts.MotRefMdlMotCurrDaxMaxSca.Val /end CHARACTERISTIC
/begin CHARACTERISTIC CalRegn01Cmn.MotRefMdlMotVelLpFilFrq.Val "MICROSAR RTE" VALUE 0x0 RTE_RL_FLOAT32_IEEE 0 NO_COMPU_METHOD 1.0 200.0 SYMBOL_LINK "Rte_CalprmRom_CalRegn01Cmn_DEFAULT_RTE_CALPRM_GROUP.MotRefMdlMotVelLpFilFrq_Val" 0 DISPLAY_IDENTIFIER CalRegn01Cmn.CalibrationPorts.MotRefMdlMotVelLpFilFrq.Val /end CHARACTERISTIC
/begin CHARACTERISTIC CalRegn01Cmn.MotRefMdlMotVltgDerivtvTiCon.Val "MICROSAR RTE" VALUE 0x0 RTE_RL_FLOAT32_IEEE 0 NO_COMPU_METHOD 0.0 0.05 SYMBOL_LINK "Rte_CalprmRom_CalRegn01Cmn_DEFAULT_RTE_CALPRM_GROUP.MotRefMdlMotVltgDerivtvTiCon_Val" 0 DISPLAY_IDENTIFIER CalRegn01Cmn.CalibrationPorts.MotRefMdlMotVltgDerivtvTiCon.Val /end CHARACTERISTIC
/begin CHARACTERISTIC CalRegn01Cmn.MotRefMdlQuad13VltgSdlX.Ary1D "MICROSAR RTE" VAL_BLK 0x0 RTE_RL_UWORD 0 RTE_CM_Vel4 0 1350 MATRIX_DIM 10 1 1 SYMBOL_LINK "Rte_CalprmRom_CalRegn01Cmn_DEFAULT_RTE_CALPRM_GROUP.MotRefMdlQuad13VltgSdlX_Ary1D" 0 DISPLAY_IDENTIFIER CalRegn01Cmn.CalibrationPorts.MotRefMdlQuad13VltgSdlX.Ary1D /end CHARACTERISTIC
/begin CHARACTERISTIC CalRegn01Cmn.MotRefMdlQuad13VltgSdlY.Ary1D "MICROSAR RTE" VAL_BLK 0x0 RTE_RL_UWORD 0 RTE_CM_Volt18 0 5 MATRIX_DIM 10 1 1 SYMBOL_LINK "Rte_CalprmRom_CalRegn01Cmn_DEFAULT_RTE_CALPRM_GROUP.MotRefMdlQuad13VltgSdlY_Ary1D" 0 DISPLAY_IDENTIFIER CalRegn01Cmn.CalibrationPorts.MotRefMdlQuad13VltgSdlY.Ary1D /end CHARACTERISTIC
/begin CHARACTERISTIC CalRegn01Cmn.MotRefMdlQuad24VltgSdlX.Ary1D "MICROSAR RTE" VAL_BLK 0x0 RTE_RL_UWORD 0 RTE_CM_Vel4 0 1350 MATRIX_DIM 10 1 1 SYMBOL_LINK "Rte_CalprmRom_CalRegn01Cmn_DEFAULT_RTE_CALPRM_GROUP.MotRefMdlQuad24VltgSdlX_Ary1D" 0 DISPLAY_IDENTIFIER CalRegn01Cmn.CalibrationPorts.MotRefMdlQuad24VltgSdlX.Ary1D /end CHARACTERISTIC
/begin CHARACTERISTIC CalRegn01Cmn.MotRefMdlQuad24VltgSdlY.Ary1D "MICROSAR RTE" VAL_BLK 0x0 RTE_RL_UWORD 0 RTE_CM_Volt18 0 5 MATRIX_DIM 10 1 1 SYMBOL_LINK "Rte_CalprmRom_CalRegn01Cmn_DEFAULT_RTE_CALPRM_GROUP.MotRefMdlQuad24VltgSdlY_Ary1D" 0 DISPLAY_IDENTIFIER CalRegn01Cmn.CalibrationPorts.MotRefMdlQuad24VltgSdlY.Ary1D /end CHARACTERISTIC
/begin CHARACTERISTIC CalRegn01Cmn.MotRefMdlRefLocnItrnLim.Val "MICROSAR RTE" VALUE 0x0 RTE_RL_UBYTE 0 NO_COMPU_METHOD 1.0 20.0 SYMBOL_LINK "Rte_CalprmRom_CalRegn01Cmn_DEFAULT_RTE_CALPRM_GROUP.MotRefMdlRefLocnItrnLim_Val" 0 DISPLAY_IDENTIFIER CalRegn01Cmn.CalibrationPorts.MotRefMdlRefLocnItrnLim.Val /end CHARACTERISTIC
/begin CHARACTERISTIC CalRegn01Cmn.MotRefMdlTqItrnLim.Val "MICROSAR RTE" VALUE 0x0 RTE_RL_UBYTE 0 NO_COMPU_METHOD 1.0 5.0 SYMBOL_LINK "Rte_CalprmRom_CalRegn01Cmn_DEFAULT_RTE_CALPRM_GROUP.MotRefMdlTqItrnLim_Val" 0 DISPLAY_IDENTIFIER CalRegn01Cmn.CalibrationPorts.MotRefMdlTqItrnLim.Val /end CHARACTERISTIC
/begin CHARACTERISTIC CalRegn01Cmn.MotRefMdlTqItrnTolr.Val "MICROSAR RTE" VALUE 0x0 RTE_RL_FLOAT32_IEEE 0 NO_COMPU_METHOD 0.001 0.1 SYMBOL_LINK "Rte_CalprmRom_CalRegn01Cmn_DEFAULT_RTE_CALPRM_GROUP.MotRefMdlTqItrnTolr_Val" 0 DISPLAY_IDENTIFIER CalRegn01Cmn.CalibrationPorts.MotRefMdlTqItrnTolr.Val /end CHARACTERISTIC
/begin CHARACTERISTIC CalRegn01Cmn.MotRefMdlVltgModDynCmpEna.Logl "MICROSAR RTE" VALUE 0x0 RTE_RL_BOOLEAN 0 RTE_CM_BOOLEAN 0 255 SYMBOL_LINK "Rte_CalprmRom_CalRegn01Cmn_DEFAULT_RTE_CALPRM_GROUP.MotRefMdlVltgModDynCmpEna_Logl" 0 DISPLAY_IDENTIFIER CalRegn01Cmn.CalibrationPorts.MotRefMdlVltgModDynCmpEna.Logl /end CHARACTERISTIC
/begin CHARACTERISTIC CalRegn01Cmn.MotRefMdlVltgOverRThdSca.Val "MICROSAR RTE" VALUE 0x0 RTE_RL_FLOAT32_IEEE 0 NO_COMPU_METHOD 0.0 1.0 SYMBOL_LINK "Rte_CalprmRom_CalRegn01Cmn_DEFAULT_RTE_CALPRM_GROUP.MotRefMdlVltgOverRThdSca_Val" 0 DISPLAY_IDENTIFIER CalRegn01Cmn.CalibrationPorts.MotRefMdlVltgOverRThdSca.Val /end CHARACTERISTIC
/begin CHARACTERISTIC CalRegn01Cmn.MotRplCoggCfgMotAgTiDly.Val "MICROSAR RTE" VALUE 0x0 RTE_RL_FLOAT32_IEEE 0 NO_COMPU_METHOD -3.402823466e+38 3.402823466e+38 SYMBOL_LINK "Rte_CalprmRom_CalRegn01Cmn_DEFAULT_RTE_CALPRM_GROUP.MotRplCoggCfgMotAgTiDly_Val" 0 DISPLAY_IDENTIFIER CalRegn01Cmn.CalibrationPorts.MotRplCoggCfgMotAgTiDly.Val /end CHARACTERISTIC
/begin CHARACTERISTIC CalRegn01Cmn.MotRplCoggCfgMotCurrDaxRplBilnrSeln.Ary1D "MICROSAR RTE" VAL_BLK 0x0 RTE_RL_UWORD 0 NO_COMPU_METHOD 0 65535 MATRIX_DIM 10 1 1 SYMBOL_LINK "Rte_CalprmRom_CalRegn01Cmn_DEFAULT_RTE_CALPRM_GROUP.MotRplCoggCfgMotCurrDaxRplBilnrSeln_Ary1D" 0 DISPLAY_IDENTIFIER CalRegn01Cmn.CalibrationPorts.MotRplCoggCfgMotCurrDaxRplBilnrSeln.Ary1D /end CHARACTERISTIC
/begin CHARACTERISTIC CalRegn01Cmn.MotRplCoggCfgMotCurrQaxRpl.Ary1D "MICROSAR RTE" VAL_BLK 0x0 RTE_RL_UWORD 0 NO_COMPU_METHOD 0 65535 MATRIX_DIM 12 1 1 SYMBOL_LINK "Rte_CalprmRom_CalRegn01Cmn_DEFAULT_RTE_CALPRM_GROUP.MotRplCoggCfgMotCurrQaxRpl_Ary1D" 0 DISPLAY_IDENTIFIER CalRegn01Cmn.CalibrationPorts.MotRplCoggCfgMotCurrQaxRpl.Ary1D /end CHARACTERISTIC
/begin CHARACTERISTIC CalRegn01Cmn.MotRplCoggCfgMotTqCmdCurrRgltrBwCmpMgnY.Ary2D "MICROSAR RTE" VAL_BLK 0x0 RTE_RL_UWORD 0 NO_COMPU_METHOD 0 65535 MATRIX_DIM 8 20 1 SYMBOL_LINK "Rte_CalprmRom_CalRegn01Cmn_DEFAULT_RTE_CALPRM_GROUP.MotRplCoggCfgMotTqCmdCurrRgltrBwCmpMgnY_Ary2D" 0 DISPLAY_IDENTIFIER CalRegn01Cmn.CalibrationPorts.MotRplCoggCfgMotTqCmdCurrRgltrBwCmpMgnY.Ary2D /end CHARACTERISTIC
/begin CHARACTERISTIC CalRegn01Cmn.MotRplCoggCfgMotTqCmdCurrRgltrBwCmpPhaY.Ary2D "MICROSAR RTE" VAL_BLK 0x0 RTE_RL_UWORD 0 NO_COMPU_METHOD 0 65535 MATRIX_DIM 8 20 1 SYMBOL_LINK "Rte_CalprmRom_CalRegn01Cmn_DEFAULT_RTE_CALPRM_GROUP.MotRplCoggCfgMotTqCmdCurrRgltrBwCmpPhaY_Ary2D" 0 DISPLAY_IDENTIFIER CalRegn01Cmn.CalibrationPorts.MotRplCoggCfgMotTqCmdCurrRgltrBwCmpPhaY.Ary2D /end CHARACTERISTIC
/begin CHARACTERISTIC CalRegn01Cmn.MotRplCoggCfgMotTqCmdCurrRgltrBwCmpX.Ary1D "MICROSAR RTE" VAL_BLK 0x0 RTE_RL_UWORD 0 NO_COMPU_METHOD 0 65535 MATRIX_DIM 8 1 1 SYMBOL_LINK "Rte_CalprmRom_CalRegn01Cmn_DEFAULT_RTE_CALPRM_GROUP.MotRplCoggCfgMotTqCmdCurrRgltrBwCmpX_Ary1D" 0 DISPLAY_IDENTIFIER CalRegn01Cmn.CalibrationPorts.MotRplCoggCfgMotTqCmdCurrRgltrBwCmpX.Ary1D /end CHARACTERISTIC
/begin CHARACTERISTIC CalRegn01Cmn.MotRplCoggCfgMotTqRplOrder1X.Ary2D "MICROSAR RTE" VAL_BLK 0x0 RTE_RL_SWORD 0 NO_COMPU_METHOD -32768 32767 MATRIX_DIM 12 10 1 SYMBOL_LINK "Rte_CalprmRom_CalRegn01Cmn_DEFAULT_RTE_CALPRM_GROUP.MotRplCoggCfgMotTqRplOrder1X_Ary2D" 0 DISPLAY_IDENTIFIER CalRegn01Cmn.CalibrationPorts.MotRplCoggCfgMotTqRplOrder1X.Ary2D /end CHARACTERISTIC
/begin CHARACTERISTIC CalRegn01Cmn.MotRplCoggCfgMotTqRplOrder1Y.Ary2D "MICROSAR RTE" VAL_BLK 0x0 RTE_RL_SWORD 0 NO_COMPU_METHOD -32768 32767 MATRIX_DIM 12 10 1 SYMBOL_LINK "Rte_CalprmRom_CalRegn01Cmn_DEFAULT_RTE_CALPRM_GROUP.MotRplCoggCfgMotTqRplOrder1Y_Ary2D" 0 DISPLAY_IDENTIFIER CalRegn01Cmn.CalibrationPorts.MotRplCoggCfgMotTqRplOrder1Y.Ary2D /end CHARACTERISTIC
/begin CHARACTERISTIC CalRegn01Cmn.MotRplCoggCfgMotTqRplOrder2X.Ary2D "MICROSAR RTE" VAL_BLK 0x0 RTE_RL_SWORD 0 NO_COMPU_METHOD -32768 32767 MATRIX_DIM 12 10 1 SYMBOL_LINK "Rte_CalprmRom_CalRegn01Cmn_DEFAULT_RTE_CALPRM_GROUP.MotRplCoggCfgMotTqRplOrder2X_Ary2D" 0 DISPLAY_IDENTIFIER CalRegn01Cmn.CalibrationPorts.MotRplCoggCfgMotTqRplOrder2X.Ary2D /end CHARACTERISTIC
/begin CHARACTERISTIC CalRegn01Cmn.MotRplCoggCfgMotTqRplOrder2Y.Ary2D "MICROSAR RTE" VAL_BLK 0x0 RTE_RL_SWORD 0 NO_COMPU_METHOD -32768 32767 MATRIX_DIM 12 10 1 SYMBOL_LINK "Rte_CalprmRom_CalRegn01Cmn_DEFAULT_RTE_CALPRM_GROUP.MotRplCoggCfgMotTqRplOrder2Y_Ary2D" 0 DISPLAY_IDENTIFIER CalRegn01Cmn.CalibrationPorts.MotRplCoggCfgMotTqRplOrder2Y.Ary2D /end CHARACTERISTIC
/begin CHARACTERISTIC CalRegn01Cmn.MotRplCoggCfgMotTqRplOrder3X.Ary2D "MICROSAR RTE" VAL_BLK 0x0 RTE_RL_SWORD 0 NO_COMPU_METHOD -32768 32767 MATRIX_DIM 12 10 1 SYMBOL_LINK "Rte_CalprmRom_CalRegn01Cmn_DEFAULT_RTE_CALPRM_GROUP.MotRplCoggCfgMotTqRplOrder3X_Ary2D" 0 DISPLAY_IDENTIFIER CalRegn01Cmn.CalibrationPorts.MotRplCoggCfgMotTqRplOrder3X.Ary2D /end CHARACTERISTIC
/begin CHARACTERISTIC CalRegn01Cmn.MotRplCoggCfgMotTqRplOrder3Y.Ary2D "MICROSAR RTE" VAL_BLK 0x0 RTE_RL_SWORD 0 NO_COMPU_METHOD -32768 32767 MATRIX_DIM 12 10 1 SYMBOL_LINK "Rte_CalprmRom_CalRegn01Cmn_DEFAULT_RTE_CALPRM_GROUP.MotRplCoggCfgMotTqRplOrder3Y_Ary2D" 0 DISPLAY_IDENTIFIER CalRegn01Cmn.CalibrationPorts.MotRplCoggCfgMotTqRplOrder3Y.Ary2D /end CHARACTERISTIC
/begin CHARACTERISTIC CalRegn01Cmn.MotRplCoggCfgMotVelBilnrSeln.Ary1D "MICROSAR RTE" VAL_BLK 0x0 RTE_RL_UWORD 0 NO_COMPU_METHOD 0 65535 MATRIX_DIM 20 1 1 SYMBOL_LINK "Rte_CalprmRom_CalRegn01Cmn_DEFAULT_RTE_CALPRM_GROUP.MotRplCoggCfgMotVelBilnrSeln_Ary1D" 0 DISPLAY_IDENTIFIER CalRegn01Cmn.CalibrationPorts.MotRplCoggCfgMotVelBilnrSeln.Ary1D /end CHARACTERISTIC
/begin CHARACTERISTIC CalRegn01Cmn.MotRplCoggCmdHrmncOrder1Elec.Val "MICROSAR RTE" VALUE 0x0 RTE_RL_UBYTE 0 NO_COMPU_METHOD 0 255 SYMBOL_LINK "Rte_CalprmRom_CalRegn01Cmn_DEFAULT_RTE_CALPRM_GROUP.MotRplCoggCmdHrmncOrder1Elec_Val" 0 DISPLAY_IDENTIFIER CalRegn01Cmn.CalibrationPorts.MotRplCoggCmdHrmncOrder1Elec.Val /end CHARACTERISTIC
/begin CHARACTERISTIC CalRegn01Cmn.MotRplCoggCmdHrmncOrder2Elec.Val "MICROSAR RTE" VALUE 0x0 RTE_RL_UBYTE 0 NO_COMPU_METHOD 0 255 SYMBOL_LINK "Rte_CalprmRom_CalRegn01Cmn_DEFAULT_RTE_CALPRM_GROUP.MotRplCoggCmdHrmncOrder2Elec_Val" 0 DISPLAY_IDENTIFIER CalRegn01Cmn.CalibrationPorts.MotRplCoggCmdHrmncOrder2Elec.Val /end CHARACTERISTIC
/begin CHARACTERISTIC CalRegn01Cmn.MotRplCoggCmdHrmncOrder3Elec.Val "MICROSAR RTE" VALUE 0x0 RTE_RL_UBYTE 0 NO_COMPU_METHOD 0 255 SYMBOL_LINK "Rte_CalprmRom_CalRegn01Cmn_DEFAULT_RTE_CALPRM_GROUP.MotRplCoggCmdHrmncOrder3Elec_Val" 0 DISPLAY_IDENTIFIER CalRegn01Cmn.CalibrationPorts.MotRplCoggCmdHrmncOrder3Elec.Val /end CHARACTERISTIC
/begin CHARACTERISTIC CalRegn01Cmn.MotTqCmdScaMax.Val "MICROSAR RTE" VALUE 0x0 RTE_RL_FLOAT32_IEEE 0 NO_COMPU_METHOD -3.402823466e+38 3.402823466e+38 SYMBOL_LINK "Rte_CalprmRom_CalRegn01Cmn_DEFAULT_RTE_CALPRM_GROUP.MotTqCmdScaMax_Val" 0 DISPLAY_IDENTIFIER CalRegn01Cmn.CalibrationPorts.MotTqCmdScaMax.Val /end CHARACTERISTIC
/begin CHARACTERISTIC CalRegn01Cmn.MotTqCmdScaMin.Val "MICROSAR RTE" VALUE 0x0 RTE_RL_FLOAT32_IEEE 0 NO_COMPU_METHOD -3.402823466e+38 3.402823466e+38 SYMBOL_LINK "Rte_CalprmRom_CalRegn01Cmn_DEFAULT_RTE_CALPRM_GROUP.MotTqCmdScaMin_Val" 0 DISPLAY_IDENTIFIER CalRegn01Cmn.CalibrationPorts.MotTqCmdScaMin.Val /end CHARACTERISTIC
/begin CHARACTERISTIC CalRegn01Cmn.MotTqTranlDampgVehSpdBlndY.Ary1D "MICROSAR RTE" VAL_BLK 0x0 RTE_RL_UWORD 0 NO_COMPU_METHOD 0 65535 MATRIX_DIM 4 1 1 SYMBOL_LINK "Rte_CalprmRom_CalRegn01Cmn_DEFAULT_RTE_CALPRM_GROUP.MotTqTranlDampgVehSpdBlndY_Ary1D" 0 DISPLAY_IDENTIFIER CalRegn01Cmn.CalibrationPorts.MotTqTranlDampgVehSpdBlndY.Ary1D /end CHARACTERISTIC
/begin CHARACTERISTIC CalRegn01Cmn.NxtrCalIdsCal0DevlpAuthor.Ary1D "MICROSAR RTE" VAL_BLK 0x0 RTE_RL_UBYTE 0 NO_COMPU_METHOD 0 255 MATRIX_DIM 6 1 1 SYMBOL_LINK "Rte_CalprmRom_CalRegn01Cmn_DEFAULT_RTE_CALPRM_GROUP.NxtrCalIdsCal0DevlpAuthor_Ary1D" 0 DISPLAY_IDENTIFIER CalRegn01Cmn.CalibrationPorts.NxtrCalIdsCal0DevlpAuthor.Ary1D /end CHARACTERISTIC
/begin CHARACTERISTIC CalRegn01Cmn.NxtrCalIdsCal0DevlpDesc.Ary1D "MICROSAR RTE" VAL_BLK 0x0 RTE_RL_UBYTE 0 NO_COMPU_METHOD 0 255 MATRIX_DIM 48 1 1 SYMBOL_LINK "Rte_CalprmRom_CalRegn01Cmn_DEFAULT_RTE_CALPRM_GROUP.NxtrCalIdsCal0DevlpDesc_Ary1D" 0 DISPLAY_IDENTIFIER CalRegn01Cmn.CalibrationPorts.NxtrCalIdsCal0DevlpDesc.Ary1D /end CHARACTERISTIC
/begin CHARACTERISTIC CalRegn01Cmn.NxtrCalIdsCal0DevlpRelNr.Val "MICROSAR RTE" VALUE 0x0 RTE_RL_ULONG 0 NO_COMPU_METHOD 0 4294967295 SYMBOL_LINK "Rte_CalprmRom_CalRegn01Cmn_DEFAULT_RTE_CALPRM_GROUP.NxtrCalIdsCal0DevlpRelNr_Val" 0 DISPLAY_IDENTIFIER CalRegn01Cmn.CalibrationPorts.NxtrCalIdsCal0DevlpRelNr.Val /end CHARACTERISTIC
/begin CHARACTERISTIC CalRegn01Cmn.NxtrCalIdsCal0DevlpRelSt.Val "MICROSAR RTE" VALUE 0x0 RTE_RL_UBYTE 0 NO_COMPU_METHOD 0 255 SYMBOL_LINK "Rte_CalprmRom_CalRegn01Cmn_DEFAULT_RTE_CALPRM_GROUP.NxtrCalIdsCal0DevlpRelSt_Val" 0 DISPLAY_IDENTIFIER CalRegn01Cmn.CalibrationPorts.NxtrCalIdsCal0DevlpRelSt.Val /end CHARACTERISTIC
/begin CHARACTERISTIC CalRegn01Cmn.NxtrCalIdsCal0DevlpTiStamp.Val "MICROSAR RTE" VALUE 0x0 RTE_RL_ULONG 0 NO_COMPU_METHOD 0 4294967295 SYMBOL_LINK "Rte_CalprmRom_CalRegn01Cmn_DEFAULT_RTE_CALPRM_GROUP.NxtrCalIdsCal0DevlpTiStamp_Val" 0 DISPLAY_IDENTIFIER CalRegn01Cmn.CalibrationPorts.NxtrCalIdsCal0DevlpTiStamp.Val /end CHARACTERISTIC
/begin CHARACTERISTIC CalRegn01Cmn.NxtrCalIdsCal0DevlpVers.Val "MICROSAR RTE" VALUE 0x0 RTE_RL_UBYTE 0 NO_COMPU_METHOD 0 255 SYMBOL_LINK "Rte_CalprmRom_CalRegn01Cmn_DEFAULT_RTE_CALPRM_GROUP.NxtrCalIdsCal0DevlpVers_Val" 0 DISPLAY_IDENTIFIER CalRegn01Cmn.CalibrationPorts.NxtrCalIdsCal0DevlpVers.Val /end CHARACTERISTIC
/begin CHARACTERISTIC CalRegn01Cmn.PartNrCmpdVehPartnProdtStruct.Ary1D "MICROSAR RTE" VAL_BLK 0x0 RTE_RL_UBYTE 0 NO_COMPU_METHOD 0 255 MATRIX_DIM 14 1 1 SYMBOL_LINK "Rte_CalprmRom_CalRegn01Cmn_DEFAULT_RTE_CALPRM_GROUP.PartNrCmpdVehPartnProdtStruct_Ary1D" 0 DISPLAY_IDENTIFIER CalRegn01Cmn.CalibrationPorts.PartNrCmpdVehPartnProdtStruct.Ary1D /end CHARACTERISTIC
/begin CHARACTERISTIC CalRegn01Cmn.PwrDiscnctOpenThd.Val "MICROSAR RTE" VALUE 0x0 RTE_RL_FLOAT32_IEEE 0 NO_COMPU_METHOD 0.0 5.0 SYMBOL_LINK "Rte_CalprmRom_CalRegn01Cmn_DEFAULT_RTE_CALPRM_GROUP.PwrDiscnctOpenThd_Val" 0 DISPLAY_IDENTIFIER CalRegn01Cmn.CalibrationPorts.PwrDiscnctOpenThd.Val /end CHARACTERISTIC
/begin CHARACTERISTIC CalRegn01Cmn.PwrLimrAssiRednLpFilFrq.Val "MICROSAR RTE" VALUE 0x0 RTE_RL_FLOAT32_IEEE 0 NO_COMPU_METHOD -3.402823466e+38 3.402823466e+38 SYMBOL_LINK "Rte_CalprmRom_CalRegn01Cmn_DEFAULT_RTE_CALPRM_GROUP.PwrLimrAssiRednLpFilFrq_Val" 0 DISPLAY_IDENTIFIER CalRegn01Cmn.CalibrationPorts.PwrLimrAssiRednLpFilFrq.Val /end CHARACTERISTIC
/begin CHARACTERISTIC CalRegn01Cmn.PwrLimrBackEmfConStdT.Val "MICROSAR RTE" VALUE 0x0 RTE_RL_FLOAT32_IEEE 0 NO_COMPU_METHOD -3.402823466e+38 3.402823466e+38 SYMBOL_LINK "Rte_CalprmRom_CalRegn01Cmn_DEFAULT_RTE_CALPRM_GROUP.PwrLimrBackEmfConStdT_Val" 0 DISPLAY_IDENTIFIER CalRegn01Cmn.CalibrationPorts.PwrLimrBackEmfConStdT.Val /end CHARACTERISTIC
/begin CHARACTERISTIC CalRegn01Cmn.PwrLimrBrdgVltgAdjSlew.Val "MICROSAR RTE" VALUE 0x0 RTE_RL_FLOAT32_IEEE 0 NO_COMPU_METHOD -3.402823466e+38 3.402823466e+38 SYMBOL_LINK "Rte_CalprmRom_CalRegn01Cmn_DEFAULT_RTE_CALPRM_GROUP.PwrLimrBrdgVltgAdjSlew_Val" 0 DISPLAY_IDENTIFIER CalRegn01Cmn.CalibrationPorts.PwrLimrBrdgVltgAdjSlew.Val /end CHARACTERISTIC
/begin CHARACTERISTIC CalRegn01Cmn.PwrLimrBrdgVltgAltFltAdj.Val "MICROSAR RTE" VALUE 0x0 RTE_RL_FLOAT32_IEEE 0 NO_COMPU_METHOD -3.402823466e+38 3.402823466e+38 SYMBOL_LINK "Rte_CalprmRom_CalRegn01Cmn_DEFAULT_RTE_CALPRM_GROUP.PwrLimrBrdgVltgAltFltAdj_Val" 0 DISPLAY_IDENTIFIER CalRegn01Cmn.CalibrationPorts.PwrLimrBrdgVltgAltFltAdj.Val /end CHARACTERISTIC
/begin CHARACTERISTIC CalRegn01Cmn.PwrLimrFilAssiRednThd.Val "MICROSAR RTE" VALUE 0x0 RTE_RL_FLOAT32_IEEE 0 NO_COMPU_METHOD -3.402823466e+38 3.402823466e+38 SYMBOL_LINK "Rte_CalprmRom_CalRegn01Cmn_DEFAULT_RTE_CALPRM_GROUP.PwrLimrFilAssiRednThd_Val" 0 DISPLAY_IDENTIFIER CalRegn01Cmn.CalibrationPorts.PwrLimrFilAssiRednThd.Val /end CHARACTERISTIC
/begin CHARACTERISTIC CalRegn01Cmn.PwrLimrLoVoltAssiRcvrThd.Val "MICROSAR RTE" VALUE 0x0 RTE_RL_FLOAT32_IEEE 0 NO_COMPU_METHOD -3.402823466e+38 3.402823466e+38 SYMBOL_LINK "Rte_CalprmRom_CalRegn01Cmn_DEFAULT_RTE_CALPRM_GROUP.PwrLimrLoVoltAssiRcvrThd_Val" 0 DISPLAY_IDENTIFIER CalRegn01Cmn.CalibrationPorts.PwrLimrLoVoltAssiRcvrThd.Val /end CHARACTERISTIC
/begin CHARACTERISTIC CalRegn01Cmn.PwrLimrLoVoltAssiRcvrTi.Val "MICROSAR RTE" VALUE 0x0 RTE_RL_UWORD 0 NO_COMPU_METHOD 0 65535 SYMBOL_LINK "Rte_CalprmRom_CalRegn01Cmn_DEFAULT_RTE_CALPRM_GROUP.PwrLimrLoVoltAssiRcvrTi_Val" 0 DISPLAY_IDENTIFIER CalRegn01Cmn.CalibrationPorts.PwrLimrLoVoltAssiRcvrTi.Val /end CHARACTERISTIC
/begin CHARACTERISTIC CalRegn01Cmn.PwrLimrMotEnvlpX.Ary1D "MICROSAR RTE" VAL_BLK 0x0 RTE_RL_SWORD 0 NO_COMPU_METHOD -32768 32767 MATRIX_DIM 14 1 1 SYMBOL_LINK "Rte_CalprmRom_CalRegn01Cmn_DEFAULT_RTE_CALPRM_GROUP.PwrLimrMotEnvlpX_Ary1D" 0 DISPLAY_IDENTIFIER CalRegn01Cmn.CalibrationPorts.PwrLimrMotEnvlpX.Ary1D /end CHARACTERISTIC
/begin CHARACTERISTIC CalRegn01Cmn.PwrLimrMotEnvlpY.Ary1D "MICROSAR RTE" VAL_BLK 0x0 RTE_RL_UWORD 0 NO_COMPU_METHOD 0 65535 MATRIX_DIM 14 1 1 SYMBOL_LINK "Rte_CalprmRom_CalRegn01Cmn_DEFAULT_RTE_CALPRM_GROUP.PwrLimrMotEnvlpY_Ary1D" 0 DISPLAY_IDENTIFIER CalRegn01Cmn.CalibrationPorts.PwrLimrMotEnvlpY.Ary1D /end CHARACTERISTIC
/begin CHARACTERISTIC CalRegn01Cmn.PwrLimrMotVelLpFilFrq.Val "MICROSAR RTE" VALUE 0x0 RTE_RL_FLOAT32_IEEE 0 NO_COMPU_METHOD -3.402823466e+38 3.402823466e+38 SYMBOL_LINK "Rte_CalprmRom_CalRegn01Cmn_DEFAULT_RTE_CALPRM_GROUP.PwrLimrMotVelLpFilFrq_Val" 0 DISPLAY_IDENTIFIER CalRegn01Cmn.CalibrationPorts.PwrLimrMotVelLpFilFrq.Val /end CHARACTERISTIC
/begin CHARACTERISTIC CalRegn01Cmn.PwrLimrSpdAdjSlewDec.Val "MICROSAR RTE" VALUE 0x0 RTE_RL_FLOAT32_IEEE 0 NO_COMPU_METHOD -3.402823466e+38 3.402823466e+38 SYMBOL_LINK "Rte_CalprmRom_CalRegn01Cmn_DEFAULT_RTE_CALPRM_GROUP.PwrLimrSpdAdjSlewDec_Val" 0 DISPLAY_IDENTIFIER CalRegn01Cmn.CalibrationPorts.PwrLimrSpdAdjSlewDec.Val /end CHARACTERISTIC
/begin CHARACTERISTIC CalRegn01Cmn.PwrLimrSpdAdjSlewEna.Logl "MICROSAR RTE" VALUE 0x0 RTE_RL_BOOLEAN 0 RTE_CM_BOOLEAN 0 255 SYMBOL_LINK "Rte_CalprmRom_CalRegn01Cmn_DEFAULT_RTE_CALPRM_GROUP.PwrLimrSpdAdjSlewEna_Logl" 0 DISPLAY_IDENTIFIER CalRegn01Cmn.CalibrationPorts.PwrLimrSpdAdjSlewEna.Logl /end CHARACTERISTIC
/begin CHARACTERISTIC CalRegn01Cmn.PwrLimrSpdAdjSlewInc.Val "MICROSAR RTE" VALUE 0x0 RTE_RL_FLOAT32_IEEE 0 NO_COMPU_METHOD -3.402823466e+38 3.402823466e+38 SYMBOL_LINK "Rte_CalprmRom_CalRegn01Cmn_DEFAULT_RTE_CALPRM_GROUP.PwrLimrSpdAdjSlewInc_Val" 0 DISPLAY_IDENTIFIER CalRegn01Cmn.CalibrationPorts.PwrLimrSpdAdjSlewInc.Val /end CHARACTERISTIC
/begin CHARACTERISTIC CalRegn01Cmn.PwrLimrStdOperMotEnvlpX.Ary1D "MICROSAR RTE" VAL_BLK 0x0 RTE_RL_UWORD 0 NO_COMPU_METHOD 0 65535 MATRIX_DIM 6 1 1 SYMBOL_LINK "Rte_CalprmRom_CalRegn01Cmn_DEFAULT_RTE_CALPRM_GROUP.PwrLimrStdOperMotEnvlpX_Ary1D" 0 DISPLAY_IDENTIFIER CalRegn01Cmn.CalibrationPorts.PwrLimrStdOperMotEnvlpX.Ary1D /end CHARACTERISTIC
/begin CHARACTERISTIC CalRegn01Cmn.PwrLimrStdOperMotEnvlpY.Ary1D "MICROSAR RTE" VAL_BLK 0x0 RTE_RL_UWORD 0 NO_COMPU_METHOD 0 65535 MATRIX_DIM 6 1 1 SYMBOL_LINK "Rte_CalprmRom_CalRegn01Cmn_DEFAULT_RTE_CALPRM_GROUP.PwrLimrStdOperMotEnvlpY_Ary1D" 0 DISPLAY_IDENTIFIER CalRegn01Cmn.CalibrationPorts.PwrLimrStdOperMotEnvlpY.Ary1D /end CHARACTERISTIC
/begin CHARACTERISTIC CalRegn01Cmn.PwrLimrVltgDptMotVelOffsX.Ary1D "MICROSAR RTE" VAL_BLK 0x0 RTE_RL_UWORD 0 NO_COMPU_METHOD 0 65535 MATRIX_DIM 10 1 1 SYMBOL_LINK "Rte_CalprmRom_CalRegn01Cmn_DEFAULT_RTE_CALPRM_GROUP.PwrLimrVltgDptMotVelOffsX_Ary1D" 0 DISPLAY_IDENTIFIER CalRegn01Cmn.CalibrationPorts.PwrLimrVltgDptMotVelOffsX.Ary1D /end CHARACTERISTIC
/begin CHARACTERISTIC CalRegn01Cmn.PwrLimrVltgDptMotVelOffsY.Ary1D "MICROSAR RTE" VAL_BLK 0x0 RTE_RL_UWORD 0 NO_COMPU_METHOD 0 65535 MATRIX_DIM 10 1 1 SYMBOL_LINK "Rte_CalprmRom_CalRegn01Cmn_DEFAULT_RTE_CALPRM_GROUP.PwrLimrVltgDptMotVelOffsY_Ary1D" 0 DISPLAY_IDENTIFIER CalRegn01Cmn.CalibrationPorts.PwrLimrVltgDptMotVelOffsY.Ary1D /end CHARACTERISTIC
/begin CHARACTERISTIC CalRegn01Cmn.PwrSplyNtc0x07BFailStep.Val "MICROSAR RTE" VALUE 0x0 RTE_RL_UWORD 0 NO_COMPU_METHOD 0 65535 SYMBOL_LINK "Rte_CalprmRom_CalRegn01Cmn_DEFAULT_RTE_CALPRM_GROUP.PwrSplyNtc0x07BFailStep_Val" 0 DISPLAY_IDENTIFIER CalRegn01Cmn.CalibrationPorts.PwrSplyNtc0x07BFailStep.Val /end CHARACTERISTIC
/begin CHARACTERISTIC CalRegn01Cmn.PwrSplyNtc0x07BPassStep.Val "MICROSAR RTE" VALUE 0x0 RTE_RL_UWORD 0 NO_COMPU_METHOD 0 65535 SYMBOL_LINK "Rte_CalprmRom_CalRegn01Cmn_DEFAULT_RTE_CALPRM_GROUP.PwrSplyNtc0x07BPassStep_Val" 0 DISPLAY_IDENTIFIER CalRegn01Cmn.CalibrationPorts.PwrSplyNtc0x07BPassStep.Val /end CHARACTERISTIC
/begin CHARACTERISTIC CalRegn01Cmn.PwrSplyNtc0x07CFailStep.Val "MICROSAR RTE" VALUE 0x0 RTE_RL_UWORD 0 NO_COMPU_METHOD 0 65535 SYMBOL_LINK "Rte_CalprmRom_CalRegn01Cmn_DEFAULT_RTE_CALPRM_GROUP.PwrSplyNtc0x07CFailStep_Val" 0 DISPLAY_IDENTIFIER CalRegn01Cmn.CalibrationPorts.PwrSplyNtc0x07CFailStep.Val /end CHARACTERISTIC
/begin CHARACTERISTIC CalRegn01Cmn.PwrSplyNtc0x07CPassStep.Val "MICROSAR RTE" VALUE 0x0 RTE_RL_UWORD 0 NO_COMPU_METHOD 0 65535 SYMBOL_LINK "Rte_CalprmRom_CalRegn01Cmn_DEFAULT_RTE_CALPRM_GROUP.PwrSplyNtc0x07CPassStep_Val" 0 DISPLAY_IDENTIFIER CalRegn01Cmn.CalibrationPorts.PwrSplyNtc0x07CPassStep.Val /end CHARACTERISTIC
/begin CHARACTERISTIC CalRegn01Cmn.PwrSplyNtc0x07DFailStep.Val "MICROSAR RTE" VALUE 0x0 RTE_RL_UWORD 0 NO_COMPU_METHOD 0 65535 SYMBOL_LINK "Rte_CalprmRom_CalRegn01Cmn_DEFAULT_RTE_CALPRM_GROUP.PwrSplyNtc0x07DFailStep_Val" 0 DISPLAY_IDENTIFIER CalRegn01Cmn.CalibrationPorts.PwrSplyNtc0x07DFailStep.Val /end CHARACTERISTIC
/begin CHARACTERISTIC CalRegn01Cmn.PwrSplyNtc0x07DPassStep.Val "MICROSAR RTE" VALUE 0x0 RTE_RL_UWORD 0 NO_COMPU_METHOD 0 65535 SYMBOL_LINK "Rte_CalprmRom_CalRegn01Cmn_DEFAULT_RTE_CALPRM_GROUP.PwrSplyNtc0x07DPassStep_Val" 0 DISPLAY_IDENTIFIER CalRegn01Cmn.CalibrationPorts.PwrSplyNtc0x07DPassStep.Val /end CHARACTERISTIC
/begin CHARACTERISTIC CalRegn01Cmn.SinVltgGennDthrLpFilCoeff.Val "MICROSAR RTE" VALUE 0x0 RTE_RL_FLOAT32_IEEE 0 NO_COMPU_METHOD 0.0 1.0 SYMBOL_LINK "Rte_CalprmRom_CalRegn01Cmn_DEFAULT_RTE_CALPRM_GROUP.SinVltgGennDthrLpFilCoeff_Val" 0 DISPLAY_IDENTIFIER CalRegn01Cmn.CalibrationPorts.SinVltgGennDthrLpFilCoeff.Val /end CHARACTERISTIC
/begin CHARACTERISTIC CalRegn01Cmn.SnsrOffsLrngSampleCntForHwTqLrngRst.Val "MICROSAR RTE" VALUE 0x0 RTE_RL_UWORD 0 NO_COMPU_METHOD 0 65535 SYMBOL_LINK "Rte_CalprmRom_CalRegn01Cmn_DEFAULT_RTE_CALPRM_GROUP.SnsrOffsLrngSampleCntForHwTqLrngRst_Val" 0 DISPLAY_IDENTIFIER CalRegn01Cmn.CalibrationPorts.SnsrOffsLrngSampleCntForHwTqLrngRst.Val /end CHARACTERISTIC
/begin CHARACTERISTIC CalRegn01Cmn.StHlthSigNormnAbsltMotPosDifStHlthDiagThd.Val "MICROSAR RTE" VALUE 0x0 RTE_RL_UBYTE 0 NO_COMPU_METHOD 0 255 SYMBOL_LINK "Rte_CalprmRom_CalRegn01Cmn_DEFAULT_RTE_CALPRM_GROUP.StHlthSigNormnAbsltMotPosDifStHlthDiagThd_Val" 0 DISPLAY_IDENTIFIER CalRegn01Cmn.CalibrationPorts.StHlthSigNormnAbsltMotPosDifStHlthDiagThd.Val /end CHARACTERISTIC
/begin CHARACTERISTIC CalRegn01Cmn.StHlthSigNormnCurrMotSumStHlthDiagThd.Val "MICROSAR RTE" VALUE 0x0 RTE_RL_UBYTE 0 NO_COMPU_METHOD 0 255 SYMBOL_LINK "Rte_CalprmRom_CalRegn01Cmn_DEFAULT_RTE_CALPRM_GROUP.StHlthSigNormnCurrMotSumStHlthDiagThd_Val" 0 DISPLAY_IDENTIFIER CalRegn01Cmn.CalibrationPorts.StHlthSigNormnCurrMotSumStHlthDiagThd.Val /end CHARACTERISTIC
/begin CHARACTERISTIC CalRegn01Cmn.StHlthSigNormnDigTqStHlthDiagThd.Val "MICROSAR RTE" VALUE 0x0 RTE_RL_UBYTE 0 NO_COMPU_METHOD 0 255 SYMBOL_LINK "Rte_CalprmRom_CalRegn01Cmn_DEFAULT_RTE_CALPRM_GROUP.StHlthSigNormnDigTqStHlthDiagThd_Val" 0 DISPLAY_IDENTIFIER CalRegn01Cmn.CalibrationPorts.StHlthSigNormnDigTqStHlthDiagThd.Val /end CHARACTERISTIC
/begin CHARACTERISTIC CalRegn01Cmn.StHlthSigNormnDutyCycFltLimThd.Val "MICROSAR RTE" VALUE 0x0 RTE_RL_UWORD 0 NO_COMPU_METHOD 0 65535 SYMBOL_LINK "Rte_CalprmRom_CalRegn01Cmn_DEFAULT_RTE_CALPRM_GROUP.StHlthSigNormnDutyCycFltLimThd_Val" 0 DISPLAY_IDENTIFIER CalRegn01Cmn.CalibrationPorts.StHlthSigNormnDutyCycFltLimThd.Val /end CHARACTERISTIC
/begin CHARACTERISTIC CalRegn01Cmn.StHlthSigNormnIdptSigStHlthSca.Val "MICROSAR RTE" VALUE 0x0 RTE_RL_UBYTE 0 NO_COMPU_METHOD 0 255 SYMBOL_LINK "Rte_CalprmRom_CalRegn01Cmn_DEFAULT_RTE_CALPRM_GROUP.StHlthSigNormnIdptSigStHlthSca_Val" 0 DISPLAY_IDENTIFIER CalRegn01Cmn.CalibrationPorts.StHlthSigNormnIdptSigStHlthSca.Val /end CHARACTERISTIC
/begin CHARACTERISTIC CalRegn01Cmn.StHlthSigNormnMaxFricThd.Val "MICROSAR RTE" VALUE 0x0 RTE_RL_FLOAT32_IEEE 0 NO_COMPU_METHOD -3.402823466e+38 3.402823466e+38 SYMBOL_LINK "Rte_CalprmRom_CalRegn01Cmn_DEFAULT_RTE_CALPRM_GROUP.StHlthSigNormnMaxFricThd_Val" 0 DISPLAY_IDENTIFIER CalRegn01Cmn.CalibrationPorts.StHlthSigNormnMaxFricThd.Val /end CHARACTERISTIC
/begin CHARACTERISTIC CalRegn01Cmn.StHlthSigNormnMinRackTrvlLim.Val "MICROSAR RTE" VALUE 0x0 RTE_RL_FLOAT32_IEEE 0 NO_COMPU_METHOD -3.402823466e+38 3.402823466e+38 SYMBOL_LINK "Rte_CalprmRom_CalRegn01Cmn_DEFAULT_RTE_CALPRM_GROUP.StHlthSigNormnMinRackTrvlLim_Val" 0 DISPLAY_IDENTIFIER CalRegn01Cmn.CalibrationPorts.StHlthSigNormnMinRackTrvlLim.Val /end CHARACTERISTIC
/begin CHARACTERISTIC CalRegn01Cmn.StHlthSigNormnMotPosStHlthDiagThd.Val "MICROSAR RTE" VALUE 0x0 RTE_RL_UBYTE 0 NO_COMPU_METHOD 0 255 SYMBOL_LINK "Rte_CalprmRom_CalRegn01Cmn_DEFAULT_RTE_CALPRM_GROUP.StHlthSigNormnMotPosStHlthDiagThd_Val" 0 DISPLAY_IDENTIFIER CalRegn01Cmn.CalibrationPorts.StHlthSigNormnMotPosStHlthDiagThd.Val /end CHARACTERISTIC
/begin CHARACTERISTIC CalRegn01Cmn.StHlthSigNormnMotVelCal.Val "MICROSAR RTE" VALUE 0x0 RTE_RL_FLOAT32_IEEE 0 NO_COMPU_METHOD -3.402823466e+38 3.402823466e+38 SYMBOL_LINK "Rte_CalprmRom_CalRegn01Cmn_DEFAULT_RTE_CALPRM_GROUP.StHlthSigNormnMotVelCal_Val" 0 DISPLAY_IDENTIFIER CalRegn01Cmn.CalibrationPorts.StHlthSigNormnMotVelCal.Val /end CHARACTERISTIC
/begin CHARACTERISTIC CalRegn01Cmn.StHlthSigNormnPhaInfoStHlthDiagThd.Val "MICROSAR RTE" VALUE 0x0 RTE_RL_UBYTE 0 NO_COMPU_METHOD 0 255 SYMBOL_LINK "Rte_CalprmRom_CalRegn01Cmn_DEFAULT_RTE_CALPRM_GROUP.StHlthSigNormnPhaInfoStHlthDiagThd_Val" 0 DISPLAY_IDENTIFIER CalRegn01Cmn.CalibrationPorts.StHlthSigNormnPhaInfoStHlthDiagThd.Val /end CHARACTERISTIC
/begin CHARACTERISTIC CalRegn01Cmn.StHlthSigNormnStHlthCorrlnErr.Val "MICROSAR RTE" VALUE 0x0 RTE_RL_UWORD 0 NO_COMPU_METHOD 0 65535 SYMBOL_LINK "Rte_CalprmRom_CalRegn01Cmn_DEFAULT_RTE_CALPRM_GROUP.StHlthSigNormnStHlthCorrlnErr_Val" 0 DISPLAY_IDENTIFIER CalRegn01Cmn.CalibrationPorts.StHlthSigNormnStHlthCorrlnErr.Val /end CHARACTERISTIC
/begin CHARACTERISTIC CalRegn01Cmn.StHlthSigNormnStHlthCurrMotSum.Val "MICROSAR RTE" VALUE 0x0 RTE_RL_FLOAT32_IEEE 0 NO_COMPU_METHOD -3.402823466e+38 3.402823466e+38 SYMBOL_LINK "Rte_CalprmRom_CalRegn01Cmn_DEFAULT_RTE_CALPRM_GROUP.StHlthSigNormnStHlthCurrMotSum_Val" 0 DISPLAY_IDENTIFIER CalRegn01Cmn.CalibrationPorts.StHlthSigNormnStHlthCurrMotSum.Val /end CHARACTERISTIC
/begin CHARACTERISTIC CalRegn01Cmn.StHlthSigNormnStHlthPhaInfo.Val "MICROSAR RTE" VALUE 0x0 RTE_RL_FLOAT32_IEEE 0 NO_COMPU_METHOD -3.402823466e+38 3.402823466e+38 SYMBOL_LINK "Rte_CalprmRom_CalRegn01Cmn_DEFAULT_RTE_CALPRM_GROUP.StHlthSigNormnStHlthPhaInfo_Val" 0 DISPLAY_IDENTIFIER CalRegn01Cmn.CalibrationPorts.StHlthSigNormnStHlthPhaInfo.Val /end CHARACTERISTIC
/begin CHARACTERISTIC CalRegn01Cmn.StHlthSigNormnValMaxStHlthErr.Val "MICROSAR RTE" VALUE 0x0 RTE_RL_FLOAT32_IEEE 0 NO_COMPU_METHOD -3.402823466e+38 3.402823466e+38 SYMBOL_LINK "Rte_CalprmRom_CalRegn01Cmn_DEFAULT_RTE_CALPRM_GROUP.StHlthSigNormnValMaxStHlthErr_Val" 0 DISPLAY_IDENTIFIER CalRegn01Cmn.CalibrationPorts.StHlthSigNormnValMaxStHlthErr.Val /end CHARACTERISTIC
/begin CHARACTERISTIC CalRegn01Cmn.StHlthSigNormnValMinStHlthErr.Val "MICROSAR RTE" VALUE 0x0 RTE_RL_FLOAT32_IEEE 0 NO_COMPU_METHOD -3.402823466e+38 3.402823466e+38 SYMBOL_LINK "Rte_CalprmRom_CalRegn01Cmn_DEFAULT_RTE_CALPRM_GROUP.StHlthSigNormnValMinStHlthErr_Val" 0 DISPLAY_IDENTIFIER CalRegn01Cmn.CalibrationPorts.StHlthSigNormnValMinStHlthErr.Val /end CHARACTERISTIC
/begin CHARACTERISTIC CalRegn01Cmn.StHlthSigNormnWhlImbRejctnThd.Val "MICROSAR RTE" VALUE 0x0 RTE_RL_FLOAT32_IEEE 0 NO_COMPU_METHOD -3.402823466e+38 3.402823466e+38 SYMBOL_LINK "Rte_CalprmRom_CalRegn01Cmn_DEFAULT_RTE_CALPRM_GROUP.StHlthSigNormnWhlImbRejctnThd_Val" 0 DISPLAY_IDENTIFIER CalRegn01Cmn.CalibrationPorts.StHlthSigNormnWhlImbRejctnThd.Val /end CHARACTERISTIC
/begin GROUP CalRegn01Cmn.GmMsg34ABusChassisExpStuckTiOut.Val "MICROSAR RTE" /begin SUB_GROUP /end SUB_GROUP /begin FUNCTION_LIST /end FUNCTION_LIST /begin REF_CHARACTERISTIC CalRegn01Cmn.GmMsg34ABusChassisExpStuckTiOut.Val /end REF_CHARACTERISTIC /begin REF_MEASUREMENT /end REF_MEASUREMENT /end GROUP
/begin GROUP CalRegn01Cmn.GmMsg34ABusHiSpdInvldTiOut.Val "MICROSAR RTE" /begin SUB_GROUP /end SUB_GROUP /begin FUNCTION_LIST /end FUNCTION_LIST /begin REF_CHARACTERISTIC CalRegn01Cmn.GmMsg34ABusHiSpdInvldTiOut.Val /end REF_CHARACTERISTIC /begin REF_MEASUREMENT /end REF_MEASUREMENT /end GROUP
/begin GROUP CalRegn01Cmn.GmMsg34ABusHiSpdMissTiOut.Val "MICROSAR RTE" /begin SUB_GROUP /end SUB_GROUP /begin FUNCTION_LIST /end FUNCTION_LIST /begin REF_CHARACTERISTIC CalRegn01Cmn.GmMsg34ABusHiSpdMissTiOut.Val /end REF_CHARACTERISTIC /begin REF_MEASUREMENT /end REF_MEASUREMENT /end GROUP
/begin GROUP CalRegn01Cmn.GmMsg34ABusHiSpdStuckTiOut.Val "MICROSAR RTE" /begin SUB_GROUP /end SUB_GROUP /begin FUNCTION_LIST /end FUNCTION_LIST /begin REF_CHARACTERISTIC CalRegn01Cmn.GmMsg34ABusHiSpdStuckTiOut.Val /end REF_CHARACTERISTIC /begin REF_MEASUREMENT /end REF_MEASUREMENT /end GROUP
/begin GROUP CalRegn01Cmn.GmMsg3F1BusHiSpdAmbTDft.Val "MICROSAR RTE" /begin SUB_GROUP /end SUB_GROUP /begin FUNCTION_LIST /end FUNCTION_LIST /begin REF_CHARACTERISTIC CalRegn01Cmn.GmMsg3F1BusHiSpdAmbTDft.Val /end REF_CHARACTERISTIC /begin REF_MEASUREMENT /end REF_MEASUREMENT /end GROUP
/begin GROUP CalRegn01Cmn.GmMsg3F1BusHiSpdInvldTiOut.Val "MICROSAR RTE" /begin SUB_GROUP /end SUB_GROUP /begin FUNCTION_LIST /end FUNCTION_LIST /begin REF_CHARACTERISTIC CalRegn01Cmn.GmMsg3F1BusHiSpdInvldTiOut.Val /end REF_CHARACTERISTIC /begin REF_MEASUREMENT /end REF_MEASUREMENT /end GROUP
/begin GROUP CalRegn01Cmn.GmMsg3F1BusHiSpdMissTiOut.Val "MICROSAR RTE" /begin SUB_GROUP /end SUB_GROUP /begin FUNCTION_LIST /end FUNCTION_LIST /begin REF_CHARACTERISTIC CalRegn01Cmn.GmMsg3F1BusHiSpdMissTiOut.Val /end REF_CHARACTERISTIC /begin REF_MEASUREMENT /end REF_MEASUREMENT /end GROUP
/begin GROUP CalRegn01Cmn.GmMsg4D1BusHiSpdEngOilTDft.Val "MICROSAR RTE" /begin SUB_GROUP /end SUB_GROUP /begin FUNCTION_LIST /end FUNCTION_LIST /begin REF_CHARACTERISTIC CalRegn01Cmn.GmMsg4D1BusHiSpdEngOilTDft.Val /end REF_CHARACTERISTIC /begin REF_MEASUREMENT /end REF_MEASUREMENT /end GROUP
/begin GROUP CalRegn01Cmn.GmMsg4D1BusHiSpdInvldTiOut.Val "MICROSAR RTE" /begin SUB_GROUP /end SUB_GROUP /begin FUNCTION_LIST /end FUNCTION_LIST /begin REF_CHARACTERISTIC CalRegn01Cmn.GmMsg4D1BusHiSpdInvldTiOut.Val /end REF_CHARACTERISTIC /begin REF_MEASUREMENT /end REF_MEASUREMENT /end GROUP
/begin GROUP CalRegn01Cmn.GmMsg4D1BusHiSpdMissTiOut.Val "MICROSAR RTE" /begin SUB_GROUP /end SUB_GROUP /begin FUNCTION_LIST /end FUNCTION_LIST /begin REF_CHARACTERISTIC CalRegn01Cmn.GmMsg4D1BusHiSpdMissTiOut.Val /end REF_CHARACTERISTIC /begin REF_MEASUREMENT /end REF_MEASUREMENT /end GROUP
/begin GROUP CalRegn01Cmn.GmMsg500BusHiSpdMissTiOut.Val "MICROSAR RTE" /begin SUB_GROUP /end SUB_GROUP /begin FUNCTION_LIST /end FUNCTION_LIST /begin REF_CHARACTERISTIC CalRegn01Cmn.GmMsg500BusHiSpdMissTiOut.Val /end REF_CHARACTERISTIC /begin REF_MEASUREMENT /end REF_MEASUREMENT /end GROUP
/begin GROUP CalRegn01Cmn.GmMsg500BusHiSpdWhlPlsPerRevDft.Val "MICROSAR RTE" /begin SUB_GROUP /end SUB_GROUP /begin FUNCTION_LIST /end FUNCTION_LIST /begin REF_CHARACTERISTIC CalRegn01Cmn.GmMsg500BusHiSpdWhlPlsPerRevDft.Val /end REF_CHARACTERISTIC /begin REF_MEASUREMENT /end REF_MEASUREMENT /end GROUP
/begin GROUP CalRegn01Cmn.GmMsg500BusHiSpdWhlRotlStsTiStampReslDft.Val "MICROSAR RTE" /begin SUB_GROUP /end SUB_GROUP /begin FUNCTION_LIST /end FUNCTION_LIST /begin REF_CHARACTERISTIC CalRegn01Cmn.GmMsg500BusHiSpdWhlRotlStsTiStampReslDft.Val /end REF_CHARACTERISTIC /begin REF_MEASUREMENT /end REF_MEASUREMENT /end GROUP
/begin GROUP CalRegn01Cmn.HiFrqAssiPahFwlOverLimDiagcFailStep.Val "MICROSAR RTE" /begin SUB_GROUP /end SUB_GROUP /begin FUNCTION_LIST /end FUNCTION_LIST /begin REF_CHARACTERISTIC CalRegn01Cmn.HiFrqAssiPahFwlOverLimDiagcFailStep.Val /end REF_CHARACTERISTIC /begin REF_MEASUREMENT /end REF_MEASUREMENT /end GROUP
/begin GROUP CalRegn01Cmn.HiFrqAssiPahFwlOverLimDiagcPassStep.Val "MICROSAR RTE" /begin SUB_GROUP /end SUB_GROUP /begin FUNCTION_LIST /end FUNCTION_LIST /begin REF_CHARACTERISTIC CalRegn01Cmn.HiFrqAssiPahFwlOverLimDiagcPassStep.Val /end REF_CHARACTERISTIC /begin REF_MEASUREMENT /end REF_MEASUREMENT /end GROUP
/begin GROUP CalRegn01Cmn.HwAgArbnHwAgMaxStall.Val "MICROSAR RTE" /begin SUB_GROUP /end SUB_GROUP /begin FUNCTION_LIST /end FUNCTION_LIST /begin REF_CHARACTERISTIC CalRegn01Cmn.HwAgArbnHwAgMaxStall.Val /end REF_CHARACTERISTIC /begin REF_MEASUREMENT /end REF_MEASUREMENT /end GROUP
/begin GROUP CalRegn01Cmn.HwAgCorrlnHwAgAbsltDif.Val "MICROSAR RTE" /begin SUB_GROUP /end SUB_GROUP /begin FUNCTION_LIST /end FUNCTION_LIST /begin REF_CHARACTERISTIC CalRegn01Cmn.HwAgCorrlnHwAgAbsltDif.Val /end REF_CHARACTERISTIC /begin REF_MEASUREMENT /end REF_MEASUREMENT /end GROUP
/begin GROUP CalRegn01Cmn.HwAgCorrlnHwAgMaxStall.Val "MICROSAR RTE" /begin SUB_GROUP /end SUB_GROUP /begin FUNCTION_LIST /end FUNCTION_LIST /begin REF_CHARACTERISTIC CalRegn01Cmn.HwAgCorrlnHwAgMaxStall.Val /end REF_CHARACTERISTIC /begin REF_MEASUREMENT /end REF_MEASUREMENT /end GROUP
/begin GROUP CalRegn01Cmn.HwAgCorrlnNtc0x092FailStep.Val "MICROSAR RTE" /begin SUB_GROUP /end SUB_GROUP /begin FUNCTION_LIST /end FUNCTION_LIST /begin REF_CHARACTERISTIC CalRegn01Cmn.HwAgCorrlnNtc0x092FailStep.Val /end REF_CHARACTERISTIC /begin REF_MEASUREMENT /end REF_MEASUREMENT /end GROUP
/begin GROUP CalRegn01Cmn.HwAgCorrlnNtc0x092PassStep.Val "MICROSAR RTE" /begin SUB_GROUP /end SUB_GROUP /begin FUNCTION_LIST /end FUNCTION_LIST /begin REF_CHARACTERISTIC CalRegn01Cmn.HwAgCorrlnNtc0x092PassStep.Val /end REF_CHARACTERISTIC /begin REF_MEASUREMENT /end REF_MEASUREMENT /end GROUP
/begin GROUP CalRegn01Cmn.HwAgSnsrlsCorrdPinionAgHwConf.Val "MICROSAR RTE" /begin SUB_GROUP /end SUB_GROUP /begin FUNCTION_LIST /end FUNCTION_LIST /begin REF_CHARACTERISTIC CalRegn01Cmn.HwAgSnsrlsCorrdPinionAgHwConf.Val /end REF_CHARACTERISTIC /begin REF_MEASUREMENT /end REF_MEASUREMENT /end GROUP
/begin GROUP CalRegn01Cmn.HwAgSnsrlsFCentrHwConf.Val "MICROSAR RTE" /begin SUB_GROUP /end SUB_GROUP /begin FUNCTION_LIST /end FUNCTION_LIST /begin REF_CHARACTERISTIC CalRegn01Cmn.HwAgSnsrlsFCentrHwConf.Val /end REF_CHARACTERISTIC /begin REF_MEASUREMENT /end REF_MEASUREMENT /end GROUP
/begin GROUP CalRegn01Cmn.HwAgSnsrlsPinionTqFilFrq.Val "MICROSAR RTE" /begin SUB_GROUP /end SUB_GROUP /begin FUNCTION_LIST /end FUNCTION_LIST /begin REF_CHARACTERISTIC CalRegn01Cmn.HwAgSnsrlsPinionTqFilFrq.Val /end REF_CHARACTERISTIC /begin REF_MEASUREMENT /end REF_MEASUREMENT /end GROUP
/begin GROUP CalRegn01Cmn.HwAgSnsrlsRelHwAgFil1Frq.Val "MICROSAR RTE" /begin SUB_GROUP /end SUB_GROUP /begin FUNCTION_LIST /end FUNCTION_LIST /begin REF_CHARACTERISTIC CalRegn01Cmn.HwAgSnsrlsRelHwAgFil1Frq.Val /end REF_CHARACTERISTIC /begin REF_MEASUREMENT /end REF_MEASUREMENT /end GROUP
/begin GROUP CalRegn01Cmn.HwAgSnsrlsRelHwAgFil2Frq.Val "MICROSAR RTE" /begin SUB_GROUP /end SUB_GROUP /begin FUNCTION_LIST /end FUNCTION_LIST /begin REF_CHARACTERISTIC CalRegn01Cmn.HwAgSnsrlsRelHwAgFil2Frq.Val /end REF_CHARACTERISTIC /begin REF_MEASUREMENT /end REF_MEASUREMENT /end GROUP
/begin GROUP CalRegn01Cmn.HwAgSnsrlsSmotngCoeff.Val "MICROSAR RTE" /begin SUB_GROUP /end SUB_GROUP /begin FUNCTION_LIST /end FUNCTION_LIST /begin REF_CHARACTERISTIC CalRegn01Cmn.HwAgSnsrlsSmotngCoeff.Val /end REF_CHARACTERISTIC /begin REF_MEASUREMENT /end REF_MEASUREMENT /end GROUP
/begin GROUP CalRegn01Cmn.HwAgSnsrlsSmotngStepThd.Val "MICROSAR RTE" /begin SUB_GROUP /end SUB_GROUP /begin FUNCTION_LIST /end FUNCTION_LIST /begin REF_CHARACTERISTIC CalRegn01Cmn.HwAgSnsrlsSmotngStepThd.Val /end REF_CHARACTERISTIC /begin REF_MEASUREMENT /end REF_MEASUREMENT /end GROUP
/begin GROUP CalRegn01Cmn.HwAgSnsrlsStordPinionConf.Val "MICROSAR RTE" /begin SUB_GROUP /end SUB_GROUP /begin FUNCTION_LIST /end FUNCTION_LIST /begin REF_CHARACTERISTIC CalRegn01Cmn.HwAgSnsrlsStordPinionConf.Val /end REF_CHARACTERISTIC /begin REF_MEASUREMENT /end REF_MEASUREMENT /end GROUP
/begin GROUP CalRegn01Cmn.HwAgSnsrlsStordPinionConfThd.Val "MICROSAR RTE" /begin SUB_GROUP /end SUB_GROUP /begin FUNCTION_LIST /end FUNCTION_LIST /begin REF_CHARACTERISTIC CalRegn01Cmn.HwAgSnsrlsStordPinionConfThd.Val /end REF_CHARACTERISTIC /begin REF_MEASUREMENT /end REF_MEASUREMENT /end GROUP
/begin GROUP CalRegn01Cmn.HwAgSnsrlsVehDynDifThd.Val "MICROSAR RTE" /begin SUB_GROUP /end SUB_GROUP /begin FUNCTION_LIST /end FUNCTION_LIST /begin REF_CHARACTERISTIC CalRegn01Cmn.HwAgSnsrlsVehDynDifThd.Val /end REF_CHARACTERISTIC /begin REF_MEASUREMENT /end REF_MEASUREMENT /end GROUP
/begin GROUP CalRegn01Cmn.HwAgSnsrlsVehDynHwConf.Val "MICROSAR RTE" /begin SUB_GROUP /end SUB_GROUP /begin FUNCTION_LIST /end FUNCTION_LIST /begin REF_CHARACTERISTIC CalRegn01Cmn.HwAgSnsrlsVehDynHwConf.Val /end REF_CHARACTERISTIC /begin REF_MEASUREMENT /end REF_MEASUREMENT /end GROUP
/begin GROUP CalRegn01Cmn.HwAgSnsrlsVehDynMotVelThd.Val "MICROSAR RTE" /begin SUB_GROUP /end SUB_GROUP /begin FUNCTION_LIST /end FUNCTION_LIST /begin REF_CHARACTERISTIC CalRegn01Cmn.HwAgSnsrlsVehDynMotVelThd.Val /end REF_CHARACTERISTIC /begin REF_MEASUREMENT /end REF_MEASUREMENT /end GROUP
/begin GROUP CalRegn01Cmn.HwAgSnsrlsVehDynPinionTqThd.Val "MICROSAR RTE" /begin SUB_GROUP /end SUB_GROUP /begin FUNCTION_LIST /end FUNCTION_LIST /begin REF_CHARACTERISTIC CalRegn01Cmn.HwAgSnsrlsVehDynPinionTqThd.Val /end REF_CHARACTERISTIC /begin REF_MEASUREMENT /end REF_MEASUREMENT /end GROUP
/begin GROUP CalRegn01Cmn.HwAgSnsrlsVehDynTmr1Thd.Val "MICROSAR RTE" /begin SUB_GROUP /end SUB_GROUP /begin FUNCTION_LIST /end FUNCTION_LIST /begin REF_CHARACTERISTIC CalRegn01Cmn.HwAgSnsrlsVehDynTmr1Thd.Val /end REF_CHARACTERISTIC /begin REF_MEASUREMENT /end REF_MEASUREMENT /end GROUP
/begin GROUP CalRegn01Cmn.HwAgSnsrlsVehDynTmr2Thd.Val "MICROSAR RTE" /begin SUB_GROUP /end SUB_GROUP /begin FUNCTION_LIST /end FUNCTION_LIST /begin REF_CHARACTERISTIC CalRegn01Cmn.HwAgSnsrlsVehDynTmr2Thd.Val /end REF_CHARACTERISTIC /begin REF_MEASUREMENT /end REF_MEASUREMENT /end GROUP
/begin GROUP CalRegn01Cmn.HwAgSnsrlsWhlFrqThd.Val "MICROSAR RTE" /begin SUB_GROUP /end SUB_GROUP /begin FUNCTION_LIST /end FUNCTION_LIST /begin REF_CHARACTERISTIC CalRegn01Cmn.HwAgSnsrlsWhlFrqThd.Val /end REF_CHARACTERISTIC /begin REF_MEASUREMENT /end REF_MEASUREMENT /end GROUP
/begin GROUP CalRegn01Cmn.HwAgSnsrlsWhlSpdHwAgCoeff1.Val "MICROSAR RTE" /begin SUB_GROUP /end SUB_GROUP /begin FUNCTION_LIST /end FUNCTION_LIST /begin REF_CHARACTERISTIC CalRegn01Cmn.HwAgSnsrlsWhlSpdHwAgCoeff1.Val /end REF_CHARACTERISTIC /begin REF_MEASUREMENT /end REF_MEASUREMENT /end GROUP
/begin GROUP CalRegn01Cmn.HwAgSnsrlsWhlSpdHwAgCoeff2.Val "MICROSAR RTE" /begin SUB_GROUP /end SUB_GROUP /begin FUNCTION_LIST /end FUNCTION_LIST /begin REF_CHARACTERISTIC CalRegn01Cmn.HwAgSnsrlsWhlSpdHwAgCoeff2.Val /end REF_CHARACTERISTIC /begin REF_MEASUREMENT /end REF_MEASUREMENT /end GROUP
/begin GROUP CalRegn01Cmn.HwAgSnsrlsWhlSpdHwAgThd.Val "MICROSAR RTE" /begin SUB_GROUP /end SUB_GROUP /begin FUNCTION_LIST /end FUNCTION_LIST /begin REF_CHARACTERISTIC CalRegn01Cmn.HwAgSnsrlsWhlSpdHwAgThd.Val /end REF_CHARACTERISTIC /begin REF_MEASUREMENT /end REF_MEASUREMENT /end GROUP
/begin GROUP CalRegn01Cmn.HwAgSnsrlsWhlSpdHwConf.Val "MICROSAR RTE" /begin SUB_GROUP /end SUB_GROUP /begin FUNCTION_LIST /end FUNCTION_LIST /begin REF_CHARACTERISTIC CalRegn01Cmn.HwAgSnsrlsWhlSpdHwConf.Val /end REF_CHARACTERISTIC /begin REF_MEASUREMENT /end REF_MEASUREMENT /end GROUP
/begin GROUP CalRegn01Cmn.HwAgSnsrlsWhlSpdRatThd.Val "MICROSAR RTE" /begin SUB_GROUP /end SUB_GROUP /begin FUNCTION_LIST /end FUNCTION_LIST /begin REF_CHARACTERISTIC CalRegn01Cmn.HwAgSnsrlsWhlSpdRatThd.Val /end REF_CHARACTERISTIC /begin REF_MEASUREMENT /end REF_MEASUREMENT /end GROUP
/begin GROUP CalRegn01Cmn.HwAgSnsrlsWhlSpdTmrThd.Val "MICROSAR RTE" /begin SUB_GROUP /end SUB_GROUP /begin FUNCTION_LIST /end FUNCTION_LIST /begin REF_CHARACTERISTIC CalRegn01Cmn.HwAgSnsrlsWhlSpdTmrThd.Val /end REF_CHARACTERISTIC /begin REF_MEASUREMENT /end REF_MEASUREMENT /end GROUP
/begin GROUP CalRegn01Cmn.HwAgSnsrlsWhlSpdVehSpdThd.Val "MICROSAR RTE" /begin SUB_GROUP /end SUB_GROUP /begin FUNCTION_LIST /end FUNCTION_LIST /begin REF_CHARACTERISTIC CalRegn01Cmn.HwAgSnsrlsWhlSpdVehSpdThd.Val /end REF_CHARACTERISTIC /begin REF_MEASUREMENT /end REF_MEASUREMENT /end GROUP
/begin GROUP CalRegn01Cmn.HwAgSysArbnHwAgConf1Snsr.Val "MICROSAR RTE" /begin SUB_GROUP /end SUB_GROUP /begin FUNCTION_LIST /end FUNCTION_LIST /begin REF_CHARACTERISTIC CalRegn01Cmn.HwAgSysArbnHwAgConf1Snsr.Val /end REF_CHARACTERISTIC /begin REF_MEASUREMENT /end REF_MEASUREMENT /end GROUP
/begin GROUP CalRegn01Cmn.HwAgSysArbnHwAgConf2Snsr.Val "MICROSAR RTE" /begin SUB_GROUP /end SUB_GROUP /begin FUNCTION_LIST /end FUNCTION_LIST /begin REF_CHARACTERISTIC CalRegn01Cmn.HwAgSysArbnHwAgConf2Snsr.Val /end REF_CHARACTERISTIC /begin REF_MEASUREMENT /end REF_MEASUREMENT /end GROUP
/begin GROUP CalRegn01Cmn.HwAgSysArbnHwAgConfNoSnsr.Val "MICROSAR RTE" /begin SUB_GROUP /end SUB_GROUP /begin FUNCTION_LIST /end FUNCTION_LIST /begin REF_CHARACTERISTIC CalRegn01Cmn.HwAgSysArbnHwAgConfNoSnsr.Val /end REF_CHARACTERISTIC /begin REF_MEASUREMENT /end REF_MEASUREMENT /end GROUP
/begin GROUP CalRegn01Cmn.HwAgSysArbnHwAgCorrdCorrlnThd.Val "MICROSAR RTE" /begin SUB_GROUP /end SUB_GROUP /begin FUNCTION_LIST /end FUNCTION_LIST /begin REF_CHARACTERISTIC CalRegn01Cmn.HwAgSysArbnHwAgCorrdCorrlnThd.Val /end REF_CHARACTERISTIC /begin REF_MEASUREMENT /end REF_MEASUREMENT /end GROUP
/begin GROUP CalRegn01Cmn.HwAgSysArbnHwAgCorrlnFailDebStep.Val "MICROSAR RTE" /begin SUB_GROUP /end SUB_GROUP /begin FUNCTION_LIST /end FUNCTION_LIST /begin REF_CHARACTERISTIC CalRegn01Cmn.HwAgSysArbnHwAgCorrlnFailDebStep.Val /end REF_CHARACTERISTIC /begin REF_MEASUREMENT /end REF_MEASUREMENT /end GROUP
/begin GROUP CalRegn01Cmn.HwAgSysArbnHwAgCorrlnPassDebStep.Val "MICROSAR RTE" /begin SUB_GROUP /end SUB_GROUP /begin FUNCTION_LIST /end FUNCTION_LIST /begin REF_CHARACTERISTIC CalRegn01Cmn.HwAgSysArbnHwAgCorrlnPassDebStep.Val /end REF_CHARACTERISTIC /begin REF_MEASUREMENT /end REF_MEASUREMENT /end GROUP
/begin GROUP CalRegn01Cmn.HwAgSysArbnHwAgCorrlnRng.Val "MICROSAR RTE" /begin SUB_GROUP /end SUB_GROUP /begin FUNCTION_LIST /end FUNCTION_LIST /begin REF_CHARACTERISTIC CalRegn01Cmn.HwAgSysArbnHwAgCorrlnRng.Val /end REF_CHARACTERISTIC /begin REF_MEASUREMENT /end REF_MEASUREMENT /end GROUP
/begin GROUP CalRegn01Cmn.HwAgSysArbnHwAgSlewRate.Val "MICROSAR RTE" /begin SUB_GROUP /end SUB_GROUP /begin FUNCTION_LIST /end FUNCTION_LIST /begin REF_CHARACTERISTIC CalRegn01Cmn.HwAgSysArbnHwAgSlewRate.Val /end REF_CHARACTERISTIC /begin REF_MEASUREMENT /end REF_MEASUREMENT /end GROUP
/begin GROUP CalRegn01Cmn.HwAgSysArbnHwAgSnsrlsCorrlnThd.Val "MICROSAR RTE" /begin SUB_GROUP /end SUB_GROUP /begin FUNCTION_LIST /end FUNCTION_LIST /begin REF_CHARACTERISTIC CalRegn01Cmn.HwAgSysArbnHwAgSnsrlsCorrlnThd.Val /end REF_CHARACTERISTIC /begin REF_MEASUREMENT /end REF_MEASUREMENT /end GROUP
/begin GROUP CalRegn01Cmn.HwAgSysArbnHwAgSnsrlsKineThd.Val "MICROSAR RTE" /begin SUB_GROUP /end SUB_GROUP /begin FUNCTION_LIST /end FUNCTION_LIST /begin REF_CHARACTERISTIC CalRegn01Cmn.HwAgSysArbnHwAgSnsrlsKineThd.Val /end REF_CHARACTERISTIC /begin REF_MEASUREMENT /end REF_MEASUREMENT /end GROUP
/begin GROUP CalRegn01Cmn.HwAgSysArbnHwAgToMotAgCorrlnElpdTiLim.Val "MICROSAR RTE" /begin SUB_GROUP /end SUB_GROUP /begin FUNCTION_LIST /end FUNCTION_LIST /begin REF_CHARACTERISTIC CalRegn01Cmn.HwAgSysArbnHwAgToMotAgCorrlnElpdTiLim.Val /end REF_CHARACTERISTIC /begin REF_MEASUREMENT /end REF_MEASUREMENT /end GROUP
/begin GROUP CalRegn01Cmn.HwAgSysArbnSerlComHwAgCorrdConf.Val "MICROSAR RTE" /begin SUB_GROUP /end SUB_GROUP /begin FUNCTION_LIST /end FUNCTION_LIST /begin REF_CHARACTERISTIC CalRegn01Cmn.HwAgSysArbnSerlComHwAgCorrdConf.Val /end REF_CHARACTERISTIC /begin REF_MEASUREMENT /end REF_MEASUREMENT /end GROUP
/begin GROUP CalRegn01Cmn.HwAgSysArbnSerlComHwAgSnsrlsConf.Val "MICROSAR RTE" /begin SUB_GROUP /end SUB_GROUP /begin FUNCTION_LIST /end FUNCTION_LIST /begin REF_CHARACTERISTIC CalRegn01Cmn.HwAgSysArbnSerlComHwAgSnsrlsConf.Val /end REF_CHARACTERISTIC /begin REF_MEASUREMENT /end REF_MEASUREMENT /end GROUP
/begin GROUP CalRegn01Cmn.HwAgSysArbnSlewRateTmr.Val "MICROSAR RTE" /begin SUB_GROUP /end SUB_GROUP /begin FUNCTION_LIST /end FUNCTION_LIST /begin REF_CHARACTERISTIC CalRegn01Cmn.HwAgSysArbnSlewRateTmr.Val /end REF_CHARACTERISTIC /begin REF_MEASUREMENT /end REF_MEASUREMENT /end GROUP
/begin GROUP CalRegn01Cmn.HwAgTrajGennAMax.Val "MICROSAR RTE" /begin SUB_GROUP /end SUB_GROUP /begin FUNCTION_LIST /end FUNCTION_LIST /begin REF_CHARACTERISTIC CalRegn01Cmn.HwAgTrajGennAMax.Val /end REF_CHARACTERISTIC /begin REF_MEASUREMENT /end REF_MEASUREMENT /end GROUP
/begin GROUP CalRegn01Cmn.HwAgTrajGennAgMax.Val "MICROSAR RTE" /begin SUB_GROUP /end SUB_GROUP /begin FUNCTION_LIST /end FUNCTION_LIST /begin REF_CHARACTERISTIC CalRegn01Cmn.HwAgTrajGennAgMax.Val /end REF_CHARACTERISTIC /begin REF_MEASUREMENT /end REF_MEASUREMENT /end GROUP
/begin GROUP CalRegn01Cmn.HwAgTrajGennVelMax.Val "MICROSAR RTE" /begin SUB_GROUP /end SUB_GROUP /begin FUNCTION_LIST /end FUNCTION_LIST /begin REF_CHARACTERISTIC CalRegn01Cmn.HwAgTrajGennVelMax.Val /end REF_CHARACTERISTIC /begin REF_MEASUREMENT /end REF_MEASUREMENT /end GROUP
/begin GROUP CalRegn01Cmn.HwTq2MeasHwTq2PrtclFltFailStep.Val "MICROSAR RTE" /begin SUB_GROUP /end SUB_GROUP /begin FUNCTION_LIST /end FUNCTION_LIST /begin REF_CHARACTERISTIC CalRegn01Cmn.HwTq2MeasHwTq2PrtclFltFailStep.Val /end REF_CHARACTERISTIC /begin REF_MEASUREMENT /end REF_MEASUREMENT /end GROUP
/begin GROUP CalRegn01Cmn.HwTq2MeasHwTq2PrtclFltPassStep.Val "MICROSAR RTE" /begin SUB_GROUP /end SUB_GROUP /begin FUNCTION_LIST /end FUNCTION_LIST /begin REF_CHARACTERISTIC CalRegn01Cmn.HwTq2MeasHwTq2PrtclFltPassStep.Val /end REF_CHARACTERISTIC /begin REF_MEASUREMENT /end REF_MEASUREMENT /end GROUP
/begin GROUP CalRegn01Cmn.HwTq3MeasHwTq3PrtclFltFailStep.Val "MICROSAR RTE" /begin SUB_GROUP /end SUB_GROUP /begin FUNCTION_LIST /end FUNCTION_LIST /begin REF_CHARACTERISTIC CalRegn01Cmn.HwTq3MeasHwTq3PrtclFltFailStep.Val /end REF_CHARACTERISTIC /begin REF_MEASUREMENT /end REF_MEASUREMENT /end GROUP
/begin GROUP CalRegn01Cmn.HwTq3MeasHwTq3PrtclFltPassStep.Val "MICROSAR RTE" /begin SUB_GROUP /end SUB_GROUP /begin FUNCTION_LIST /end FUNCTION_LIST /begin REF_CHARACTERISTIC CalRegn01Cmn.HwTq3MeasHwTq3PrtclFltPassStep.Val /end REF_CHARACTERISTIC /begin REF_MEASUREMENT /end REF_MEASUREMENT /end GROUP
/begin GROUP CalRegn01Cmn.HwTqArbnMaxStallTqA.Val "MICROSAR RTE" /begin SUB_GROUP /end SUB_GROUP /begin FUNCTION_LIST /end FUNCTION_LIST /begin REF_CHARACTERISTIC CalRegn01Cmn.HwTqArbnMaxStallTqA.Val /end REF_CHARACTERISTIC /begin REF_MEASUREMENT /end REF_MEASUREMENT /end GROUP
/begin GROUP CalRegn01Cmn.HwTqArbnMaxStallTqB.Val "MICROSAR RTE" /begin SUB_GROUP /end SUB_GROUP /begin FUNCTION_LIST /end FUNCTION_LIST /begin REF_CHARACTERISTIC CalRegn01Cmn.HwTqArbnMaxStallTqB.Val /end REF_CHARACTERISTIC /begin REF_MEASUREMENT /end REF_MEASUREMENT /end GROUP
/begin GROUP CalRegn01Cmn.HwTqArbnMaxStallTqC.Val "MICROSAR RTE" /begin SUB_GROUP /end SUB_GROUP /begin FUNCTION_LIST /end FUNCTION_LIST /begin REF_CHARACTERISTIC CalRegn01Cmn.HwTqArbnMaxStallTqC.Val /end REF_CHARACTERISTIC /begin REF_MEASUREMENT /end REF_MEASUREMENT /end GROUP
/begin GROUP CalRegn01Cmn.HwTqArbnMaxStallTqD.Val "MICROSAR RTE" /begin SUB_GROUP /end SUB_GROUP /begin FUNCTION_LIST /end FUNCTION_LIST /begin REF_CHARACTERISTIC CalRegn01Cmn.HwTqArbnMaxStallTqD.Val /end REF_CHARACTERISTIC /begin REF_MEASUREMENT /end REF_MEASUREMENT /end GROUP
/begin GROUP CalRegn01Cmn.HwTqCorrlnChACmnModCmpLpFilActvnThd.Val "MICROSAR RTE" /begin SUB_GROUP /end SUB_GROUP /begin FUNCTION_LIST /end FUNCTION_LIST /begin REF_CHARACTERISTIC CalRegn01Cmn.HwTqCorrlnChACmnModCmpLpFilActvnThd.Val /end REF_CHARACTERISTIC /begin REF_MEASUREMENT /end REF_MEASUREMENT /end GROUP
/begin GROUP CalRegn01Cmn.HwTqCorrlnChACmnModCmpLpFilFrq.Val "MICROSAR RTE" /begin SUB_GROUP /end SUB_GROUP /begin FUNCTION_LIST /end FUNCTION_LIST /begin REF_CHARACTERISTIC CalRegn01Cmn.HwTqCorrlnChACmnModCmpLpFilFrq.Val /end REF_CHARACTERISTIC /begin REF_MEASUREMENT /end REF_MEASUREMENT /end GROUP
/begin GROUP CalRegn01Cmn.HwTqCorrlnChACmnModCmpLpFilOutpLim.Val "MICROSAR RTE" /begin SUB_GROUP /end SUB_GROUP /begin FUNCTION_LIST /end FUNCTION_LIST /begin REF_CHARACTERISTIC CalRegn01Cmn.HwTqCorrlnChACmnModCmpLpFilOutpLim.Val /end REF_CHARACTERISTIC /begin REF_MEASUREMENT /end REF_MEASUREMENT /end GROUP
/begin GROUP CalRegn01Cmn.HwTqCorrlnChAImdtCorrlnChkFailThd.Val "MICROSAR RTE" /begin SUB_GROUP /end SUB_GROUP /begin FUNCTION_LIST /end FUNCTION_LIST /begin REF_CHARACTERISTIC CalRegn01Cmn.HwTqCorrlnChAImdtCorrlnChkFailThd.Val /end REF_CHARACTERISTIC /begin REF_MEASUREMENT /end REF_MEASUREMENT /end GROUP
/begin GROUP CalRegn01Cmn.HwTqCorrlnChAImdtCorrlnChkPassThd.Val "MICROSAR RTE" /begin SUB_GROUP /end SUB_GROUP /begin FUNCTION_LIST /end FUNCTION_LIST /begin REF_CHARACTERISTIC CalRegn01Cmn.HwTqCorrlnChAImdtCorrlnChkPassThd.Val /end REF_CHARACTERISTIC /begin REF_MEASUREMENT /end REF_MEASUREMENT /end GROUP
/begin GROUP CalRegn01Cmn.HwTqCorrlnChAStabStClrFltThd.Val "MICROSAR RTE" /begin SUB_GROUP /end SUB_GROUP /begin FUNCTION_LIST /end FUNCTION_LIST /begin REF_CHARACTERISTIC CalRegn01Cmn.HwTqCorrlnChAStabStClrFltThd.Val /end REF_CHARACTERISTIC /begin REF_MEASUREMENT /end REF_MEASUREMENT /end GROUP
/begin GROUP CalRegn01Cmn.HwTqCorrlnChAStabStLpFilFrq.Val "MICROSAR RTE" /begin SUB_GROUP /end SUB_GROUP /begin FUNCTION_LIST /end FUNCTION_LIST /begin REF_CHARACTERISTIC CalRegn01Cmn.HwTqCorrlnChAStabStLpFilFrq.Val /end REF_CHARACTERISTIC /begin REF_MEASUREMENT /end REF_MEASUREMENT /end GROUP
/begin GROUP CalRegn01Cmn.HwTqCorrlnChAStabStSetFltThd.Val "MICROSAR RTE" /begin SUB_GROUP /end SUB_GROUP /begin FUNCTION_LIST /end FUNCTION_LIST /begin REF_CHARACTERISTIC CalRegn01Cmn.HwTqCorrlnChAStabStSetFltThd.Val /end REF_CHARACTERISTIC /begin REF_MEASUREMENT /end REF_MEASUREMENT /end GROUP
/begin GROUP CalRegn01Cmn.HwTqCorrlnChATqSumMaxLim.Val "MICROSAR RTE" /begin SUB_GROUP /end SUB_GROUP /begin FUNCTION_LIST /end FUNCTION_LIST /begin REF_CHARACTERISTIC CalRegn01Cmn.HwTqCorrlnChATqSumMaxLim.Val /end REF_CHARACTERISTIC /begin REF_MEASUREMENT /end REF_MEASUREMENT /end GROUP
/begin GROUP CalRegn01Cmn.HwTqCorrlnChATraLpFilX.Ary1D "MICROSAR RTE" /begin SUB_GROUP /end SUB_GROUP /begin FUNCTION_LIST /end FUNCTION_LIST /begin REF_CHARACTERISTIC CalRegn01Cmn.HwTqCorrlnChATraLpFilX.Ary1D /end REF_CHARACTERISTIC /begin REF_MEASUREMENT /end REF_MEASUREMENT /end GROUP
/begin GROUP CalRegn01Cmn.HwTqCorrlnChATraLpFilY.Ary1D "MICROSAR RTE" /begin SUB_GROUP /end SUB_GROUP /begin FUNCTION_LIST /end FUNCTION_LIST /begin REF_CHARACTERISTIC CalRegn01Cmn.HwTqCorrlnChATraLpFilY.Ary1D /end REF_CHARACTERISTIC /begin REF_MEASUREMENT /end REF_MEASUREMENT /end GROUP
/begin GROUP CalRegn01Cmn.HwTqCorrlnChATraSumClrFltThd.Val "MICROSAR RTE" /begin SUB_GROUP /end SUB_GROUP /begin FUNCTION_LIST /end FUNCTION_LIST /begin REF_CHARACTERISTIC CalRegn01Cmn.HwTqCorrlnChATraSumClrFltThd.Val /end REF_CHARACTERISTIC /begin REF_MEASUREMENT /end REF_MEASUREMENT /end GROUP
/begin GROUP CalRegn01Cmn.HwTqCorrlnChATraSumSetFltThd.Val "MICROSAR RTE" /begin SUB_GROUP /end SUB_GROUP /begin FUNCTION_LIST /end FUNCTION_LIST /begin REF_CHARACTERISTIC CalRegn01Cmn.HwTqCorrlnChATraSumSetFltThd.Val /end REF_CHARACTERISTIC /begin REF_MEASUREMENT /end REF_MEASUREMENT /end GROUP
/begin GROUP CalRegn01Cmn.HwTqCorrlnChBCmnModCmpLpFilActvnThd.Val "MICROSAR RTE" /begin SUB_GROUP /end SUB_GROUP /begin FUNCTION_LIST /end FUNCTION_LIST /begin REF_CHARACTERISTIC CalRegn01Cmn.HwTqCorrlnChBCmnModCmpLpFilActvnThd.Val /end REF_CHARACTERISTIC /begin REF_MEASUREMENT /end REF_MEASUREMENT /end GROUP
/begin GROUP CalRegn01Cmn.HwTqCorrlnChBCmnModCmpLpFilFrq.Val "MICROSAR RTE" /begin SUB_GROUP /end SUB_GROUP /begin FUNCTION_LIST /end FUNCTION_LIST /begin REF_CHARACTERISTIC CalRegn01Cmn.HwTqCorrlnChBCmnModCmpLpFilFrq.Val /end REF_CHARACTERISTIC /begin REF_MEASUREMENT /end REF_MEASUREMENT /end GROUP
/begin GROUP CalRegn01Cmn.HwTqCorrlnChBCmnModCmpLpFilOutpLim.Val "MICROSAR RTE" /begin SUB_GROUP /end SUB_GROUP /begin FUNCTION_LIST /end FUNCTION_LIST /begin REF_CHARACTERISTIC CalRegn01Cmn.HwTqCorrlnChBCmnModCmpLpFilOutpLim.Val /end REF_CHARACTERISTIC /begin REF_MEASUREMENT /end REF_MEASUREMENT /end GROUP
/begin GROUP CalRegn01Cmn.HwTqCorrlnChBImdtCorrlnChkFailThd.Val "MICROSAR RTE" /begin SUB_GROUP /end SUB_GROUP /begin FUNCTION_LIST /end FUNCTION_LIST /begin REF_CHARACTERISTIC CalRegn01Cmn.HwTqCorrlnChBImdtCorrlnChkFailThd.Val /end REF_CHARACTERISTIC /begin REF_MEASUREMENT /end REF_MEASUREMENT /end GROUP
/begin GROUP CalRegn01Cmn.HwTqCorrlnChBImdtCorrlnChkPassThd.Val "MICROSAR RTE" /begin SUB_GROUP /end SUB_GROUP /begin FUNCTION_LIST /end FUNCTION_LIST /begin REF_CHARACTERISTIC CalRegn01Cmn.HwTqCorrlnChBImdtCorrlnChkPassThd.Val /end REF_CHARACTERISTIC /begin REF_MEASUREMENT /end REF_MEASUREMENT /end GROUP
/begin GROUP CalRegn01Cmn.HwTqCorrlnChBStabStClrFltThd.Val "MICROSAR RTE" /begin SUB_GROUP /end SUB_GROUP /begin FUNCTION_LIST /end FUNCTION_LIST /begin REF_CHARACTERISTIC CalRegn01Cmn.HwTqCorrlnChBStabStClrFltThd.Val /end REF_CHARACTERISTIC /begin REF_MEASUREMENT /end REF_MEASUREMENT /end GROUP
/begin GROUP CalRegn01Cmn.HwTqCorrlnChBStabStLpFilFrq.Val "MICROSAR RTE" /begin SUB_GROUP /end SUB_GROUP /begin FUNCTION_LIST /end FUNCTION_LIST /begin REF_CHARACTERISTIC CalRegn01Cmn.HwTqCorrlnChBStabStLpFilFrq.Val /end REF_CHARACTERISTIC /begin REF_MEASUREMENT /end REF_MEASUREMENT /end GROUP
/begin GROUP CalRegn01Cmn.HwTqCorrlnChBStabStSetFltThd.Val "MICROSAR RTE" /begin SUB_GROUP /end SUB_GROUP /begin FUNCTION_LIST /end FUNCTION_LIST /begin REF_CHARACTERISTIC CalRegn01Cmn.HwTqCorrlnChBStabStSetFltThd.Val /end REF_CHARACTERISTIC /begin REF_MEASUREMENT /end REF_MEASUREMENT /end GROUP
/begin GROUP CalRegn01Cmn.HwTqCorrlnChBTqSumMaxLim.Val "MICROSAR RTE" /begin SUB_GROUP /end SUB_GROUP /begin FUNCTION_LIST /end FUNCTION_LIST /begin REF_CHARACTERISTIC CalRegn01Cmn.HwTqCorrlnChBTqSumMaxLim.Val /end REF_CHARACTERISTIC /begin REF_MEASUREMENT /end REF_MEASUREMENT /end GROUP
/begin GROUP CalRegn01Cmn.HwTqCorrlnChBTraLpFilX.Ary1D "MICROSAR RTE" /begin SUB_GROUP /end SUB_GROUP /begin FUNCTION_LIST /end FUNCTION_LIST /begin REF_CHARACTERISTIC CalRegn01Cmn.HwTqCorrlnChBTraLpFilX.Ary1D /end REF_CHARACTERISTIC /begin REF_MEASUREMENT /end REF_MEASUREMENT /end GROUP
/begin GROUP CalRegn01Cmn.HwTqCorrlnChBTraLpFilY.Ary1D "MICROSAR RTE" /begin SUB_GROUP /end SUB_GROUP /begin FUNCTION_LIST /end FUNCTION_LIST /begin REF_CHARACTERISTIC CalRegn01Cmn.HwTqCorrlnChBTraLpFilY.Ary1D /end REF_CHARACTERISTIC /begin REF_MEASUREMENT /end REF_MEASUREMENT /end GROUP
/begin GROUP CalRegn01Cmn.HwTqCorrlnChBTraSumClrFltThd.Val "MICROSAR RTE" /begin SUB_GROUP /end SUB_GROUP /begin FUNCTION_LIST /end FUNCTION_LIST /begin REF_CHARACTERISTIC CalRegn01Cmn.HwTqCorrlnChBTraSumClrFltThd.Val /end REF_CHARACTERISTIC /begin REF_MEASUREMENT /end REF_MEASUREMENT /end GROUP
/begin GROUP CalRegn01Cmn.HwTqCorrlnChBTraSumSetFltThd.Val "MICROSAR RTE" /begin SUB_GROUP /end SUB_GROUP /begin FUNCTION_LIST /end FUNCTION_LIST /begin REF_CHARACTERISTIC CalRegn01Cmn.HwTqCorrlnChBTraSumSetFltThd.Val /end REF_CHARACTERISTIC /begin REF_MEASUREMENT /end REF_MEASUREMENT /end GROUP
/begin GROUP CalRegn01Cmn.HwTqCorrlnMaxStallTqA.Val "MICROSAR RTE" /begin SUB_GROUP /end SUB_GROUP /begin FUNCTION_LIST /end FUNCTION_LIST /begin REF_CHARACTERISTIC CalRegn01Cmn.HwTqCorrlnMaxStallTqA.Val /end REF_CHARACTERISTIC /begin REF_MEASUREMENT /end REF_MEASUREMENT /end GROUP
/begin GROUP CalRegn01Cmn.HwTqCorrlnMaxStallTqB.Val "MICROSAR RTE" /begin SUB_GROUP /end SUB_GROUP /begin FUNCTION_LIST /end FUNCTION_LIST /begin REF_CHARACTERISTIC CalRegn01Cmn.HwTqCorrlnMaxStallTqB.Val /end REF_CHARACTERISTIC /begin REF_MEASUREMENT /end REF_MEASUREMENT /end GROUP
/begin GROUP CalRegn01Cmn.HwTqCorrlnMaxStallTqC.Val "MICROSAR RTE" /begin SUB_GROUP /end SUB_GROUP /begin FUNCTION_LIST /end FUNCTION_LIST /begin REF_CHARACTERISTIC CalRegn01Cmn.HwTqCorrlnMaxStallTqC.Val /end REF_CHARACTERISTIC /begin REF_MEASUREMENT /end REF_MEASUREMENT /end GROUP
/begin GROUP CalRegn01Cmn.HwTqCorrlnMaxStallTqD.Val "MICROSAR RTE" /begin SUB_GROUP /end SUB_GROUP /begin FUNCTION_LIST /end FUNCTION_LIST /begin REF_CHARACTERISTIC CalRegn01Cmn.HwTqCorrlnMaxStallTqD.Val /end REF_CHARACTERISTIC /begin REF_MEASUREMENT /end REF_MEASUREMENT /end GROUP
/begin GROUP CalRegn01Cmn.LoaMgrCurrIvtrMtgtnRate.Val "MICROSAR RTE" /begin SUB_GROUP /end SUB_GROUP /begin FUNCTION_LIST /end FUNCTION_LIST /begin REF_CHARACTERISTIC CalRegn01Cmn.LoaMgrCurrIvtrMtgtnRate.Val /end REF_CHARACTERISTIC /begin REF_MEASUREMENT /end REF_MEASUREMENT /end GROUP
/begin GROUP CalRegn01Cmn.LoaMgrCurrIvtrMtgtnSca.Val "MICROSAR RTE" /begin SUB_GROUP /end SUB_GROUP /begin FUNCTION_LIST /end FUNCTION_LIST /begin REF_CHARACTERISTIC CalRegn01Cmn.LoaMgrCurrIvtrMtgtnSca.Val /end REF_CHARACTERISTIC /begin REF_MEASUREMENT /end REF_MEASUREMENT /end GROUP
/begin GROUP CalRegn01Cmn.LoaMgrCurrIvtrMtgtnScaZeroEna.Logl "MICROSAR RTE" /begin SUB_GROUP /end SUB_GROUP /begin FUNCTION_LIST /end FUNCTION_LIST /begin REF_CHARACTERISTIC CalRegn01Cmn.LoaMgrCurrIvtrMtgtnScaZeroEna.Logl /end REF_CHARACTERISTIC /begin REF_MEASUREMENT /end REF_MEASUREMENT /end GROUP
/begin GROUP CalRegn01Cmn.LoaMgrCurrMeasIdptSig0Resp.Val "MICROSAR RTE" /begin SUB_GROUP /end SUB_GROUP /begin FUNCTION_LIST /end FUNCTION_LIST /begin REF_CHARACTERISTIC CalRegn01Cmn.LoaMgrCurrMeasIdptSig0Resp.Val /end REF_CHARACTERISTIC /begin REF_MEASUREMENT /end REF_MEASUREMENT /end GROUP
/begin GROUP CalRegn01Cmn.LoaMgrCurrMeasIdptSig1Resp.Val "MICROSAR RTE" /begin SUB_GROUP /end SUB_GROUP /begin FUNCTION_LIST /end FUNCTION_LIST /begin REF_CHARACTERISTIC CalRegn01Cmn.LoaMgrCurrMeasIdptSig1Resp.Val /end REF_CHARACTERISTIC /begin REF_MEASUREMENT /end REF_MEASUREMENT /end GROUP
/begin GROUP CalRegn01Cmn.LoaMgrCurrMeasIdptSig2Resp.Val "MICROSAR RTE" /begin SUB_GROUP /end SUB_GROUP /begin FUNCTION_LIST /end FUNCTION_LIST /begin REF_CHARACTERISTIC CalRegn01Cmn.LoaMgrCurrMeasIdptSig2Resp.Val /end REF_CHARACTERISTIC /begin REF_MEASUREMENT /end REF_MEASUREMENT /end GROUP
/begin GROUP CalRegn01Cmn.LoaMgrCurrMeasIdptSigFltThd.Val "MICROSAR RTE" /begin SUB_GROUP /end SUB_GROUP /begin FUNCTION_LIST /end FUNCTION_LIST /begin REF_CHARACTERISTIC CalRegn01Cmn.LoaMgrCurrMeasIdptSigFltThd.Val /end REF_CHARACTERISTIC /begin REF_MEASUREMENT /end REF_MEASUREMENT /end GROUP
/begin GROUP CalRegn01Cmn.LoaMgrCurrMeasMtgtnRate.Val "MICROSAR RTE" /begin SUB_GROUP /end SUB_GROUP /begin FUNCTION_LIST /end FUNCTION_LIST /begin REF_CHARACTERISTIC CalRegn01Cmn.LoaMgrCurrMeasMtgtnRate.Val /end REF_CHARACTERISTIC /begin REF_MEASUREMENT /end REF_MEASUREMENT /end GROUP
/begin GROUP CalRegn01Cmn.LoaMgrCurrMeasMtgtnSca.Val "MICROSAR RTE" /begin SUB_GROUP /end SUB_GROUP /begin FUNCTION_LIST /end FUNCTION_LIST /begin REF_CHARACTERISTIC CalRegn01Cmn.LoaMgrCurrMeasMtgtnSca.Val /end REF_CHARACTERISTIC /begin REF_MEASUREMENT /end REF_MEASUREMENT /end GROUP
/begin GROUP CalRegn01Cmn.LoaMgrCurrMeasMtgtnScaZeroEna.Logl "MICROSAR RTE" /begin SUB_GROUP /end SUB_GROUP /begin FUNCTION_LIST /end FUNCTION_LIST /begin REF_CHARACTERISTIC CalRegn01Cmn.LoaMgrCurrMeasMtgtnScaZeroEna.Logl /end REF_CHARACTERISTIC /begin REF_MEASUREMENT /end REF_MEASUREMENT /end GROUP
/begin GROUP CalRegn01Cmn.LoaMgrFadeOutStRate.Val "MICROSAR RTE" /begin SUB_GROUP /end SUB_GROUP /begin FUNCTION_LIST /end FUNCTION_LIST /begin REF_CHARACTERISTIC CalRegn01Cmn.LoaMgrFadeOutStRate.Val /end REF_CHARACTERISTIC /begin REF_MEASUREMENT /end REF_MEASUREMENT /end GROUP
/begin GROUP CalRegn01Cmn.LoaMgrHwTqIdptSig0NoTqLoaResp.Val "MICROSAR RTE" /begin SUB_GROUP /end SUB_GROUP /begin FUNCTION_LIST /end FUNCTION_LIST /begin REF_CHARACTERISTIC CalRegn01Cmn.LoaMgrHwTqIdptSig0NoTqLoaResp.Val /end REF_CHARACTERISTIC /begin REF_MEASUREMENT /end REF_MEASUREMENT /end GROUP
/begin GROUP CalRegn01Cmn.LoaMgrHwTqIdptSig1NoTqLoaResp.Val "MICROSAR RTE" /begin SUB_GROUP /end SUB_GROUP /begin FUNCTION_LIST /end FUNCTION_LIST /begin REF_CHARACTERISTIC CalRegn01Cmn.LoaMgrHwTqIdptSig1NoTqLoaResp.Val /end REF_CHARACTERISTIC /begin REF_MEASUREMENT /end REF_MEASUREMENT /end GROUP
/begin GROUP CalRegn01Cmn.LoaMgrHwTqIdptSig2Resp.Val "MICROSAR RTE" /begin SUB_GROUP /end SUB_GROUP /begin FUNCTION_LIST /end FUNCTION_LIST /begin REF_CHARACTERISTIC CalRegn01Cmn.LoaMgrHwTqIdptSig2Resp.Val /end REF_CHARACTERISTIC /begin REF_MEASUREMENT /end REF_MEASUREMENT /end GROUP
/begin GROUP CalRegn01Cmn.LoaMgrHwTqIdptSig4Resp.Val "MICROSAR RTE" /begin SUB_GROUP /end SUB_GROUP /begin FUNCTION_LIST /end FUNCTION_LIST /begin REF_CHARACTERISTIC CalRegn01Cmn.LoaMgrHwTqIdptSig4Resp.Val /end REF_CHARACTERISTIC /begin REF_MEASUREMENT /end REF_MEASUREMENT /end GROUP
/begin GROUP CalRegn01Cmn.LoaMgrHwTqIdptSigFltThd.Val "MICROSAR RTE" /begin SUB_GROUP /end SUB_GROUP /begin FUNCTION_LIST /end FUNCTION_LIST /begin REF_CHARACTERISTIC CalRegn01Cmn.LoaMgrHwTqIdptSigFltThd.Val /end REF_CHARACTERISTIC /begin REF_MEASUREMENT /end REF_MEASUREMENT /end GROUP
/begin GROUP CalRegn01Cmn.LoaMgrHwTqLoaAvlResp.Val "MICROSAR RTE" /begin SUB_GROUP /end SUB_GROUP /begin FUNCTION_LIST /end FUNCTION_LIST /begin REF_CHARACTERISTIC CalRegn01Cmn.LoaMgrHwTqLoaAvlResp.Val /end REF_CHARACTERISTIC /begin REF_MEASUREMENT /end REF_MEASUREMENT /end GROUP
/begin GROUP CalRegn01Cmn.LoaMgrIvtrIdptSig0Resp.Val "MICROSAR RTE" /begin SUB_GROUP /end SUB_GROUP /begin FUNCTION_LIST /end FUNCTION_LIST /begin REF_CHARACTERISTIC CalRegn01Cmn.LoaMgrIvtrIdptSig0Resp.Val /end REF_CHARACTERISTIC /begin REF_MEASUREMENT /end REF_MEASUREMENT /end GROUP
/begin GROUP CalRegn01Cmn.LoaMgrIvtrIdptSig1Resp.Val "MICROSAR RTE" /begin SUB_GROUP /end SUB_GROUP /begin FUNCTION_LIST /end FUNCTION_LIST /begin REF_CHARACTERISTIC CalRegn01Cmn.LoaMgrIvtrIdptSig1Resp.Val /end REF_CHARACTERISTIC /begin REF_MEASUREMENT /end REF_MEASUREMENT /end GROUP
/begin GROUP CalRegn01Cmn.LoaMgrIvtrIdptSig2Resp.Val "MICROSAR RTE" /begin SUB_GROUP /end SUB_GROUP /begin FUNCTION_LIST /end FUNCTION_LIST /begin REF_CHARACTERISTIC CalRegn01Cmn.LoaMgrIvtrIdptSig2Resp.Val /end REF_CHARACTERISTIC /begin REF_MEASUREMENT /end REF_MEASUREMENT /end GROUP
/begin GROUP CalRegn01Cmn.LoaMgrIvtrIdptSigFltThd.Val "MICROSAR RTE" /begin SUB_GROUP /end SUB_GROUP /begin FUNCTION_LIST /end FUNCTION_LIST /begin REF_CHARACTERISTIC CalRegn01Cmn.LoaMgrIvtrIdptSigFltThd.Val /end REF_CHARACTERISTIC /begin REF_MEASUREMENT /end REF_MEASUREMENT /end GROUP
/begin GROUP CalRegn01Cmn.LoaMgrIvtrMtgtnRate.Val "MICROSAR RTE" /begin SUB_GROUP /end SUB_GROUP /begin FUNCTION_LIST /end FUNCTION_LIST /begin REF_CHARACTERISTIC CalRegn01Cmn.LoaMgrIvtrMtgtnRate.Val /end REF_CHARACTERISTIC /begin REF_MEASUREMENT /end REF_MEASUREMENT /end GROUP
/begin GROUP CalRegn01Cmn.LoaMgrIvtrMtgtnSca.Val "MICROSAR RTE" /begin SUB_GROUP /end SUB_GROUP /begin FUNCTION_LIST /end FUNCTION_LIST /begin REF_CHARACTERISTIC CalRegn01Cmn.LoaMgrIvtrMtgtnSca.Val /end REF_CHARACTERISTIC /begin REF_MEASUREMENT /end REF_MEASUREMENT /end GROUP
/begin GROUP CalRegn01Cmn.LoaMgrIvtrMtgtnScaZeroEna.Logl "MICROSAR RTE" /begin SUB_GROUP /end SUB_GROUP /begin FUNCTION_LIST /end FUNCTION_LIST /begin REF_CHARACTERISTIC CalRegn01Cmn.LoaMgrIvtrMtgtnScaZeroEna.Logl /end REF_CHARACTERISTIC /begin REF_MEASUREMENT /end REF_MEASUREMENT /end GROUP
/begin GROUP CalRegn01Cmn.LoaMgrLimdStRate.Val "MICROSAR RTE" /begin SUB_GROUP /end SUB_GROUP /begin FUNCTION_LIST /end FUNCTION_LIST /begin REF_CHARACTERISTIC CalRegn01Cmn.LoaMgrLimdStRate.Val /end REF_CHARACTERISTIC /begin REF_MEASUREMENT /end REF_MEASUREMENT /end GROUP
/begin GROUP CalRegn01Cmn.LoaMgrLimdStSca.Val "MICROSAR RTE" /begin SUB_GROUP /end SUB_GROUP /begin FUNCTION_LIST /end FUNCTION_LIST /begin REF_CHARACTERISTIC CalRegn01Cmn.LoaMgrLimdStSca.Val /end REF_CHARACTERISTIC /begin REF_MEASUREMENT /end REF_MEASUREMENT /end GROUP
/begin GROUP CalRegn01Cmn.LoaMgrMotAgAvlSnsrlsResp.Val "MICROSAR RTE" /begin SUB_GROUP /end SUB_GROUP /begin FUNCTION_LIST /end FUNCTION_LIST /begin REF_CHARACTERISTIC CalRegn01Cmn.LoaMgrMotAgAvlSnsrlsResp.Val /end REF_CHARACTERISTIC /begin REF_MEASUREMENT /end REF_MEASUREMENT /end GROUP
/begin GROUP CalRegn01Cmn.LoaMgrMotAgIdptSig0NoSnsrlsResp.Val "MICROSAR RTE" /begin SUB_GROUP /end SUB_GROUP /begin FUNCTION_LIST /end FUNCTION_LIST /begin REF_CHARACTERISTIC CalRegn01Cmn.LoaMgrMotAgIdptSig0NoSnsrlsResp.Val /end REF_CHARACTERISTIC /begin REF_MEASUREMENT /end REF_MEASUREMENT /end GROUP
/begin GROUP CalRegn01Cmn.LoaMgrMotAgIdptSig1NoSnsrlsResp.Val "MICROSAR RTE" /begin SUB_GROUP /end SUB_GROUP /begin FUNCTION_LIST /end FUNCTION_LIST /begin REF_CHARACTERISTIC CalRegn01Cmn.LoaMgrMotAgIdptSig1NoSnsrlsResp.Val /end REF_CHARACTERISTIC /begin REF_MEASUREMENT /end REF_MEASUREMENT /end GROUP
/begin GROUP CalRegn01Cmn.LoaMgrMotAgIdptSig2Resp.Val "MICROSAR RTE" /begin SUB_GROUP /end SUB_GROUP /begin FUNCTION_LIST /end FUNCTION_LIST /begin REF_CHARACTERISTIC CalRegn01Cmn.LoaMgrMotAgIdptSig2Resp.Val /end REF_CHARACTERISTIC /begin REF_MEASUREMENT /end REF_MEASUREMENT /end GROUP
/begin GROUP CalRegn01Cmn.LoaMgrMotAgIdptSig3Resp.Val "MICROSAR RTE" /begin SUB_GROUP /end SUB_GROUP /begin FUNCTION_LIST /end FUNCTION_LIST /begin REF_CHARACTERISTIC CalRegn01Cmn.LoaMgrMotAgIdptSig3Resp.Val /end REF_CHARACTERISTIC /begin REF_MEASUREMENT /end REF_MEASUREMENT /end GROUP
/begin GROUP CalRegn01Cmn.LoaMgrMotAgIdptSigFltThd.Val "MICROSAR RTE" /begin SUB_GROUP /end SUB_GROUP /begin FUNCTION_LIST /end FUNCTION_LIST /begin REF_CHARACTERISTIC CalRegn01Cmn.LoaMgrMotAgIdptSigFltThd.Val /end REF_CHARACTERISTIC /begin REF_MEASUREMENT /end REF_MEASUREMENT /end GROUP
/begin GROUP CalRegn01Cmn.LoaMgrMotAgMtgtnRate.Val "MICROSAR RTE" /begin SUB_GROUP /end SUB_GROUP /begin FUNCTION_LIST /end FUNCTION_LIST /begin REF_CHARACTERISTIC CalRegn01Cmn.LoaMgrMotAgMtgtnRate.Val /end REF_CHARACTERISTIC /begin REF_MEASUREMENT /end REF_MEASUREMENT /end GROUP
/begin GROUP CalRegn01Cmn.LoaMgrMotAgMtgtnSca.Val "MICROSAR RTE" /begin SUB_GROUP /end SUB_GROUP /begin FUNCTION_LIST /end FUNCTION_LIST /begin REF_CHARACTERISTIC CalRegn01Cmn.LoaMgrMotAgMtgtnSca.Val /end REF_CHARACTERISTIC /begin REF_MEASUREMENT /end REF_MEASUREMENT /end GROUP
/begin GROUP CalRegn01Cmn.LoaMgrMotAgMtgtnScaZeroEna.Logl "MICROSAR RTE" /begin SUB_GROUP /end SUB_GROUP /begin FUNCTION_LIST /end FUNCTION_LIST /begin REF_CHARACTERISTIC CalRegn01Cmn.LoaMgrMotAgMtgtnScaZeroEna.Logl /end REF_CHARACTERISTIC /begin REF_MEASUREMENT /end REF_MEASUREMENT /end GROUP
/begin GROUP CalRegn01Cmn.MotAg2MeasOffs.Val "MICROSAR RTE" /begin SUB_GROUP /end SUB_GROUP /begin FUNCTION_LIST /end FUNCTION_LIST /begin REF_CHARACTERISTIC CalRegn01Cmn.MotAg2MeasOffs.Val /end REF_CHARACTERISTIC /begin REF_MEASUREMENT /end REF_MEASUREMENT /end GROUP
/begin GROUP CalRegn01Cmn.MotCtrlPrmEstimnFetRNom.Val "MICROSAR RTE" /begin SUB_GROUP /end SUB_GROUP /begin FUNCTION_LIST /end FUNCTION_LIST /begin REF_CHARACTERISTIC CalRegn01Cmn.MotCtrlPrmEstimnFetRNom.Val /end REF_CHARACTERISTIC /begin REF_MEASUREMENT /end REF_MEASUREMENT /end GROUP
/begin GROUP CalRegn01Cmn.MotCtrlPrmEstimnFetThermCoeff.Val "MICROSAR RTE" /begin SUB_GROUP /end SUB_GROUP /begin FUNCTION_LIST /end FUNCTION_LIST /begin REF_CHARACTERISTIC CalRegn01Cmn.MotCtrlPrmEstimnFetThermCoeff.Val /end REF_CHARACTERISTIC /begin REF_MEASUREMENT /end REF_MEASUREMENT /end GROUP
/begin GROUP CalRegn01Cmn.MotCtrlPrmEstimnMagThermCoeff.Val "MICROSAR RTE" /begin SUB_GROUP /end SUB_GROUP /begin FUNCTION_LIST /end FUNCTION_LIST /begin REF_CHARACTERISTIC CalRegn01Cmn.MotCtrlPrmEstimnMagThermCoeff.Val /end REF_CHARACTERISTIC /begin REF_MEASUREMENT /end REF_MEASUREMENT /end GROUP
/begin GROUP CalRegn01Cmn.MotCtrlPrmEstimnMotBackEmfConHiLim.Val "MICROSAR RTE" /begin SUB_GROUP /end SUB_GROUP /begin FUNCTION_LIST /end FUNCTION_LIST /begin REF_CHARACTERISTIC CalRegn01Cmn.MotCtrlPrmEstimnMotBackEmfConHiLim.Val /end REF_CHARACTERISTIC /begin REF_MEASUREMENT /end REF_MEASUREMENT /end GROUP
/begin GROUP CalRegn01Cmn.MotCtrlPrmEstimnMotBackEmfConLoLim.Val "MICROSAR RTE" /begin SUB_GROUP /end SUB_GROUP /begin FUNCTION_LIST /end FUNCTION_LIST /begin REF_CHARACTERISTIC CalRegn01Cmn.MotCtrlPrmEstimnMotBackEmfConLoLim.Val /end REF_CHARACTERISTIC /begin REF_MEASUREMENT /end REF_MEASUREMENT /end GROUP
/begin GROUP CalRegn01Cmn.MotCtrlPrmEstimnMotBackEmfConNom.Val "MICROSAR RTE" /begin SUB_GROUP /end SUB_GROUP /begin FUNCTION_LIST /end FUNCTION_LIST /begin REF_CHARACTERISTIC CalRegn01Cmn.MotCtrlPrmEstimnMotBackEmfConNom.Val /end REF_CHARACTERISTIC /begin REF_MEASUREMENT /end REF_MEASUREMENT /end GROUP
/begin GROUP CalRegn01Cmn.MotCtrlPrmEstimnMotBackEmfConSatnScaIvtrLoaMtgtn.Val "MICROSAR RTE" /begin SUB_GROUP /end SUB_GROUP /begin FUNCTION_LIST /end FUNCTION_LIST
 /begin REF_CHARACTERISTIC CalRegn01Cmn.MotCtrlPrmEstimnMotBackEmfConSatnScaIvtrLoaMtgtn.Val /end REF_CHARACTERISTIC
 /begin REF_MEASUREMENT /end REF_MEASUREMENT
/end GROUP
/begin GROUP CalRegn01Cmn.MotCtrlPrmEstimnMotBackEmfConSatnX.Ary1D "MICROSAR RTE" /begin SUB_GROUP /end SUB_GROUP /begin FUNCTION_LIST /end FUNCTION_LIST /begin REF_CHARACTERISTIC CalRegn01Cmn.MotCtrlPrmEstimnMotBackEmfConSatnX.Ary1D /end REF_CHARACTERISTIC /begin REF_MEASUREMENT /end REF_MEASUREMENT /end GROUP
/begin GROUP CalRegn01Cmn.MotCtrlPrmEstimnMotBackEmfConSatnY.Ary1D "MICROSAR RTE" /begin SUB_GROUP /end SUB_GROUP /begin FUNCTION_LIST /end FUNCTION_LIST /begin REF_CHARACTERISTIC CalRegn01Cmn.MotCtrlPrmEstimnMotBackEmfConSatnY.Ary1D /end REF_CHARACTERISTIC /begin REF_MEASUREMENT /end REF_MEASUREMENT /end GROUP
/begin GROUP CalRegn01Cmn.MotCtrlPrmEstimnMotCurrDaxInduSatnBilnrSeln.Ary1D "MICROSAR RTE" /begin SUB_GROUP /end SUB_GROUP /begin FUNCTION_LIST /end FUNCTION_LIST
 /begin REF_CHARACTERISTIC CalRegn01Cmn.MotCtrlPrmEstimnMotCurrDaxInduSatnBilnrSeln.Ary1D /end REF_CHARACTERISTIC
 /begin REF_MEASUREMENT /end REF_MEASUREMENT
/end GROUP
/begin GROUP CalRegn01Cmn.MotCtrlPrmEstimnMotCurrQaxInduSatnX.Ary1D "MICROSAR RTE" /begin SUB_GROUP /end SUB_GROUP /begin FUNCTION_LIST /end FUNCTION_LIST /begin REF_CHARACTERISTIC CalRegn01Cmn.MotCtrlPrmEstimnMotCurrQaxInduSatnX.Ary1D /end REF_CHARACTERISTIC /begin REF_MEASUREMENT /end REF_MEASUREMENT /end GROUP
/begin GROUP CalRegn01Cmn.MotCtrlPrmEstimnMotInduDaxHiLim.Val "MICROSAR RTE" /begin SUB_GROUP /end SUB_GROUP /begin FUNCTION_LIST /end FUNCTION_LIST /begin REF_CHARACTERISTIC CalRegn01Cmn.MotCtrlPrmEstimnMotInduDaxHiLim.Val /end REF_CHARACTERISTIC /begin REF_MEASUREMENT /end REF_MEASUREMENT /end GROUP
/begin GROUP CalRegn01Cmn.MotCtrlPrmEstimnMotInduDaxIvtrLoaMtgtn.Val "MICROSAR RTE" /begin SUB_GROUP /end SUB_GROUP /begin FUNCTION_LIST /end FUNCTION_LIST /begin REF_CHARACTERISTIC CalRegn01Cmn.MotCtrlPrmEstimnMotInduDaxIvtrLoaMtgtn.Val /end REF_CHARACTERISTIC /begin REF_MEASUREMENT /end REF_MEASUREMENT /end GROUP
/begin GROUP CalRegn01Cmn.MotCtrlPrmEstimnMotInduDaxLoLim.Val "MICROSAR RTE" /begin SUB_GROUP /end SUB_GROUP /begin FUNCTION_LIST /end FUNCTION_LIST /begin REF_CHARACTERISTIC CalRegn01Cmn.MotCtrlPrmEstimnMotInduDaxLoLim.Val /end REF_CHARACTERISTIC /begin REF_MEASUREMENT /end REF_MEASUREMENT /end GROUP
/begin GROUP CalRegn01Cmn.MotCtrlPrmEstimnMotInduDaxNom.Val "MICROSAR RTE" /begin SUB_GROUP /end SUB_GROUP /begin FUNCTION_LIST /end FUNCTION_LIST /begin REF_CHARACTERISTIC CalRegn01Cmn.MotCtrlPrmEstimnMotInduDaxNom.Val /end REF_CHARACTERISTIC /begin REF_MEASUREMENT /end REF_MEASUREMENT /end GROUP
/begin GROUP CalRegn01Cmn.MotCtrlPrmEstimnMotInduDaxSatnScaY.Ary2D "MICROSAR RTE" /begin SUB_GROUP /end SUB_GROUP /begin FUNCTION_LIST /end FUNCTION_LIST /begin REF_CHARACTERISTIC CalRegn01Cmn.MotCtrlPrmEstimnMotInduDaxSatnScaY.Ary2D /end REF_CHARACTERISTIC /begin REF_MEASUREMENT /end REF_MEASUREMENT /end GROUP
/begin GROUP CalRegn01Cmn.MotCtrlPrmEstimnMotInduQaxHiLim.Val "MICROSAR RTE" /begin SUB_GROUP /end SUB_GROUP /begin FUNCTION_LIST /end FUNCTION_LIST /begin REF_CHARACTERISTIC CalRegn01Cmn.MotCtrlPrmEstimnMotInduQaxHiLim.Val /end REF_CHARACTERISTIC /begin REF_MEASUREMENT /end REF_MEASUREMENT /end GROUP
/begin GROUP CalRegn01Cmn.MotCtrlPrmEstimnMotInduQaxIvtrLoaMtgtn.Val "MICROSAR RTE" /begin SUB_GROUP /end SUB_GROUP /begin FUNCTION_LIST /end FUNCTION_LIST /begin REF_CHARACTERISTIC CalRegn01Cmn.MotCtrlPrmEstimnMotInduQaxIvtrLoaMtgtn.Val /end REF_CHARACTERISTIC /begin REF_MEASUREMENT /end REF_MEASUREMENT /end GROUP
/begin GROUP CalRegn01Cmn.MotCtrlPrmEstimnMotInduQaxLoLim.Val "MICROSAR RTE" /begin SUB_GROUP /end SUB_GROUP /begin FUNCTION_LIST /end FUNCTION_LIST /begin REF_CHARACTERISTIC CalRegn01Cmn.MotCtrlPrmEstimnMotInduQaxLoLim.Val /end REF_CHARACTERISTIC /begin REF_MEASUREMENT /end REF_MEASUREMENT /end GROUP
/begin GROUP CalRegn01Cmn.MotCtrlPrmEstimnMotInduQaxNom.Val "MICROSAR RTE" /begin SUB_GROUP /end SUB_GROUP /begin FUNCTION_LIST /end FUNCTION_LIST /begin REF_CHARACTERISTIC CalRegn01Cmn.MotCtrlPrmEstimnMotInduQaxNom.Val /end REF_CHARACTERISTIC /begin REF_MEASUREMENT /end REF_MEASUREMENT /end GROUP
/begin GROUP CalRegn01Cmn.MotCtrlPrmEstimnMotInduQaxSatnScaY.Ary2D "MICROSAR RTE" /begin SUB_GROUP /end SUB_GROUP /begin FUNCTION_LIST /end FUNCTION_LIST /begin REF_CHARACTERISTIC CalRegn01Cmn.MotCtrlPrmEstimnMotInduQaxSatnScaY.Ary2D /end REF_CHARACTERISTIC /begin REF_MEASUREMENT /end REF_MEASUREMENT /end GROUP
/begin GROUP CalRegn01Cmn.MotCtrlPrmEstimnMotRHiLim.Val "MICROSAR RTE" /begin SUB_GROUP /end SUB_GROUP /begin FUNCTION_LIST /end FUNCTION_LIST /begin REF_CHARACTERISTIC CalRegn01Cmn.MotCtrlPrmEstimnMotRHiLim.Val /end REF_CHARACTERISTIC /begin REF_MEASUREMENT /end REF_MEASUREMENT /end GROUP
/begin GROUP CalRegn01Cmn.MotCtrlPrmEstimnMotRLoLim.Val "MICROSAR RTE" /begin SUB_GROUP /end SUB_GROUP /begin FUNCTION_LIST /end FUNCTION_LIST /begin REF_CHARACTERISTIC CalRegn01Cmn.MotCtrlPrmEstimnMotRLoLim.Val /end REF_CHARACTERISTIC /begin REF_MEASUREMENT /end REF_MEASUREMENT /end GROUP
/begin GROUP CalRegn01Cmn.MotCtrlPrmEstimnMotRNom.Val "MICROSAR RTE" /begin SUB_GROUP /end SUB_GROUP /begin FUNCTION_LIST /end FUNCTION_LIST /begin REF_CHARACTERISTIC CalRegn01Cmn.MotCtrlPrmEstimnMotRNom.Val /end REF_CHARACTERISTIC /begin REF_MEASUREMENT /end REF_MEASUREMENT /end GROUP
/begin GROUP CalRegn01Cmn.MotCtrlPrmEstimnMotWidgThermCoeff.Val "MICROSAR RTE" /begin SUB_GROUP /end SUB_GROUP /begin FUNCTION_LIST /end FUNCTION_LIST /begin REF_CHARACTERISTIC CalRegn01Cmn.MotCtrlPrmEstimnMotWidgThermCoeff.Val /end REF_CHARACTERISTIC /begin REF_MEASUREMENT /end REF_MEASUREMENT /end GROUP
/begin GROUP CalRegn01Cmn.MotCtrlPrmEstimnTNom.Val "MICROSAR RTE" /begin SUB_GROUP /end SUB_GROUP /begin FUNCTION_LIST /end FUNCTION_LIST /begin REF_CHARACTERISTIC CalRegn01Cmn.MotCtrlPrmEstimnTNom.Val /end REF_CHARACTERISTIC /begin REF_MEASUREMENT /end REF_MEASUREMENT /end GROUP
/begin GROUP CalRegn01Cmn.MotCurrPeakEstimnCurrFilFrq.Val "MICROSAR RTE" /begin SUB_GROUP /end SUB_GROUP /begin FUNCTION_LIST /end FUNCTION_LIST /begin REF_CHARACTERISTIC CalRegn01Cmn.MotCurrPeakEstimnCurrFilFrq.Val /end REF_CHARACTERISTIC /begin REF_MEASUREMENT /end REF_MEASUREMENT /end GROUP
/begin GROUP CalRegn01Cmn.MotCurrPeakEstimnCurrPeakEstimdFilFrq.Val "MICROSAR RTE" /begin SUB_GROUP /end SUB_GROUP /begin FUNCTION_LIST /end FUNCTION_LIST /begin REF_CHARACTERISTIC CalRegn01Cmn.MotCurrPeakEstimnCurrPeakEstimdFilFrq.Val /end REF_CHARACTERISTIC /begin REF_MEASUREMENT /end REF_MEASUREMENT /end GROUP
/begin GROUP CalRegn01Cmn.MotCurrRegCfgCtrlrDynGainVehSpdCutOff.Val "MICROSAR RTE" /begin SUB_GROUP /end SUB_GROUP /begin FUNCTION_LIST /end FUNCTION_LIST /begin REF_CHARACTERISTIC CalRegn01Cmn.MotCurrRegCfgCtrlrDynGainVehSpdCutOff.Val /end REF_CHARACTERISTIC /begin REF_MEASUREMENT /end REF_MEASUREMENT /end GROUP
/begin GROUP CalRegn01Cmn.MotCurrRegCfgCurrLoopSecOrderTrfFctEna.Logl "MICROSAR RTE" /begin SUB_GROUP /end SUB_GROUP /begin FUNCTION_LIST /end FUNCTION_LIST /begin REF_CHARACTERISTIC CalRegn01Cmn.MotCurrRegCfgCurrLoopSecOrderTrfFctEna.Logl /end REF_CHARACTERISTIC /begin REF_MEASUREMENT /end REF_MEASUREMENT /end GROUP
/begin GROUP CalRegn01Cmn.MotCurrRegCfgIntglGainSampleTi.Val "MICROSAR RTE" /begin SUB_GROUP /end SUB_GROUP /begin FUNCTION_LIST /end FUNCTION_LIST /begin REF_CHARACTERISTIC CalRegn01Cmn.MotCurrRegCfgIntglGainSampleTi.Val /end REF_CHARACTERISTIC /begin REF_MEASUREMENT /end REF_MEASUREMENT /end GROUP
/begin GROUP CalRegn01Cmn.MotCurrRegCfgMotAgCompuDly.Val "MICROSAR RTE" /begin SUB_GROUP /end SUB_GROUP /begin FUNCTION_LIST /end FUNCTION_LIST /begin REF_CHARACTERISTIC CalRegn01Cmn.MotCurrRegCfgMotAgCompuDly.Val /end REF_CHARACTERISTIC /begin REF_MEASUREMENT /end REF_MEASUREMENT /end GROUP
/begin GROUP CalRegn01Cmn.MotCurrRegCfgMotClsdLoopBwDaxY.Ary1D "MICROSAR RTE" /begin SUB_GROUP /end SUB_GROUP /begin FUNCTION_LIST /end FUNCTION_LIST /begin REF_CHARACTERISTIC CalRegn01Cmn.MotCurrRegCfgMotClsdLoopBwDaxY.Ary1D /end REF_CHARACTERISTIC /begin REF_MEASUREMENT /end REF_MEASUREMENT /end GROUP
/begin GROUP CalRegn01Cmn.MotCurrRegCfgMotClsdLoopBwQaxY.Ary1D "MICROSAR RTE" /begin SUB_GROUP /end SUB_GROUP /begin FUNCTION_LIST /end FUNCTION_LIST /begin REF_CHARACTERISTIC CalRegn01Cmn.MotCurrRegCfgMotClsdLoopBwQaxY.Ary1D /end REF_CHARACTERISTIC /begin REF_MEASUREMENT /end REF_MEASUREMENT /end GROUP
/begin GROUP CalRegn01Cmn.MotCurrRegCfgMotCtrlPrmSelnX.Ary1D "MICROSAR RTE" /begin SUB_GROUP /end SUB_GROUP /begin FUNCTION_LIST /end FUNCTION_LIST /begin REF_CHARACTERISTIC CalRegn01Cmn.MotCurrRegCfgMotCtrlPrmSelnX.Ary1D /end REF_CHARACTERISTIC /begin REF_MEASUREMENT /end REF_MEASUREMENT /end GROUP
/begin GROUP CalRegn01Cmn.MotCurrRegCfgMotDampgRatDax.Val "MICROSAR RTE" /begin SUB_GROUP /end SUB_GROUP /begin FUNCTION_LIST /end FUNCTION_LIST /begin REF_CHARACTERISTIC CalRegn01Cmn.MotCurrRegCfgMotDampgRatDax.Val /end REF_CHARACTERISTIC /begin REF_MEASUREMENT /end REF_MEASUREMENT /end GROUP
/begin GROUP CalRegn01Cmn.MotCurrRegCfgMotDampgRatQax.Val "MICROSAR RTE" /begin SUB_GROUP /end SUB_GROUP /begin FUNCTION_LIST /end FUNCTION_LIST /begin REF_CHARACTERISTIC CalRegn01Cmn.MotCurrRegCfgMotDampgRatQax.Val /end REF_CHARACTERISTIC /begin REF_MEASUREMENT /end REF_MEASUREMENT /end GROUP
/begin GROUP CalRegn01Cmn.MotCurrRegCfgMotNatFrqDaxY.Ary1D "MICROSAR RTE" /begin SUB_GROUP /end SUB_GROUP /begin FUNCTION_LIST /end FUNCTION_LIST /begin REF_CHARACTERISTIC CalRegn01Cmn.MotCurrRegCfgMotNatFrqDaxY.Ary1D /end REF_CHARACTERISTIC /begin REF_MEASUREMENT /end REF_MEASUREMENT /end GROUP
/begin GROUP CalRegn01Cmn.MotCurrRegCfgMotNatFrqQaxY.Ary1D "MICROSAR RTE" /begin SUB_GROUP /end SUB_GROUP /begin FUNCTION_LIST /end FUNCTION_LIST /begin REF_CHARACTERISTIC CalRegn01Cmn.MotCurrRegCfgMotNatFrqQaxY.Ary1D /end REF_CHARACTERISTIC /begin REF_MEASUREMENT /end REF_MEASUREMENT /end GROUP
/begin GROUP CalRegn01Cmn.MotCurrRegCfgMotRVirtDax.Val "MICROSAR RTE" /begin SUB_GROUP /end SUB_GROUP /begin FUNCTION_LIST /end FUNCTION_LIST /begin REF_CHARACTERISTIC CalRegn01Cmn.MotCurrRegCfgMotRVirtDax.Val /end REF_CHARACTERISTIC /begin REF_MEASUREMENT /end REF_MEASUREMENT /end GROUP
/begin GROUP CalRegn01Cmn.MotCurrRegCfgMotRVirtQax.Val "MICROSAR RTE" /begin SUB_GROUP /end SUB_GROUP /begin FUNCTION_LIST /end FUNCTION_LIST /begin REF_CHARACTERISTIC CalRegn01Cmn.MotCurrRegCfgMotRVirtQax.Val /end REF_CHARACTERISTIC /begin REF_MEASUREMENT /end REF_MEASUREMENT /end GROUP
/begin GROUP CalRegn01Cmn.MotCurrRegCfgMotVelFilFrq.Val "MICROSAR RTE" /begin SUB_GROUP /end SUB_GROUP /begin FUNCTION_LIST /end FUNCTION_LIST /begin REF_CHARACTERISTIC CalRegn01Cmn.MotCurrRegCfgMotVelFilFrq.Val /end REF_CHARACTERISTIC /begin REF_MEASUREMENT /end REF_MEASUREMENT /end GROUP
/begin GROUP CalRegn01Cmn.MotCurrRegVltgLimrCurrLoaScarSlewRate.Val "MICROSAR RTE" /begin SUB_GROUP /end SUB_GROUP /begin FUNCTION_LIST /end FUNCTION_LIST /begin REF_CHARACTERISTIC CalRegn01Cmn.MotCurrRegVltgLimrCurrLoaScarSlewRate.Val /end REF_CHARACTERISTIC /begin REF_MEASUREMENT /end REF_MEASUREMENT /end GROUP
/begin GROUP CalRegn01Cmn.MotCurrRegVltgLimrDaxAntiWdupCoeff.Val "MICROSAR RTE" /begin SUB_GROUP /end SUB_GROUP /begin FUNCTION_LIST /end FUNCTION_LIST /begin REF_CHARACTERISTIC CalRegn01Cmn.MotCurrRegVltgLimrDaxAntiWdupCoeff.Val /end REF_CHARACTERISTIC /begin REF_MEASUREMENT /end REF_MEASUREMENT /end GROUP
/begin GROUP CalRegn01Cmn.MotCurrRegVltgLimrDualEcuLoaScarSlewRate.Val "MICROSAR RTE" /begin SUB_GROUP /end SUB_GROUP /begin FUNCTION_LIST /end FUNCTION_LIST /begin REF_CHARACTERISTIC CalRegn01Cmn.MotCurrRegVltgLimrDualEcuLoaScarSlewRate.Val /end REF_CHARACTERISTIC /begin REF_MEASUREMENT /end REF_MEASUREMENT /end GROUP
/begin GROUP CalRegn01Cmn.MotCurrRegVltgLimrIvtrLoaScarSlewRate.Val "MICROSAR RTE" /begin SUB_GROUP /end SUB_GROUP /begin FUNCTION_LIST /end FUNCTION_LIST /begin REF_CHARACTERISTIC CalRegn01Cmn.MotCurrRegVltgLimrIvtrLoaScarSlewRate.Val /end REF_CHARACTERISTIC /begin REF_MEASUREMENT /end REF_MEASUREMENT /end GROUP
/begin GROUP CalRegn01Cmn.MotCurrRegVltgLimrMotCurrPredEna.Logl "MICROSAR RTE" /begin SUB_GROUP /end SUB_GROUP /begin FUNCTION_LIST /end FUNCTION_LIST /begin REF_CHARACTERISTIC CalRegn01Cmn.MotCurrRegVltgLimrMotCurrPredEna.Logl /end REF_CHARACTERISTIC /begin REF_MEASUREMENT /end REF_MEASUREMENT /end GROUP
/begin GROUP CalRegn01Cmn.MotCurrRegVltgLimrMotCurrPredTi.Val "MICROSAR RTE" /begin SUB_GROUP /end SUB_GROUP /begin FUNCTION_LIST /end FUNCTION_LIST /begin REF_CHARACTERISTIC CalRegn01Cmn.MotCurrRegVltgLimrMotCurrPredTi.Val /end REF_CHARACTERISTIC /begin REF_MEASUREMENT /end REF_MEASUREMENT /end GROUP
/begin GROUP CalRegn01Cmn.MotCurrRegVltgLimrMotCurrQaxRefMdfnRplEna.Logl "MICROSAR RTE" /begin SUB_GROUP /end SUB_GROUP /begin FUNCTION_LIST /end FUNCTION_LIST
 /begin REF_CHARACTERISTIC CalRegn01Cmn.MotCurrRegVltgLimrMotCurrQaxRefMdfnRplEna.Logl /end REF_CHARACTERISTIC
 /begin REF_MEASUREMENT /end REF_MEASUREMENT
/end GROUP
/begin GROUP CalRegn01Cmn.MotCurrRegVltgLimrMotVltgBrdgFilEna.Logl "MICROSAR RTE" /begin SUB_GROUP /end SUB_GROUP /begin FUNCTION_LIST /end FUNCTION_LIST /begin REF_CHARACTERISTIC CalRegn01Cmn.MotCurrRegVltgLimrMotVltgBrdgFilEna.Logl /end REF_CHARACTERISTIC /begin REF_MEASUREMENT /end REF_MEASUREMENT /end GROUP
/begin GROUP CalRegn01Cmn.MotCurrRegVltgLimrMotVltgBrdgLpFilFrq.Val "MICROSAR RTE" /begin SUB_GROUP /end SUB_GROUP /begin FUNCTION_LIST /end FUNCTION_LIST /begin REF_CHARACTERISTIC CalRegn01Cmn.MotCurrRegVltgLimrMotVltgBrdgLpFilFrq.Val /end REF_CHARACTERISTIC /begin REF_MEASUREMENT /end REF_MEASUREMENT /end GROUP
/begin GROUP CalRegn01Cmn.MotCurrRegVltgLimrMotVltgDaxIntglHiLim.Val "MICROSAR RTE" /begin SUB_GROUP /end SUB_GROUP /begin FUNCTION_LIST /end FUNCTION_LIST /begin REF_CHARACTERISTIC CalRegn01Cmn.MotCurrRegVltgLimrMotVltgDaxIntglHiLim.Val /end REF_CHARACTERISTIC /begin REF_MEASUREMENT /end REF_MEASUREMENT /end GROUP
/begin GROUP CalRegn01Cmn.MotCurrRegVltgLimrMotVltgDaxIntglLoLim.Val "MICROSAR RTE" /begin SUB_GROUP /end SUB_GROUP /begin FUNCTION_LIST /end FUNCTION_LIST /begin REF_CHARACTERISTIC CalRegn01Cmn.MotCurrRegVltgLimrMotVltgDaxIntglLoLim.Val /end REF_CHARACTERISTIC /begin REF_MEASUREMENT /end REF_MEASUREMENT /end GROUP
/begin GROUP CalRegn01Cmn.MotCurrRegVltgLimrMotVltgQaxFfFilEna.Logl "MICROSAR RTE" /begin SUB_GROUP /end SUB_GROUP /begin FUNCTION_LIST /end FUNCTION_LIST /begin REF_CHARACTERISTIC CalRegn01Cmn.MotCurrRegVltgLimrMotVltgQaxFfFilEna.Logl /end REF_CHARACTERISTIC /begin REF_MEASUREMENT /end REF_MEASUREMENT /end GROUP
/begin GROUP CalRegn01Cmn.MotCurrRegVltgLimrMotVltgQaxFfLpFilFrq.Val "MICROSAR RTE" /begin SUB_GROUP /end SUB_GROUP /begin FUNCTION_LIST /end FUNCTION_LIST /begin REF_CHARACTERISTIC CalRegn01Cmn.MotCurrRegVltgLimrMotVltgQaxFfLpFilFrq.Val /end REF_CHARACTERISTIC /begin REF_MEASUREMENT /end REF_MEASUREMENT /end GROUP
/begin GROUP CalRegn01Cmn.MotCurrRegVltgLimrMotVltgQaxIntglHiLim.Val "MICROSAR RTE" /begin SUB_GROUP /end SUB_GROUP /begin FUNCTION_LIST /end FUNCTION_LIST /begin REF_CHARACTERISTIC CalRegn01Cmn.MotCurrRegVltgLimrMotVltgQaxIntglHiLim.Val /end REF_CHARACTERISTIC /begin REF_MEASUREMENT /end REF_MEASUREMENT /end GROUP
/begin GROUP CalRegn01Cmn.MotCurrRegVltgLimrMotVltgQaxIntglLoLim.Val "MICROSAR RTE" /begin SUB_GROUP /end SUB_GROUP /begin FUNCTION_LIST /end FUNCTION_LIST /begin REF_CHARACTERISTIC CalRegn01Cmn.MotCurrRegVltgLimrMotVltgQaxIntglLoLim.Val /end REF_CHARACTERISTIC /begin REF_MEASUREMENT /end REF_MEASUREMENT /end GROUP
/begin GROUP CalRegn01Cmn.MotCurrRegVltgLimrQaxAntiWdupCoeff.Val "MICROSAR RTE" /begin SUB_GROUP /end SUB_GROUP /begin FUNCTION_LIST /end FUNCTION_LIST /begin REF_CHARACTERISTIC CalRegn01Cmn.MotCurrRegVltgLimrQaxAntiWdupCoeff.Val /end REF_CHARACTERISTIC /begin REF_MEASUREMENT /end REF_MEASUREMENT /end GROUP
/begin GROUP CalRegn01Cmn.MotCurrRegVltgLimrQaxAntiWdupScagDi.Logl "MICROSAR RTE" /begin SUB_GROUP /end SUB_GROUP /begin FUNCTION_LIST /end FUNCTION_LIST /begin REF_CHARACTERISTIC CalRegn01Cmn.MotCurrRegVltgLimrQaxAntiWdupScagDi.Logl /end REF_CHARACTERISTIC /begin REF_MEASUREMENT /end REF_MEASUREMENT /end GROUP
/begin GROUP CalRegn01Cmn.MotDrvDiagcErrFilFrq.Val "MICROSAR RTE" /begin SUB_GROUP /end SUB_GROUP /begin FUNCTION_LIST /end FUNCTION_LIST /begin REF_CHARACTERISTIC CalRegn01Cmn.MotDrvDiagcErrFilFrq.Val /end REF_CHARACTERISTIC /begin REF_MEASUREMENT /end REF_MEASUREMENT /end GROUP
/begin GROUP CalRegn01Cmn.MotDrvDiagcErrOffs.Val "MICROSAR RTE" /begin SUB_GROUP /end SUB_GROUP /begin FUNCTION_LIST /end FUNCTION_LIST /begin REF_CHARACTERISTIC CalRegn01Cmn.MotDrvDiagcErrOffs.Val /end REF_CHARACTERISTIC /begin REF_MEASUREMENT /end REF_MEASUREMENT /end GROUP
/begin GROUP CalRegn01Cmn.MotDrvDiagcErrThd.Val "MICROSAR RTE" /begin SUB_GROUP /end SUB_GROUP /begin FUNCTION_LIST /end FUNCTION_LIST /begin REF_CHARACTERISTIC CalRegn01Cmn.MotDrvDiagcErrThd.Val /end REF_CHARACTERISTIC /begin REF_MEASUREMENT /end REF_MEASUREMENT /end GROUP
/begin GROUP CalRegn01Cmn.MotQuadDetnMotDirHysInsts.Val "MICROSAR RTE" /begin SUB_GROUP /end SUB_GROUP /begin FUNCTION_LIST /end FUNCTION_LIST /begin REF_CHARACTERISTIC CalRegn01Cmn.MotQuadDetnMotDirHysInsts.Val /end REF_CHARACTERISTIC /begin REF_MEASUREMENT /end REF_MEASUREMENT /end GROUP
/begin GROUP CalRegn01Cmn.MotRefMdlCurrDaxBoostGain.Val "MICROSAR RTE" /begin SUB_GROUP /end SUB_GROUP /begin FUNCTION_LIST /end FUNCTION_LIST /begin REF_CHARACTERISTIC CalRegn01Cmn.MotRefMdlCurrDaxBoostGain.Val /end REF_CHARACTERISTIC /begin REF_MEASUREMENT /end REF_MEASUREMENT /end GROUP
/begin GROUP CalRegn01Cmn.MotRefMdlCurrDaxBoostTqScaX.Ary1D "MICROSAR RTE" /begin SUB_GROUP /end SUB_GROUP /begin FUNCTION_LIST /end FUNCTION_LIST /begin REF_CHARACTERISTIC CalRegn01Cmn.MotRefMdlCurrDaxBoostTqScaX.Ary1D /end REF_CHARACTERISTIC /begin REF_MEASUREMENT /end REF_MEASUREMENT /end GROUP
/begin GROUP CalRegn01Cmn.MotRefMdlCurrDaxBoostTqScaY.Ary1D "MICROSAR RTE" /begin SUB_GROUP /end SUB_GROUP /begin FUNCTION_LIST /end FUNCTION_LIST /begin REF_CHARACTERISTIC CalRegn01Cmn.MotRefMdlCurrDaxBoostTqScaY.Ary1D /end REF_CHARACTERISTIC /begin REF_MEASUREMENT /end REF_MEASUREMENT /end GROUP
/begin GROUP CalRegn01Cmn.MotRefMdlCurrDaxQaxRefDelta.Ary1D "MICROSAR RTE" /begin SUB_GROUP /end SUB_GROUP /begin FUNCTION_LIST /end FUNCTION_LIST /begin REF_CHARACTERISTIC CalRegn01Cmn.MotRefMdlCurrDaxQaxRefDelta.Ary1D /end REF_CHARACTERISTIC /begin REF_MEASUREMENT /end REF_MEASUREMENT /end GROUP
/begin GROUP CalRegn01Cmn.MotRefMdlCurrItrnTolr.Val "MICROSAR RTE" /begin SUB_GROUP /end SUB_GROUP /begin FUNCTION_LIST /end FUNCTION_LIST /begin REF_CHARACTERISTIC CalRegn01Cmn.MotRefMdlCurrItrnTolr.Val /end REF_CHARACTERISTIC /begin REF_MEASUREMENT /end REF_MEASUREMENT /end GROUP
/begin GROUP CalRegn01Cmn.MotRefMdlFbCtrlDi.Logl "MICROSAR RTE" /begin SUB_GROUP /end SUB_GROUP /begin FUNCTION_LIST /end FUNCTION_LIST /begin REF_CHARACTERISTIC CalRegn01Cmn.MotRefMdlFbCtrlDi.Logl /end REF_CHARACTERISTIC /begin REF_MEASUREMENT /end REF_MEASUREMENT /end GROUP
/begin GROUP CalRegn01Cmn.MotRefMdlIvtrDeadTiBrdgVltgSca.Val "MICROSAR RTE" /begin SUB_GROUP /end SUB_GROUP /begin FUNCTION_LIST /end FUNCTION_LIST /begin REF_CHARACTERISTIC CalRegn01Cmn.MotRefMdlIvtrDeadTiBrdgVltgSca.Val /end REF_CHARACTERISTIC /begin REF_MEASUREMENT /end REF_MEASUREMENT /end GROUP
/begin GROUP CalRegn01Cmn.MotRefMdlMinCurrItrnLim.Val "MICROSAR RTE" /begin SUB_GROUP /end SUB_GROUP /begin FUNCTION_LIST /end FUNCTION_LIST /begin REF_CHARACTERISTIC CalRegn01Cmn.MotRefMdlMinCurrItrnLim.Val /end REF_CHARACTERISTIC /begin REF_MEASUREMENT /end REF_MEASUREMENT /end GROUP
/begin GROUP CalRegn01Cmn.MotRefMdlMotCurrDaxMaxSca.Val "MICROSAR RTE" /begin SUB_GROUP /end SUB_GROUP /begin FUNCTION_LIST /end FUNCTION_LIST /begin REF_CHARACTERISTIC CalRegn01Cmn.MotRefMdlMotCurrDaxMaxSca.Val /end REF_CHARACTERISTIC /begin REF_MEASUREMENT /end REF_MEASUREMENT /end GROUP
/begin GROUP CalRegn01Cmn.MotRefMdlMotVelLpFilFrq.Val "MICROSAR RTE" /begin SUB_GROUP /end SUB_GROUP /begin FUNCTION_LIST /end FUNCTION_LIST /begin REF_CHARACTERISTIC CalRegn01Cmn.MotRefMdlMotVelLpFilFrq.Val /end REF_CHARACTERISTIC /begin REF_MEASUREMENT /end REF_MEASUREMENT /end GROUP
/begin GROUP CalRegn01Cmn.MotRefMdlMotVltgDerivtvTiCon.Val "MICROSAR RTE" /begin SUB_GROUP /end SUB_GROUP /begin FUNCTION_LIST /end FUNCTION_LIST /begin REF_CHARACTERISTIC CalRegn01Cmn.MotRefMdlMotVltgDerivtvTiCon.Val /end REF_CHARACTERISTIC /begin REF_MEASUREMENT /end REF_MEASUREMENT /end GROUP
/begin GROUP CalRegn01Cmn.MotRefMdlQuad13VltgSdlX.Ary1D "MICROSAR RTE" /begin SUB_GROUP /end SUB_GROUP /begin FUNCTION_LIST /end FUNCTION_LIST /begin REF_CHARACTERISTIC CalRegn01Cmn.MotRefMdlQuad13VltgSdlX.Ary1D /end REF_CHARACTERISTIC /begin REF_MEASUREMENT /end REF_MEASUREMENT /end GROUP
/begin GROUP CalRegn01Cmn.MotRefMdlQuad13VltgSdlY.Ary1D "MICROSAR RTE" /begin SUB_GROUP /end SUB_GROUP /begin FUNCTION_LIST /end FUNCTION_LIST /begin REF_CHARACTERISTIC CalRegn01Cmn.MotRefMdlQuad13VltgSdlY.Ary1D /end REF_CHARACTERISTIC /begin REF_MEASUREMENT /end REF_MEASUREMENT /end GROUP
/begin GROUP CalRegn01Cmn.MotRefMdlQuad24VltgSdlX.Ary1D "MICROSAR RTE" /begin SUB_GROUP /end SUB_GROUP /begin FUNCTION_LIST /end FUNCTION_LIST /begin REF_CHARACTERISTIC CalRegn01Cmn.MotRefMdlQuad24VltgSdlX.Ary1D /end REF_CHARACTERISTIC /begin REF_MEASUREMENT /end REF_MEASUREMENT /end GROUP
/begin GROUP CalRegn01Cmn.MotRefMdlQuad24VltgSdlY.Ary1D "MICROSAR RTE" /begin SUB_GROUP /end SUB_GROUP /begin FUNCTION_LIST /end FUNCTION_LIST /begin REF_CHARACTERISTIC CalRegn01Cmn.MotRefMdlQuad24VltgSdlY.Ary1D /end REF_CHARACTERISTIC /begin REF_MEASUREMENT /end REF_MEASUREMENT /end GROUP
/begin GROUP CalRegn01Cmn.MotRefMdlRefLocnItrnLim.Val "MICROSAR RTE" /begin SUB_GROUP /end SUB_GROUP /begin FUNCTION_LIST /end FUNCTION_LIST /begin REF_CHARACTERISTIC CalRegn01Cmn.MotRefMdlRefLocnItrnLim.Val /end REF_CHARACTERISTIC /begin REF_MEASUREMENT /end REF_MEASUREMENT /end GROUP
/begin GROUP CalRegn01Cmn.MotRefMdlTqItrnLim.Val "MICROSAR RTE" /begin SUB_GROUP /end SUB_GROUP /begin FUNCTION_LIST /end FUNCTION_LIST /begin REF_CHARACTERISTIC CalRegn01Cmn.MotRefMdlTqItrnLim.Val /end REF_CHARACTERISTIC /begin REF_MEASUREMENT /end REF_MEASUREMENT /end GROUP
/begin GROUP CalRegn01Cmn.MotRefMdlTqItrnTolr.Val "MICROSAR RTE" /begin SUB_GROUP /end SUB_GROUP /begin FUNCTION_LIST /end FUNCTION_LIST /begin REF_CHARACTERISTIC CalRegn01Cmn.MotRefMdlTqItrnTolr.Val /end REF_CHARACTERISTIC /begin REF_MEASUREMENT /end REF_MEASUREMENT /end GROUP
/begin GROUP CalRegn01Cmn.MotRefMdlVltgModDynCmpEna.Logl "MICROSAR RTE" /begin SUB_GROUP /end SUB_GROUP /begin FUNCTION_LIST /end FUNCTION_LIST /begin REF_CHARACTERISTIC CalRegn01Cmn.MotRefMdlVltgModDynCmpEna.Logl /end REF_CHARACTERISTIC /begin REF_MEASUREMENT /end REF_MEASUREMENT /end GROUP
/begin GROUP CalRegn01Cmn.MotRefMdlVltgOverRThdSca.Val "MICROSAR RTE" /begin SUB_GROUP /end SUB_GROUP /begin FUNCTION_LIST /end FUNCTION_LIST /begin REF_CHARACTERISTIC CalRegn01Cmn.MotRefMdlVltgOverRThdSca.Val /end REF_CHARACTERISTIC /begin REF_MEASUREMENT /end REF_MEASUREMENT /end GROUP
/begin GROUP CalRegn01Cmn.MotRplCoggCfgMotAgTiDly.Val "MICROSAR RTE" /begin SUB_GROUP /end SUB_GROUP /begin FUNCTION_LIST /end FUNCTION_LIST /begin REF_CHARACTERISTIC CalRegn01Cmn.MotRplCoggCfgMotAgTiDly.Val /end REF_CHARACTERISTIC /begin REF_MEASUREMENT /end REF_MEASUREMENT /end GROUP
/begin GROUP CalRegn01Cmn.MotRplCoggCfgMotCurrDaxRplBilnrSeln.Ary1D "MICROSAR RTE" /begin SUB_GROUP /end SUB_GROUP /begin FUNCTION_LIST /end FUNCTION_LIST /begin REF_CHARACTERISTIC CalRegn01Cmn.MotRplCoggCfgMotCurrDaxRplBilnrSeln.Ary1D /end REF_CHARACTERISTIC /begin REF_MEASUREMENT /end REF_MEASUREMENT /end GROUP
/begin GROUP CalRegn01Cmn.MotRplCoggCfgMotCurrQaxRpl.Ary1D "MICROSAR RTE" /begin SUB_GROUP /end SUB_GROUP /begin FUNCTION_LIST /end FUNCTION_LIST /begin REF_CHARACTERISTIC CalRegn01Cmn.MotRplCoggCfgMotCurrQaxRpl.Ary1D /end REF_CHARACTERISTIC /begin REF_MEASUREMENT /end REF_MEASUREMENT /end GROUP
/begin GROUP CalRegn01Cmn.MotRplCoggCfgMotTqCmdCurrRgltrBwCmpMgnY.Ary2D "MICROSAR RTE" /begin SUB_GROUP /end SUB_GROUP /begin FUNCTION_LIST /end FUNCTION_LIST /begin REF_CHARACTERISTIC CalRegn01Cmn.MotRplCoggCfgMotTqCmdCurrRgltrBwCmpMgnY.Ary2D /end REF_CHARACTERISTIC /begin REF_MEASUREMENT /end REF_MEASUREMENT /end GROUP
/begin GROUP CalRegn01Cmn.MotRplCoggCfgMotTqCmdCurrRgltrBwCmpPhaY.Ary2D "MICROSAR RTE" /begin SUB_GROUP /end SUB_GROUP /begin FUNCTION_LIST /end FUNCTION_LIST /begin REF_CHARACTERISTIC CalRegn01Cmn.MotRplCoggCfgMotTqCmdCurrRgltrBwCmpPhaY.Ary2D /end REF_CHARACTERISTIC /begin REF_MEASUREMENT /end REF_MEASUREMENT /end GROUP
/begin GROUP CalRegn01Cmn.MotRplCoggCfgMotTqCmdCurrRgltrBwCmpX.Ary1D "MICROSAR RTE" /begin SUB_GROUP /end SUB_GROUP /begin FUNCTION_LIST /end FUNCTION_LIST /begin REF_CHARACTERISTIC CalRegn01Cmn.MotRplCoggCfgMotTqCmdCurrRgltrBwCmpX.Ary1D /end REF_CHARACTERISTIC /begin REF_MEASUREMENT /end REF_MEASUREMENT /end GROUP
/begin GROUP CalRegn01Cmn.MotRplCoggCfgMotTqRplOrder1X.Ary2D "MICROSAR RTE" /begin SUB_GROUP /end SUB_GROUP /begin FUNCTION_LIST /end FUNCTION_LIST /begin REF_CHARACTERISTIC CalRegn01Cmn.MotRplCoggCfgMotTqRplOrder1X.Ary2D /end REF_CHARACTERISTIC /begin REF_MEASUREMENT /end REF_MEASUREMENT /end GROUP
/begin GROUP CalRegn01Cmn.MotRplCoggCfgMotTqRplOrder1Y.Ary2D "MICROSAR RTE" /begin SUB_GROUP /end SUB_GROUP /begin FUNCTION_LIST /end FUNCTION_LIST /begin REF_CHARACTERISTIC CalRegn01Cmn.MotRplCoggCfgMotTqRplOrder1Y.Ary2D /end REF_CHARACTERISTIC /begin REF_MEASUREMENT /end REF_MEASUREMENT /end GROUP
/begin GROUP CalRegn01Cmn.MotRplCoggCfgMotTqRplOrder2X.Ary2D "MICROSAR RTE" /begin SUB_GROUP /end SUB_GROUP /begin FUNCTION_LIST /end FUNCTION_LIST /begin REF_CHARACTERISTIC CalRegn01Cmn.MotRplCoggCfgMotTqRplOrder2X.Ary2D /end REF_CHARACTERISTIC /begin REF_MEASUREMENT /end REF_MEASUREMENT /end GROUP
/begin GROUP CalRegn01Cmn.MotRplCoggCfgMotTqRplOrder2Y.Ary2D "MICROSAR RTE" /begin SUB_GROUP /end SUB_GROUP /begin FUNCTION_LIST /end FUNCTION_LIST /begin REF_CHARACTERISTIC CalRegn01Cmn.MotRplCoggCfgMotTqRplOrder2Y.Ary2D /end REF_CHARACTERISTIC /begin REF_MEASUREMENT /end REF_MEASUREMENT /end GROUP
/begin GROUP CalRegn01Cmn.MotRplCoggCfgMotTqRplOrder3X.Ary2D "MICROSAR RTE" /begin SUB_GROUP /end SUB_GROUP /begin FUNCTION_LIST /end FUNCTION_LIST /begin REF_CHARACTERISTIC CalRegn01Cmn.MotRplCoggCfgMotTqRplOrder3X.Ary2D /end REF_CHARACTERISTIC /begin REF_MEASUREMENT /end REF_MEASUREMENT /end GROUP
/begin GROUP CalRegn01Cmn.MotRplCoggCfgMotTqRplOrder3Y.Ary2D "MICROSAR RTE" /begin SUB_GROUP /end SUB_GROUP /begin FUNCTION_LIST /end FUNCTION_LIST /begin REF_CHARACTERISTIC CalRegn01Cmn.MotRplCoggCfgMotTqRplOrder3Y.Ary2D /end REF_CHARACTERISTIC /begin REF_MEASUREMENT /end REF_MEASUREMENT /end GROUP
/begin GROUP CalRegn01Cmn.MotRplCoggCfgMotVelBilnrSeln.Ary1D "MICROSAR RTE" /begin SUB_GROUP /end SUB_GROUP /begin FUNCTION_LIST /end FUNCTION_LIST /begin REF_CHARACTERISTIC CalRegn01Cmn.MotRplCoggCfgMotVelBilnrSeln.Ary1D /end REF_CHARACTERISTIC /begin REF_MEASUREMENT /end REF_MEASUREMENT /end GROUP
/begin GROUP CalRegn01Cmn.MotRplCoggCmdHrmncOrder1Elec.Val "MICROSAR RTE" /begin SUB_GROUP /end SUB_GROUP /begin FUNCTION_LIST /end FUNCTION_LIST /begin REF_CHARACTERISTIC CalRegn01Cmn.MotRplCoggCmdHrmncOrder1Elec.Val /end REF_CHARACTERISTIC /begin REF_MEASUREMENT /end REF_MEASUREMENT /end GROUP
/begin GROUP CalRegn01Cmn.MotRplCoggCmdHrmncOrder2Elec.Val "MICROSAR RTE" /begin SUB_GROUP /end SUB_GROUP /begin FUNCTION_LIST /end FUNCTION_LIST /begin REF_CHARACTERISTIC CalRegn01Cmn.MotRplCoggCmdHrmncOrder2Elec.Val /end REF_CHARACTERISTIC /begin REF_MEASUREMENT /end REF_MEASUREMENT /end GROUP
/begin GROUP CalRegn01Cmn.MotRplCoggCmdHrmncOrder3Elec.Val "MICROSAR RTE" /begin SUB_GROUP /end SUB_GROUP /begin FUNCTION_LIST /end FUNCTION_LIST /begin REF_CHARACTERISTIC CalRegn01Cmn.MotRplCoggCmdHrmncOrder3Elec.Val /end REF_CHARACTERISTIC /begin REF_MEASUREMENT /end REF_MEASUREMENT /end GROUP
/begin GROUP CalRegn01Cmn.MotTqCmdScaMax.Val "MICROSAR RTE" /begin SUB_GROUP /end SUB_GROUP /begin FUNCTION_LIST /end FUNCTION_LIST /begin REF_CHARACTERISTIC CalRegn01Cmn.MotTqCmdScaMax.Val /end REF_CHARACTERISTIC /begin REF_MEASUREMENT /end REF_MEASUREMENT /end GROUP
/begin GROUP CalRegn01Cmn.MotTqCmdScaMin.Val "MICROSAR RTE" /begin SUB_GROUP /end SUB_GROUP /begin FUNCTION_LIST /end FUNCTION_LIST /begin REF_CHARACTERISTIC CalRegn01Cmn.MotTqCmdScaMin.Val /end REF_CHARACTERISTIC /begin REF_MEASUREMENT /end REF_MEASUREMENT /end GROUP
/begin GROUP CalRegn01Cmn.MotTqTranlDampgVehSpdBlndY.Ary1D "MICROSAR RTE" /begin SUB_GROUP /end SUB_GROUP /begin FUNCTION_LIST /end FUNCTION_LIST /begin REF_CHARACTERISTIC CalRegn01Cmn.MotTqTranlDampgVehSpdBlndY.Ary1D /end REF_CHARACTERISTIC /begin REF_MEASUREMENT /end REF_MEASUREMENT /end GROUP
/begin GROUP CalRegn01Cmn.NxtrCalIdsCal0DevlpAuthor.Ary1D "MICROSAR RTE" /begin SUB_GROUP /end SUB_GROUP /begin FUNCTION_LIST /end FUNCTION_LIST /begin REF_CHARACTERISTIC CalRegn01Cmn.NxtrCalIdsCal0DevlpAuthor.Ary1D /end REF_CHARACTERISTIC /begin REF_MEASUREMENT /end REF_MEASUREMENT /end GROUP
/begin GROUP CalRegn01Cmn.NxtrCalIdsCal0DevlpDesc.Ary1D "MICROSAR RTE" /begin SUB_GROUP /end SUB_GROUP /begin FUNCTION_LIST /end FUNCTION_LIST /begin REF_CHARACTERISTIC CalRegn01Cmn.NxtrCalIdsCal0DevlpDesc.Ary1D /end REF_CHARACTERISTIC /begin REF_MEASUREMENT /end REF_MEASUREMENT /end GROUP
/begin GROUP CalRegn01Cmn.NxtrCalIdsCal0DevlpRelNr.Val "MICROSAR RTE" /begin SUB_GROUP /end SUB_GROUP /begin FUNCTION_LIST /end FUNCTION_LIST /begin REF_CHARACTERISTIC CalRegn01Cmn.NxtrCalIdsCal0DevlpRelNr.Val /end REF_CHARACTERISTIC /begin REF_MEASUREMENT /end REF_MEASUREMENT /end GROUP
/begin GROUP CalRegn01Cmn.NxtrCalIdsCal0DevlpRelSt.Val "MICROSAR RTE" /begin SUB_GROUP /end SUB_GROUP /begin FUNCTION_LIST /end FUNCTION_LIST /begin REF_CHARACTERISTIC CalRegn01Cmn.NxtrCalIdsCal0DevlpRelSt.Val /end REF_CHARACTERISTIC /begin REF_MEASUREMENT /end REF_MEASUREMENT /end GROUP
/begin GROUP CalRegn01Cmn.NxtrCalIdsCal0DevlpTiStamp.Val "MICROSAR RTE" /begin SUB_GROUP /end SUB_GROUP /begin FUNCTION_LIST /end FUNCTION_LIST /begin REF_CHARACTERISTIC CalRegn01Cmn.NxtrCalIdsCal0DevlpTiStamp.Val /end REF_CHARACTERISTIC /begin REF_MEASUREMENT /end REF_MEASUREMENT /end GROUP
/begin GROUP CalRegn01Cmn.NxtrCalIdsCal0DevlpVers.Val "MICROSAR RTE" /begin SUB_GROUP /end SUB_GROUP /begin FUNCTION_LIST /end FUNCTION_LIST /begin REF_CHARACTERISTIC CalRegn01Cmn.NxtrCalIdsCal0DevlpVers.Val /end REF_CHARACTERISTIC /begin REF_MEASUREMENT /end REF_MEASUREMENT /end GROUP
/begin GROUP CalRegn01Cmn.PartNrCmpdVehPartnProdtStruct.Ary1D "MICROSAR RTE" /begin SUB_GROUP /end SUB_GROUP /begin FUNCTION_LIST /end FUNCTION_LIST /begin REF_CHARACTERISTIC CalRegn01Cmn.PartNrCmpdVehPartnProdtStruct.Ary1D /end REF_CHARACTERISTIC /begin REF_MEASUREMENT /end REF_MEASUREMENT /end GROUP
/begin GROUP CalRegn01Cmn.PwrDiscnctOpenThd.Val "MICROSAR RTE" /begin SUB_GROUP /end SUB_GROUP /begin FUNCTION_LIST /end FUNCTION_LIST /begin REF_CHARACTERISTIC CalRegn01Cmn.PwrDiscnctOpenThd.Val /end REF_CHARACTERISTIC /begin REF_MEASUREMENT /end REF_MEASUREMENT /end GROUP
/begin GROUP CalRegn01Cmn.PwrLimrAssiRednLpFilFrq.Val "MICROSAR RTE" /begin SUB_GROUP /end SUB_GROUP /begin FUNCTION_LIST /end FUNCTION_LIST /begin REF_CHARACTERISTIC CalRegn01Cmn.PwrLimrAssiRednLpFilFrq.Val /end REF_CHARACTERISTIC /begin REF_MEASUREMENT /end REF_MEASUREMENT /end GROUP
/begin GROUP CalRegn01Cmn.PwrLimrBackEmfConStdT.Val "MICROSAR RTE" /begin SUB_GROUP /end SUB_GROUP /begin FUNCTION_LIST /end FUNCTION_LIST /begin REF_CHARACTERISTIC CalRegn01Cmn.PwrLimrBackEmfConStdT.Val /end REF_CHARACTERISTIC /begin REF_MEASUREMENT /end REF_MEASUREMENT /end GROUP
/begin GROUP CalRegn01Cmn.PwrLimrBrdgVltgAdjSlew.Val "MICROSAR RTE" /begin SUB_GROUP /end SUB_GROUP /begin FUNCTION_LIST /end FUNCTION_LIST /begin REF_CHARACTERISTIC CalRegn01Cmn.PwrLimrBrdgVltgAdjSlew.Val /end REF_CHARACTERISTIC /begin REF_MEASUREMENT /end REF_MEASUREMENT /end GROUP
/begin GROUP CalRegn01Cmn.PwrLimrBrdgVltgAltFltAdj.Val "MICROSAR RTE" /begin SUB_GROUP /end SUB_GROUP /begin FUNCTION_LIST /end FUNCTION_LIST /begin REF_CHARACTERISTIC CalRegn01Cmn.PwrLimrBrdgVltgAltFltAdj.Val /end REF_CHARACTERISTIC /begin REF_MEASUREMENT /end REF_MEASUREMENT /end GROUP
/begin GROUP CalRegn01Cmn.PwrLimrFilAssiRednThd.Val "MICROSAR RTE" /begin SUB_GROUP /end SUB_GROUP /begin FUNCTION_LIST /end FUNCTION_LIST /begin REF_CHARACTERISTIC CalRegn01Cmn.PwrLimrFilAssiRednThd.Val /end REF_CHARACTERISTIC /begin REF_MEASUREMENT /end REF_MEASUREMENT /end GROUP
/begin GROUP CalRegn01Cmn.PwrLimrLoVoltAssiRcvrThd.Val "MICROSAR RTE" /begin SUB_GROUP /end SUB_GROUP /begin FUNCTION_LIST /end FUNCTION_LIST /begin REF_CHARACTERISTIC CalRegn01Cmn.PwrLimrLoVoltAssiRcvrThd.Val /end REF_CHARACTERISTIC /begin REF_MEASUREMENT /end REF_MEASUREMENT /end GROUP
/begin GROUP CalRegn01Cmn.PwrLimrLoVoltAssiRcvrTi.Val "MICROSAR RTE" /begin SUB_GROUP /end SUB_GROUP /begin FUNCTION_LIST /end FUNCTION_LIST /begin REF_CHARACTERISTIC CalRegn01Cmn.PwrLimrLoVoltAssiRcvrTi.Val /end REF_CHARACTERISTIC /begin REF_MEASUREMENT /end REF_MEASUREMENT /end GROUP
/begin GROUP CalRegn01Cmn.PwrLimrMotEnvlpX.Ary1D "MICROSAR RTE" /begin SUB_GROUP /end SUB_GROUP /begin FUNCTION_LIST /end FUNCTION_LIST /begin REF_CHARACTERISTIC CalRegn01Cmn.PwrLimrMotEnvlpX.Ary1D /end REF_CHARACTERISTIC /begin REF_MEASUREMENT /end REF_MEASUREMENT /end GROUP
/begin GROUP CalRegn01Cmn.PwrLimrMotEnvlpY.Ary1D "MICROSAR RTE" /begin SUB_GROUP /end SUB_GROUP /begin FUNCTION_LIST /end FUNCTION_LIST /begin REF_CHARACTERISTIC CalRegn01Cmn.PwrLimrMotEnvlpY.Ary1D /end REF_CHARACTERISTIC /begin REF_MEASUREMENT /end REF_MEASUREMENT /end GROUP
/begin GROUP CalRegn01Cmn.PwrLimrMotVelLpFilFrq.Val "MICROSAR RTE" /begin SUB_GROUP /end SUB_GROUP /begin FUNCTION_LIST /end FUNCTION_LIST /begin REF_CHARACTERISTIC CalRegn01Cmn.PwrLimrMotVelLpFilFrq.Val /end REF_CHARACTERISTIC /begin REF_MEASUREMENT /end REF_MEASUREMENT /end GROUP
/begin GROUP CalRegn01Cmn.PwrLimrSpdAdjSlewDec.Val "MICROSAR RTE" /begin SUB_GROUP /end SUB_GROUP /begin FUNCTION_LIST /end FUNCTION_LIST /begin REF_CHARACTERISTIC CalRegn01Cmn.PwrLimrSpdAdjSlewDec.Val /end REF_CHARACTERISTIC /begin REF_MEASUREMENT /end REF_MEASUREMENT /end GROUP
/begin GROUP CalRegn01Cmn.PwrLimrSpdAdjSlewEna.Logl "MICROSAR RTE" /begin SUB_GROUP /end SUB_GROUP /begin FUNCTION_LIST /end FUNCTION_LIST /begin REF_CHARACTERISTIC CalRegn01Cmn.PwrLimrSpdAdjSlewEna.Logl /end REF_CHARACTERISTIC /begin REF_MEASUREMENT /end REF_MEASUREMENT /end GROUP
/begin GROUP CalRegn01Cmn.PwrLimrSpdAdjSlewInc.Val "MICROSAR RTE" /begin SUB_GROUP /end SUB_GROUP /begin FUNCTION_LIST /end FUNCTION_LIST /begin REF_CHARACTERISTIC CalRegn01Cmn.PwrLimrSpdAdjSlewInc.Val /end REF_CHARACTERISTIC /begin REF_MEASUREMENT /end REF_MEASUREMENT /end GROUP
/begin GROUP CalRegn01Cmn.PwrLimrStdOperMotEnvlpX.Ary1D "MICROSAR RTE" /begin SUB_GROUP /end SUB_GROUP /begin FUNCTION_LIST /end FUNCTION_LIST /begin REF_CHARACTERISTIC CalRegn01Cmn.PwrLimrStdOperMotEnvlpX.Ary1D /end REF_CHARACTERISTIC /begin REF_MEASUREMENT /end REF_MEASUREMENT /end GROUP
/begin GROUP CalRegn01Cmn.PwrLimrStdOperMotEnvlpY.Ary1D "MICROSAR RTE" /begin SUB_GROUP /end SUB_GROUP /begin FUNCTION_LIST /end FUNCTION_LIST /begin REF_CHARACTERISTIC CalRegn01Cmn.PwrLimrStdOperMotEnvlpY.Ary1D /end REF_CHARACTERISTIC /begin REF_MEASUREMENT /end REF_MEASUREMENT /end GROUP
/begin GROUP CalRegn01Cmn.PwrLimrVltgDptMotVelOffsX.Ary1D "MICROSAR RTE" /begin SUB_GROUP /end SUB_GROUP /begin FUNCTION_LIST /end FUNCTION_LIST /begin REF_CHARACTERISTIC CalRegn01Cmn.PwrLimrVltgDptMotVelOffsX.Ary1D /end REF_CHARACTERISTIC /begin REF_MEASUREMENT /end REF_MEASUREMENT /end GROUP
/begin GROUP CalRegn01Cmn.PwrLimrVltgDptMotVelOffsY.Ary1D "MICROSAR RTE" /begin SUB_GROUP /end SUB_GROUP /begin FUNCTION_LIST /end FUNCTION_LIST /begin REF_CHARACTERISTIC CalRegn01Cmn.PwrLimrVltgDptMotVelOffsY.Ary1D /end REF_CHARACTERISTIC /begin REF_MEASUREMENT /end REF_MEASUREMENT /end GROUP
/begin GROUP CalRegn01Cmn.PwrSplyNtc0x07BFailStep.Val "MICROSAR RTE" /begin SUB_GROUP /end SUB_GROUP /begin FUNCTION_LIST /end FUNCTION_LIST /begin REF_CHARACTERISTIC CalRegn01Cmn.PwrSplyNtc0x07BFailStep.Val /end REF_CHARACTERISTIC /begin REF_MEASUREMENT /end REF_MEASUREMENT /end GROUP
/begin GROUP CalRegn01Cmn.PwrSplyNtc0x07BPassStep.Val "MICROSAR RTE" /begin SUB_GROUP /end SUB_GROUP /begin FUNCTION_LIST /end FUNCTION_LIST /begin REF_CHARACTERISTIC CalRegn01Cmn.PwrSplyNtc0x07BPassStep.Val /end REF_CHARACTERISTIC /begin REF_MEASUREMENT /end REF_MEASUREMENT /end GROUP
/begin GROUP CalRegn01Cmn.PwrSplyNtc0x07CFailStep.Val "MICROSAR RTE" /begin SUB_GROUP /end SUB_GROUP /begin FUNCTION_LIST /end FUNCTION_LIST /begin REF_CHARACTERISTIC CalRegn01Cmn.PwrSplyNtc0x07CFailStep.Val /end REF_CHARACTERISTIC /begin REF_MEASUREMENT /end REF_MEASUREMENT /end GROUP
/begin GROUP CalRegn01Cmn.PwrSplyNtc0x07CPassStep.Val "MICROSAR RTE" /begin SUB_GROUP /end SUB_GROUP /begin FUNCTION_LIST /end FUNCTION_LIST /begin REF_CHARACTERISTIC CalRegn01Cmn.PwrSplyNtc0x07CPassStep.Val /end REF_CHARACTERISTIC /begin REF_MEASUREMENT /end REF_MEASUREMENT /end GROUP
/begin GROUP CalRegn01Cmn.PwrSplyNtc0x07DFailStep.Val "MICROSAR RTE" /begin SUB_GROUP /end SUB_GROUP /begin FUNCTION_LIST /end FUNCTION_LIST /begin REF_CHARACTERISTIC CalRegn01Cmn.PwrSplyNtc0x07DFailStep.Val /end REF_CHARACTERISTIC /begin REF_MEASUREMENT /end REF_MEASUREMENT /end GROUP
/begin GROUP CalRegn01Cmn.PwrSplyNtc0x07DPassStep.Val "MICROSAR RTE" /begin SUB_GROUP /end SUB_GROUP /begin FUNCTION_LIST /end FUNCTION_LIST /begin REF_CHARACTERISTIC CalRegn01Cmn.PwrSplyNtc0x07DPassStep.Val /end REF_CHARACTERISTIC /begin REF_MEASUREMENT /end REF_MEASUREMENT /end GROUP
/begin GROUP CalRegn01Cmn.SinVltgGennDthrLpFilCoeff.Val "MICROSAR RTE" /begin SUB_GROUP /end SUB_GROUP /begin FUNCTION_LIST /end FUNCTION_LIST /begin REF_CHARACTERISTIC CalRegn01Cmn.SinVltgGennDthrLpFilCoeff.Val /end REF_CHARACTERISTIC /begin REF_MEASUREMENT /end REF_MEASUREMENT /end GROUP
/begin GROUP CalRegn01Cmn.SnsrOffsLrngSampleCntForHwTqLrngRst.Val "MICROSAR RTE" /begin SUB_GROUP /end SUB_GROUP /begin FUNCTION_LIST /end FUNCTION_LIST /begin REF_CHARACTERISTIC CalRegn01Cmn.SnsrOffsLrngSampleCntForHwTqLrngRst.Val /end REF_CHARACTERISTIC /begin REF_MEASUREMENT /end REF_MEASUREMENT /end GROUP
/begin GROUP CalRegn01Cmn.StHlthSigNormnAbsltMotPosDifStHlthDiagThd.Val "MICROSAR RTE" /begin SUB_GROUP /end SUB_GROUP /begin FUNCTION_LIST /end FUNCTION_LIST /begin REF_CHARACTERISTIC CalRegn01Cmn.StHlthSigNormnAbsltMotPosDifStHlthDiagThd.Val /end REF_CHARACTERISTIC /begin REF_MEASUREMENT /end REF_MEASUREMENT /end GROUP
/begin GROUP CalRegn01Cmn.StHlthSigNormnCurrMotSumStHlthDiagThd.Val "MICROSAR RTE" /begin SUB_GROUP /end SUB_GROUP /begin FUNCTION_LIST /end FUNCTION_LIST /begin REF_CHARACTERISTIC CalRegn01Cmn.StHlthSigNormnCurrMotSumStHlthDiagThd.Val /end REF_CHARACTERISTIC /begin REF_MEASUREMENT /end REF_MEASUREMENT /end GROUP
/begin GROUP CalRegn01Cmn.StHlthSigNormnDigTqStHlthDiagThd.Val "MICROSAR RTE" /begin SUB_GROUP /end SUB_GROUP /begin FUNCTION_LIST /end FUNCTION_LIST /begin REF_CHARACTERISTIC CalRegn01Cmn.StHlthSigNormnDigTqStHlthDiagThd.Val /end REF_CHARACTERISTIC /begin REF_MEASUREMENT /end REF_MEASUREMENT /end GROUP
/begin GROUP CalRegn01Cmn.StHlthSigNormnDutyCycFltLimThd.Val "MICROSAR RTE" /begin SUB_GROUP /end SUB_GROUP /begin FUNCTION_LIST /end FUNCTION_LIST /begin REF_CHARACTERISTIC CalRegn01Cmn.StHlthSigNormnDutyCycFltLimThd.Val /end REF_CHARACTERISTIC /begin REF_MEASUREMENT /end REF_MEASUREMENT /end GROUP
/begin GROUP CalRegn01Cmn.StHlthSigNormnIdptSigStHlthSca.Val "MICROSAR RTE" /begin SUB_GROUP /end SUB_GROUP /begin FUNCTION_LIST /end FUNCTION_LIST /begin REF_CHARACTERISTIC CalRegn01Cmn.StHlthSigNormnIdptSigStHlthSca.Val /end REF_CHARACTERISTIC /begin REF_MEASUREMENT /end REF_MEASUREMENT /end GROUP
/begin GROUP CalRegn01Cmn.StHlthSigNormnMaxFricThd.Val "MICROSAR RTE" /begin SUB_GROUP /end SUB_GROUP /begin FUNCTION_LIST /end FUNCTION_LIST /begin REF_CHARACTERISTIC CalRegn01Cmn.StHlthSigNormnMaxFricThd.Val /end REF_CHARACTERISTIC /begin REF_MEASUREMENT /end REF_MEASUREMENT /end GROUP
/begin GROUP CalRegn01Cmn.StHlthSigNormnMinRackTrvlLim.Val "MICROSAR RTE" /begin SUB_GROUP /end SUB_GROUP /begin FUNCTION_LIST /end FUNCTION_LIST /begin REF_CHARACTERISTIC CalRegn01Cmn.StHlthSigNormnMinRackTrvlLim.Val /end REF_CHARACTERISTIC /begin REF_MEASUREMENT /end REF_MEASUREMENT /end GROUP
/begin GROUP CalRegn01Cmn.StHlthSigNormnMotPosStHlthDiagThd.Val "MICROSAR RTE" /begin SUB_GROUP /end SUB_GROUP /begin FUNCTION_LIST /end FUNCTION_LIST /begin REF_CHARACTERISTIC CalRegn01Cmn.StHlthSigNormnMotPosStHlthDiagThd.Val /end REF_CHARACTERISTIC /begin REF_MEASUREMENT /end REF_MEASUREMENT /end GROUP
/begin GROUP CalRegn01Cmn.StHlthSigNormnMotVelCal.Val "MICROSAR RTE" /begin SUB_GROUP /end SUB_GROUP /begin FUNCTION_LIST /end FUNCTION_LIST /begin REF_CHARACTERISTIC CalRegn01Cmn.StHlthSigNormnMotVelCal.Val /end REF_CHARACTERISTIC /begin REF_MEASUREMENT /end REF_MEASUREMENT /end GROUP
/begin GROUP CalRegn01Cmn.StHlthSigNormnPhaInfoStHlthDiagThd.Val "MICROSAR RTE" /begin SUB_GROUP /end SUB_GROUP /begin FUNCTION_LIST /end FUNCTION_LIST /begin REF_CHARACTERISTIC CalRegn01Cmn.StHlthSigNormnPhaInfoStHlthDiagThd.Val /end REF_CHARACTERISTIC /begin REF_MEASUREMENT /end REF_MEASUREMENT /end GROUP
/begin GROUP CalRegn01Cmn.StHlthSigNormnStHlthCorrlnErr.Val "MICROSAR RTE" /begin SUB_GROUP /end SUB_GROUP /begin FUNCTION_LIST /end FUNCTION_LIST /begin REF_CHARACTERISTIC CalRegn01Cmn.StHlthSigNormnStHlthCorrlnErr.Val /end REF_CHARACTERISTIC /begin REF_MEASUREMENT /end REF_MEASUREMENT /end GROUP
/begin GROUP CalRegn01Cmn.StHlthSigNormnStHlthCurrMotSum.Val "MICROSAR RTE" /begin SUB_GROUP /end SUB_GROUP /begin FUNCTION_LIST /end FUNCTION_LIST /begin REF_CHARACTERISTIC CalRegn01Cmn.StHlthSigNormnStHlthCurrMotSum.Val /end REF_CHARACTERISTIC /begin REF_MEASUREMENT /end REF_MEASUREMENT /end GROUP
/begin GROUP CalRegn01Cmn.StHlthSigNormnStHlthPhaInfo.Val "MICROSAR RTE" /begin SUB_GROUP /end SUB_GROUP /begin FUNCTION_LIST /end FUNCTION_LIST /begin REF_CHARACTERISTIC CalRegn01Cmn.StHlthSigNormnStHlthPhaInfo.Val /end REF_CHARACTERISTIC /begin REF_MEASUREMENT /end REF_MEASUREMENT /end GROUP
/begin GROUP CalRegn01Cmn.StHlthSigNormnValMaxStHlthErr.Val "MICROSAR RTE" /begin SUB_GROUP /end SUB_GROUP /begin FUNCTION_LIST /end FUNCTION_LIST /begin REF_CHARACTERISTIC CalRegn01Cmn.StHlthSigNormnValMaxStHlthErr.Val /end REF_CHARACTERISTIC /begin REF_MEASUREMENT /end REF_MEASUREMENT /end GROUP
/begin GROUP CalRegn01Cmn.StHlthSigNormnValMinStHlthErr.Val "MICROSAR RTE" /begin SUB_GROUP /end SUB_GROUP /begin FUNCTION_LIST /end FUNCTION_LIST /begin REF_CHARACTERISTIC CalRegn01Cmn.StHlthSigNormnValMinStHlthErr.Val /end REF_CHARACTERISTIC /begin REF_MEASUREMENT /end REF_MEASUREMENT /end GROUP
/begin GROUP CalRegn01Cmn.StHlthSigNormnWhlImbRejctnThd.Val "MICROSAR RTE" /begin SUB_GROUP /end SUB_GROUP /begin FUNCTION_LIST /end FUNCTION_LIST /begin REF_CHARACTERISTIC CalRegn01Cmn.StHlthSigNormnWhlImbRejctnThd.Val /end REF_CHARACTERISTIC /begin REF_MEASUREMENT /end REF_MEASUREMENT /end GROUP
/**********************************************************************************************************************
* RECORD_LAYOUT
*********************************************************************************************************************/
/begin RECORD_LAYOUT RTE_RL_UBYTE FNC_VALUES 1 UBYTE ROW_DIR DIRECT /end RECORD_LAYOUT
/begin RECORD_LAYOUT RTE_RL_UWORD FNC_VALUES 1 UWORD ROW_DIR DIRECT /end RECORD_LAYOUT
/begin RECORD_LAYOUT RTE_RL_ULONG FNC_VALUES 1 ULONG ROW_DIR DIRECT /end RECORD_LAYOUT
/begin RECORD_LAYOUT RTE_RL_SWORD FNC_VALUES 1 SWORD ROW_DIR DIRECT /end RECORD_LAYOUT
/begin RECORD_LAYOUT RTE_RL_SLONG FNC_VALUES 1 SLONG ROW_DIR DIRECT /end RECORD_LAYOUT
/begin RECORD_LAYOUT RTE_RL_FLOAT32_IEEE FNC_VALUES 1 FLOAT32_IEEE ROW_DIR DIRECT /end RECORD_LAYOUT
/begin RECORD_LAYOUT RTE_RL_BOOLEAN FNC_VALUES 1 UBYTE ROW_DIR DIRECT /end RECORD_LAYOUT
/**********************************************************************************************************************
* COMPU_METHOD / COMPU_VTAB_RANGE
*********************************************************************************************************************/
/begin COMPU_METHOD RTE_CM_BOOLEAN "" TAB_VERB "%3.1" "" COMPU_TAB_REF RTE_CM_BOOLEAN /end COMPU_METHOD
/begin COMPU_VTAB_RANGE RTE_CM_BOOLEAN "" 2 0 0 "false" 1 255 "true" /end COMPU_VTAB_RANGE
/begin COMPU_METHOD RTE_CM_Curr8 "" RAT_FUNC "%.1" "Amp" COEFFS 0 128 0 0 0 1 /end COMPU_METHOD
/begin COMPU_METHOD RTE_CM_Uls11 "" RAT_FUNC "%.1" "Uls" COEFFS 0 16384 0 0 0 1 /end COMPU_METHOD
/begin COMPU_METHOD RTE_CM_Frq3 "" RAT_FUNC "%.1" "Hz" COEFFS 0 64 0 0 0 1 /end COMPU_METHOD
/begin COMPU_METHOD RTE_CM_Frq4 "" RAT_FUNC "%.1" "Hz" COEFFS 0 64 0 0 0 1 /end COMPU_METHOD
/begin COMPU_METHOD RTE_CM_Vel4 "" RAT_FUNC "%.1" "MotRad/s" COEFFS 0 32 0 0 0 1 /end COMPU_METHOD
/begin COMPU_METHOD RTE_CM_Frq5 "" RAT_FUNC "%.1" "Hz" COEFFS 0 128 0 0 0 1 /end COMPU_METHOD
/begin COMPU_METHOD RTE_CM_Frq6 "" RAT_FUNC "%.1" "Hz" COEFFS 0 128 0 0 0 1 /end COMPU_METHOD
/begin COMPU_METHOD RTE_CM_Ag6 "" RAT_FUNC "%.1" "MotDeg" COEFFS 0 8192 0 0 0 1 /end COMPU_METHOD
/begin COMPU_METHOD RTE_CM_Tq13 "" RAT_FUNC "%.1" "MotNm" COEFFS 0 0.000244140625 0 0 0 1 /end COMPU_METHOD
/begin COMPU_METHOD RTE_CM_Uls15 "" RAT_FUNC "%.1" "Uls" COEFFS 0 3.0517578125e-005 0 0 0 1 /end COMPU_METHOD
/begin COMPU_METHOD RTE_CM_Volt18 "" RAT_FUNC "%.1" "V" COEFFS 0 8192 0 0 0 1 /end COMPU_METHOD
