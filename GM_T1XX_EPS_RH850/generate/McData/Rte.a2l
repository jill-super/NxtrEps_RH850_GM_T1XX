/begin CHARACTERISTIC AAACalRegn03Rt01GroupB_Dummy_1.EotProtnEntrGainY.Ary2D "MICROSAR RTE" VAL_BLK 0x0 RTE_RL_UWORD 0 NO_COMPU_METHOD 0 65535 MATRIX_DIM 4 5 1 SYMBOL_LINK "Rte_CalprmRom_CalRegn03Rt01GroupB_DEFAULT_RTE_CALPRM_GROUP.EotProtnEntrGainY_Ary2D" 0 DISPLAY_IDENTIFIER AAACalRegn03Rt01GroupB_Dummy_1.CalibrationPorts.EotProtnEntrGainY.Ary2D /end CHARACTERISTIC
/begin CHARACTERISTIC AAACalRegn03Rt01GroupB_Dummy_1.EotProtnExitDampgY.Ary2D "MICROSAR RTE" VAL_BLK 0x0 RTE_RL_UWORD 0 NO_COMPU_METHOD 0 65535 MATRIX_DIM 2 4 1 SYMBOL_LINK "Rte_CalprmRom_CalRegn03Rt01GroupB_DEFAULT_RTE_CALPRM_GROUP.EotProtnExitDampgY_Ary2D" 0 DISPLAY_IDENTIFIER AAACalRegn03Rt01GroupB_Dummy_1.CalibrationPorts.EotProtnExitDampgY.Ary2D /end CHARACTERISTIC
/begin CHARACTERISTIC AAACalRegn03Rt01GroupB_Dummy_1.EotProtnHwDegDampgX.Ary2D "MICROSAR RTE" VAL_BLK 0x0 RTE_RL_UWORD 0 NO_COMPU_METHOD 0 65535 MATRIX_DIM 2 4 1 SYMBOL_LINK "Rte_CalprmRom_CalRegn03Rt01GroupB_DEFAULT_RTE_CALPRM_GROUP.EotProtnHwDegDampgX_Ary2D" 0 DISPLAY_IDENTIFIER AAACalRegn03Rt01GroupB_Dummy_1.CalibrationPorts.EotProtnHwDegDampgX.Ary2D /end CHARACTERISTIC
/begin CHARACTERISTIC AAACalRegn03Rt01GroupB_Dummy_1.EotProtnNormDampgY.Ary2D "MICROSAR RTE" VAL_BLK 0x0 RTE_RL_UWORD 0 NO_COMPU_METHOD 0 65535 MATRIX_DIM 2 4 1 SYMBOL_LINK "Rte_CalprmRom_CalRegn03Rt01GroupB_DEFAULT_RTE_CALPRM_GROUP.EotProtnNormDampgY_Ary2D" 0 DISPLAY_IDENTIFIER AAACalRegn03Rt01GroupB_Dummy_1.CalibrationPorts.EotProtnNormDampgY.Ary2D /end CHARACTERISTIC
/begin CHARACTERISTIC AAACalRegn03Rt01GroupB_Dummy_1.InertiaCmpVelAssiBasdDampgRollgWhlImbRejctnOnY.Ary1D "MICROSAR RTE" VAL_BLK 0x0 RTE_RL_UWORD 0 NO_COMPU_METHOD 0 65535 MATRIX_DIM 10 1 1 SYMBOL_LINK "Rte_CalprmRom_CalRegn03Rt01GroupB_DEFAULT_RTE_CALPRM_GROUP.InertiaCmpVelAssiBasdDampgRollgWhlImbRejctnOnY_Ary1D" 0 DISPLAY_IDENTIFIER AAACalRegn03Rt01GroupB_Dummy_1.CalibrationPorts.InertiaCmpVelAssiBasdDampgRollgWhlImbRejctnOnY.Ary1D /end CHARACTERISTIC
/begin CHARACTERISTIC AAACalRegn03Rt01GroupB_Dummy_2.AssiHiFrqTqWhlImbRejctnTqX.Ary2D "MICROSAR RTE" VAL_BLK 0x0 RTE_RL_UWORD 0 NO_COMPU_METHOD 0 65535 MATRIX_DIM 13 12 1 SYMBOL_LINK "Rte_CalprmRom_CalRegn03Rt02GroupB_DEFAULT_RTE_CALPRM_GROUP.AssiHiFrqTqWhlImbRejctnTqX_Ary2D" 0 DISPLAY_IDENTIFIER AAACalRegn03Rt01GroupB_Dummy_2.CalibrationPorts.AssiHiFrqTqWhlImbRejctnTqX.Ary2D /end CHARACTERISTIC
/begin CHARACTERISTIC AAACalRegn03Rt01GroupB_Dummy_2.AssiHiFrqWhlImbRejctnBlndX.Ary2D "MICROSAR RTE" VAL_BLK 0x0 RTE_RL_UWORD 0 NO_COMPU_METHOD 0 65535 MATRIX_DIM 5 12 1 SYMBOL_LINK "Rte_CalprmRom_CalRegn03Rt02GroupB_DEFAULT_RTE_CALPRM_GROUP.AssiHiFrqWhlImbRejctnBlndX_Ary2D" 0 DISPLAY_IDENTIFIER AAACalRegn03Rt01GroupB_Dummy_2.CalibrationPorts.AssiHiFrqWhlImbRejctnBlndX.Ary2D /end CHARACTERISTIC
/begin CHARACTERISTIC AAACalRegn03Rt01GroupB_Dummy_2.AssiHiFrqWhlImbRejctnBlndY.Ary2D "MICROSAR RTE" VAL_BLK 0x0 RTE_RL_UWORD 0 NO_COMPU_METHOD 0 65535 MATRIX_DIM 5 12 1 SYMBOL_LINK "Rte_CalprmRom_CalRegn03Rt02GroupB_DEFAULT_RTE_CALPRM_GROUP.AssiHiFrqWhlImbRejctnBlndY_Ary2D" 0 DISPLAY_IDENTIFIER AAACalRegn03Rt01GroupB_Dummy_2.CalibrationPorts.AssiHiFrqWhlImbRejctnBlndY.Ary2D /end CHARACTERISTIC
/begin CHARACTERISTIC AAACalRegn03Rt01GroupB_Dummy_2.AssiHiFrqWhlImbRejctnGainY.Ary2D "MICROSAR RTE" VAL_BLK 0x0 RTE_RL_UWORD 0 NO_COMPU_METHOD 0 65535 MATRIX_DIM 13 12 1 SYMBOL_LINK "Rte_CalprmRom_CalRegn03Rt02GroupB_DEFAULT_RTE_CALPRM_GROUP.AssiHiFrqWhlImbRejctnGainY_Ary2D" 0 DISPLAY_IDENTIFIER AAACalRegn03Rt01GroupB_Dummy_2.CalibrationPorts.AssiHiFrqWhlImbRejctnGainY.Ary2D /end CHARACTERISTIC
/begin CHARACTERISTIC AAACalRegn03Rt01GroupB_Dummy_2.AssiMotTqWhlImbRejctnMaxX.Ary2D "MICROSAR RTE" VAL_BLK 0x0 RTE_RL_UWORD 0 NO_COMPU_METHOD 0 65535 MATRIX_DIM 20 12 1 SYMBOL_LINK "Rte_CalprmRom_CalRegn03Rt02GroupB_DEFAULT_RTE_CALPRM_GROUP.AssiMotTqWhlImbRejctnMaxX_Ary2D" 0 DISPLAY_IDENTIFIER AAACalRegn03Rt01GroupB_Dummy_2.CalibrationPorts.AssiMotTqWhlImbRejctnMaxX.Ary2D /end CHARACTERISTIC
/begin CHARACTERISTIC AAACalRegn03Rt01GroupB_Dummy_2.AssiMotTqWhlImbRejctnMaxY.Ary2D "MICROSAR RTE" VAL_BLK 0x0 RTE_RL_SWORD 0 NO_COMPU_METHOD -32768 32767 MATRIX_DIM 20 12 1 SYMBOL_LINK "Rte_CalprmRom_CalRegn03Rt02GroupB_DEFAULT_RTE_CALPRM_GROUP.AssiMotTqWhlImbRejctnMaxY_Ary2D" 0 DISPLAY_IDENTIFIER AAACalRegn03Rt01GroupB_Dummy_2.CalibrationPorts.AssiMotTqWhlImbRejctnMaxY.Ary2D /end CHARACTERISTIC
/begin CHARACTERISTIC AAACalRegn03Rt01GroupB_Dummy_2.AssiWhlImbRejctnBlndScaX.Ary2D "MICROSAR RTE" VAL_BLK 0x0 RTE_RL_UWORD 0 NO_COMPU_METHOD 0 65535 MATRIX_DIM 5 12 1 SYMBOL_LINK "Rte_CalprmRom_CalRegn03Rt02GroupB_DEFAULT_RTE_CALPRM_GROUP.AssiWhlImbRejctnBlndScaX_Ary2D" 0 DISPLAY_IDENTIFIER AAACalRegn03Rt01GroupB_Dummy_2.CalibrationPorts.AssiWhlImbRejctnBlndScaX.Ary2D /end CHARACTERISTIC
/begin CHARACTERISTIC AAACalRegn03Rt01GroupB_Dummy_2.AssiWhlImbRejctnBlndScaY.Ary2D "MICROSAR RTE" VAL_BLK 0x0 RTE_RL_UWORD 0 NO_COMPU_METHOD 0 65535 MATRIX_DIM 5 12 1 SYMBOL_LINK "Rte_CalprmRom_CalRegn03Rt02GroupB_DEFAULT_RTE_CALPRM_GROUP.AssiWhlImbRejctnBlndScaY_Ary2D" 0 DISPLAY_IDENTIFIER AAACalRegn03Rt01GroupB_Dummy_2.CalibrationPorts.AssiWhlImbRejctnBlndScaY.Ary2D /end CHARACTERISTIC
/begin CHARACTERISTIC AAACalRegn03Rt01GroupB_Dummy_2.EotProtnDampgVehSpdTbl.Ary1D "MICROSAR RTE" VAL_BLK 0x0 RTE_RL_UWORD 0 NO_COMPU_METHOD 0 65535 MATRIX_DIM 4 1 1 SYMBOL_LINK "Rte_CalprmRom_CalRegn03Rt02GroupB_DEFAULT_RTE_CALPRM_GROUP.EotProtnDampgVehSpdTbl_Ary1D" 0 DISPLAY_IDENTIFIER AAACalRegn03Rt01GroupB_Dummy_2.CalibrationPorts.EotProtnDampgVehSpdTbl.Ary1D /end CHARACTERISTIC
/begin CHARACTERISTIC AAACalRegn03Rt01GroupB_Dummy_2.EotProtnEntrGainVehSpdTbl.Ary1D "MICROSAR RTE" VAL_BLK 0x0 RTE_RL_UWORD 0 NO_COMPU_METHOD 0 65535 MATRIX_DIM 5 1 1 SYMBOL_LINK "Rte_CalprmRom_CalRegn03Rt02GroupB_DEFAULT_RTE_CALPRM_GROUP.EotProtnEntrGainVehSpdTbl_Ary1D" 0 DISPLAY_IDENTIFIER AAACalRegn03Rt01GroupB_Dummy_2.CalibrationPorts.EotProtnEntrGainVehSpdTbl.Ary1D /end CHARACTERISTIC
/begin CHARACTERISTIC AAACalRegn03Rt01GroupB_Dummy_2.EotProtnEntrGainX.Ary2D "MICROSAR RTE" VAL_BLK 0x0 RTE_RL_UWORD 0 NO_COMPU_METHOD 0 65535 MATRIX_DIM 4 5 1 SYMBOL_LINK "Rte_CalprmRom_CalRegn03Rt02GroupB_DEFAULT_RTE_CALPRM_GROUP.EotProtnEntrGainX_Ary2D" 0 DISPLAY_IDENTIFIER AAACalRegn03Rt01GroupB_Dummy_2.CalibrationPorts.EotProtnEntrGainX.Ary2D /end CHARACTERISTIC
/begin CHARACTERISTIC AAACalRegn03Rt01GroupB_Dummy_2.EotProtnEntrGainY.Ary2D "MICROSAR RTE" VAL_BLK 0x0 RTE_RL_UWORD 0 NO_COMPU_METHOD 0 65535 MATRIX_DIM 4 5 1 SYMBOL_LINK "Rte_CalprmRom_CalRegn03Rt02GroupB_DEFAULT_RTE_CALPRM_GROUP.EotProtnEntrGainY_Ary2D" 0 DISPLAY_IDENTIFIER AAACalRegn03Rt01GroupB_Dummy_2.CalibrationPorts.EotProtnEntrGainY.Ary2D /end CHARACTERISTIC
/begin CHARACTERISTIC AAACalRegn03Rt01GroupB_Dummy_2.EotProtnExitDampgY.Ary2D "MICROSAR RTE" VAL_BLK 0x0 RTE_RL_UWORD 0 NO_COMPU_METHOD 0 65535 MATRIX_DIM 2 4 1 SYMBOL_LINK "Rte_CalprmRom_CalRegn03Rt02GroupB_DEFAULT_RTE_CALPRM_GROUP.EotProtnExitDampgY_Ary2D" 0 DISPLAY_IDENTIFIER AAACalRegn03Rt01GroupB_Dummy_2.CalibrationPorts.EotProtnExitDampgY.Ary2D /end CHARACTERISTIC
/begin CHARACTERISTIC AAACalRegn03Rt01GroupB_Dummy_2.EotProtnHwDegDampgX.Ary2D "MICROSAR RTE" VAL_BLK 0x0 RTE_RL_UWORD 0 NO_COMPU_METHOD 0 65535 MATRIX_DIM 2 4 1 SYMBOL_LINK "Rte_CalprmRom_CalRegn03Rt02GroupB_DEFAULT_RTE_CALPRM_GROUP.EotProtnHwDegDampgX_Ary2D" 0 DISPLAY_IDENTIFIER AAACalRegn03Rt01GroupB_Dummy_2.CalibrationPorts.EotProtnHwDegDampgX.Ary2D /end CHARACTERISTIC
/begin CHARACTERISTIC AAACalRegn03Rt01GroupB_Dummy_2.EotProtnNormDampgY.Ary2D "MICROSAR RTE" VAL_BLK 0x0 RTE_RL_UWORD 0 NO_COMPU_METHOD 0 65535 MATRIX_DIM 2 4 1 SYMBOL_LINK "Rte_CalprmRom_CalRegn03Rt02GroupB_DEFAULT_RTE_CALPRM_GROUP.EotProtnNormDampgY_Ary2D" 0 DISPLAY_IDENTIFIER AAACalRegn03Rt01GroupB_Dummy_2.CalibrationPorts.EotProtnNormDampgY.Ary2D /end CHARACTERISTIC
/begin CHARACTERISTIC AAACalRegn03Rt01GroupB_Dummy_2.InertiaCmpVelAssiBasdDampgRollgWhlImbRejctnOnY.Ary1D "MICROSAR RTE" VAL_BLK 0x0 RTE_RL_UWORD 0 NO_COMPU_METHOD 0 65535 MATRIX_DIM 10 1 1 SYMBOL_LINK "Rte_CalprmRom_CalRegn03Rt02GroupB_DEFAULT_RTE_CALPRM_GROUP.InertiaCmpVelAssiBasdDampgRollgWhlImbRejctnOnY_Ary1D" 0 DISPLAY_IDENTIFIER AAACalRegn03Rt01GroupB_Dummy_2.CalibrationPorts.InertiaCmpVelAssiBasdDampgRollgWhlImbRejctnOnY.Ary1D /end CHARACTERISTIC
/begin CHARACTERISTIC AAACalRegn03Rt01GroupB_Dummy_3.AssiHiFrqTqWhlImbRejctnTqX.Ary2D "MICROSAR RTE" VAL_BLK 0x0 RTE_RL_UWORD 0 NO_COMPU_METHOD 0 65535 MATRIX_DIM 13 12 1 SYMBOL_LINK "Rte_CalprmRom_CalRegn03Rt03GroupB_DEFAULT_RTE_CALPRM_GROUP.AssiHiFrqTqWhlImbRejctnTqX_Ary2D" 0 DISPLAY_IDENTIFIER AAACalRegn03Rt01GroupB_Dummy_3.CalibrationPorts.AssiHiFrqTqWhlImbRejctnTqX.Ary2D /end CHARACTERISTIC
/begin CHARACTERISTIC AAACalRegn03Rt01GroupB_Dummy_3.AssiHiFrqWhlImbRejctnBlndX.Ary2D "MICROSAR RTE" VAL_BLK 0x0 RTE_RL_UWORD 0 NO_COMPU_METHOD 0 65535 MATRIX_DIM 5 12 1 SYMBOL_LINK "Rte_CalprmRom_CalRegn03Rt03GroupB_DEFAULT_RTE_CALPRM_GROUP.AssiHiFrqWhlImbRejctnBlndX_Ary2D" 0 DISPLAY_IDENTIFIER AAACalRegn03Rt01GroupB_Dummy_3.CalibrationPorts.AssiHiFrqWhlImbRejctnBlndX.Ary2D /end CHARACTERISTIC
/begin CHARACTERISTIC AAACalRegn03Rt01GroupB_Dummy_3.AssiHiFrqWhlImbRejctnBlndY.Ary2D "MICROSAR RTE" VAL_BLK 0x0 RTE_RL_UWORD 0 NO_COMPU_METHOD 0 65535 MATRIX_DIM 5 12 1 SYMBOL_LINK "Rte_CalprmRom_CalRegn03Rt03GroupB_DEFAULT_RTE_CALPRM_GROUP.AssiHiFrqWhlImbRejctnBlndY_Ary2D" 0 DISPLAY_IDENTIFIER AAACalRegn03Rt01GroupB_Dummy_3.CalibrationPorts.AssiHiFrqWhlImbRejctnBlndY.Ary2D /end CHARACTERISTIC
/begin CHARACTERISTIC AAACalRegn03Rt01GroupB_Dummy_3.AssiHiFrqWhlImbRejctnGainY.Ary2D "MICROSAR RTE" VAL_BLK 0x0 RTE_RL_UWORD 0 NO_COMPU_METHOD 0 65535 MATRIX_DIM 13 12 1 SYMBOL_LINK "Rte_CalprmRom_CalRegn03Rt03GroupB_DEFAULT_RTE_CALPRM_GROUP.AssiHiFrqWhlImbRejctnGainY_Ary2D" 0 DISPLAY_IDENTIFIER AAACalRegn03Rt01GroupB_Dummy_3.CalibrationPorts.AssiHiFrqWhlImbRejctnGainY.Ary2D /end CHARACTERISTIC
/begin CHARACTERISTIC AAACalRegn03Rt01GroupB_Dummy_3.AssiMotTqWhlImbRejctnMaxX.Ary2D "MICROSAR RTE" VAL_BLK 0x0 RTE_RL_UWORD 0 NO_COMPU_METHOD 0 65535 MATRIX_DIM 20 12 1 SYMBOL_LINK "Rte_CalprmRom_CalRegn03Rt03GroupB_DEFAULT_RTE_CALPRM_GROUP.AssiMotTqWhlImbRejctnMaxX_Ary2D" 0 DISPLAY_IDENTIFIER AAACalRegn03Rt01GroupB_Dummy_3.CalibrationPorts.AssiMotTqWhlImbRejctnMaxX.Ary2D /end CHARACTERISTIC
/begin CHARACTERISTIC AAACalRegn03Rt01GroupB_Dummy_3.AssiMotTqWhlImbRejctnMaxY.Ary2D "MICROSAR RTE" VAL_BLK 0x0 RTE_RL_SWORD 0 NO_COMPU_METHOD -32768 32767 MATRIX_DIM 20 12 1 SYMBOL_LINK "Rte_CalprmRom_CalRegn03Rt03GroupB_DEFAULT_RTE_CALPRM_GROUP.AssiMotTqWhlImbRejctnMaxY_Ary2D" 0 DISPLAY_IDENTIFIER AAACalRegn03Rt01GroupB_Dummy_3.CalibrationPorts.AssiMotTqWhlImbRejctnMaxY.Ary2D /end CHARACTERISTIC
/begin CHARACTERISTIC AAACalRegn03Rt01GroupB_Dummy_3.AssiWhlImbRejctnBlndScaX.Ary2D "MICROSAR RTE" VAL_BLK 0x0 RTE_RL_UWORD 0 NO_COMPU_METHOD 0 65535 MATRIX_DIM 5 12 1 SYMBOL_LINK "Rte_CalprmRom_CalRegn03Rt03GroupB_DEFAULT_RTE_CALPRM_GROUP.AssiWhlImbRejctnBlndScaX_Ary2D" 0 DISPLAY_IDENTIFIER AAACalRegn03Rt01GroupB_Dummy_3.CalibrationPorts.AssiWhlImbRejctnBlndScaX.Ary2D /end CHARACTERISTIC
/begin CHARACTERISTIC AAACalRegn03Rt01GroupB_Dummy_3.AssiWhlImbRejctnBlndScaY.Ary2D "MICROSAR RTE" VAL_BLK 0x0 RTE_RL_UWORD 0 NO_COMPU_METHOD 0 65535 MATRIX_DIM 5 12 1 SYMBOL_LINK "Rte_CalprmRom_CalRegn03Rt03GroupB_DEFAULT_RTE_CALPRM_GROUP.AssiWhlImbRejctnBlndScaY_Ary2D" 0 DISPLAY_IDENTIFIER AAACalRegn03Rt01GroupB_Dummy_3.CalibrationPorts.AssiWhlImbRejctnBlndScaY.Ary2D /end CHARACTERISTIC
/begin CHARACTERISTIC AAACalRegn03Rt01GroupB_Dummy_3.EotProtnDampgVehSpdTbl.Ary1D "MICROSAR RTE" VAL_BLK 0x0 RTE_RL_UWORD 0 NO_COMPU_METHOD 0 65535 MATRIX_DIM 4 1 1 SYMBOL_LINK "Rte_CalprmRom_CalRegn03Rt03GroupB_DEFAULT_RTE_CALPRM_GROUP.EotProtnDampgVehSpdTbl_Ary1D" 0 DISPLAY_IDENTIFIER AAACalRegn03Rt01GroupB_Dummy_3.CalibrationPorts.EotProtnDampgVehSpdTbl.Ary1D /end CHARACTERISTIC
/begin CHARACTERISTIC AAACalRegn03Rt01GroupB_Dummy_3.EotProtnEntrGainVehSpdTbl.Ary1D "MICROSAR RTE" VAL_BLK 0x0 RTE_RL_UWORD 0 NO_COMPU_METHOD 0 65535 MATRIX_DIM 5 1 1 SYMBOL_LINK "Rte_CalprmRom_CalRegn03Rt03GroupB_DEFAULT_RTE_CALPRM_GROUP.EotProtnEntrGainVehSpdTbl_Ary1D" 0 DISPLAY_IDENTIFIER AAACalRegn03Rt01GroupB_Dummy_3.CalibrationPorts.EotProtnEntrGainVehSpdTbl.Ary1D /end CHARACTERISTIC
/begin CHARACTERISTIC AAACalRegn03Rt01GroupB_Dummy_3.EotProtnEntrGainX.Ary2D "MICROSAR RTE" VAL_BLK 0x0 RTE_RL_UWORD 0 NO_COMPU_METHOD 0 65535 MATRIX_DIM 4 5 1 SYMBOL_LINK "Rte_CalprmRom_CalRegn03Rt03GroupB_DEFAULT_RTE_CALPRM_GROUP.EotProtnEntrGainX_Ary2D" 0 DISPLAY_IDENTIFIER AAACalRegn03Rt01GroupB_Dummy_3.CalibrationPorts.EotProtnEntrGainX.Ary2D /end CHARACTERISTIC
/begin CHARACTERISTIC AAACalRegn03Rt01GroupB_Dummy_3.EotProtnEntrGainY.Ary2D "MICROSAR RTE" VAL_BLK 0x0 RTE_RL_UWORD 0 NO_COMPU_METHOD 0 65535 MATRIX_DIM 4 5 1 SYMBOL_LINK "Rte_CalprmRom_CalRegn03Rt03GroupB_DEFAULT_RTE_CALPRM_GROUP.EotProtnEntrGainY_Ary2D" 0 DISPLAY_IDENTIFIER AAACalRegn03Rt01GroupB_Dummy_3.CalibrationPorts.EotProtnEntrGainY.Ary2D /end CHARACTERISTIC
/begin CHARACTERISTIC AAACalRegn03Rt01GroupB_Dummy_3.EotProtnExitDampgY.Ary2D "MICROSAR RTE" VAL_BLK 0x0 RTE_RL_UWORD 0 NO_COMPU_METHOD 0 65535 MATRIX_DIM 2 4 1 SYMBOL_LINK "Rte_CalprmRom_CalRegn03Rt03GroupB_DEFAULT_RTE_CALPRM_GROUP.EotProtnExitDampgY_Ary2D" 0 DISPLAY_IDENTIFIER AAACalRegn03Rt01GroupB_Dummy_3.CalibrationPorts.EotProtnExitDampgY.Ary2D /end CHARACTERISTIC
/begin CHARACTERISTIC AAACalRegn03Rt01GroupB_Dummy_3.EotProtnHwDegDampgX.Ary2D "MICROSAR RTE" VAL_BLK 0x0 RTE_RL_UWORD 0 NO_COMPU_METHOD 0 65535 MATRIX_DIM 2 4 1 SYMBOL_LINK "Rte_CalprmRom_CalRegn03Rt03GroupB_DEFAULT_RTE_CALPRM_GROUP.EotProtnHwDegDampgX_Ary2D" 0 DISPLAY_IDENTIFIER AAACalRegn03Rt01GroupB_Dummy_3.CalibrationPorts.EotProtnHwDegDampgX.Ary2D /end CHARACTERISTIC
/begin CHARACTERISTIC AAACalRegn03Rt01GroupB_Dummy_3.EotProtnNormDampgY.Ary2D "MICROSAR RTE" VAL_BLK 0x0 RTE_RL_UWORD 0 NO_COMPU_METHOD 0 65535 MATRIX_DIM 2 4 1 SYMBOL_LINK "Rte_CalprmRom_CalRegn03Rt03GroupB_DEFAULT_RTE_CALPRM_GROUP.EotProtnNormDampgY_Ary2D" 0 DISPLAY_IDENTIFIER AAACalRegn03Rt01GroupB_Dummy_3.CalibrationPorts.EotProtnNormDampgY.Ary2D /end CHARACTERISTIC
/begin CHARACTERISTIC AAACalRegn03Rt01GroupB_Dummy_3.InertiaCmpVelAssiBasdDampgRollgWhlImbRejctnOnY.Ary1D "MICROSAR RTE" VAL_BLK 0x0 RTE_RL_UWORD 0 NO_COMPU_METHOD 0 65535 MATRIX_DIM 10 1 1 SYMBOL_LINK "Rte_CalprmRom_CalRegn03Rt03GroupB_DEFAULT_RTE_CALPRM_GROUP.InertiaCmpVelAssiBasdDampgRollgWhlImbRejctnOnY_Ary1D" 0 DISPLAY_IDENTIFIER AAACalRegn03Rt01GroupB_Dummy_3.CalibrationPorts.InertiaCmpVelAssiBasdDampgRollgWhlImbRejctnOnY.Ary1D /end CHARACTERISTIC
/begin CHARACTERISTIC AAACalRegn03Rt01GroupB_Dummy_4.AssiHiFrqTqWhlImbRejctnTqX.Ary2D "MICROSAR RTE" VAL_BLK 0x0 RTE_RL_UWORD 0 NO_COMPU_METHOD 0 65535 MATRIX_DIM 13 12 1 SYMBOL_LINK "Rte_CalprmRom_CalRegn03Rt04GroupB_DEFAULT_RTE_CALPRM_GROUP.AssiHiFrqTqWhlImbRejctnTqX_Ary2D" 0 DISPLAY_IDENTIFIER AAACalRegn03Rt01GroupB_Dummy_4.CalibrationPorts.AssiHiFrqTqWhlImbRejctnTqX.Ary2D /end CHARACTERISTIC
/begin CHARACTERISTIC AAACalRegn03Rt01GroupB_Dummy_4.AssiHiFrqWhlImbRejctnBlndX.Ary2D "MICROSAR RTE" VAL_BLK 0x0 RTE_RL_UWORD 0 NO_COMPU_METHOD 0 65535 MATRIX_DIM 5 12 1 SYMBOL_LINK "Rte_CalprmRom_CalRegn03Rt04GroupB_DEFAULT_RTE_CALPRM_GROUP.AssiHiFrqWhlImbRejctnBlndX_Ary2D" 0 DISPLAY_IDENTIFIER AAACalRegn03Rt01GroupB_Dummy_4.CalibrationPorts.AssiHiFrqWhlImbRejctnBlndX.Ary2D /end CHARACTERISTIC
/begin CHARACTERISTIC AAACalRegn03Rt01GroupB_Dummy_4.AssiHiFrqWhlImbRejctnBlndY.Ary2D "MICROSAR RTE" VAL_BLK 0x0 RTE_RL_UWORD 0 NO_COMPU_METHOD 0 65535 MATRIX_DIM 5 12 1 SYMBOL_LINK "Rte_CalprmRom_CalRegn03Rt04GroupB_DEFAULT_RTE_CALPRM_GROUP.AssiHiFrqWhlImbRejctnBlndY_Ary2D" 0 DISPLAY_IDENTIFIER AAACalRegn03Rt01GroupB_Dummy_4.CalibrationPorts.AssiHiFrqWhlImbRejctnBlndY.Ary2D /end CHARACTERISTIC
/begin CHARACTERISTIC AAACalRegn03Rt01GroupB_Dummy_4.AssiHiFrqWhlImbRejctnGainY.Ary2D "MICROSAR RTE" VAL_BLK 0x0 RTE_RL_UWORD 0 NO_COMPU_METHOD 0 65535 MATRIX_DIM 13 12 1 SYMBOL_LINK "Rte_CalprmRom_CalRegn03Rt04GroupB_DEFAULT_RTE_CALPRM_GROUP.AssiHiFrqWhlImbRejctnGainY_Ary2D" 0 DISPLAY_IDENTIFIER AAACalRegn03Rt01GroupB_Dummy_4.CalibrationPorts.AssiHiFrqWhlImbRejctnGainY.Ary2D /end CHARACTERISTIC
/begin CHARACTERISTIC AAACalRegn03Rt01GroupB_Dummy_4.AssiMotTqWhlImbRejctnMaxX.Ary2D "MICROSAR RTE" VAL_BLK 0x0 RTE_RL_UWORD 0 NO_COMPU_METHOD 0 65535 MATRIX_DIM 20 12 1 SYMBOL_LINK "Rte_CalprmRom_CalRegn03Rt04GroupB_DEFAULT_RTE_CALPRM_GROUP.AssiMotTqWhlImbRejctnMaxX_Ary2D" 0 DISPLAY_IDENTIFIER AAACalRegn03Rt01GroupB_Dummy_4.CalibrationPorts.AssiMotTqWhlImbRejctnMaxX.Ary2D /end CHARACTERISTIC
/begin CHARACTERISTIC AAACalRegn03Rt01GroupB_Dummy_4.AssiMotTqWhlImbRejctnMaxY.Ary2D "MICROSAR RTE" VAL_BLK 0x0 RTE_RL_SWORD 0 NO_COMPU_METHOD -32768 32767 MATRIX_DIM 20 12 1 SYMBOL_LINK "Rte_CalprmRom_CalRegn03Rt04GroupB_DEFAULT_RTE_CALPRM_GROUP.AssiMotTqWhlImbRejctnMaxY_Ary2D" 0 DISPLAY_IDENTIFIER AAACalRegn03Rt01GroupB_Dummy_4.CalibrationPorts.AssiMotTqWhlImbRejctnMaxY.Ary2D /end CHARACTERISTIC
/begin CHARACTERISTIC AAACalRegn03Rt01GroupB_Dummy_4.AssiWhlImbRejctnBlndScaX.Ary2D "MICROSAR RTE" VAL_BLK 0x0 RTE_RL_UWORD 0 NO_COMPU_METHOD 0 65535 MATRIX_DIM 5 12 1 SYMBOL_LINK "Rte_CalprmRom_CalRegn03Rt04GroupB_DEFAULT_RTE_CALPRM_GROUP.AssiWhlImbRejctnBlndScaX_Ary2D" 0 DISPLAY_IDENTIFIER AAACalRegn03Rt01GroupB_Dummy_4.CalibrationPorts.AssiWhlImbRejctnBlndScaX.Ary2D /end CHARACTERISTIC
/begin CHARACTERISTIC AAACalRegn03Rt01GroupB_Dummy_4.AssiWhlImbRejctnBlndScaY.Ary2D "MICROSAR RTE" VAL_BLK 0x0 RTE_RL_UWORD 0 NO_COMPU_METHOD 0 65535 MATRIX_DIM 5 12 1 SYMBOL_LINK "Rte_CalprmRom_CalRegn03Rt04GroupB_DEFAULT_RTE_CALPRM_GROUP.AssiWhlImbRejctnBlndScaY_Ary2D" 0 DISPLAY_IDENTIFIER AAACalRegn03Rt01GroupB_Dummy_4.CalibrationPorts.AssiWhlImbRejctnBlndScaY.Ary2D /end CHARACTERISTIC
/begin CHARACTERISTIC AAACalRegn03Rt01GroupB_Dummy_4.EotProtnDampgVehSpdTbl.Ary1D "MICROSAR RTE" VAL_BLK 0x0 RTE_RL_UWORD 0 NO_COMPU_METHOD 0 65535 MATRIX_DIM 4 1 1 SYMBOL_LINK "Rte_CalprmRom_CalRegn03Rt04GroupB_DEFAULT_RTE_CALPRM_GROUP.EotProtnDampgVehSpdTbl_Ary1D" 0 DISPLAY_IDENTIFIER AAACalRegn03Rt01GroupB_Dummy_4.CalibrationPorts.EotProtnDampgVehSpdTbl.Ary1D /end CHARACTERISTIC
/begin CHARACTERISTIC AAACalRegn03Rt01GroupB_Dummy_4.EotProtnEntrGainVehSpdTbl.Ary1D "MICROSAR RTE" VAL_BLK 0x0 RTE_RL_UWORD 0 NO_COMPU_METHOD 0 65535 MATRIX_DIM 5 1 1 SYMBOL_LINK "Rte_CalprmRom_CalRegn03Rt04GroupB_DEFAULT_RTE_CALPRM_GROUP.EotProtnEntrGainVehSpdTbl_Ary1D" 0 DISPLAY_IDENTIFIER AAACalRegn03Rt01GroupB_Dummy_4.CalibrationPorts.EotProtnEntrGainVehSpdTbl.Ary1D /end CHARACTERISTIC
/begin CHARACTERISTIC AAACalRegn03Rt01GroupB_Dummy_4.EotProtnEntrGainX.Ary2D "MICROSAR RTE" VAL_BLK 0x0 RTE_RL_UWORD 0 NO_COMPU_METHOD 0 65535 MATRIX_DIM 4 5 1 SYMBOL_LINK "Rte_CalprmRom_CalRegn03Rt04GroupB_DEFAULT_RTE_CALPRM_GROUP.EotProtnEntrGainX_Ary2D" 0 DISPLAY_IDENTIFIER AAACalRegn03Rt01GroupB_Dummy_4.CalibrationPorts.EotProtnEntrGainX.Ary2D /end CHARACTERISTIC
/begin CHARACTERISTIC AAACalRegn03Rt01GroupB_Dummy_4.EotProtnEntrGainY.Ary2D "MICROSAR RTE" VAL_BLK 0x0 RTE_RL_UWORD 0 NO_COMPU_METHOD 0 65535 MATRIX_DIM 4 5 1 SYMBOL_LINK "Rte_CalprmRom_CalRegn03Rt04GroupB_DEFAULT_RTE_CALPRM_GROUP.EotProtnEntrGainY_Ary2D" 0 DISPLAY_IDENTIFIER AAACalRegn03Rt01GroupB_Dummy_4.CalibrationPorts.EotProtnEntrGainY.Ary2D /end CHARACTERISTIC
/begin CHARACTERISTIC AAACalRegn03Rt01GroupB_Dummy_4.EotProtnExitDampgY.Ary2D "MICROSAR RTE" VAL_BLK 0x0 RTE_RL_UWORD 0 NO_COMPU_METHOD 0 65535 MATRIX_DIM 2 4 1 SYMBOL_LINK "Rte_CalprmRom_CalRegn03Rt04GroupB_DEFAULT_RTE_CALPRM_GROUP.EotProtnExitDampgY_Ary2D" 0 DISPLAY_IDENTIFIER AAACalRegn03Rt01GroupB_Dummy_4.CalibrationPorts.EotProtnExitDampgY.Ary2D /end CHARACTERISTIC
/begin CHARACTERISTIC AAACalRegn03Rt01GroupB_Dummy_4.EotProtnHwDegDampgX.Ary2D "MICROSAR RTE" VAL_BLK 0x0 RTE_RL_UWORD 0 NO_COMPU_METHOD 0 65535 MATRIX_DIM 2 4 1 SYMBOL_LINK "Rte_CalprmRom_CalRegn03Rt04GroupB_DEFAULT_RTE_CALPRM_GROUP.EotProtnHwDegDampgX_Ary2D" 0 DISPLAY_IDENTIFIER AAACalRegn03Rt01GroupB_Dummy_4.CalibrationPorts.EotProtnHwDegDampgX.Ary2D /end CHARACTERISTIC
/begin CHARACTERISTIC AAACalRegn03Rt01GroupB_Dummy_4.EotProtnNormDampgY.Ary2D "MICROSAR RTE" VAL_BLK 0x0 RTE_RL_UWORD 0 NO_COMPU_METHOD 0 65535 MATRIX_DIM 2 4 1 SYMBOL_LINK "Rte_CalprmRom_CalRegn03Rt04GroupB_DEFAULT_RTE_CALPRM_GROUP.EotProtnNormDampgY_Ary2D" 0 DISPLAY_IDENTIFIER AAACalRegn03Rt01GroupB_Dummy_4.CalibrationPorts.EotProtnNormDampgY.Ary2D /end CHARACTERISTIC
/begin CHARACTERISTIC AAACalRegn03Rt01GroupB_Dummy_4.InertiaCmpVelAssiBasdDampgRollgWhlImbRejctnOnY.Ary1D "MICROSAR RTE" VAL_BLK 0x0 RTE_RL_UWORD 0 NO_COMPU_METHOD 0 65535 MATRIX_DIM 10 1 1 SYMBOL_LINK "Rte_CalprmRom_CalRegn03Rt04GroupB_DEFAULT_RTE_CALPRM_GROUP.InertiaCmpVelAssiBasdDampgRollgWhlImbRejctnOnY_Ary1D" 0 DISPLAY_IDENTIFIER AAACalRegn03Rt01GroupB_Dummy_4.CalibrationPorts.InertiaCmpVelAssiBasdDampgRollgWhlImbRejctnOnY.Ary1D /end CHARACTERISTIC
/begin CHARACTERISTIC AAACalRegn03Rt01_Dummy.InertiaCmpVelDampgFilFrq.Ary1D "MICROSAR RTE" VAL_BLK 0x0 RTE_RL_UWORD 0 NO_COMPU_METHOD 0 65535 MATRIX_DIM 12 1 1 SYMBOL_LINK "Rte_CalprmRom_CalRegn03Rt00_DEFAULT_RTE_CALPRM_GROUP.InertiaCmpVelDampgFilFrq_Ary1D" 0 DISPLAY_IDENTIFIER AAACalRegn03Rt01_Dummy.CalibrationPorts.InertiaCmpVelDampgFilFrq.Ary1D /end CHARACTERISTIC
/begin CHARACTERISTIC AAACalRegn03Rt01_Dummy.InertiaCmpVelDampgFilFrqWhlImbRejctnOn.Ary1D "MICROSAR RTE" VAL_BLK 0x0 RTE_RL_UWORD 0 NO_COMPU_METHOD 0 65535 MATRIX_DIM 12 1 1 SYMBOL_LINK "Rte_CalprmRom_CalRegn03Rt00_DEFAULT_RTE_CALPRM_GROUP.InertiaCmpVelDampgFilFrqWhlImbRejctnOn_Ary1D" 0 DISPLAY_IDENTIFIER AAACalRegn03Rt01_Dummy.CalibrationPorts.InertiaCmpVelDampgFilFrqWhlImbRejctnOn.Ary1D /end CHARACTERISTIC
/begin CHARACTERISTIC AAACalRegn03Rt01_Dummy_1.InertiaCmpVelDampgFilFrq.Ary1D "MICROSAR RTE" VAL_BLK 0x0 RTE_RL_UWORD 0 NO_COMPU_METHOD 0 65535 MATRIX_DIM 12 1 1 SYMBOL_LINK "Rte_CalprmRom_CalRegn03Rt01_DEFAULT_RTE_CALPRM_GROUP.InertiaCmpVelDampgFilFrq_Ary1D" 0 DISPLAY_IDENTIFIER AAACalRegn03Rt01_Dummy_1.CalibrationPorts.InertiaCmpVelDampgFilFrq.Ary1D /end CHARACTERISTIC
/begin CHARACTERISTIC AAACalRegn03Rt01_Dummy_1.InertiaCmpVelDampgFilFrqWhlImbRejctnOn.Ary1D "MICROSAR RTE" VAL_BLK 0x0 RTE_RL_UWORD 0 NO_COMPU_METHOD 0 65535 MATRIX_DIM 12 1 1 SYMBOL_LINK "Rte_CalprmRom_CalRegn03Rt01_DEFAULT_RTE_CALPRM_GROUP.InertiaCmpVelDampgFilFrqWhlImbRejctnOn_Ary1D" 0 DISPLAY_IDENTIFIER AAACalRegn03Rt01_Dummy_1.CalibrationPorts.InertiaCmpVelDampgFilFrqWhlImbRejctnOn.Ary1D /end CHARACTERISTIC
/begin CHARACTERISTIC AAACalRegn03Rt01_Dummy_2.InertiaCmpVelDampgFilFrq.Ary1D "MICROSAR RTE" VAL_BLK 0x0 RTE_RL_UWORD 0 NO_COMPU_METHOD 0 65535 MATRIX_DIM 12 1 1 SYMBOL_LINK "Rte_CalprmRom_CalRegn03Rt02_DEFAULT_RTE_CALPRM_GROUP.InertiaCmpVelDampgFilFrq_Ary1D" 0 DISPLAY_IDENTIFIER AAACalRegn03Rt01_Dummy_2.CalibrationPorts.InertiaCmpVelDampgFilFrq.Ary1D /end CHARACTERISTIC
/begin CHARACTERISTIC AAACalRegn03Rt01_Dummy_2.InertiaCmpVelDampgFilFrqWhlImbRejctnOn.Ary1D "MICROSAR RTE" VAL_BLK 0x0 RTE_RL_UWORD 0 NO_COMPU_METHOD 0 65535 MATRIX_DIM 12 1 1 SYMBOL_LINK "Rte_CalprmRom_CalRegn03Rt02_DEFAULT_RTE_CALPRM_GROUP.InertiaCmpVelDampgFilFrqWhlImbRejctnOn_Ary1D" 0 DISPLAY_IDENTIFIER AAACalRegn03Rt01_Dummy_2.CalibrationPorts.InertiaCmpVelDampgFilFrqWhlImbRejctnOn.Ary1D /end CHARACTERISTIC
/begin CHARACTERISTIC AAACalRegn03Rt01_Dummy_3.InertiaCmpVelDampgFilFrq.Ary1D "MICROSAR RTE" VAL_BLK 0x0 RTE_RL_UWORD 0 NO_COMPU_METHOD 0 65535 MATRIX_DIM 12 1 1 SYMBOL_LINK "Rte_CalprmRom_CalRegn03Rt03_DEFAULT_RTE_CALPRM_GROUP.InertiaCmpVelDampgFilFrq_Ary1D" 0 DISPLAY_IDENTIFIER AAACalRegn03Rt01_Dummy_3.CalibrationPorts.InertiaCmpVelDampgFilFrq.Ary1D /end CHARACTERISTIC
/begin CHARACTERISTIC AAACalRegn03Rt01_Dummy_3.InertiaCmpVelDampgFilFrqWhlImbRejctnOn.Ary1D "MICROSAR RTE" VAL_BLK 0x0 RTE_RL_UWORD 0 NO_COMPU_METHOD 0 65535 MATRIX_DIM 12 1 1 SYMBOL_LINK "Rte_CalprmRom_CalRegn03Rt03_DEFAULT_RTE_CALPRM_GROUP.InertiaCmpVelDampgFilFrqWhlImbRejctnOn_Ary1D" 0 DISPLAY_IDENTIFIER AAACalRegn03Rt01_Dummy_3.CalibrationPorts.InertiaCmpVelDampgFilFrqWhlImbRejctnOn.Ary1D /end CHARACTERISTIC
/begin CHARACTERISTIC AAACalRegn03Rt01_Dummy_4.InertiaCmpVelDampgFilFrq.Ary1D "MICROSAR RTE" VAL_BLK 0x0 RTE_RL_UWORD 0 NO_COMPU_METHOD 0 65535 MATRIX_DIM 12 1 1 SYMBOL_LINK "Rte_CalprmRom_CalRegn03Rt04_DEFAULT_RTE_CALPRM_GROUP.InertiaCmpVelDampgFilFrq_Ary1D" 0 DISPLAY_IDENTIFIER AAACalRegn03Rt01_Dummy_4.CalibrationPorts.InertiaCmpVelDampgFilFrq.Ary1D /end CHARACTERISTIC
/begin CHARACTERISTIC AAACalRegn03Rt01_Dummy_4.InertiaCmpVelDampgFilFrqWhlImbRejctnOn.Ary1D "MICROSAR RTE" VAL_BLK 0x0 RTE_RL_UWORD 0 NO_COMPU_METHOD 0 65535 MATRIX_DIM 12 1 1 SYMBOL_LINK "Rte_CalprmRom_CalRegn03Rt04_DEFAULT_RTE_CALPRM_GROUP.InertiaCmpVelDampgFilFrqWhlImbRejctnOn_Ary1D" 0 DISPLAY_IDENTIFIER AAACalRegn03Rt01_Dummy_4.CalibrationPorts.InertiaCmpVelDampgFilFrqWhlImbRejctnOn.Ary1D /end CHARACTERISTIC
/begin CHARACTERISTIC Assi.AssiMotTqWhlImbRejctnMaxX.Ary2D "MICROSAR RTE" VAL_BLK 0x0 RTE_RL_UWORD 0 RTE_CM_Tq6 0 10 MATRIX_DIM 20 12 1 SYMBOL_LINK "Rte_CalprmRom_CalRegn03Rt00GroupB_DEFAULT_RTE_CALPRM_GROUP.AssiMotTqWhlImbRejctnMaxX_Ary2D" 0 DISPLAY_IDENTIFIER Assi.CalibrationPorts.AssiMotTqWhlImbRejctnMaxX.Ary2D /end CHARACTERISTIC
/begin CHARACTERISTIC Assi.AssiMotTqWhlImbRejctnMaxY.Ary2D "MICROSAR RTE" VAL_BLK 0x0 RTE_RL_SWORD 0 RTE_CM_Tq11 -1 15.99 MATRIX_DIM 20 12 1 SYMBOL_LINK "Rte_CalprmRom_CalRegn03Rt00GroupB_DEFAULT_RTE_CALPRM_GROUP.AssiMotTqWhlImbRejctnMaxY_Ary2D" 0 DISPLAY_IDENTIFIER Assi.CalibrationPorts.AssiMotTqWhlImbRejctnMaxY.Ary2D /end CHARACTERISTIC
/begin CHARACTERISTIC Assi.AssiMotTqWhlImbRejctnMinX.Ary2D "MICROSAR RTE" VAL_BLK 0x0 RTE_RL_UWORD 0 RTE_CM_Tq6 0 10 MATRIX_DIM 20 12 1 SYMBOL_LINK "Rte_CalprmRom_CalRegn03Rt00GroupA_DEFAULT_RTE_CALPRM_GROUP.AssiMotTqWhlImbRejctnMinX_Ary2D" 0 DISPLAY_IDENTIFIER Assi.CalibrationPorts.AssiMotTqWhlImbRejctnMinX.Ary2D /end CHARACTERISTIC
/begin CHARACTERISTIC Assi.AssiMotTqWhlImbRejctnMinY.Ary2D "MICROSAR RTE" VAL_BLK 0x0 RTE_RL_SWORD 0 RTE_CM_Tq11 -1 15.99 MATRIX_DIM 20 12 1 SYMBOL_LINK "Rte_CalprmRom_CalRegn03Rt00GroupA_DEFAULT_RTE_CALPRM_GROUP.AssiMotTqWhlImbRejctnMinY_Ary2D" 0 DISPLAY_IDENTIFIER Assi.CalibrationPorts.AssiMotTqWhlImbRejctnMinY.Ary2D /end CHARACTERISTIC
/begin CHARACTERISTIC Assi.AssiThermScaX.Ary1D "MICROSAR RTE" VAL_BLK 0x0 RTE_RL_UWORD 0 NO_COMPU_METHOD 0.0 200.0 MATRIX_DIM 2 1 1 SYMBOL_LINK "Rte_CalprmRom_CalRegn03CmnGroupA_DEFAULT_RTE_CALPRM_GROUP.AssiThermScaX_Ary1D" 0 DISPLAY_IDENTIFIER Assi.CalibrationPorts.AssiThermScaX.Ary1D /end CHARACTERISTIC
/begin CHARACTERISTIC Assi.AssiThermScaY.Ary1D "MICROSAR RTE" VAL_BLK 0x0 RTE_RL_UWORD 0 RTE_CM_Uls4 0 1 MATRIX_DIM 2 1 1 SYMBOL_LINK "Rte_CalprmRom_CalRegn03CmnGroupA_DEFAULT_RTE_CALPRM_GROUP.AssiThermScaY_Ary1D" 0 DISPLAY_IDENTIFIER Assi.CalibrationPorts.AssiThermScaY.Ary1D /end CHARACTERISTIC
/begin CHARACTERISTIC Assi.AssiWhlImbRejctnBlndScaX.Ary2D "MICROSAR RTE" VAL_BLK 0x0 RTE_RL_UWORD 0 RTE_CM_Tq12 0 8.8 MATRIX_DIM 5 12 1 SYMBOL_LINK "Rte_CalprmRom_CalRegn03Rt00GroupB_DEFAULT_RTE_CALPRM_GROUP.AssiWhlImbRejctnBlndScaX_Ary2D" 0 DISPLAY_IDENTIFIER Assi.CalibrationPorts.AssiWhlImbRejctnBlndScaX.Ary2D /end CHARACTERISTIC
/begin CHARACTERISTIC Assi.AssiWhlImbRejctnBlndScaY.Ary2D "MICROSAR RTE" VAL_BLK 0x0 RTE_RL_UWORD 0 RTE_CM_Uls4 0 1 MATRIX_DIM 5 12 1 SYMBOL_LINK "Rte_CalprmRom_CalRegn03Rt00GroupB_DEFAULT_RTE_CALPRM_GROUP.AssiWhlImbRejctnBlndScaY_Ary2D" 0 DISPLAY_IDENTIFIER Assi.CalibrationPorts.AssiWhlImbRejctnBlndScaY.Ary2D /end CHARACTERISTIC
/begin CHARACTERISTIC Assi.SysGlbPrmVehSpd.Ary1D "MICROSAR RTE" VAL_BLK 0x0 RTE_RL_UWORD 0 RTE_CM_Spd2 0 511 MATRIX_DIM 12 1 1 SYMBOL_LINK "Rte_CalprmRom_CalRegn01Cmn_DEFAULT_RTE_CALPRM_GROUP.SysGlbPrmVehSpdBilnrSeln_Ary1D" 0 DISPLAY_IDENTIFIER Assi.CalibrationPorts.SysGlbPrmVehSpd.Ary1D /end CHARACTERISTIC
/begin CHARACTERISTIC Assi.SysGlbPrmVehSpdBilnrSeln.Ary1D "MICROSAR RTE" VAL_BLK 0x0 RTE_RL_UWORD 0 RTE_CM_Spd2 0 511 MATRIX_DIM 12 1 1 SYMBOL_LINK "Rte_CalprmRom_CalRegn01Cmn_DEFAULT_RTE_CALPRM_GROUP.SysGlbPrmVehSpdBilnrSeln_Ary1D" 0 DISPLAY_IDENTIFIER Assi.CalibrationPorts.SysGlbPrmVehSpdBilnrSeln.Ary1D /end CHARACTERISTIC
/begin CHARACTERISTIC AssiHiFrq.AssiHiFrqGainY.Ary2D "MICROSAR RTE" VAL_BLK 0x0 RTE_RL_UWORD 0 NO_COMPU_METHOD 0 65535 MATRIX_DIM 13 12 1 SYMBOL_LINK "Rte_CalprmRom_CalRegn03Rt00GroupA_DEFAULT_RTE_CALPRM_GROUP.AssiHiFrqGainY_Ary2D" 0 DISPLAY_IDENTIFIER AssiHiFrq.CalibrationPorts.AssiHiFrqGainY.Ary2D /end CHARACTERISTIC
/begin CHARACTERISTIC AssiHiFrq.AssiHiFrqHpFilFrq.Val "MICROSAR RTE" VALUE 0x0 RTE_RL_FLOAT32_IEEE 0 NO_COMPU_METHOD -3.402823466e+38 3.402823466e+38 SYMBOL_LINK "Rte_CalprmRom_CalRegn03Inin00_DEFAULT_RTE_CALPRM_GROUP.AssiHiFrqHpFilFrq_Val" 0 DISPLAY_IDENTIFIER AssiHiFrq.CalibrationPorts.AssiHiFrqHpFilFrq.Val /end CHARACTERISTIC
/begin CHARACTERISTIC AssiHiFrq.AssiHiFrqHpFilFrqY.Ary1D "MICROSAR RTE" VAL_BLK 0x0 RTE_RL_UWORD 0 NO_COMPU_METHOD 0 65535 MATRIX_DIM 12 1 1 SYMBOL_LINK "Rte_CalprmRom_CalRegn03Cmn_DEFAULT_RTE_CALPRM_GROUP.AssiHiFrqHpFilFrqY_Ary1D" 0 DISPLAY_IDENTIFIER AssiHiFrq.CalibrationPorts.AssiHiFrqHpFilFrqY.Ary1D /end CHARACTERISTIC
/begin CHARACTERISTIC AssiHiFrq.AssiHiFrqTqWhlImbRejctnTqX.Ary2D "MICROSAR RTE" VAL_BLK 0x0 RTE_RL_UWORD 0 NO_COMPU_METHOD 0 65535 MATRIX_DIM 13 12 1 SYMBOL_LINK "Rte_CalprmRom_CalRegn03Rt00GroupB_DEFAULT_RTE_CALPRM_GROUP.AssiHiFrqTqWhlImbRejctnTqX_Ary2D" 0 DISPLAY_IDENTIFIER AssiHiFrq.CalibrationPorts.AssiHiFrqTqWhlImbRejctnTqX.Ary2D /end CHARACTERISTIC
/begin CHARACTERISTIC AssiHiFrq.AssiHiFrqTqX.Ary2D "MICROSAR RTE" VAL_BLK 0x0 RTE_RL_UWORD 0 NO_COMPU_METHOD 0 65535 MATRIX_DIM 13 12 1 SYMBOL_LINK "Rte_CalprmRom_CalRegn03Rt00GroupA_DEFAULT_RTE_CALPRM_GROUP.AssiHiFrqTqX_Ary2D" 0 DISPLAY_IDENTIFIER AssiHiFrq.CalibrationPorts.AssiHiFrqTqX.Ary2D /end CHARACTERISTIC
/begin CHARACTERISTIC AssiHiFrq.AssiHiFrqWhlImbRejctnBlndX.Ary2D "MICROSAR RTE" VAL_BLK 0x0 RTE_RL_UWORD 0 NO_COMPU_METHOD 0 65535 MATRIX_DIM 5 12 1 SYMBOL_LINK "Rte_CalprmRom_CalRegn03Rt00GroupB_DEFAULT_RTE_CALPRM_GROUP.AssiHiFrqWhlImbRejctnBlndX_Ary2D" 0 DISPLAY_IDENTIFIER AssiHiFrq.CalibrationPorts.AssiHiFrqWhlImbRejctnBlndX.Ary2D /end CHARACTERISTIC
/begin CHARACTERISTIC AssiHiFrq.AssiHiFrqWhlImbRejctnBlndY.Ary2D "MICROSAR RTE" VAL_BLK 0x0 RTE_RL_UWORD 0 NO_COMPU_METHOD 0 65535 MATRIX_DIM 5 12 1 SYMBOL_LINK "Rte_CalprmRom_CalRegn03Rt00GroupB_DEFAULT_RTE_CALPRM_GROUP.AssiHiFrqWhlImbRejctnBlndY_Ary2D" 0 DISPLAY_IDENTIFIER AssiHiFrq.CalibrationPorts.AssiHiFrqWhlImbRejctnBlndY.Ary2D /end CHARACTERISTIC
/begin CHARACTERISTIC AssiHiFrq.AssiHiFrqWhlImbRejctnGainY.Ary2D "MICROSAR RTE" VAL_BLK 0x0 RTE_RL_UWORD 0 NO_COMPU_METHOD 0 65535 MATRIX_DIM 13 12 1 SYMBOL_LINK "Rte_CalprmRom_CalRegn03Rt00GroupB_DEFAULT_RTE_CALPRM_GROUP.AssiHiFrqWhlImbRejctnGainY_Ary2D" 0 DISPLAY_IDENTIFIER AssiHiFrq.CalibrationPorts.AssiHiFrqWhlImbRejctnGainY.Ary2D /end CHARACTERISTIC
/begin CHARACTERISTIC AssiHiFrq.SysGlbPrmVehSpdBilnrSeln.Ary1D "MICROSAR RTE" VAL_BLK 0x0 RTE_RL_UWORD 0 NO_COMPU_METHOD 0 65535 MATRIX_DIM 12 1 1 SYMBOL_LINK "Rte_CalprmRom_CalRegn01Cmn_DEFAULT_RTE_CALPRM_GROUP.SysGlbPrmVehSpdBilnrSeln_Ary1D" 0 DISPLAY_IDENTIFIER AssiHiFrq.CalibrationPorts.SysGlbPrmVehSpdBilnrSeln.Ary1D /end CHARACTERISTIC
/begin CHARACTERISTIC AssiPahFwl.AssiPahFwlCmdSplitLpFilFrq.Val "MICROSAR RTE" VALUE 0x0 RTE_RL_FLOAT32_IEEE 0 NO_COMPU_METHOD -3.402823466e+38 3.402823466e+38 SYMBOL_LINK "Rte_CalprmRom_CalRegn01Inin00_DEFAULT_RTE_CALPRM_GROUP.AssiPahFwlCmdSplitLpFilFrq_Val" 0 DISPLAY_IDENTIFIER AssiPahFwl.CalibrationPorts.AssiPahFwlCmdSplitLpFilFrq.Val /end CHARACTERISTIC
/begin CHARACTERISTIC AssiPahFwl.AssiPahFwlDftAssiX.Ary1D "MICROSAR RTE" VAL_BLK 0x0 RTE_RL_UWORD 0 NO_COMPU_METHOD 0 65535 MATRIX_DIM 20 1 1 SYMBOL_LINK "Rte_CalprmRom_CalRegn01Inin00_DEFAULT_RTE_CALPRM_GROUP.AssiPahFwlDftAssiX_Ary1D" 0 DISPLAY_IDENTIFIER AssiPahFwl.CalibrationPorts.AssiPahFwlDftAssiX.Ary1D /end CHARACTERISTIC
/begin CHARACTERISTIC AssiPahFwl.AssiPahFwlDftAssiY.Ary1D "MICROSAR RTE" VAL_BLK 0x0 RTE_RL_SWORD 0 NO_COMPU_METHOD -32768 32767 MATRIX_DIM 20 1 1 SYMBOL_LINK "Rte_CalprmRom_CalRegn01Inin00_DEFAULT_RTE_CALPRM_GROUP.AssiPahFwlDftAssiY_Ary1D" 0 DISPLAY_IDENTIFIER AssiPahFwl.CalibrationPorts.AssiPahFwlDftAssiY.Ary1D /end CHARACTERISTIC
/begin CHARACTERISTIC AssiPahFwl.AssiPahFwlDiRcvr.Logl "MICROSAR RTE" VALUE 0x0 RTE_RL_BOOLEAN 0 RTE_CM_BOOLEAN 0 255 SYMBOL_LINK "Rte_CalprmRom_CalRegn01Cmn_DEFAULT_RTE_CALPRM_GROUP.AssiPahFwlDiRcvr_Logl" 0 DISPLAY_IDENTIFIER AssiPahFwl.CalibrationPorts.AssiPahFwlDiRcvr.Logl /end CHARACTERISTIC
/begin CHARACTERISTIC AssiPahFwl.AssiPahFwlFwlActvLpFilFrq.Val "MICROSAR RTE" VALUE 0x0 RTE_RL_FLOAT32_IEEE 0 NO_COMPU_METHOD -3.402823466e+38 3.402823466e+38 SYMBOL_LINK "Rte_CalprmRom_CalRegn01Inin00_DEFAULT_RTE_CALPRM_GROUP.AssiPahFwlFwlActvLpFilFrq_Val" 0 DISPLAY_IDENTIFIER AssiPahFwl.CalibrationPorts.AssiPahFwlFwlActvLpFilFrq.Val /end CHARACTERISTIC
/begin CHARACTERISTIC AssiPahFwl.AssiPahFwlHiFrqUpprLimY.Ary2D "MICROSAR RTE" VAL_BLK 0x0 RTE_RL_SWORD 0 NO_COMPU_METHOD -32768 32767 MATRIX_DIM 11 12 1 SYMBOL_LINK "Rte_CalprmRom_CalRegn01Inin00_DEFAULT_RTE_CALPRM_GROUP.AssiPahFwlHiFrqUpprLimY_Ary2D" 0 DISPLAY_IDENTIFIER AssiPahFwl.CalibrationPorts.AssiPahFwlHiFrqUpprLimY.Ary2D /end CHARACTERISTIC
/begin CHARACTERISTIC AssiPahFwl.AssiPahFwlHysCmpLim.Val "MICROSAR RTE" VALUE 0x0 RTE_RL_FLOAT32_IEEE 0 NO_COMPU_METHOD -3.402823466e+38 3.402823466e+38 SYMBOL_LINK "Rte_CalprmRom_CalRegn01Inin00_DEFAULT_RTE_CALPRM_GROUP.AssiPahFwlHysCmpLim_Val" 0 DISPLAY_IDENTIFIER AssiPahFwl.CalibrationPorts.AssiPahFwlHysCmpLim.Val /end CHARACTERISTIC
/begin CHARACTERISTIC AssiPahFwl.AssiPahFwlRestoreThd.Val "MICROSAR RTE" VALUE 0x0 RTE_RL_FLOAT32_IEEE 0 NO_COMPU_METHOD -3.402823466e+38 3.402823466e+38 SYMBOL_LINK "Rte_CalprmRom_CalRegn01Inin00_DEFAULT_RTE_CALPRM_GROUP.AssiPahFwlRestoreThd_Val" 0 DISPLAY_IDENTIFIER AssiPahFwl.CalibrationPorts.AssiPahFwlRestoreThd.Val /end CHARACTERISTIC
/begin CHARACTERISTIC AssiPahFwl.AssiPahFwlUpprLimX.Ary2D "MICROSAR RTE" VAL_BLK 0x0 RTE_RL_SWORD 0 NO_COMPU_METHOD -32768 32767 MATRIX_DIM 11 12 1 SYMBOL_LINK "Rte_CalprmRom_CalRegn01Inin00_DEFAULT_RTE_CALPRM_GROUP.AssiPahFwlUpprLimX_Ary2D" 0 DISPLAY_IDENTIFIER AssiPahFwl.CalibrationPorts.AssiPahFwlUpprLimX.Ary2D /end CHARACTERISTIC
/begin CHARACTERISTIC AssiPahFwl.AssiPahFwlUpprLimY.Ary2D "MICROSAR RTE" VAL_BLK 0x0 RTE_RL_SWORD 0 NO_COMPU_METHOD -32768 32767 MATRIX_DIM 11 12 1 SYMBOL_LINK "Rte_CalprmRom_CalRegn01Inin00_DEFAULT_RTE_CALPRM_GROUP.AssiPahFwlUpprLimY_Ary2D" 0 DISPLAY_IDENTIFIER AssiPahFwl.CalibrationPorts.AssiPahFwlUpprLimY.Ary2D /end CHARACTERISTIC
/begin CHARACTERISTIC AssiPahFwl.AssiPahFwlVehSpd.Ary1D "MICROSAR RTE" VAL_BLK 0x0 RTE_RL_UWORD 0 NO_COMPU_METHOD 0 65535 MATRIX_DIM 12 1 1 SYMBOL_LINK "Rte_CalprmRom_CalRegn01Cmn_DEFAULT_RTE_CALPRM_GROUP.AssiPahFwlVehSpd_Ary1D" 0 DISPLAY_IDENTIFIER AssiPahFwl.CalibrationPorts.AssiPahFwlVehSpd.Ary1D /end CHARACTERISTIC
/begin CHARACTERISTIC AssiPahFwl.BasAssiPahFwlOverLimDiagcFailStep.Val "MICROSAR RTE" VALUE 0x0 RTE_RL_UWORD 0 NO_COMPU_METHOD 0 65535 SYMBOL_LINK "Rte_CalprmRom_CalRegn01Cmn_DEFAULT_RTE_CALPRM_GROUP.BasAssiPahFwlOverLimDiagcFailStep_Val" 0 DISPLAY_IDENTIFIER AssiPahFwl.CalibrationPorts.BasAssiPahFwlOverLimDiagcFailStep.Val /end CHARACTERISTIC
/begin CHARACTERISTIC AssiPahFwl.BasAssiPahFwlOverLimDiagcPassStep.Val "MICROSAR RTE" VALUE 0x0 RTE_RL_UWORD 0 NO_COMPU_METHOD 0 65535 SYMBOL_LINK "Rte_CalprmRom_CalRegn01Cmn_DEFAULT_RTE_CALPRM_GROUP.BasAssiPahFwlOverLimDiagcPassStep_Val" 0 DISPLAY_IDENTIFIER AssiPahFwl.CalibrationPorts.BasAssiPahFwlOverLimDiagcPassStep.Val /end CHARACTERISTIC
/begin CHARACTERISTIC AssiPahFwl.HiFrqAssiPahFwlOverLimDiagcFailStep.Val "MICROSAR RTE" VALUE 0x0 RTE_RL_UWORD 0 NO_COMPU_METHOD 0 65535 SYMBOL_LINK "Rte_CalprmRom_CalRegn01Cmn_DEFAULT_RTE_CALPRM_GROUP.HiFrqAssiPahFwlOverLimDiagcFailStep_Val" 0 DISPLAY_IDENTIFIER AssiPahFwl.CalibrationPorts.HiFrqAssiPahFwlOverLimDiagcFailStep.Val /end CHARACTERISTIC
/begin CHARACTERISTIC AssiPahFwl.HiFrqAssiPahFwlOverLimDiagcPassStep.Val "MICROSAR RTE" VALUE 0x0 RTE_RL_UWORD 0 NO_COMPU_METHOD 0 65535 SYMBOL_LINK "Rte_CalprmRom_CalRegn01Cmn_DEFAULT_RTE_CALPRM_GROUP.HiFrqAssiPahFwlOverLimDiagcPassStep_Val" 0 DISPLAY_IDENTIFIER AssiPahFwl.CalibrationPorts.HiFrqAssiPahFwlOverLimDiagcPassStep.Val /end CHARACTERISTIC
/begin CHARACTERISTIC AssiSumLim.AssiSumLimNtc0x0C4FailStep.Val "MICROSAR RTE" VALUE 0x0 RTE_RL_UWORD 0 NO_COMPU_METHOD 0 65535 SYMBOL_LINK "Rte_CalprmRom_CalRegn01Cmn_DEFAULT_RTE_CALPRM_GROUP.AssiSumLimNtc0x0C4FailStep_Val" 0 DISPLAY_IDENTIFIER AssiSumLim.CalibrationPorts.AssiSumLimNtc0x0C4FailStep.Val /end CHARACTERISTIC
/begin CHARACTERISTIC AssiSumLim.AssiSumLimNtc0x0C4PassStep.Val "MICROSAR RTE" VALUE 0x0 RTE_RL_UWORD 0 NO_COMPU_METHOD 0 65535 SYMBOL_LINK "Rte_CalprmRom_CalRegn01Cmn_DEFAULT_RTE_CALPRM_GROUP.AssiSumLimNtc0x0C4PassStep_Val" 0 DISPLAY_IDENTIFIER AssiSumLim.CalibrationPorts.AssiSumLimNtc0x0C4PassStep.Val /end CHARACTERISTIC
/begin CHARACTERISTIC AssiSumLim.AssiSumLimPullCmpLim.Val "MICROSAR RTE" VALUE 0x0 RTE_RL_FLOAT32_IEEE 0 NO_COMPU_METHOD 0 8.8 SYMBOL_LINK "Rte_CalprmRom_CalRegn01Cmn_DEFAULT_RTE_CALPRM_GROUP.AssiSumLimPullCmpLim_Val" 0 DISPLAY_IDENTIFIER AssiSumLim.CalibrationPorts.AssiSumLimPullCmpLim.Val /end CHARACTERISTIC
/begin CHARACTERISTIC BattVltg.BattVltgCorrlnSysMinVltg.Val "MICROSAR RTE" VALUE 0x0 RTE_RL_FLOAT32_IEEE 0 NO_COMPU_METHOD -3.402823466e+38 3.402823466e+38 SYMBOL_LINK "Rte_CalprmRom_CalRegn01Cmn_DEFAULT_RTE_CALPRM_GROUP.BattVltgCorrlnSysMinVltg_Val" 0 DISPLAY_IDENTIFIER BattVltg.CalibrationPorts.BattVltgCorrlnSysMinVltg.Val /end CHARACTERISTIC
/begin CHARACTERISTIC BattVltg.BattVltgSwdMax.Val "MICROSAR RTE" VALUE 0x0 RTE_RL_FLOAT32_IEEE 0 NO_COMPU_METHOD 6.0 26.5 SYMBOL_LINK "Rte_CalprmRom_CalRegn01Cmn_DEFAULT_RTE_CALPRM_GROUP.BattVltgSwdMax_Val" 0 DISPLAY_IDENTIFIER BattVltg.CalibrationPorts.BattVltgSwdMax.Val /end CHARACTERISTIC
/begin CHARACTERISTIC BattVltg.BrdgVltgMax.Val "MICROSAR RTE" VALUE 0x0 RTE_RL_FLOAT32_IEEE 0 NO_COMPU_METHOD -3.402823466e+38 3.402823466e+38 SYMBOL_LINK "Rte_CalprmRom_CalRegn01Cmn_DEFAULT_RTE_CALPRM_GROUP.BrdgVltgMax_Val" 0 DISPLAY_IDENTIFIER BattVltg.CalibrationPorts.BrdgVltgMax.Val /end CHARACTERISTIC
/begin CHARACTERISTIC BattVltgCorrln.BattVltgCorrlnAllwdVltgDif.Val "MICROSAR RTE" VALUE 0x0 RTE_RL_FLOAT32_IEEE 0 NO_COMPU_METHOD -3.402823466e+38 3.402823466e+38 SYMBOL_LINK "Rte_CalprmRom_CalRegn01Cmn_DEFAULT_RTE_CALPRM_GROUP.BattVltgCorrlnAllwdVltgDif_Val" 0 DISPLAY_IDENTIFIER BattVltgCorrln.CalibrationPorts.BattVltgCorrlnAllwdVltgDif.Val /end CHARACTERISTIC
/begin CHARACTERISTIC BattVltgCorrln.BattVltgCorrlnBattLoVltg.Val "MICROSAR RTE" VALUE 0x0 RTE_RL_FLOAT32_IEEE 0 NO_COMPU_METHOD -3.402823466e+38 3.402823466e+38 SYMBOL_LINK "Rte_CalprmRom_CalRegn01Cmn_DEFAULT_RTE_CALPRM_GROUP.BattVltgCorrlnBattLoVltg_Val" 0 DISPLAY_IDENTIFIER BattVltgCorrln.CalibrationPorts.BattVltgCorrlnBattLoVltg.Val /end CHARACTERISTIC
/begin CHARACTERISTIC BattVltgCorrln.BattVltgCorrlnBattOverVltg.Val "MICROSAR RTE" VALUE 0x0 RTE_RL_FLOAT32_IEEE 0 NO_COMPU_METHOD -3.402823466e+38 3.402823466e+38 SYMBOL_LINK "Rte_CalprmRom_CalRegn01Cmn_DEFAULT_RTE_CALPRM_GROUP.BattVltgCorrlnBattOverVltg_Val" 0 DISPLAY_IDENTIFIER BattVltgCorrln.CalibrationPorts.BattVltgCorrlnBattOverVltg.Val /end CHARACTERISTIC
/begin CHARACTERISTIC BattVltgCorrln.BattVltgCorrlnBattUnderVltg.Val "MICROSAR RTE" VALUE 0x0 RTE_RL_FLOAT32_IEEE 0 NO_COMPU_METHOD -3.402823466e+38 3.402823466e+38 SYMBOL_LINK "Rte_CalprmRom_CalRegn01Cmn_DEFAULT_RTE_CALPRM_GROUP.BattVltgCorrlnBattUnderVltg_Val" 0 DISPLAY_IDENTIFIER BattVltgCorrln.CalibrationPorts.BattVltgCorrlnBattUnderVltg.Val /end CHARACTERISTIC
/begin CHARACTERISTIC BattVltgCorrln.BattVltgCorrlnNtc0x03C0x0440x04CFailStep.Val "MICROSAR RTE" VALUE 0x0 RTE_RL_UWORD 0 NO_COMPU_METHOD 0 65535 SYMBOL_LINK "Rte_CalprmRom_CalRegn01Cmn_DEFAULT_RTE_CALPRM_GROUP.BattVltgCorrlnNtc0x03C0x0440x04CFailStep_Val" 0 DISPLAY_IDENTIFIER BattVltgCorrln.CalibrationPorts.BattVltgCorrlnNtc0x03C0x0440x04CFailStep.Val /end CHARACTERISTIC
/begin CHARACTERISTIC BattVltgCorrln.BattVltgCorrlnNtc0x03C0x0440x04CPassStep.Val "MICROSAR RTE" VALUE 0x0 RTE_RL_UWORD 0 NO_COMPU_METHOD 0 65535 SYMBOL_LINK "Rte_CalprmRom_CalRegn01Cmn_DEFAULT_RTE_CALPRM_GROUP.BattVltgCorrlnNtc0x03C0x0440x04CPassStep_Val" 0 DISPLAY_IDENTIFIER BattVltgCorrln.CalibrationPorts.BattVltgCorrlnNtc0x03C0x0440x04CPassStep.Val /end CHARACTERISTIC
/begin CHARACTERISTIC BattVltgCorrln.BattVltgCorrlnNtc0x03DFailStep.Val "MICROSAR RTE" VALUE 0x0 RTE_RL_UWORD 0 NO_COMPU_METHOD 0 65535 SYMBOL_LINK "Rte_CalprmRom_CalRegn01Cmn_DEFAULT_RTE_CALPRM_GROUP.BattVltgCorrlnNtc0x03DFailStep_Val" 0 DISPLAY_IDENTIFIER BattVltgCorrln.CalibrationPorts.BattVltgCorrlnNtc0x03DFailStep.Val /end CHARACTERISTIC
/begin CHARACTERISTIC BattVltgCorrln.BattVltgCorrlnNtc0x03DPassStep.Val "MICROSAR RTE" VALUE 0x0 RTE_RL_UWORD 0 NO_COMPU_METHOD 0 65535 SYMBOL_LINK "Rte_CalprmRom_CalRegn01Cmn_DEFAULT_RTE_CALPRM_GROUP.BattVltgCorrlnNtc0x03DPassStep_Val" 0 DISPLAY_IDENTIFIER BattVltgCorrln.CalibrationPorts.BattVltgCorrlnNtc0x03DPassStep.Val /end CHARACTERISTIC
/begin CHARACTERISTIC BattVltgCorrln.BattVltgCorrlnNtc0x0B0FailStep.Val "MICROSAR RTE" VALUE 0x0 RTE_RL_UWORD 0 NO_COMPU_METHOD 0 65535 SYMBOL_LINK "Rte_CalprmRom_CalRegn01Cmn_DEFAULT_RTE_CALPRM_GROUP.BattVltgCorrlnNtc0x0B0FailStep_Val" 0 DISPLAY_IDENTIFIER BattVltgCorrln.CalibrationPorts.BattVltgCorrlnNtc0x0B0FailStep.Val /end CHARACTERISTIC
/begin CHARACTERISTIC BattVltgCorrln.BattVltgCorrlnNtc0x0B0PassStep.Val "MICROSAR RTE" VALUE 0x0 RTE_RL_UWORD 0 NO_COMPU_METHOD 0 65535 SYMBOL_LINK "Rte_CalprmRom_CalRegn01Cmn_DEFAULT_RTE_CALPRM_GROUP.BattVltgCorrlnNtc0x0B0PassStep_Val" 0 DISPLAY_IDENTIFIER BattVltgCorrln.CalibrationPorts.BattVltgCorrlnNtc0x0B0PassStep.Val /end CHARACTERISTIC
/begin CHARACTERISTIC BattVltgCorrln.BattVltgCorrlnNtc0x0B1FailStep.Val "MICROSAR RTE" VALUE 0x0 RTE_RL_UWORD 0 NO_COMPU_METHOD 0 65535 SYMBOL_LINK "Rte_CalprmRom_CalRegn01Cmn_DEFAULT_RTE_CALPRM_GROUP.BattVltgCorrlnNtc0x0B1FailStep_Val" 0 DISPLAY_IDENTIFIER BattVltgCorrln.CalibrationPorts.BattVltgCorrlnNtc0x0B1FailStep.Val /end CHARACTERISTIC
/begin CHARACTERISTIC BattVltgCorrln.BattVltgCorrlnNtc0x0B1PassStep.Val "MICROSAR RTE" VALUE 0x0 RTE_RL_UWORD 0 NO_COMPU_METHOD 0 65535 SYMBOL_LINK "Rte_CalprmRom_CalRegn01Cmn_DEFAULT_RTE_CALPRM_GROUP.BattVltgCorrlnNtc0x0B1PassStep_Val" 0 DISPLAY_IDENTIFIER BattVltgCorrln.CalibrationPorts.BattVltgCorrlnNtc0x0B1PassStep.Val /end CHARACTERISTIC
/begin CHARACTERISTIC BattVltgCorrln.BattVltgCorrlnNtc0x0B5FailStep.Val "MICROSAR RTE" VALUE 0x0 RTE_RL_UWORD 0 NO_COMPU_METHOD 0 65535 SYMBOL_LINK "Rte_CalprmRom_CalRegn01Cmn_DEFAULT_RTE_CALPRM_GROUP.BattVltgCorrlnNtc0x0B5FailStep_Val" 0 DISPLAY_IDENTIFIER BattVltgCorrln.CalibrationPorts.BattVltgCorrlnNtc0x0B5FailStep.Val /end CHARACTERISTIC
/begin CHARACTERISTIC BattVltgCorrln.BattVltgCorrlnNtc0x0B5PassStep.Val "MICROSAR RTE" VALUE 0x0 RTE_RL_UWORD 0 NO_COMPU_METHOD 0 65535 SYMBOL_LINK "Rte_CalprmRom_CalRegn01Cmn_DEFAULT_RTE_CALPRM_GROUP.BattVltgCorrlnNtc0x0B5PassStep_Val" 0 DISPLAY_IDENTIFIER BattVltgCorrln.CalibrationPorts.BattVltgCorrlnNtc0x0B5PassStep.Val /end CHARACTERISTIC
/begin CHARACTERISTIC BattVltgCorrln.BattVltgCorrlnRcvrlBattLoVltg.Val "MICROSAR RTE" VALUE 0x0 RTE_RL_FLOAT32_IEEE 0 NO_COMPU_METHOD -3.402823466e+38 3.402823466e+38 SYMBOL_LINK "Rte_CalprmRom_CalRegn01Cmn_DEFAULT_RTE_CALPRM_GROUP.BattVltgCorrlnRcvrlBattLoVltg_Val" 0 DISPLAY_IDENTIFIER BattVltgCorrln.CalibrationPorts.BattVltgCorrlnRcvrlBattLoVltg.Val /end CHARACTERISTIC
/begin CHARACTERISTIC BattVltgCorrln.BattVltgCorrlnRcvrlBattOverVltg.Val "MICROSAR RTE" VALUE 0x0 RTE_RL_FLOAT32_IEEE 0 NO_COMPU_METHOD -3.402823466e+38 3.402823466e+38 SYMBOL_LINK "Rte_CalprmRom_CalRegn01Cmn_DEFAULT_RTE_CALPRM_GROUP.BattVltgCorrlnRcvrlBattOverVltg_Val" 0 DISPLAY_IDENTIFIER BattVltgCorrln.CalibrationPorts.BattVltgCorrlnRcvrlBattOverVltg.Val /end CHARACTERISTIC
/begin CHARACTERISTIC BattVltgCorrln.BattVltgCorrlnRcvrlBattUnderVltg.Val "MICROSAR RTE" VALUE 0x0 RTE_RL_FLOAT32_IEEE 0 NO_COMPU_METHOD -3.402823466e+38 3.402823466e+38 SYMBOL_LINK "Rte_CalprmRom_CalRegn01Cmn_DEFAULT_RTE_CALPRM_GROUP.BattVltgCorrlnRcvrlBattUnderVltg_Val" 0 DISPLAY_IDENTIFIER BattVltgCorrln.CalibrationPorts.BattVltgCorrlnRcvrlBattUnderVltg.Val /end CHARACTERISTIC
/begin CHARACTERISTIC BattVltgCorrln.BattVltgCorrlnSysMinVltg.Val "MICROSAR RTE" VALUE 0x0 RTE_RL_FLOAT32_IEEE 0 NO_COMPU_METHOD -3.402823466e+38 3.402823466e+38 SYMBOL_LINK "Rte_CalprmRom_CalRegn01Cmn_DEFAULT_RTE_CALPRM_GROUP.BattVltgCorrlnSysMinVltg_Val" 0 DISPLAY_IDENTIFIER BattVltgCorrln.CalibrationPorts.BattVltgCorrlnSysMinVltg.Val /end CHARACTERISTIC
/begin CHARACTERISTIC BattVltgCorrln.BattVltgSwdMax.Val "MICROSAR RTE" VALUE 0x0 RTE_RL_FLOAT32_IEEE 0 NO_COMPU_METHOD -3.402823466e+38 3.402823466e+38 SYMBOL_LINK "Rte_CalprmRom_CalRegn01Cmn_DEFAULT_RTE_CALPRM_GROUP.BattVltgSwdMax_Val" 0 DISPLAY_IDENTIFIER BattVltgCorrln.CalibrationPorts.BattVltgSwdMax.Val /end CHARACTERISTIC
/begin CHARACTERISTIC CDD_AdcDiagc.AdcDiagcNtc0x032FailStep.Val "MICROSAR RTE" VALUE 0x0 RTE_RL_UWORD 0 NO_COMPU_METHOD 0 65535 SYMBOL_LINK "Rte_CalprmRom_CalRegn01Cmn_DEFAULT_RTE_CALPRM_GROUP.AdcDiagcNtc0x032FailStep_Val" 0 DISPLAY_IDENTIFIER CDD_AdcDiagc.CalibrationPorts.AdcDiagcNtc0x032FailStep.Val /end CHARACTERISTIC
/**********************************************************************************************************************
* MEASUREMENT
*********************************************************************************************************************/
/begin MEASUREMENT Assi.AssiCmdBas.Val "MICROSAR RTE" FLOAT32_IEEE NO_COMPU_METHOD 0 0 -8.8 8.8 ECU_ADDRESS 0 SYMBOL_LINK "Rte_Assi_AssiCmdBas_Val" 0 DISPLAY_IDENTIFIER Assi.SenderPorts.AssiCmdBas.Val /end MEASUREMENT
/begin MEASUREMENT Assi.AssiCmdBasSca.Val "MICROSAR RTE" FLOAT32_IEEE NO_COMPU_METHOD 0 0 0.0 1.0 ECU_ADDRESS 0 SYMBOL_LINK "Rte_GmTqArbn_AssiCmdBasSca_Val" 0 DISPLAY_IDENTIFIER Assi.ReceiverPorts.AssiCmdBasSca.Val /end MEASUREMENT
/begin MEASUREMENT Assi.AssiLnrGain.Val "MICROSAR RTE" FLOAT32_IEEE NO_COMPU_METHOD 0 0 0.0 1.0 ECU_ADDRESS 0 SYMBOL_LINK "Rte_CmnMfgSrv_AssiLnrGain_Val" 0 DISPLAY_IDENTIFIER Assi.ReceiverPorts.AssiLnrGain.Val /end MEASUREMENT
/begin MEASUREMENT Assi.AssiLnrGainEna.Logl "MICROSAR RTE" UBYTE RTE_CM_BOOLEAN 0 0 0 255 ECU_ADDRESS 0 SYMBOL_LINK "Rte_CmnMfgSrv_AssiLnrGainEna_Logl" 0 DISPLAY_IDENTIFIER Assi.ReceiverPorts.AssiLnrGainEna.Logl /end MEASUREMENT
/begin MEASUREMENT Assi.HwTq.Val "MICROSAR RTE" FLOAT32_IEEE NO_COMPU_METHOD 0 0 -10.0 10.0 ECU_ADDRESS 0 SYMBOL_LINK "Rte_Swp_HwTqSwp_Val" 0 DISPLAY_IDENTIFIER Assi.ReceiverPorts.HwTq.Val /end MEASUREMENT
/begin MEASUREMENT Assi.HwTqHysOvrl.Val "MICROSAR RTE" FLOAT32_IEEE NO_COMPU_METHOD 0 0 -10.0 10.0 ECU_ADDRESS 0 SYMBOL_LINK "Rte_Assi_HwTqHysOvrl_Val" 0 DISPLAY_IDENTIFIER Assi.ReceiverPorts.HwTqHysOvrl.Val /end MEASUREMENT
/begin MEASUREMENT Assi.HwTqOvrl.Val "MICROSAR RTE" FLOAT32_IEEE NO_COMPU_METHOD 0 0 -10.0 10.0 ECU_ADDRESS 0 SYMBOL_LINK "Rte_GmTqArbn_HwTqOvrl_Val" 0 DISPLAY_IDENTIFIER Assi.ReceiverPorts.HwTqOvrl.Val /end MEASUREMENT
/begin MEASUREMENT Assi.ThermLimSlowFilMax.Val "MICROSAR RTE" FLOAT32_IEEE NO_COMPU_METHOD 0 0 0.0 200.0 ECU_ADDRESS 0 SYMBOL_LINK "Rte_DutyCycThermProtn_ThermLimSlowFilMax_Val" 0 DISPLAY_IDENTIFIER Assi.ReceiverPorts.ThermLimSlowFilMax.Val /end MEASUREMENT
/begin MEASUREMENT Assi.VehSpd.Val "MICROSAR RTE" FLOAT32_IEEE NO_COMPU_METHOD 0 0 0.0 511.0 ECU_ADDRESS 0 SYMBOL_LINK "Rte_VehSigCdng_VehSpd_Val" 0 DISPLAY_IDENTIFIER Assi.ReceiverPorts.VehSpd.Val /end MEASUREMENT
/begin MEASUREMENT Assi.WhlImbRejctnAmp.Val "MICROSAR RTE" FLOAT32_IEEE NO_COMPU_METHOD 0 0 0 8.8 ECU_ADDRESS 0 SYMBOL_LINK "Rte_WhlImbRejctn_WhlImbRejctnAmp_Val" 0 DISPLAY_IDENTIFIER Assi.ReceiverPorts.WhlImbRejctnAmp.Val /end MEASUREMENT
/begin MEASUREMENT Assi.dAssiThermAssiSca "MICROSAR RTE" FLOAT32_IEEE NO_COMPU_METHOD 0 0 0.0 1.0 ECU_ADDRESS 0 SYMBOL_LINK "Rte_Assi_dAssiThermAssiSca" 0 DISPLAY_IDENTIFIER Assi.PerInstanceMemories.dAssiThermAssiSca /end MEASUREMENT
/begin MEASUREMENT Assi.dAssiWhlImbRejctnBlnd "MICROSAR RTE" FLOAT32_IEEE NO_COMPU_METHOD 0 0 0.0 1.0 ECU_ADDRESS 0 SYMBOL_LINK "Rte_Assi_dAssiWhlImbRejctnBlnd" 0 DISPLAY_IDENTIFIER Assi.PerInstanceMemories.dAssiWhlImbRejctnBlnd /end MEASUREMENT
/begin MEASUREMENT AssiHiFrq.AssiHiFrqCmd.Val "MICROSAR RTE" FLOAT32_IEEE NO_COMPU_METHOD 0 0 -3.402823466e+38 3.402823466e+38 ECU_ADDRESS 0 SYMBOL_LINK "Rte_AssiHiFrq_AssiHiFrqCmd_Val" 0 DISPLAY_IDENTIFIER AssiHiFrq.SenderPorts.AssiHiFrqCmd.Val /end MEASUREMENT
/begin MEASUREMENT AssiHiFrq.HwTq.Val "MICROSAR RTE" FLOAT32_IEEE NO_COMPU_METHOD 0 0 -3.402823466e+38 3.402823466e+38 ECU_ADDRESS 0 SYMBOL_LINK "Rte_Swp_HwTqSwp_Val" 0 DISPLAY_IDENTIFIER AssiHiFrq.ReceiverPorts.HwTq.Val /end MEASUREMENT
/begin MEASUREMENT AssiHiFrq.HwTqHpFil.CorrnFac "MICROSAR RTE" FLOAT32_IEEE NO_COMPU_METHOD 0 0 -3.402823466e+38 3.402823466e+38 ECU_ADDRESS 0 SYMBOL_LINK "Rte_AssiHiFrq_HwTqHpFil.CorrnFac" 0 DISPLAY_IDENTIFIER AssiHiFrq.PerInstanceMemories.HwTqHpFil.CorrnFac /end MEASUREMENT
/begin MEASUREMENT AssiHiFrq.HwTqHpFil.FilLpRec.FilGain "MICROSAR RTE" FLOAT32_IEEE NO_COMPU_METHOD 0 0 -3.402823466e+38 3.402823466e+38 ECU_ADDRESS 0 SYMBOL_LINK "Rte_AssiHiFrq_HwTqHpFil.FilLpRec.FilGain" 0 DISPLAY_IDENTIFIER AssiHiFrq.PerInstanceMemories.HwTqHpFil.FilLpRec.FilGain /end MEASUREMENT
/begin MEASUREMENT AssiHiFrq.HwTqHpFil.FilLpRec.FilSt "MICROSAR RTE" FLOAT32_IEEE NO_COMPU_METHOD 0 0 -3.402823466e+38 3.402823466e+38 ECU_ADDRESS 0 SYMBOL_LINK "Rte_AssiHiFrq_HwTqHpFil.FilLpRec.FilSt" 0 DISPLAY_IDENTIFIER AssiHiFrq.PerInstanceMemories.HwTqHpFil.FilLpRec.FilSt /end MEASUREMENT
/begin MEASUREMENT AssiHiFrq.VehSpd.Val "MICROSAR RTE" FLOAT32_IEEE NO_COMPU_METHOD 0 0 -3.402823466e+38 3.402823466e+38 ECU_ADDRESS 0 SYMBOL_LINK "Rte_VehSigCdng_VehSpd_Val" 0 DISPLAY_IDENTIFIER AssiHiFrq.ReceiverPorts.VehSpd.Val /end MEASUREMENT
/begin MEASUREMENT AssiHiFrq.WhlImbRejctnAmp.Val "MICROSAR RTE" FLOAT32_IEEE NO_COMPU_METHOD 0 0 -3.402823466e+38 3.402823466e+38 ECU_ADDRESS 0 SYMBOL_LINK "Rte_WhlImbRejctn_WhlImbRejctnAmp_Val" 0 DISPLAY_IDENTIFIER AssiHiFrq.ReceiverPorts.WhlImbRejctnAmp.Val /end MEASUREMENT
/begin MEASUREMENT AssiHiFrq.dAssiHiFrqGain "MICROSAR RTE" FLOAT32_IEEE NO_COMPU_METHOD 0 0 -3.402823466e+38 3.402823466e+38 ECU_ADDRESS 0 SYMBOL_LINK "Rte_AssiHiFrq_dAssiHiFrqGain" 0 DISPLAY_IDENTIFIER AssiHiFrq.PerInstanceMemories.dAssiHiFrqGain /end MEASUREMENT
/begin MEASUREMENT AssiHiFrq.dAssiHiFrqGainBlnd "MICROSAR RTE" FLOAT32_IEEE NO_COMPU_METHOD 0 0 -3.402823466e+38 3.402823466e+38 ECU_ADDRESS 0 SYMBOL_LINK "Rte_AssiHiFrq_dAssiHiFrqGainBlnd" 0 DISPLAY_IDENTIFIER AssiHiFrq.PerInstanceMemories.dAssiHiFrqGainBlnd /end MEASUREMENT
/begin MEASUREMENT AssiHiFrq.dAssiHiFrqGainWhlImbRejtcnZero "MICROSAR RTE" FLOAT32_IEEE NO_COMPU_METHOD 0 0 -3.402823466e+38 3.402823466e+38 ECU_ADDRESS 0 SYMBOL_LINK "Rte_AssiHiFrq_dAssiHiFrqGainWhlImbRejtcnZero" 0 DISPLAY_IDENTIFIER AssiHiFrq.PerInstanceMemories.dAssiHiFrqGainWhlImbRejtcnZero /end MEASUREMENT
/begin MEASUREMENT AssiPahFwl.AssiCmdBas.Val "MICROSAR RTE" FLOAT32_IEEE NO_COMPU_METHOD 0 0 -3.402823466e+38 3.402823466e+38 ECU_ADDRESS 0 SYMBOL_LINK "Rte_Assi_AssiCmdBas_Val" 0 DISPLAY_IDENTIFIER AssiPahFwl.ReceiverPorts.AssiCmdBas.Val /end MEASUREMENT
/begin MEASUREMENT AssiPahFwl.AssiCmdSum.Val "MICROSAR RTE" FLOAT32_IEEE NO_COMPU_METHOD 0 0 -3.402823466e+38 3.402823466e+38 ECU_ADDRESS 0 SYMBOL_LINK "Rte_AssiPahFwl_AssiCmdSum_Val" 0 DISPLAY_IDENTIFIER AssiPahFwl.SenderPorts.AssiCmdSum.Val /end MEASUREMENT
/begin MEASUREMENT AssiPahFwl.AssiHiFrqCmd.Val "MICROSAR RTE" FLOAT32_IEEE NO_COMPU_METHOD 0 0 -3.402823466e+38 3.402823466e+38 ECU_ADDRESS 0 SYMBOL_LINK "Rte_AssiHiFrq_AssiHiFrqCmd_Val" 0 DISPLAY_IDENTIFIER AssiPahFwl.ReceiverPorts.AssiHiFrqCmd.Val /end MEASUREMENT
/begin MEASUREMENT AssiPahFwl.AssiLnrGainEna.Logl "MICROSAR RTE" UBYTE RTE_CM_BOOLEAN 0 0 0 255 ECU_ADDRESS 0 SYMBOL_LINK "Rte_CmnMfgSrv_AssiLnrGainEna_Logl" 0 DISPLAY_IDENTIFIER AssiPahFwl.ReceiverPorts.AssiLnrGainEna.Logl /end MEASUREMENT
/begin MEASUREMENT AssiPahFwl.AssiPahLimrActv.Val "MICROSAR RTE" FLOAT32_IEEE NO_COMPU_METHOD 0 0 -3.402823466e+38 3.402823466e+38 ECU_ADDRESS 0 SYMBOL_LINK "Rte_AssiPahFwl_AssiPahLimrActv_Val" 0 DISPLAY_IDENTIFIER AssiPahFwl.SenderPorts.AssiPahLimrActv.Val /end MEASUREMENT
/begin MEASUREMENT AssiPahFwl.AssiPrfmncPrev "MICROSAR RTE" UBYTE RTE_CM_BOOLEAN 0 0 0 255 ECU_ADDRESS 0 SYMBOL_LINK "Rte_AssiPahFwl_AssiPrfmncPrev" 0 DISPLAY_IDENTIFIER AssiPahFwl.PerInstanceMemories.AssiPrfmncPrev /end MEASUREMENT
/begin MEASUREMENT AssiPahFwl.CombdAssiPrev "MICROSAR RTE" FLOAT32_IEEE NO_COMPU_METHOD 0 0 -3.402823466e+38 3.402823466e+38 ECU_ADDRESS 0 SYMBOL_LINK "Rte_AssiPahFwl_CombdAssiPrev" 0 DISPLAY_IDENTIFIER AssiPahFwl.PerInstanceMemories.CombdAssiPrev /end MEASUREMENT
/begin MEASUREMENT AssiPahFwl.FwlActvLpFilStVari.FilGain "MICROSAR RTE" FLOAT32_IEEE NO_COMPU_METHOD 0 0 -3.402823466e+38 3.402823466e+38 ECU_ADDRESS 0 SYMBOL_LINK "Rte_AssiPahFwl_FwlActvLpFilStVari.FilGain" 0 DISPLAY_IDENTIFIER AssiPahFwl.PerInstanceMemories.FwlActvLpFilStVari.FilGain /end MEASUREMENT
/begin MEASUREMENT AssiPahFwl.FwlActvLpFilStVari.FilSt "MICROSAR RTE" FLOAT32_IEEE NO_COMPU_METHOD 0 0 -3.402823466e+38 3.402823466e+38 ECU_ADDRESS 0 SYMBOL_LINK "Rte_AssiPahFwl_FwlActvLpFilStVari.FilSt" 0 DISPLAY_IDENTIFIER AssiPahFwl.PerInstanceMemories.FwlActvLpFilStVari.FilSt /end MEASUREMENT
/begin MEASUREMENT AssiPahFwl.HiFrqCmdLpFilStVari.FilGain "MICROSAR RTE" FLOAT32_IEEE NO_COMPU_METHOD 0 0 -3.402823466e+38 3.402823466e+38 ECU_ADDRESS 0 SYMBOL_LINK "Rte_AssiPahFwl_HiFrqCmdLpFilStVari.FilGain" 0 DISPLAY_IDENTIFIER AssiPahFwl.PerInstanceMemories.HiFrqCmdLpFilStVari.FilGain /end MEASUREMENT
/begin MEASUREMENT AssiPahFwl.HiFrqCmdLpFilStVari.FilSt "MICROSAR RTE" FLOAT32_IEEE NO_COMPU_METHOD 0 0 -3.402823466e+38 3.402823466e+38 ECU_ADDRESS 0 SYMBOL_LINK "Rte_AssiPahFwl_HiFrqCmdLpFilStVari.FilSt" 0 DISPLAY_IDENTIFIER AssiPahFwl.PerInstanceMemories.HiFrqCmdLpFilStVari.FilSt /end MEASUREMENT
/begin MEASUREMENT AssiPahFwl.HwTq.Val "MICROSAR RTE" FLOAT32_IEEE NO_COMPU_METHOD 0 0 -3.402823466e+38 3.402823466e+38 ECU_ADDRESS 0 SYMBOL_LINK "Rte_Swp_HwTqSwp_Val" 0 DISPLAY_IDENTIFIER AssiPahFwl.ReceiverPorts.HwTq.Val /end MEASUREMENT
/begin MEASUREMENT AssiPahFwl.HwTqOvrl.Val "MICROSAR RTE" FLOAT32_IEEE NO_COMPU_METHOD 0 0 -3.402823466e+38 3.402823466e+38 ECU_ADDRESS 0 SYMBOL_LINK "Rte_GmTqArbn_HwTqOvrl_Val" 0 DISPLAY_IDENTIFIER AssiPahFwl.ReceiverPorts.HwTqOvrl.Val /end MEASUREMENT
/begin MEASUREMENT AssiPahFwl.HysCmpCmd.Val "MICROSAR RTE" FLOAT32_IEEE NO_COMPU_METHOD 0 0 -3.402823466e+38 3.402823466e+38 ECU_ADDRESS 0 SYMBOL_LINK "Rte_HysCmp_HysCmpCmd_Val" 0 DISPLAY_IDENTIFIER AssiPahFwl.ReceiverPorts.HysCmpCmd.Val /end MEASUREMENT
/begin MEASUREMENT AssiPahFwl.LowrLimLpFilStVari.FilGain "MICROSAR RTE" FLOAT32_IEEE NO_COMPU_METHOD 0 0 -3.402823466e+38 3.402823466e+38 ECU_ADDRESS 0 SYMBOL_LINK "Rte_AssiPahFwl_LowrLimLpFilStVari.FilGain" 0 DISPLAY_IDENTIFIER AssiPahFwl.PerInstanceMemories.LowrLimLpFilStVari.FilGain /end MEASUREMENT
/begin MEASUREMENT AssiPahFwl.LowrLimLpFilStVari.FilSt "MICROSAR RTE" FLOAT32_IEEE NO_COMPU_METHOD 0 0 -3.402823466e+38 3.402823466e+38 ECU_ADDRESS 0 SYMBOL_LINK "Rte_AssiPahFwl_LowrLimLpFilStVari.FilSt" 0 DISPLAY_IDENTIFIER AssiPahFwl.PerInstanceMemories.LowrLimLpFilStVari.FilSt /end MEASUREMENT
/begin MEASUREMENT AssiPahFwl.UpprLimLpFilStVari.FilGain "MICROSAR RTE" FLOAT32_IEEE NO_COMPU_METHOD 0 0 -3.402823466e+38 3.402823466e+38 ECU_ADDRESS 0 SYMBOL_LINK "Rte_AssiPahFwl_UpprLimLpFilStVari.FilGain" 0 DISPLAY_IDENTIFIER AssiPahFwl.PerInstanceMemories.UpprLimLpFilStVari.FilGain /end MEASUREMENT
/begin MEASUREMENT AssiPahFwl.UpprLimLpFilStVari.FilSt "MICROSAR RTE" FLOAT32_IEEE NO_COMPU_METHOD 0 0 -3.402823466e+38 3.402823466e+38 ECU_ADDRESS 0 SYMBOL_LINK "Rte_AssiPahFwl_UpprLimLpFilStVari.FilSt" 0 DISPLAY_IDENTIFIER AssiPahFwl.PerInstanceMemories.UpprLimLpFilStVari.FilSt /end MEASUREMENT
/begin MEASUREMENT AssiPahFwl.VehSpd.Val "MICROSAR RTE" FLOAT32_IEEE NO_COMPU_METHOD 0 0 -3.402823466e+38 3.402823466e+38 ECU_ADDRESS 0 SYMBOL_LINK "Rte_VehSigCdng_VehSpd_Val" 0 DISPLAY_IDENTIFIER AssiPahFwl.ReceiverPorts.VehSpd.Val /end MEASUREMENT
/begin MEASUREMENT AssiPahFwl.dAssiPahFwlActvRaw "MICROSAR RTE" FLOAT32_IEEE NO_COMPU_METHOD 0 0 -3.402823466e+38 3.402823466e+38 ECU_ADDRESS 0 SYMBOL_LINK "Rte_AssiPahFwl_dAssiPahFwlActvRaw" 0 DISPLAY_IDENTIFIER AssiPahFwl.PerInstanceMemories.dAssiPahFwlActvRaw /end MEASUREMENT
/begin MEASUREMENT AssiPahFwl.dAssiPahFwlBasAssiCmdOverLim "MICROSAR RTE" UBYTE RTE_CM_BOOLEAN 0 0 0 255 ECU_ADDRESS 0 SYMBOL_LINK "Rte_AssiPahFwl_dAssiPahFwlBasAssiCmdOverLim" 0 DISPLAY_IDENTIFIER AssiPahFwl.PerInstanceMemories.dAssiPahFwlBasAssiCmdOverLim /end MEASUREMENT
/begin MEASUREMENT AssiPahFwl.dAssiPahFwlBasAssiLimd "MICROSAR RTE" FLOAT32_IEEE NO_COMPU_METHOD 0 0 -3.402823466e+38 3.402823466e+38 ECU_ADDRESS 0 SYMBOL_LINK "Rte_AssiPahFwl_dAssiPahFwlBasAssiLimd" 0 DISPLAY_IDENTIFIER AssiPahFwl.PerInstanceMemories.dAssiPahFwlBasAssiLimd /end MEASUREMENT
/begin MEASUREMENT AssiPahFwl.dAssiPahFwlBasAssiLowrLim "MICROSAR RTE" FLOAT32_IEEE NO_COMPU_METHOD 0 0 -3.402823466e+38 3.402823466e+38 ECU_ADDRESS 0 SYMBOL_LINK "Rte_AssiPahFwl_dAssiPahFwlBasAssiLowrLim" 0 DISPLAY_IDENTIFIER AssiPahFwl.PerInstanceMemories.dAssiPahFwlBasAssiLowrLim /end MEASUREMENT
/begin MEASUREMENT AssiPahFwl.dAssiPahFwlBasAssiUpprLim "MICROSAR RTE" FLOAT32_IEEE NO_COMPU_METHOD 0 0 -3.402823466e+38 3.402823466e+38 ECU_ADDRESS 0 SYMBOL_LINK "Rte_AssiPahFwl_dAssiPahFwlBasAssiUpprLim" 0 DISPLAY_IDENTIFIER AssiPahFwl.PerInstanceMemories.dAssiPahFwlBasAssiUpprLim /end MEASUREMENT
/begin MEASUREMENT AssiPahFwl.dAssiPahFwlHiFrqAssiLowrLimFild "MICROSAR RTE" FLOAT32_IEEE NO_COMPU_METHOD 0 0 -3.402823466e+38 3.402823466e+38 ECU_ADDRESS 0 SYMBOL_LINK "Rte_AssiPahFwl_dAssiPahFwlHiFrqAssiLowrLimFild" 0 DISPLAY_IDENTIFIER AssiPahFwl.PerInstanceMemories.dAssiPahFwlHiFrqAssiLowrLimFild /end MEASUREMENT
/begin MEASUREMENT AssiPahFwl.dAssiPahFwlHiFrqAssiUpprLimFild "MICROSAR RTE" FLOAT32_IEEE NO_COMPU_METHOD 0 0 -3.402823466e+38 3.402823466e+38 ECU_ADDRESS 0 SYMBOL_LINK "Rte_AssiPahFwl_dAssiPahFwlHiFrqAssiUpprLimFild" 0 DISPLAY_IDENTIFIER AssiPahFwl.PerInstanceMemories.dAssiPahFwlHiFrqAssiUpprLimFild /end MEASUREMENT
/begin MEASUREMENT AssiPahFwl.dAssiPahFwlHiFrqCmdHpPah "MICROSAR RTE" FLOAT32_IEEE NO_COMPU_METHOD 0 0 -3.402823466e+38 3.402823466e+38 ECU_ADDRESS 0 SYMBOL_LINK "Rte_AssiPahFwl_dAssiPahFwlHiFrqCmdHpPah" 0 DISPLAY_IDENTIFIER AssiPahFwl.PerInstanceMemories.dAssiPahFwlHiFrqCmdHpPah /end MEASUREMENT
/begin MEASUREMENT AssiPahFwl.dAssiPahFwlHiFrqCmdLpPah "MICROSAR RTE" FLOAT32_IEEE NO_COMPU_METHOD 0 0 -3.402823466e+38 3.402823466e+38 ECU_ADDRESS 0 SYMBOL_LINK "Rte_AssiPahFwl_dAssiPahFwlHiFrqCmdLpPah" 0 DISPLAY_IDENTIFIER AssiPahFwl.PerInstanceMemories.dAssiPahFwlHiFrqCmdLpPah /end MEASUREMENT
/begin MEASUREMENT AssiPahFwl.dAssiPahFwlHiFrqCmdOverLim "MICROSAR RTE" UBYTE RTE_CM_BOOLEAN 0 0 0 255 ECU_ADDRESS 0 SYMBOL_LINK "Rte_AssiPahFwl_dAssiPahFwlHiFrqCmdOverLim" 0 DISPLAY_IDENTIFIER AssiPahFwl.PerInstanceMemories.dAssiPahFwlHiFrqCmdOverLim /end MEASUREMENT
/begin MEASUREMENT AssiPahFwl.dAssiPahFwlHiFrqLpLimd "MICROSAR RTE" FLOAT32_IEEE NO_COMPU_METHOD 0 0 -3.402823466e+38 3.402823466e+38 ECU_ADDRESS 0 SYMBOL_LINK "Rte_AssiPahFwl_dAssiPahFwlHiFrqLpLimd" 0 DISPLAY_IDENTIFIER AssiPahFwl.PerInstanceMemories.dAssiPahFwlHiFrqLpLimd /end MEASUREMENT
/begin MEASUREMENT AssiPahFwl.dAssiPahFwlSumInp "MICROSAR RTE" FLOAT32_IEEE NO_COMPU_METHOD 0 0 -3.402823466e+38 3.402823466e+38 ECU_ADDRESS 0 SYMBOL_LINK "Rte_AssiPahFwl_dAssiPahFwlSumInp" 0 DISPLAY_IDENTIFIER AssiPahFwl.PerInstanceMemories.dAssiPahFwlSumInp /end MEASUREMENT
/begin MEASUREMENT AssiSumLim.AssiCmd.Val "MICROSAR RTE" FLOAT32_IEEE NO_COMPU_METHOD 0 0 -8.8 8.8 ECU_ADDRESS 0 SYMBOL_LINK "Rte_StabyCmp_AssiCmd_Val" 0 DISPLAY_IDENTIFIER AssiSumLim.ReceiverPorts.AssiCmd.Val /end MEASUREMENT
/begin MEASUREMENT AssiSumLim.DampgCmd.Val "MICROSAR RTE" FLOAT32_IEEE NO_COMPU_METHOD 0 0 -8.8 8.8 ECU_ADDRESS 0 SYMBOL_LINK "Rte_DampgPahFwl_DampgCmd_Val" 0 DISPLAY_IDENTIFIER AssiSumLim.ReceiverPorts.DampgCmd.Val /end MEASUREMENT
/begin MEASUREMENT AssiSumLim.EotActvCmd.Val "MICROSAR RTE" FLOAT32_IEEE NO_COMPU_METHOD 0 0 -8.8 8.8 ECU_ADDRESS 0 SYMBOL_LINK "Rte_EotProtnFwl_EotActvCmdLimd_Val" 0 DISPLAY_IDENTIFIER AssiSumLim.ReceiverPorts.EotActvCmd.Val /end MEASUREMENT
/begin MEASUREMENT AssiSumLim.EotAssiSca.Val "MICROSAR RTE" FLOAT32_IEEE NO_COMPU_METHOD 0 0 0.0 1.0 ECU_ADDRESS 0 SYMBOL_LINK "Rte_LimrCdng_EotAssiScaCdnd_Val" 0 DISPLAY_IDENTIFIER AssiSumLim.ReceiverPorts.EotAssiSca.Val /end MEASUREMENT
/begin MEASUREMENT AssiSumLim.EotDampgCmd.Val "MICROSAR RTE" FLOAT32_IEEE NO_COMPU_METHOD 0 0 -8.8 8.8 ECU_ADDRESS 0 SYMBOL_LINK "Rte_EotProtnFwl_EotDampgCmdLimd_Val" 0 DISPLAY_IDENTIFIER AssiSumLim.ReceiverPorts.EotDampgCmd.Val /end MEASUREMENT
/begin MEASUREMENT AssiSumLim.EotMotTqLim.Val "MICROSAR RTE" FLOAT32_IEEE NO_COMPU_METHOD 0 0 0 8.8 ECU_ADDRESS 0 SYMBOL_LINK "Rte_LimrCdng_EotMotTqLimCdnd_Val" 0 DISPLAY_IDENTIFIER AssiSumLim.ReceiverPorts.EotMotTqLim.Val /end MEASUREMENT
/begin MEASUREMENT AssiSumLim.HwTqLoaMtgtnEna.Logl "MICROSAR RTE" UBYTE RTE_CM_BOOLEAN 0 0 0 255 ECU_ADDRESS 0 SYMBOL_LINK "Rte_LoaMgr_HwTqLoaMtgtnEna_Logl" 0 DISPLAY_IDENTIFIER AssiSumLim.ReceiverPorts.HwTqLoaMtgtnEna.Logl /end MEASUREMENT
/begin MEASUREMENT AssiSumLim.MotTqCmd.Val "MICROSAR RTE" FLOAT32_IEEE NO_COMPU_METHOD 0 0 -8.8 8.8 ECU_ADDRESS 0 SYMBOL_LINK "Rte_AssiSumLim_MotTqCmd_Val" 0 DISPLAY_IDENTIFIER AssiSumLim.SenderPorts.MotTqCmd.Val /end MEASUREMENT
/begin MEASUREMENT AssiSumLim.MotTqCmdLimDi.Logl "MICROSAR RTE" UBYTE RTE_CM_BOOLEAN 0 0 0 255 ECU_ADDRESS 0 SYMBOL_LINK "Rte_AssiSumLim_MotTqCmdLimDi_Logl" 0 DISPLAY_IDENTIFIER AssiSumLim.ReceiverPorts.MotTqCmdLimDi.Logl /end MEASUREMENT
/begin MEASUREMENT AssiSumLim.MotTqCmdLimdPreStall.Val "MICROSAR RTE" FLOAT32_IEEE NO_COMPU_METHOD 0 0 0 8.8 ECU_ADDRESS 0 SYMBOL_LINK "Rte_AssiSumLim_MotTqCmdLimdPreStall_Val" 0 DISPLAY_IDENTIFIER AssiSumLim.SenderPorts.MotTqCmdLimdPreStall.Val /end MEASUREMENT
/begin MEASUREMENT AssiSumLim.MotTqCmdLimrMin.Val "MICROSAR RTE" FLOAT32_IEEE NO_COMPU_METHOD 0 0 0 8.8 ECU_ADDRESS 0 SYMBOL_LINK "Rte_AssiSumLim_MotTqCmdLimrMin_Val" 0 DISPLAY_IDENTIFIER AssiSumLim.SenderPorts.MotTqCmdLimrMin.Val /end MEASUREMENT
/begin MEASUREMENT AssiSumLim.MotTqCmdOvrl.Val "MICROSAR RTE" FLOAT32_IEEE NO_COMPU_METHOD 0 0 -8.8 8.8 ECU_ADDRESS 0 SYMBOL_LINK "Rte_GmTqArbn_MotTqCmdOvrl_Val" 0 DISPLAY_IDENTIFIER AssiSumLim.ReceiverPorts.MotTqCmdOvrl.Val /end MEASUREMENT
/begin MEASUREMENT AssiSumLim.MotTqCmdPreLim.Val "MICROSAR RTE" FLOAT32_IEEE NO_COMPU_METHOD 0 0 -8.8 8.8 ECU_ADDRESS 0 SYMBOL_LINK "Rte_AssiSumLim_MotTqCmdPreLim_Val" 0 DISPLAY_IDENTIFIER AssiSumLim.SenderPorts.MotTqCmdPreLim.Val /end MEASUREMENT
/begin MEASUREMENT AssiSumLim.PinionCentrLrnCmd.Val "MICROSAR RTE" FLOAT32_IEEE NO_COMPU_METHOD 0 0 -8.8 8.8 ECU_ADDRESS 0 SYMBOL_LINK "Rte_AssiSumLim_PinionCentrLrnCmd_Val" 0 DISPLAY_IDENTIFIER AssiSumLim.ReceiverPorts.PinionCentrLrnCmd.Val /end MEASUREMENT
/begin MEASUREMENT AssiSumLim.PinionCentrLrnEna.Logl "MICROSAR RTE" UBYTE RTE_CM_BOOLEAN 0 0 0 255 ECU_ADDRESS 0 SYMBOL_LINK "Rte_AssiSumLim_PinionCentrLrnEna_Logl" 0 DISPLAY_IDENTIFIER AssiSumLim.ReceiverPorts.PinionCentrLrnEna.Logl /end MEASUREMENT
/begin MEASUREMENT AssiSumLim.PullCmpCmd.Val "MICROSAR RTE" FLOAT32_IEEE NO_COMPU_METHOD 0 0 -8.8 8.8 ECU_ADDRESS 0 SYMBOL_LINK "Rte_PullCmpActv_PullCmpCmd_Val" 0 DISPLAY_IDENTIFIER AssiSumLim.ReceiverPorts.PullCmpCmd.Val /end MEASUREMENT
/begin MEASUREMENT AssiSumLim.PwrLimrRednFac.Val "MICROSAR RTE" FLOAT32_IEEE NO_COMPU_METHOD 0 0 0.0 1.0 ECU_ADDRESS 0 SYMBOL_LINK "Rte_PwrLimr_PwrLimrRednFac_Val" 0 DISPLAY_IDENTIFIER AssiSumLim.ReceiverPorts.PwrLimrRednFac.Val /end MEASUREMENT
/begin MEASUREMENT AssiSumLim.RtnCmd.Val "MICROSAR RTE" FLOAT32_IEEE NO_COMPU_METHOD 0 0 -8.8 8.8 ECU_ADDRESS 0 SYMBOL_LINK "Rte_RtnPahFwl_RtnCmdLimd_Val" 0 DISPLAY_IDENTIFIER AssiSumLim.ReceiverPorts.RtnCmd.Val /end MEASUREMENT
/begin MEASUREMENT AssiSumLim.StallMotTqLim.Val "MICROSAR RTE" FLOAT32_IEEE NO_COMPU_METHOD 0 0 0 8.8 ECU_ADDRESS 0 SYMBOL_LINK "Rte_LimrCdng_StallMotTqLimCdnd_Val" 0 DISPLAY_IDENTIFIER AssiSumLim.ReceiverPorts.StallMotTqLim.Val /end MEASUREMENT
/begin MEASUREMENT AssiSumLim.SysMotTqCmdSca.Val "MICROSAR RTE" FLOAT32_IEEE NO_COMPU_METHOD 0 0 0.0 1.0 ECU_ADDRESS 0 SYMBOL_LINK "Rte_LimrCdng_SysMotTqCmdScaCdnd_Val" 0 DISPLAY_IDENTIFIER AssiSumLim.ReceiverPorts.SysMotTqCmdSca.Val /end MEASUREMENT
/begin MEASUREMENT AssiSumLim.SysProtnRednFac.Val "MICROSAR RTE" FLOAT32_IEEE NO_COMPU_METHOD 0 0 0.0 1.0 ECU_ADDRESS 0 SYMBOL_LINK "Rte_AssiSumLim_SysProtnRednFac_Val" 0 DISPLAY_IDENTIFIER AssiSumLim.SenderPorts.SysProtnRednFac.Val /end MEASUREMENT
/begin MEASUREMENT AssiSumLim.ThermMotTqLim.Val "MICROSAR RTE" FLOAT32_IEEE NO_COMPU_METHOD 0 0 0 8.8 ECU_ADDRESS 0 SYMBOL_LINK "Rte_LimrCdng_ThermMotTqLimCdnd_Val" 0 DISPLAY_IDENTIFIER AssiSumLim.ReceiverPorts.ThermMotTqLim.Val /end MEASUREMENT
/begin MEASUREMENT AssiSumLim.ThermRednFac.Val "MICROSAR RTE" FLOAT32_IEEE NO_COMPU_METHOD 0 0 0.0 1.0 ECU_ADDRESS 0 SYMBOL_LINK "Rte_DutyCycThermProtn_ThermRednFac_Val" 0 DISPLAY_IDENTIFIER AssiSumLim.ReceiverPorts.ThermRednFac.Val /end MEASUREMENT
/begin MEASUREMENT AssiSumLim.TqLoaCmd.Val "MICROSAR RTE" FLOAT32_IEEE NO_COMPU_METHOD 0 0 -8.8 8.8 ECU_ADDRESS 0 SYMBOL_LINK "Rte_TqLoa_TqLoaCmd_Val" 0 DISPLAY_IDENTIFIER AssiSumLim.ReceiverPorts.TqLoaCmd.Val /end MEASUREMENT
/begin MEASUREMENT AssiSumLim.TqSteerMtgtnCmd.Val "MICROSAR RTE" FLOAT32_IEEE NO_COMPU_METHOD 0 0 -3.0 3.0 ECU_ADDRESS 0 SYMBOL_LINK "Rte_AssiSumLim_TqSteerMtgtnCmd_Val" 0 DISPLAY_IDENTIFIER AssiSumLim.ReceiverPorts.TqSteerMtgtnCmd.Val /end MEASUREMENT
/begin MEASUREMENT AssiSumLim.VehSpd.Val "MICROSAR RTE" FLOAT32_IEEE NO_COMPU_METHOD 0 0 0.0 511.0 ECU_ADDRESS 0 SYMBOL_LINK "Rte_VehSigCdng_VehSpd_Val" 0 DISPLAY_IDENTIFIER AssiSumLim.ReceiverPorts.VehSpd.Val /end MEASUREMENT
/begin MEASUREMENT AssiSumLim.VehSpdMotTqLim.Val "MICROSAR RTE" FLOAT32_IEEE NO_COMPU_METHOD 0 0 0 8.8 ECU_ADDRESS 0 SYMBOL_LINK "Rte_LimrCdng_VehSpdMotTqLimCdnd_Val" 0 DISPLAY_IDENTIFIER AssiSumLim.ReceiverPorts.VehSpdMotTqLim.Val /end MEASUREMENT
/begin MEASUREMENT AssiSumLim.WhlImbRejctnCmd.Val "MICROSAR RTE" FLOAT32_IEEE NO_COMPU_METHOD 0 0 -8.0 8.0 ECU_ADDRESS 0 SYMBOL_LINK "Rte_WhlImbRejctn_WhlImbRejctnCmd_Val" 0 DISPLAY_IDENTIFIER AssiSumLim.ReceiverPorts.WhlImbRejctnCmd.Val /end MEASUREMENT
/begin MEASUREMENT BattVltg.BattSwdVltgCorrlnSts.Val "MICROSAR RTE" UBYTE NO_COMPU_METHOD 0 0 0 255 ECU_ADDRESS 0 SYMBOL_LINK "Rte_BattVltgCorrln_BattSwdVltgCorrlnSts_Val" 0 DISPLAY_IDENTIFIER BattVltg.ReceiverPorts.BattSwdVltgCorrlnSts.Val /end MEASUREMENT
/begin MEASUREMENT BattVltg.BattVltg.Val "MICROSAR RTE" FLOAT32_IEEE NO_COMPU_METHOD 0 0 0.0 40.0 ECU_ADDRESS 0 SYMBOL_LINK "Rte_CDD_GmT1xxMcuCfg_BattVltg_Val" 0 DISPLAY_IDENTIFIER BattVltg.ReceiverPorts.BattVltg.Val /end MEASUREMENT
/begin MEASUREMENT BattVltg.BattVltgSwd1.Val "MICROSAR RTE" FLOAT32_IEEE NO_COMPU_METHOD 0 0 0.0 40.0 ECU_ADDRESS 0 SYMBOL_LINK "Rte_CDD_GmT1xxMcuCfg_BattVltgSwd1_Val" 0 DISPLAY_IDENTIFIER BattVltg.ReceiverPorts.BattVltgSwd1.Val /end MEASUREMENT
/begin MEASUREMENT BattVltg.BattVltgSwd2.Val "MICROSAR RTE" FLOAT32_IEEE NO_COMPU_METHOD 0 0 0.0 40.0 ECU_ADDRESS 0 SYMBOL_LINK "Rte_CDD_GmT1xxMcuCfg_BattVltgSwd2_Val" 0 DISPLAY_IDENTIFIER BattVltg.ReceiverPorts.BattVltgSwd2.Val /end MEASUREMENT
/begin MEASUREMENT BattVltg.BrdgVltg.Val "MICROSAR RTE" FLOAT32_IEEE NO_COMPU_METHOD 0 0 6.0 26.5 ECU_ADDRESS 0 SYMBOL_LINK "Rte_BattVltg_BrdgVltg_Val" 0 DISPLAY_IDENTIFIER BattVltg.SenderPorts.BrdgVltg.Val /end MEASUREMENT
/begin MEASUREMENT BattVltgCorrln.BattSwdVltgCorrlnSts.Val "MICROSAR RTE" UBYTE NO_COMPU_METHOD 0 0 0 255 ECU_ADDRESS 0 SYMBOL_LINK "Rte_BattVltgCorrln_BattSwdVltgCorrlnSts_Val" 0 DISPLAY_IDENTIFIER BattVltgCorrln.SenderPorts.BattSwdVltgCorrlnSts.Val /end MEASUREMENT
/begin MEASUREMENT BattVltgCorrln.BattVltg.Val "MICROSAR RTE" FLOAT32_IEEE NO_COMPU_METHOD 0 0 -3.402823466e+38 3.402823466e+38 ECU_ADDRESS 0 SYMBOL_LINK "Rte_CDD_GmT1xxMcuCfg_BattVltg_Val" 0 DISPLAY_IDENTIFIER BattVltgCorrln.ReceiverPorts.BattVltg.Val /end MEASUREMENT
/begin MEASUREMENT BattVltgCorrln.BattVltgAdcFaild.Logl "MICROSAR RTE" UBYTE RTE_CM_BOOLEAN 0 0 0 255 ECU_ADDRESS 0 SYMBOL_LINK "Rte_CDD_GmT1xxMcuCfg_BattVltgAdcFaild_Logl" 0 DISPLAY_IDENTIFIER BattVltgCorrln.ReceiverPorts.BattVltgAdcFaild.Logl /end MEASUREMENT
/begin MEASUREMENT BattVltgCorrln.BattVltgCorrlnIdptSig.Val "MICROSAR RTE" UBYTE NO_COMPU_METHOD 0 0 0 255 ECU_ADDRESS 0 SYMBOL_LINK "Rte_BattVltgCorrln_BattVltgCorrlnIdptSig_Val" 0 DISPLAY_IDENTIFIER BattVltgCorrln.SenderPorts.BattVltgCorrlnIdptSig.Val /end MEASUREMENT
/begin MEASUREMENT BattVltgCorrln.BattVltgSwd1.Val "MICROSAR RTE" FLOAT32_IEEE NO_COMPU_METHOD 0 0 -3.402823466e+38 3.402823466e+38 ECU_ADDRESS 0 SYMBOL_LINK "Rte_CDD_GmT1xxMcuCfg_BattVltgSwd1_Val" 0 DISPLAY_IDENTIFIER BattVltgCorrln.ReceiverPorts.BattVltgSwd1.Val /end MEASUREMENT
/begin MEASUREMENT BattVltgCorrln.BattVltgSwd1AdcFaild.Logl "MICROSAR RTE" UBYTE RTE_CM_BOOLEAN 0 0 0 255 ECU_ADDRESS 0 SYMBOL_LINK "Rte_CDD_GmT1xxMcuCfg_BattVltgSwd1AdcFaild_Logl" 0 DISPLAY_IDENTIFIER BattVltgCorrln.ReceiverPorts.BattVltgSwd1AdcFaild.Logl /end MEASUREMENT
/begin MEASUREMENT BattVltgCorrln.BattVltgSwd2.Val "MICROSAR RTE" FLOAT32_IEEE NO_COMPU_METHOD 0 0 -3.402823466e+38 3.402823466e+38 ECU_ADDRESS 0 SYMBOL_LINK "Rte_CDD_GmT1xxMcuCfg_BattVltgSwd2_Val" 0 DISPLAY_IDENTIFIER BattVltgCorrln.ReceiverPorts.BattVltgSwd2.Val /end MEASUREMENT
/begin MEASUREMENT BattVltgCorrln.BattVltgSwd2AdcFaild.Logl "MICROSAR RTE" UBYTE RTE_CM_BOOLEAN 0 0 0 255 ECU_ADDRESS 0 SYMBOL_LINK "Rte_CDD_GmT1xxMcuCfg_BattVltgSwd2AdcFaild_Logl" 0 DISPLAY_IDENTIFIER BattVltgCorrln.ReceiverPorts.BattVltgSwd2AdcFaild.Logl /end MEASUREMENT
/begin MEASUREMENT BattVltgCorrln.DftBrdgVltgActv.Logl "MICROSAR RTE" UBYTE RTE_CM_BOOLEAN 0 0 0 255 ECU_ADDRESS 0 SYMBOL_LINK "Rte_BattVltgCorrln_DftBrdgVltgActv_Logl" 0 DISPLAY_IDENTIFIER BattVltgCorrln.SenderPorts.DftBrdgVltgActv.Logl /end MEASUREMENT
/begin MEASUREMENT BattVltgCorrln.DiagcStsIvtr1Inactv.Logl "MICROSAR RTE" UBYTE RTE_CM_BOOLEAN 0 0 0 255 ECU_ADDRESS 0 SYMBOL_LINK "Rte_DiagcMgr_DiagcStsIvtr1Inactv_Logl" 0 DISPLAY_IDENTIFIER BattVltgCorrln.ReceiverPorts.DiagcStsIvtr1Inactv.Logl /end MEASUREMENT
/begin MEASUREMENT BattVltgCorrln.DiagcStsIvtr2Inactv.Logl "MICROSAR RTE" UBYTE RTE_CM_BOOLEAN 0 0 0 255 ECU_ADDRESS 0 SYMBOL_LINK "Rte_DiagcMgr_DiagcStsIvtr2Inactv_Logl" 0 DISPLAY_IDENTIFIER BattVltgCorrln.ReceiverPorts.DiagcStsIvtr2Inactv.Logl /end MEASUREMENT
/begin MEASUREMENT BattVltgCorrln.InhbBattVltgDiagc.Logl "MICROSAR RTE" UBYTE RTE_CM_BOOLEAN 0 0 0 255 ECU_ADDRESS 0 SYMBOL_LINK "Rte_BattVltgCorrln_InhbBattVltgDiagc_Logl" 0 DISPLAY_IDENTIFIER BattVltgCorrln.ReceiverPorts.InhbBattVltgDiagc.Logl /end MEASUREMENT
/begin MEASUREMENT BattVltgCorrln.StrtUpSt.Val "MICROSAR RTE" UBYTE NO_COMPU_METHOD 0 0 0 255 ECU_ADDRESS 0 SYMBOL_LINK "Rte_PwrUpSeq_StrtUpSt_Val" 0 DISPLAY_IDENTIFIER BattVltgCorrln.ReceiverPorts.StrtUpSt.Val /end MEASUREMENT
/begin MEASUREMENT BattVltgCorrln.SwdVltgLimd.Logl "MICROSAR RTE" UBYTE RTE_CM_BOOLEAN 0 0 0 255 ECU_ADDRESS 0 SYMBOL_LINK "Rte_BattVltgCorrln_SwdVltgLimd_Logl" 0 DISPLAY_IDENTIFIER BattVltgCorrln.SenderPorts.SwdVltgLimd.Logl /end MEASUREMENT
/begin MEASUREMENT BattVltgCorrln.SysSt.Val "MICROSAR RTE" UBYTE RTE_CM_ENUM_SysSt1 0 0 0 255 ECU_ADDRESS 0 SYMBOL_LINK "Rte_SysStMod_SysSt_Val" 0 DISPLAY_IDENTIFIER BattVltgCorrln.ReceiverPorts.SysSt.Val /end MEASUREMENT
/begin MEASUREMENT BattVltgCorrln.dBattVltgCorrlnBattVltgOk "MICROSAR RTE" UBYTE NO_COMPU_METHOD 0 0 0 255 ECU_ADDRESS 0 SYMBOL_LINK "Rte_BattVltgCorrln_dBattVltgCorrlnBattVltgOk" 0 DISPLAY_IDENTIFIER BattVltgCorrln.PerInstanceMemories.dBattVltgCorrlnBattVltgOk /end MEASUREMENT
/begin MEASUREMENT BattVltgCorrln.dBattVltgCorrlnBattVltgRngOk "MICROSAR RTE" UBYTE NO_COMPU_METHOD 0 0 0 255 ECU_ADDRESS 0 SYMBOL_LINK "Rte_BattVltgCorrln_dBattVltgCorrlnBattVltgRngOk" 0 DISPLAY_IDENTIFIER BattVltgCorrln.PerInstanceMemories.dBattVltgCorrlnBattVltgRngOk /end MEASUREMENT
/begin MEASUREMENT BattVltgCorrln.dBattVltgCorrlnBattVltgSwd1Ok "MICROSAR RTE" UBYTE NO_COMPU_METHOD 0 0 0 255 ECU_ADDRESS 0 SYMBOL_LINK "Rte_BattVltgCorrln_dBattVltgCorrlnBattVltgSwd1Ok" 0 DISPLAY_IDENTIFIER BattVltgCorrln.PerInstanceMemories.dBattVltgCorrlnBattVltgSwd1Ok /end MEASUREMENT
/begin MEASUREMENT BattVltgCorrln.dBattVltgCorrlnBattVltgSwd1RngOk "MICROSAR RTE" UBYTE NO_COMPU_METHOD 0 0 0 255 ECU_ADDRESS 0 SYMBOL_LINK "Rte_BattVltgCorrln_dBattVltgCorrlnBattVltgSwd1RngOk" 0 DISPLAY_IDENTIFIER BattVltgCorrln.PerInstanceMemories.dBattVltgCorrlnBattVltgSwd1RngOk /end MEASUREMENT
/begin MEASUREMENT BattVltgCorrln.dBattVltgCorrlnBattVltgSwd2Ok "MICROSAR RTE" UBYTE NO_COMPU_METHOD 0 0 0 255 ECU_ADDRESS 0 SYMBOL_LINK "Rte_BattVltgCorrln_dBattVltgCorrlnBattVltgSwd2Ok" 0 DISPLAY_IDENTIFIER BattVltgCorrln.PerInstanceMemories.dBattVltgCorrlnBattVltgSwd2Ok /end MEASUREMENT
/begin MEASUREMENT BattVltgCorrln.dBattVltgCorrlnBattVltgSwd2RngOk "MICROSAR RTE" UBYTE NO_COMPU_METHOD 0 0 0 255 ECU_ADDRESS 0 SYMBOL_LINK "Rte_BattVltgCorrln_dBattVltgCorrlnBattVltgSwd2RngOk" 0 DISPLAY_IDENTIFIER BattVltgCorrln.PerInstanceMemories.dBattVltgCorrlnBattVltgSwd2RngOk /end MEASUREMENT
/begin MEASUREMENT BattVltgCorrln.dBattVltgCorrlnNtc0x03CQlfrSts "MICROSAR RTE" UBYTE RTE_CM_ENUM_SigQlfr1 0 0 0 255 ECU_ADDRESS 0 SYMBOL_LINK "Rte_BattVltgCorrln_dBattVltgCorrlnNtc0x03CQlfrSts" 0 DISPLAY_IDENTIFIER BattVltgCorrln.PerInstanceMemories.dBattVltgCorrlnNtc0x03CQlfrSts /end MEASUREMENT
/begin MEASUREMENT BattVltgCorrln.dBattVltgCorrlnNtc0x03DQlfrSts "MICROSAR RTE" UBYTE RTE_CM_ENUM_SigQlfr1 0 0 0 255 ECU_ADDRESS 0 SYMBOL_LINK "Rte_BattVltgCorrln_dBattVltgCorrlnNtc0x03DQlfrSts" 0 DISPLAY_IDENTIFIER BattVltgCorrln.PerInstanceMemories.dBattVltgCorrlnNtc0x03DQlfrSts /end MEASUREMENT
/begin MEASUREMENT BattVltgCorrln.dBattVltgCorrlnNtc0x044QlfrSts "MICROSAR RTE" UBYTE RTE_CM_ENUM_SigQlfr1 0 0 0 255 ECU_ADDRESS 0 SYMBOL_LINK "Rte_BattVltgCorrln_dBattVltgCorrlnNtc0x044QlfrSts" 0 DISPLAY_IDENTIFIER BattVltgCorrln.PerInstanceMemories.dBattVltgCorrlnNtc0x044QlfrSts /end MEASUREMENT
/begin MEASUREMENT BattVltgCorrln.dBattVltgCorrlnNtc0x04CQlfrSts "MICROSAR RTE" UBYTE RTE_CM_ENUM_SigQlfr1 0 0 0 255 ECU_ADDRESS 0 SYMBOL_LINK "Rte_BattVltgCorrln_dBattVltgCorrlnNtc0x04CQlfrSts" 0 DISPLAY_IDENTIFIER BattVltgCorrln.PerInstanceMemories.dBattVltgCorrlnNtc0x04CQlfrSts /end MEASUREMENT
/begin MEASUREMENT CDD_Adc0CfgAndUse.Adc0DiagcEndPtr "MICROSAR RTE" UBYTE NO_COMPU_METHOD 0 0 0 255 ECU_ADDRESS 0 SYMBOL_LINK "Rte_CDD_Adc0CfgAndUse_Adc0DiagcEndPtr" 0 DISPLAY_IDENTIFIER CDD_Adc0CfgAndUse.PerInstanceMemories.Adc0DiagcEndPtr /end MEASUREMENT
/begin MEASUREMENT CDD_Adc0CfgAndUse.Adc0DiagcStrtPtr "MICROSAR RTE" UBYTE NO_COMPU_METHOD 0 0 0 255 ECU_ADDRESS 0 SYMBOL_LINK "Rte_CDD_Adc0CfgAndUse_Adc0DiagcStrtPtr" 0 DISPLAY_IDENTIFIER CDD_Adc0CfgAndUse.PerInstanceMemories.Adc0DiagcStrtPtr /end MEASUREMENT
/begin MEASUREMENT CDD_Adc1CfgAndUse.Adc1DiagcEndPtr "MICROSAR RTE" UBYTE NO_COMPU_METHOD 0 0 0 255 ECU_ADDRESS 0 SYMBOL_LINK "Rte_CDD_Adc1CfgAndUse_Adc1DiagcEndPtr" 0 DISPLAY_IDENTIFIER CDD_Adc1CfgAndUse.PerInstanceMemories.Adc1DiagcEndPtr /end MEASUREMENT
/begin MEASUREMENT CDD_Adc1CfgAndUse.Adc1DiagcStrtPtr "MICROSAR RTE" UBYTE NO_COMPU_METHOD 0 0 0 255 ECU_ADDRESS 0 SYMBOL_LINK "Rte_CDD_Adc1CfgAndUse_Adc1DiagcStrtPtr" 0 DISPLAY_IDENTIFIER CDD_Adc1CfgAndUse.PerInstanceMemories.Adc1DiagcStrtPtr /end MEASUREMENT
/begin MEASUREMENT CDD_Adc1CfgAndUse.AdcDiagcEndPtrOutp.Val "MICROSAR RTE" UBYTE NO_COMPU_METHOD 0 0 0 255 ECU_ADDRESS 0 SYMBOL_LINK "Rte_CDD_AdcDiagc_AdcDiagcEndPtrOutp_Val" 0 DISPLAY_IDENTIFIER CDD_Adc1CfgAndUse.ReceiverPorts.AdcDiagcEndPtrOutp.Val /end MEASUREMENT
/begin MEASUREMENT CDD_Adc1CfgAndUse.AdcDiagcStrtPtrOutp.Val "MICROSAR RTE" UBYTE NO_COMPU_METHOD 0 0 0 255 ECU_ADDRESS 0 SYMBOL_LINK "Rte_CDD_AdcDiagc_AdcDiagcStrtPtrOutp_Val" 0 DISPLAY_IDENTIFIER CDD_Adc1CfgAndUse.ReceiverPorts.AdcDiagcStrtPtrOutp.Val /end MEASUREMENT
/begin MEASUREMENT CDD_AdcDiagc.Adc0Faild.Logl "MICROSAR RTE" UBYTE RTE_CM_BOOLEAN 0 0 0 255 ECU_ADDRESS 0 SYMBOL_LINK "Rte_CDD_AdcDiagc_Adc0Faild_Logl" 0 DISPLAY_IDENTIFIER CDD_AdcDiagc.SenderPorts.Adc0Faild.Logl /end MEASUREMENT
/begin MEASUREMENT CDD_AdcDiagc.Adc0FltCntSt0 "MICROSAR RTE" UBYTE NO_COMPU_METHOD 0 0 0 255 ECU_ADDRESS 0 SYMBOL_LINK "Rte_CDD_AdcDiagc_Adc0FltCntSt0" 0 DISPLAY_IDENTIFIER CDD_AdcDiagc.PerInstanceMemories.Adc0FltCntSt0 /end MEASUREMENT
/begin MEASUREMENT CDD_AdcDiagc.Adc0FltCntSt2 "MICROSAR RTE" UBYTE NO_COMPU_METHOD 0 0 0 255 ECU_ADDRESS 0 SYMBOL_LINK "Rte_CDD_AdcDiagc_Adc0FltCntSt2" 0 DISPLAY_IDENTIFIER CDD_AdcDiagc.PerInstanceMemories.Adc0FltCntSt2 /end MEASUREMENT
/begin MEASUREMENT CDD_AdcDiagc.Adc0FltCntSt4 "MICROSAR RTE" UBYTE NO_COMPU_METHOD 0 0 0 255 ECU_ADDRESS 0 SYMBOL_LINK "Rte_CDD_AdcDiagc_Adc0FltCntSt4" 0 DISPLAY_IDENTIFIER CDD_AdcDiagc.PerInstanceMemories.Adc0FltCntSt4 /end MEASUREMENT
/begin MEASUREMENT CDD_AdcDiagc.Adc0FltCntSt6 "MICROSAR RTE" UBYTE NO_COMPU_METHOD 0 0 0 255 ECU_ADDRESS 0 SYMBOL_LINK "Rte_CDD_AdcDiagc_Adc0FltCntSt6" 0 DISPLAY_IDENTIFIER CDD_AdcDiagc.PerInstanceMemories.Adc0FltCntSt6 /end MEASUREMENT
/begin MEASUREMENT CDD_AdcDiagc.Adc0ScanGroup2Ref0.Val "MICROSAR RTE" FLOAT32_IEEE NO_COMPU_METHOD 0 0 -3.402823466e+38 3.402823466e+38 ECU_ADDRESS 0 SYMBOL_LINK "Rte_CDD_MotCtrlMgr_Adc0ScanGroup2Ref0_Val" 0 DISPLAY_IDENTIFIER CDD_AdcDiagc.ReceiverPorts.Adc0ScanGroup2Ref0.Val /end MEASUREMENT
/begin MEASUREMENT CDD_AdcDiagc.Adc0ScanGroup2Ref1.Val "MICROSAR RTE" FLOAT32_IEEE NO_COMPU_METHOD 0 0 -3.402823466e+38 3.402823466e+38 ECU_ADDRESS 0 SYMBOL_LINK "Rte_CDD_MotCtrlMgr_Adc0ScanGroup2Ref1_Val" 0 DISPLAY_IDENTIFIER CDD_AdcDiagc.ReceiverPorts.Adc0ScanGroup2Ref1.Val /end MEASUREMENT
/begin MEASUREMENT CDD_AdcDiagc.Adc0ScanGroup2RefFltCntSt "MICROSAR RTE" UBYTE NO_COMPU_METHOD 0 0 0 255 ECU_ADDRESS 0 SYMBOL_LINK "Rte_CDD_AdcDiagc_Adc0ScanGroup2RefFltCntSt" 0 DISPLAY_IDENTIFIER CDD_AdcDiagc.PerInstanceMemories.Adc0ScanGroup2RefFltCntSt /end MEASUREMENT
/begin MEASUREMENT CDD_AdcDiagc.Adc0ScanGroup3Ref0.Val "MICROSAR RTE" FLOAT32_IEEE NO_COMPU_METHOD 0 0 -3.402823466e+38 3.402823466e+38 ECU_ADDRESS 0 SYMBOL_LINK "Rte_CDD_MotCtrlMgr_Adc0ScanGroup3Ref0_Val" 0 DISPLAY_IDENTIFIER CDD_AdcDiagc.ReceiverPorts.Adc0ScanGroup3Ref0.Val /end MEASUREMENT
/begin MEASUREMENT CDD_AdcDiagc.Adc0ScanGroup3Ref1.Val "MICROSAR RTE" FLOAT32_IEEE NO_COMPU_METHOD 0 0 -3.402823466e+38 3.402823466e+38 ECU_ADDRESS 0 SYMBOL_LINK "Rte_CDD_MotCtrlMgr_Adc0ScanGroup3Ref1_Val" 0 DISPLAY_IDENTIFIER CDD_AdcDiagc.ReceiverPorts.Adc0ScanGroup3Ref1.Val /end MEASUREMENT
/begin MEASUREMENT CDD_AdcDiagc.Adc0ScanGroup3RefFltCntSt "MICROSAR RTE" UBYTE NO_COMPU_METHOD 0 0 0 255 ECU_ADDRESS 0 SYMBOL_LINK "Rte_CDD_AdcDiagc_Adc0ScanGroup3RefFltCntSt" 0 DISPLAY_IDENTIFIER CDD_AdcDiagc.PerInstanceMemories.Adc0ScanGroup3RefFltCntSt /end MEASUREMENT
/begin MEASUREMENT CDD_AdcDiagc.Adc0SelfDiag0.Val "MICROSAR RTE" FLOAT32_IEEE NO_COMPU_METHOD 0 0 -3.402823466e+38 3.402823466e+38 ECU_ADDRESS 0 SYMBOL_LINK "Rte_CDD_MotCtrlMgr_Adc0SelfDiag0_Val" 0 DISPLAY_IDENTIFIER CDD_AdcDiagc.ReceiverPorts.Adc0SelfDiag0.Val /end MEASUREMENT
/begin MEASUREMENT CDD_AdcDiagc.Adc0SelfDiag2.Val "MICROSAR RTE" FLOAT32_IEEE NO_COMPU_METHOD 0 0 -3.402823466e+38 3.402823466e+38 ECU_ADDRESS 0 SYMBOL_LINK "Rte_CDD_MotCtrlMgr_Adc0SelfDiag2_Val" 0 DISPLAY_IDENTIFIER CDD_AdcDiagc.ReceiverPorts.Adc0SelfDiag2.Val /end MEASUREMENT
/begin MEASUREMENT CDD_AdcDiagc.Adc0SelfDiag4.Val "MICROSAR RTE" FLOAT32_IEEE NO_COMPU_METHOD 0 0 -3.402823466e+38 3.402823466e+38 ECU_ADDRESS 0 SYMBOL_LINK "Rte_CDD_MotCtrlMgr_Adc0SelfDiag4_Val" 0 DISPLAY_IDENTIFIER CDD_AdcDiagc.ReceiverPorts.Adc0SelfDiag4.Val /end MEASUREMENT
/begin MEASUREMENT CDD_AdcDiagc.Adc1Faild.Logl "MICROSAR RTE" UBYTE RTE_CM_BOOLEAN 0 0 0 255 ECU_ADDRESS 0 SYMBOL_LINK "Rte_CDD_AdcDiagc_Adc1Faild_Logl" 0 DISPLAY_IDENTIFIER CDD_AdcDiagc.SenderPorts.Adc1Faild.Logl /end MEASUREMENT
/begin MEASUREMENT CDD_AdcDiagc.Adc1FltCntSt0 "MICROSAR RTE" UBYTE NO_COMPU_METHOD 0 0 0 255 ECU_ADDRESS 0 SYMBOL_LINK "Rte_CDD_AdcDiagc_Adc1FltCntSt0" 0 DISPLAY_IDENTIFIER CDD_AdcDiagc.PerInstanceMemories.Adc1FltCntSt0 /end MEASUREMENT
/begin MEASUREMENT CDD_AdcDiagc.Adc1FltCntSt2 "MICROSAR RTE" UBYTE NO_COMPU_METHOD 0 0 0 255 ECU_ADDRESS 0 SYMBOL_LINK "Rte_CDD_AdcDiagc_Adc1FltCntSt2" 0 DISPLAY_IDENTIFIER CDD_AdcDiagc.PerInstanceMemories.Adc1FltCntSt2 /end MEASUREMENT
/begin MEASUREMENT CDD_AdcDiagc.Adc1FltCntSt4 "MICROSAR RTE" UBYTE NO_COMPU_METHOD 0 0 0 255 ECU_ADDRESS 0 SYMBOL_LINK "Rte_CDD_AdcDiagc_Adc1FltCntSt4" 0 DISPLAY_IDENTIFIER CDD_AdcDiagc.PerInstanceMemories.Adc1FltCntSt4 /end MEASUREMENT
/begin MEASUREMENT CDD_AdcDiagc.Adc1FltCntSt6 "MICROSAR RTE" UBYTE NO_COMPU_METHOD 0 0 0 255 ECU_ADDRESS 0 SYMBOL_LINK "Rte_CDD_AdcDiagc_Adc1FltCntSt6" 0 DISPLAY_IDENTIFIER CDD_AdcDiagc.PerInstanceMemories.Adc1FltCntSt6 /end MEASUREMENT
/begin MEASUREMENT CDD_AdcDiagc.Adc1ScanGroup2Ref0.Val "MICROSAR RTE" FLOAT32_IEEE NO_COMPU_METHOD 0 0 -3.402823466e+38 3.402823466e+38 ECU_ADDRESS 0 SYMBOL_LINK "Rte_CDD_GmT1xxMcuCfg_Adc1ScanGroup2Ref0_Val" 0 DISPLAY_IDENTIFIER CDD_AdcDiagc.ReceiverPorts.Adc1ScanGroup2Ref0.Val /end MEASUREMENT
/begin MEASUREMENT CDD_AdcDiagc.Adc1ScanGroup2Ref1.Val "MICROSAR RTE" FLOAT32_IEEE NO_COMPU_METHOD 0 0 -3.402823466e+38 3.402823466e+38 ECU_ADDRESS 0 SYMBOL_LINK "Rte_CDD_GmT1xxMcuCfg_Adc1ScanGroup2Ref1_Val" 0 DISPLAY_IDENTIFIER CDD_AdcDiagc.ReceiverPorts.Adc1ScanGroup2Ref1.Val /end MEASUREMENT
/begin MEASUREMENT CDD_AdcDiagc.Adc1ScanGroup2RefFltCntSt "MICROSAR RTE" UBYTE NO_COMPU_METHOD 0 0 0 255 ECU_ADDRESS 0 SYMBOL_LINK "Rte_CDD_AdcDiagc_Adc1ScanGroup2RefFltCntSt" 0 DISPLAY_IDENTIFIER CDD_AdcDiagc.PerInstanceMemories.Adc1ScanGroup2RefFltCntSt /end MEASUREMENT
/begin MEASUREMENT CDD_AdcDiagc.Adc1ScanGroup3Ref0.Val "MICROSAR RTE" FLOAT32_IEEE NO_COMPU_METHOD 0 0 -3.402823466e+38 3.402823466e+38 ECU_ADDRESS 0 SYMBOL_LINK "Rte_CDD_GmT1xxMcuCfg_Adc1ScanGroup3Ref0_Val" 0 DISPLAY_IDENTIFIER CDD_AdcDiagc.ReceiverPorts.Adc1ScanGroup3Ref0.Val /end MEASUREMENT
/begin MEASUREMENT CDD_AdcDiagc.Adc1ScanGroup3Ref1.Val "MICROSAR RTE" FLOAT32_IEEE NO_COMPU_METHOD 0 0 -3.402823466e+38 3.402823466e+38 ECU_ADDRESS 0 SYMBOL_LINK "Rte_CDD_GmT1xxMcuCfg_Adc1ScanGroup3Ref1_Val" 0 DISPLAY_IDENTIFIER CDD_AdcDiagc.ReceiverPorts.Adc1ScanGroup3Ref1.Val /end MEASUREMENT
/begin MEASUREMENT CDD_AdcDiagc.Adc1ScanGroup3RefFltCntSt "MICROSAR RTE" UBYTE NO_COMPU_METHOD 0 0 0 255 ECU_ADDRESS 0 SYMBOL_LINK "Rte_CDD_AdcDiagc_Adc1ScanGroup3RefFltCntSt" 0 DISPLAY_IDENTIFIER CDD_AdcDiagc.PerInstanceMemories.Adc1ScanGroup3RefFltCntSt /end MEASUREMENT
/begin MEASUREMENT CDD_AdcDiagc.Adc1SelfDiag0.Val "MICROSAR RTE" FLOAT32_IEEE NO_COMPU_METHOD 0 0 -3.402823466e+38 3.402823466e+38 ECU_ADDRESS 0 SYMBOL_LINK "Rte_CDD_GmT1xxMcuCfg_Adc1SelfDiag0_Val" 0 DISPLAY_IDENTIFIER CDD_AdcDiagc.ReceiverPorts.Adc1SelfDiag0.Val /end MEASUREMENT
/begin MEASUREMENT CDD_AdcDiagc.Adc1SelfDiag2.Val "MICROSAR RTE" FLOAT32_IEEE NO_COMPU_METHOD 0 0 -3.402823466e+38 3.402823466e+38 ECU_ADDRESS 0 SYMBOL_LINK "Rte_CDD_GmT1xxMcuCfg_Adc1SelfDiag2_Val" 0 DISPLAY_IDENTIFIER CDD_AdcDiagc.ReceiverPorts.Adc1SelfDiag2.Val /end MEASUREMENT
/begin MEASUREMENT CDD_AdcDiagc.Adc1SelfDiag4.Val "MICROSAR RTE" FLOAT32_IEEE NO_COMPU_METHOD 0 0 -3.402823466e+38 3.402823466e+38 ECU_ADDRESS 0 SYMBOL_LINK "Rte_CDD_GmT1xxMcuCfg_Adc1SelfDiag4_Val" 0 DISPLAY_IDENTIFIER CDD_AdcDiagc.ReceiverPorts.Adc1SelfDiag4.Val /end MEASUREMENT
/begin MEASUREMENT CDD_AdcDiagc.AdcDiagcEndPtr "MICROSAR RTE" UBYTE NO_COMPU_METHOD 0 0 0 255 ECU_ADDRESS 0 SYMBOL_LINK "Rte_CDD_AdcDiagc_AdcDiagcEndPtr" 0 DISPLAY_IDENTIFIER CDD_AdcDiagc.PerInstanceMemories.AdcDiagcEndPtr /end MEASUREMENT
/begin MEASUREMENT CDD_AdcDiagc.AdcDiagcEndPtrOutp.Val "MICROSAR RTE" UBYTE NO_COMPU_METHOD 0 0 0 255 ECU_ADDRESS 0 SYMBOL_LINK "Rte_CDD_AdcDiagc_AdcDiagcEndPtrOutp_Val" 0 DISPLAY_IDENTIFIER CDD_AdcDiagc.SenderPorts.AdcDiagcEndPtrOutp.Val /end MEASUREMENT
/begin GROUP AAACalRegn03Rt01GroupB_Dummy_1.EotProtnEntrGainY.Ary2D "MICROSAR RTE" /begin SUB_GROUP /end SUB_GROUP /begin FUNCTION_LIST /end FUNCTION_LIST /begin REF_CHARACTERISTIC AAACalRegn03Rt01GroupB_Dummy_1.EotProtnEntrGainY.Ary2D /end REF_CHARACTERISTIC /begin REF_MEASUREMENT /end REF_MEASUREMENT /end GROUP
/begin GROUP AAACalRegn03Rt01GroupB_Dummy_1.EotProtnExitDampgY.Ary2D "MICROSAR RTE" /begin SUB_GROUP /end SUB_GROUP /begin FUNCTION_LIST /end FUNCTION_LIST /begin REF_CHARACTERISTIC AAACalRegn03Rt01GroupB_Dummy_1.EotProtnExitDampgY.Ary2D /end REF_CHARACTERISTIC /begin REF_MEASUREMENT /end REF_MEASUREMENT /end GROUP
/begin GROUP AAACalRegn03Rt01GroupB_Dummy_1.EotProtnHwDegDampgX.Ary2D "MICROSAR RTE" /begin SUB_GROUP /end SUB_GROUP /begin FUNCTION_LIST /end FUNCTION_LIST /begin REF_CHARACTERISTIC AAACalRegn03Rt01GroupB_Dummy_1.EotProtnHwDegDampgX.Ary2D /end REF_CHARACTERISTIC /begin REF_MEASUREMENT /end REF_MEASUREMENT /end GROUP
/begin GROUP AAACalRegn03Rt01GroupB_Dummy_1.EotProtnNormDampgY.Ary2D "MICROSAR RTE" /begin SUB_GROUP /end SUB_GROUP /begin FUNCTION_LIST /end FUNCTION_LIST /begin REF_CHARACTERISTIC AAACalRegn03Rt01GroupB_Dummy_1.EotProtnNormDampgY.Ary2D /end REF_CHARACTERISTIC /begin REF_MEASUREMENT /end REF_MEASUREMENT /end GROUP
/begin GROUP AAACalRegn03Rt01GroupB_Dummy_1.InertiaCmpVelAssiBasdDampgRollgWhlImbRejctnOnY.Ary1D "MICROSAR RTE" /begin SUB_GROUP /end SUB_GROUP /begin FUNCTION_LIST /end FUNCTION_LIST
 /begin REF_CHARACTERISTIC AAACalRegn03Rt01GroupB_Dummy_1.InertiaCmpVelAssiBasdDampgRollgWhlImbRejctnOnY.Ary1D /end REF_CHARACTERISTIC
 /begin REF_MEASUREMENT /end REF_MEASUREMENT
/end GROUP
/begin GROUP AAACalRegn03Rt01GroupB_Dummy_2 "MICROSAR RTE" /begin SUB_GROUP AAACalRegn03Rt01GroupB_Dummy_2.CalibrationPorts /end SUB_GROUP /begin FUNCTION_LIST /end FUNCTION_LIST /begin REF_CHARACTERISTIC /end REF_CHARACTERISTIC /begin REF_MEASUREMENT /end REF_MEASUREMENT /end GROUP
/begin GROUP AAACalRegn03Rt01GroupB_Dummy_2.AssiHiFrqTqWhlImbRejctnTqX.Ary2D "MICROSAR RTE" /begin SUB_GROUP /end SUB_GROUP /begin FUNCTION_LIST /end FUNCTION_LIST
 /begin REF_CHARACTERISTIC AAACalRegn03Rt01GroupB_Dummy_2.AssiHiFrqTqWhlImbRejctnTqX.Ary2D /end REF_CHARACTERISTIC
 /begin REF_MEASUREMENT /end REF_MEASUREMENT
/end GROUP
/begin GROUP AAACalRegn03Rt01GroupB_Dummy_2.AssiHiFrqWhlImbRejctnBlndX.Ary2D "MICROSAR RTE" /begin SUB_GROUP /end SUB_GROUP /begin FUNCTION_LIST /end FUNCTION_LIST
 /begin REF_CHARACTERISTIC AAACalRegn03Rt01GroupB_Dummy_2.AssiHiFrqWhlImbRejctnBlndX.Ary2D /end REF_CHARACTERISTIC
 /begin REF_MEASUREMENT /end REF_MEASUREMENT
/end GROUP
/begin GROUP AAACalRegn03Rt01GroupB_Dummy_2.AssiHiFrqWhlImbRejctnBlndY.Ary2D "MICROSAR RTE" /begin SUB_GROUP /end SUB_GROUP /begin FUNCTION_LIST /end FUNCTION_LIST
 /begin REF_CHARACTERISTIC AAACalRegn03Rt01GroupB_Dummy_2.AssiHiFrqWhlImbRejctnBlndY.Ary2D /end REF_CHARACTERISTIC
 /begin REF_MEASUREMENT /end REF_MEASUREMENT
/end GROUP
/begin GROUP AAACalRegn03Rt01GroupB_Dummy_2.AssiHiFrqWhlImbRejctnGainY.Ary2D "MICROSAR RTE" /begin SUB_GROUP /end SUB_GROUP /begin FUNCTION_LIST /end FUNCTION_LIST
 /begin REF_CHARACTERISTIC AAACalRegn03Rt01GroupB_Dummy_2.AssiHiFrqWhlImbRejctnGainY.Ary2D /end REF_CHARACTERISTIC
 /begin REF_MEASUREMENT /end REF_MEASUREMENT
/end GROUP
/begin GROUP AAACalRegn03Rt01GroupB_Dummy_2.AssiMotTqWhlImbRejctnMaxX.Ary2D "MICROSAR RTE" /begin SUB_GROUP /end SUB_GROUP /begin FUNCTION_LIST /end FUNCTION_LIST
 /begin REF_CHARACTERISTIC AAACalRegn03Rt01GroupB_Dummy_2.AssiMotTqWhlImbRejctnMaxX.Ary2D /end REF_CHARACTERISTIC
 /begin REF_MEASUREMENT /end REF_MEASUREMENT
/end GROUP
/begin GROUP AAACalRegn03Rt01GroupB_Dummy_2.AssiMotTqWhlImbRejctnMaxY.Ary2D "MICROSAR RTE" /begin SUB_GROUP /end SUB_GROUP /begin FUNCTION_LIST /end FUNCTION_LIST
 /begin REF_CHARACTERISTIC AAACalRegn03Rt01GroupB_Dummy_2.AssiMotTqWhlImbRejctnMaxY.Ary2D /end REF_CHARACTERISTIC
 /begin REF_MEASUREMENT /end REF_MEASUREMENT
/end GROUP
/begin GROUP AAACalRegn03Rt01GroupB_Dummy_2.AssiWhlImbRejctnBlndScaX.Ary2D "MICROSAR RTE" /begin SUB_GROUP /end SUB_GROUP /begin FUNCTION_LIST /end FUNCTION_LIST
 /begin REF_CHARACTERISTIC AAACalRegn03Rt01GroupB_Dummy_2.AssiWhlImbRejctnBlndScaX.Ary2D /end REF_CHARACTERISTIC
 /begin REF_MEASUREMENT /end REF_MEASUREMENT
/end GROUP
/begin GROUP AAACalRegn03Rt01GroupB_Dummy_2.AssiWhlImbRejctnBlndScaY.Ary2D "MICROSAR RTE" /begin SUB_GROUP /end SUB_GROUP /begin FUNCTION_LIST /end FUNCTION_LIST
 /begin REF_CHARACTERISTIC AAACalRegn03Rt01GroupB_Dummy_2.AssiWhlImbRejctnBlndScaY.Ary2D /end REF_CHARACTERISTIC
 /begin REF_MEASUREMENT /end REF_MEASUREMENT
/end GROUP
/begin GROUP AAACalRegn03Rt01GroupB_Dummy_2.CalibrationPorts "MICROSAR RTE"
 /begin SUB_GROUP AAACalRegn03Rt01GroupB_Dummy_2.AssiHiFrqTqWhlImbRejctnTqX.Ary2D AAACalRegn03Rt01GroupB_Dummy_2.AssiHiFrqWhlImbRejctnBlndX.Ary2D AAACalRegn03Rt01GroupB_Dummy_2.AssiHiFrqWhlImbRejctnBlndY.Ary2D AAACalRegn03Rt01GroupB_Dummy_2.AssiHiFrqWhlImbRejctnGainY.Ary2D AAACalRegn03Rt01GroupB_Dummy_2.AssiMotTqWhlImbRejctnMaxX.Ary2D AAACalRegn03Rt01GroupB_Dummy_2.AssiMotTqWhlImbRejctnMaxY.Ary2D AAACalRegn03Rt01GroupB_Dummy_2.AssiWhlImbRejctnBlndScaX.Ary2D AAACalRegn03Rt01GroupB_Dummy_2.AssiWhlImbRejctnBlndScaY.Ary2D AAACalRegn03Rt01GroupB_Dummy_2.EotProtnDampgVehSpdTbl.Ary1D AAACalRegn03Rt01GroupB_Dummy_2.EotProtnEntrGainVehSpdTbl.Ary1D AAACalRegn03Rt01GroupB_Dummy_2.EotProtnEntrGainX.Ary2D AAACalRegn03Rt01GroupB_Dummy_2.EotProtnEntrGainY.Ary2D AAACalRegn03Rt01GroupB_Dummy_2.EotProtnExitDampgY.Ary2D AAACalRegn03Rt01GroupB_Dummy_2.EotProtnHwDegDampgX.Ary2D AAACalRegn03Rt01GroupB_Dummy_2.EotProtnNormDampgY.Ary2D AAACalRegn03Rt01GroupB_Dummy_2.InertiaCmpVelAssiBasdDampgRollgWhlImbRejctnOnY.Ary1D /end SUB_GROUP
 /begin FUNCTION_LIST /end FUNCTION_LIST
 /begin REF_CHARACTERISTIC /end REF_CHARACTERISTIC
 /begin REF_MEASUREMENT /end REF_MEASUREMENT
/end GROUP
/begin GROUP AAACalRegn03Rt01GroupB_Dummy_2.EotProtnDampgVehSpdTbl.Ary1D "MICROSAR RTE" /begin SUB_GROUP /end SUB_GROUP /begin FUNCTION_LIST /end FUNCTION_LIST
 /begin REF_CHARACTERISTIC AAACalRegn03Rt01GroupB_Dummy_2.EotProtnDampgVehSpdTbl.Ary1D /end REF_CHARACTERISTIC
 /begin REF_MEASUREMENT /end REF_MEASUREMENT
/end GROUP
/begin GROUP AAACalRegn03Rt01GroupB_Dummy_2.EotProtnEntrGainVehSpdTbl.Ary1D "MICROSAR RTE" /begin SUB_GROUP /end SUB_GROUP /begin FUNCTION_LIST /end FUNCTION_LIST
 /begin REF_CHARACTERISTIC AAACalRegn03Rt01GroupB_Dummy_2.EotProtnEntrGainVehSpdTbl.Ary1D /end REF_CHARACTERISTIC
 /begin REF_MEASUREMENT /end REF_MEASUREMENT
/end GROUP
/begin GROUP AAACalRegn03Rt01GroupB_Dummy_2.EotProtnEntrGainX.Ary2D "MICROSAR RTE" /begin SUB_GROUP /end SUB_GROUP /begin FUNCTION_LIST /end FUNCTION_LIST /begin REF_CHARACTERISTIC AAACalRegn03Rt01GroupB_Dummy_2.EotProtnEntrGainX.Ary2D /end REF_CHARACTERISTIC /begin REF_MEASUREMENT /end REF_MEASUREMENT /end GROUP
/begin GROUP AAACalRegn03Rt01GroupB_Dummy_2.EotProtnEntrGainY.Ary2D "MICROSAR RTE" /begin SUB_GROUP /end SUB_GROUP /begin FUNCTION_LIST /end FUNCTION_LIST /begin REF_CHARACTERISTIC AAACalRegn03Rt01GroupB_Dummy_2.EotProtnEntrGainY.Ary2D /end REF_CHARACTERISTIC /begin REF_MEASUREMENT /end REF_MEASUREMENT /end GROUP
/begin GROUP AAACalRegn03Rt01GroupB_Dummy_2.EotProtnExitDampgY.Ary2D "MICROSAR RTE" /begin SUB_GROUP /end SUB_GROUP /begin FUNCTION_LIST /end FUNCTION_LIST /begin REF_CHARACTERISTIC AAACalRegn03Rt01GroupB_Dummy_2.EotProtnExitDampgY.Ary2D /end REF_CHARACTERISTIC /begin REF_MEASUREMENT /end REF_MEASUREMENT /end GROUP
/begin GROUP AAACalRegn03Rt01GroupB_Dummy_2.EotProtnHwDegDampgX.Ary2D "MICROSAR RTE" /begin SUB_GROUP /end SUB_GROUP /begin FUNCTION_LIST /end FUNCTION_LIST /begin REF_CHARACTERISTIC AAACalRegn03Rt01GroupB_Dummy_2.EotProtnHwDegDampgX.Ary2D /end REF_CHARACTERISTIC /begin REF_MEASUREMENT /end REF_MEASUREMENT /end GROUP
/begin GROUP AAACalRegn03Rt01GroupB_Dummy_2.EotProtnNormDampgY.Ary2D "MICROSAR RTE" /begin SUB_GROUP /end SUB_GROUP /begin FUNCTION_LIST /end FUNCTION_LIST /begin REF_CHARACTERISTIC AAACalRegn03Rt01GroupB_Dummy_2.EotProtnNormDampgY.Ary2D /end REF_CHARACTERISTIC /begin REF_MEASUREMENT /end REF_MEASUREMENT /end GROUP
/begin GROUP AAACalRegn03Rt01GroupB_Dummy_2.InertiaCmpVelAssiBasdDampgRollgWhlImbRejctnOnY.Ary1D "MICROSAR RTE" /begin SUB_GROUP /end SUB_GROUP /begin FUNCTION_LIST /end FUNCTION_LIST
 /begin REF_CHARACTERISTIC AAACalRegn03Rt01GroupB_Dummy_2.InertiaCmpVelAssiBasdDampgRollgWhlImbRejctnOnY.Ary1D /end REF_CHARACTERISTIC
 /begin REF_MEASUREMENT /end REF_MEASUREMENT
/end GROUP
/begin GROUP AAACalRegn03Rt01GroupB_Dummy_3 "MICROSAR RTE" /begin SUB_GROUP AAACalRegn03Rt01GroupB_Dummy_3.CalibrationPorts /end SUB_GROUP /begin FUNCTION_LIST /end FUNCTION_LIST /begin REF_CHARACTERISTIC /end REF_CHARACTERISTIC /begin REF_MEASUREMENT /end REF_MEASUREMENT /end GROUP
/begin GROUP AAACalRegn03Rt01GroupB_Dummy_3.AssiHiFrqTqWhlImbRejctnTqX.Ary2D "MICROSAR RTE" /begin SUB_GROUP /end SUB_GROUP /begin FUNCTION_LIST /end FUNCTION_LIST
 /begin REF_CHARACTERISTIC AAACalRegn03Rt01GroupB_Dummy_3.AssiHiFrqTqWhlImbRejctnTqX.Ary2D /end REF_CHARACTERISTIC
 /begin REF_MEASUREMENT /end REF_MEASUREMENT
/end GROUP
/begin GROUP AAACalRegn03Rt01GroupB_Dummy_3.AssiHiFrqWhlImbRejctnBlndX.Ary2D "MICROSAR RTE" /begin SUB_GROUP /end SUB_GROUP /begin FUNCTION_LIST /end FUNCTION_LIST
 /begin REF_CHARACTERISTIC AAACalRegn03Rt01GroupB_Dummy_3.AssiHiFrqWhlImbRejctnBlndX.Ary2D /end REF_CHARACTERISTIC
 /begin REF_MEASUREMENT /end REF_MEASUREMENT
/end GROUP
/begin GROUP AAACalRegn03Rt01GroupB_Dummy_3.AssiHiFrqWhlImbRejctnBlndY.Ary2D "MICROSAR RTE" /begin SUB_GROUP /end SUB_GROUP /begin FUNCTION_LIST /end FUNCTION_LIST
 /begin REF_CHARACTERISTIC AAACalRegn03Rt01GroupB_Dummy_3.AssiHiFrqWhlImbRejctnBlndY.Ary2D /end REF_CHARACTERISTIC
 /begin REF_MEASUREMENT /end REF_MEASUREMENT
/end GROUP
/begin GROUP AAACalRegn03Rt01GroupB_Dummy_3.AssiHiFrqWhlImbRejctnGainY.Ary2D "MICROSAR RTE" /begin SUB_GROUP /end SUB_GROUP /begin FUNCTION_LIST /end FUNCTION_LIST
 /begin REF_CHARACTERISTIC AAACalRegn03Rt01GroupB_Dummy_3.AssiHiFrqWhlImbRejctnGainY.Ary2D /end REF_CHARACTERISTIC
 /begin REF_MEASUREMENT /end REF_MEASUREMENT
/end GROUP
/begin GROUP AAACalRegn03Rt01GroupB_Dummy_3.AssiMotTqWhlImbRejctnMaxX.Ary2D "MICROSAR RTE" /begin SUB_GROUP /end SUB_GROUP /begin FUNCTION_LIST /end FUNCTION_LIST
 /begin REF_CHARACTERISTIC AAACalRegn03Rt01GroupB_Dummy_3.AssiMotTqWhlImbRejctnMaxX.Ary2D /end REF_CHARACTERISTIC
 /begin REF_MEASUREMENT /end REF_MEASUREMENT
/end GROUP
/begin GROUP AAACalRegn03Rt01GroupB_Dummy_3.AssiMotTqWhlImbRejctnMaxY.Ary2D "MICROSAR RTE" /begin SUB_GROUP /end SUB_GROUP /begin FUNCTION_LIST /end FUNCTION_LIST
 /begin REF_CHARACTERISTIC AAACalRegn03Rt01GroupB_Dummy_3.AssiMotTqWhlImbRejctnMaxY.Ary2D /end REF_CHARACTERISTIC
 /begin REF_MEASUREMENT /end REF_MEASUREMENT
/end GROUP
/begin GROUP AAACalRegn03Rt01GroupB_Dummy_3.AssiWhlImbRejctnBlndScaX.Ary2D "MICROSAR RTE" /begin SUB_GROUP /end SUB_GROUP /begin FUNCTION_LIST /end FUNCTION_LIST
 /begin REF_CHARACTERISTIC AAACalRegn03Rt01GroupB_Dummy_3.AssiWhlImbRejctnBlndScaX.Ary2D /end REF_CHARACTERISTIC
 /begin REF_MEASUREMENT /end REF_MEASUREMENT
/end GROUP
/begin GROUP AAACalRegn03Rt01GroupB_Dummy_3.AssiWhlImbRejctnBlndScaY.Ary2D "MICROSAR RTE" /begin SUB_GROUP /end SUB_GROUP /begin FUNCTION_LIST /end FUNCTION_LIST
 /begin REF_CHARACTERISTIC AAACalRegn03Rt01GroupB_Dummy_3.AssiWhlImbRejctnBlndScaY.Ary2D /end REF_CHARACTERISTIC
 /begin REF_MEASUREMENT /end REF_MEASUREMENT
/end GROUP
/begin GROUP AAACalRegn03Rt01GroupB_Dummy_3.CalibrationPorts "MICROSAR RTE"
 /begin SUB_GROUP AAACalRegn03Rt01GroupB_Dummy_3.AssiHiFrqTqWhlImbRejctnTqX.Ary2D AAACalRegn03Rt01GroupB_Dummy_3.AssiHiFrqWhlImbRejctnBlndX.Ary2D AAACalRegn03Rt01GroupB_Dummy_3.AssiHiFrqWhlImbRejctnBlndY.Ary2D AAACalRegn03Rt01GroupB_Dummy_3.AssiHiFrqWhlImbRejctnGainY.Ary2D AAACalRegn03Rt01GroupB_Dummy_3.AssiMotTqWhlImbRejctnMaxX.Ary2D AAACalRegn03Rt01GroupB_Dummy_3.AssiMotTqWhlImbRejctnMaxY.Ary2D AAACalRegn03Rt01GroupB_Dummy_3.AssiWhlImbRejctnBlndScaX.Ary2D AAACalRegn03Rt01GroupB_Dummy_3.AssiWhlImbRejctnBlndScaY.Ary2D AAACalRegn03Rt01GroupB_Dummy_3.EotProtnDampgVehSpdTbl.Ary1D AAACalRegn03Rt01GroupB_Dummy_3.EotProtnEntrGainVehSpdTbl.Ary1D AAACalRegn03Rt01GroupB_Dummy_3.EotProtnEntrGainX.Ary2D AAACalRegn03Rt01GroupB_Dummy_3.EotProtnEntrGainY.Ary2D AAACalRegn03Rt01GroupB_Dummy_3.EotProtnExitDampgY.Ary2D AAACalRegn03Rt01GroupB_Dummy_3.EotProtnHwDegDampgX.Ary2D AAACalRegn03Rt01GroupB_Dummy_3.EotProtnNormDampgY.Ary2D AAACalRegn03Rt01GroupB_Dummy_3.InertiaCmpVelAssiBasdDampgRollgWhlImbRejctnOnY.Ary1D /end SUB_GROUP
 /begin FUNCTION_LIST /end FUNCTION_LIST
 /begin REF_CHARACTERISTIC /end REF_CHARACTERISTIC
 /begin REF_MEASUREMENT /end REF_MEASUREMENT
/end GROUP
/begin GROUP AAACalRegn03Rt01GroupB_Dummy_3.EotProtnDampgVehSpdTbl.Ary1D "MICROSAR RTE" /begin SUB_GROUP /end SUB_GROUP /begin FUNCTION_LIST /end FUNCTION_LIST
 /begin REF_CHARACTERISTIC AAACalRegn03Rt01GroupB_Dummy_3.EotProtnDampgVehSpdTbl.Ary1D /end REF_CHARACTERISTIC
 /begin REF_MEASUREMENT /end REF_MEASUREMENT
/end GROUP
/begin GROUP AAACalRegn03Rt01GroupB_Dummy_3.EotProtnEntrGainVehSpdTbl.Ary1D "MICROSAR RTE" /begin SUB_GROUP /end SUB_GROUP /begin FUNCTION_LIST /end FUNCTION_LIST
 /begin REF_CHARACTERISTIC AAACalRegn03Rt01GroupB_Dummy_3.EotProtnEntrGainVehSpdTbl.Ary1D /end REF_CHARACTERISTIC
 /begin REF_MEASUREMENT /end REF_MEASUREMENT
/end GROUP
/begin GROUP AAACalRegn03Rt01GroupB_Dummy_3.EotProtnEntrGainX.Ary2D "MICROSAR RTE" /begin SUB_GROUP /end SUB_GROUP /begin FUNCTION_LIST /end FUNCTION_LIST /begin REF_CHARACTERISTIC AAACalRegn03Rt01GroupB_Dummy_3.EotProtnEntrGainX.Ary2D /end REF_CHARACTERISTIC /begin REF_MEASUREMENT /end REF_MEASUREMENT /end GROUP
/begin GROUP AAACalRegn03Rt01GroupB_Dummy_3.EotProtnEntrGainY.Ary2D "MICROSAR RTE" /begin SUB_GROUP /end SUB_GROUP /begin FUNCTION_LIST /end FUNCTION_LIST /begin REF_CHARACTERISTIC AAACalRegn03Rt01GroupB_Dummy_3.EotProtnEntrGainY.Ary2D /end REF_CHARACTERISTIC /begin REF_MEASUREMENT /end REF_MEASUREMENT /end GROUP
/begin GROUP AAACalRegn03Rt01GroupB_Dummy_3.EotProtnExitDampgY.Ary2D "MICROSAR RTE" /begin SUB_GROUP /end SUB_GROUP /begin FUNCTION_LIST /end FUNCTION_LIST /begin REF_CHARACTERISTIC AAACalRegn03Rt01GroupB_Dummy_3.EotProtnExitDampgY.Ary2D /end REF_CHARACTERISTIC /begin REF_MEASUREMENT /end REF_MEASUREMENT /end GROUP
/begin GROUP AAACalRegn03Rt01GroupB_Dummy_3.EotProtnHwDegDampgX.Ary2D "MICROSAR RTE" /begin SUB_GROUP /end SUB_GROUP /begin FUNCTION_LIST /end FUNCTION_LIST /begin REF_CHARACTERISTIC AAACalRegn03Rt01GroupB_Dummy_3.EotProtnHwDegDampgX.Ary2D /end REF_CHARACTERISTIC /begin REF_MEASUREMENT /end REF_MEASUREMENT /end GROUP
/begin GROUP AAACalRegn03Rt01GroupB_Dummy_3.EotProtnNormDampgY.Ary2D "MICROSAR RTE" /begin SUB_GROUP /end SUB_GROUP /begin FUNCTION_LIST /end FUNCTION_LIST /begin REF_CHARACTERISTIC AAACalRegn03Rt01GroupB_Dummy_3.EotProtnNormDampgY.Ary2D /end REF_CHARACTERISTIC /begin REF_MEASUREMENT /end REF_MEASUREMENT /end GROUP
/begin GROUP AAACalRegn03Rt01GroupB_Dummy_3.InertiaCmpVelAssiBasdDampgRollgWhlImbRejctnOnY.Ary1D "MICROSAR RTE" /begin SUB_GROUP /end SUB_GROUP /begin FUNCTION_LIST /end FUNCTION_LIST
 /begin REF_CHARACTERISTIC AAACalRegn03Rt01GroupB_Dummy_3.InertiaCmpVelAssiBasdDampgRollgWhlImbRejctnOnY.Ary1D /end REF_CHARACTERISTIC
 /begin REF_MEASUREMENT /end REF_MEASUREMENT
/end GROUP
/begin GROUP AAACalRegn03Rt01GroupB_Dummy_4 "MICROSAR RTE" /begin SUB_GROUP AAACalRegn03Rt01GroupB_Dummy_4.CalibrationPorts /end SUB_GROUP /begin FUNCTION_LIST /end FUNCTION_LIST /begin REF_CHARACTERISTIC /end REF_CHARACTERISTIC /begin REF_MEASUREMENT /end REF_MEASUREMENT /end GROUP
/begin GROUP AAACalRegn03Rt01GroupB_Dummy_4.AssiHiFrqTqWhlImbRejctnTqX.Ary2D "MICROSAR RTE" /begin SUB_GROUP /end SUB_GROUP /begin FUNCTION_LIST /end FUNCTION_LIST
 /begin REF_CHARACTERISTIC AAACalRegn03Rt01GroupB_Dummy_4.AssiHiFrqTqWhlImbRejctnTqX.Ary2D /end REF_CHARACTERISTIC
 /begin REF_MEASUREMENT /end REF_MEASUREMENT
/end GROUP
/begin GROUP AAACalRegn03Rt01GroupB_Dummy_4.AssiHiFrqWhlImbRejctnBlndX.Ary2D "MICROSAR RTE" /begin SUB_GROUP /end SUB_GROUP /begin FUNCTION_LIST /end FUNCTION_LIST
 /begin REF_CHARACTERISTIC AAACalRegn03Rt01GroupB_Dummy_4.AssiHiFrqWhlImbRejctnBlndX.Ary2D /end REF_CHARACTERISTIC
 /begin REF_MEASUREMENT /end REF_MEASUREMENT
/end GROUP
/begin GROUP AAACalRegn03Rt01GroupB_Dummy_4.AssiHiFrqWhlImbRejctnBlndY.Ary2D "MICROSAR RTE" /begin SUB_GROUP /end SUB_GROUP /begin FUNCTION_LIST /end FUNCTION_LIST
 /begin REF_CHARACTERISTIC AAACalRegn03Rt01GroupB_Dummy_4.AssiHiFrqWhlImbRejctnBlndY.Ary2D /end REF_CHARACTERISTIC
 /begin REF_MEASUREMENT /end REF_MEASUREMENT
/end GROUP
/begin GROUP AAACalRegn03Rt01GroupB_Dummy_4.AssiHiFrqWhlImbRejctnGainY.Ary2D "MICROSAR RTE" /begin SUB_GROUP /end SUB_GROUP /begin FUNCTION_LIST /end FUNCTION_LIST
 /begin REF_CHARACTERISTIC AAACalRegn03Rt01GroupB_Dummy_4.AssiHiFrqWhlImbRejctnGainY.Ary2D /end REF_CHARACTERISTIC
 /begin REF_MEASUREMENT /end REF_MEASUREMENT
/end GROUP
/begin GROUP AAACalRegn03Rt01GroupB_Dummy_4.AssiMotTqWhlImbRejctnMaxX.Ary2D "MICROSAR RTE" /begin SUB_GROUP /end SUB_GROUP /begin FUNCTION_LIST /end FUNCTION_LIST
 /begin REF_CHARACTERISTIC AAACalRegn03Rt01GroupB_Dummy_4.AssiMotTqWhlImbRejctnMaxX.Ary2D /end REF_CHARACTERISTIC
 /begin REF_MEASUREMENT /end REF_MEASUREMENT
/end GROUP
/begin GROUP AAACalRegn03Rt01GroupB_Dummy_4.AssiMotTqWhlImbRejctnMaxY.Ary2D "MICROSAR RTE" /begin SUB_GROUP /end SUB_GROUP /begin FUNCTION_LIST /end FUNCTION_LIST
 /begin REF_CHARACTERISTIC AAACalRegn03Rt01GroupB_Dummy_4.AssiMotTqWhlImbRejctnMaxY.Ary2D /end REF_CHARACTERISTIC
 /begin REF_MEASUREMENT /end REF_MEASUREMENT
/end GROUP
/begin GROUP AAACalRegn03Rt01GroupB_Dummy_4.AssiWhlImbRejctnBlndScaX.Ary2D "MICROSAR RTE" /begin SUB_GROUP /end SUB_GROUP /begin FUNCTION_LIST /end FUNCTION_LIST
 /begin REF_CHARACTERISTIC AAACalRegn03Rt01GroupB_Dummy_4.AssiWhlImbRejctnBlndScaX.Ary2D /end REF_CHARACTERISTIC
 /begin REF_MEASUREMENT /end REF_MEASUREMENT
/end GROUP
/begin GROUP AAACalRegn03Rt01GroupB_Dummy_4.AssiWhlImbRejctnBlndScaY.Ary2D "MICROSAR RTE" /begin SUB_GROUP /end SUB_GROUP /begin FUNCTION_LIST /end FUNCTION_LIST
 /begin REF_CHARACTERISTIC AAACalRegn03Rt01GroupB_Dummy_4.AssiWhlImbRejctnBlndScaY.Ary2D /end REF_CHARACTERISTIC
 /begin REF_MEASUREMENT /end REF_MEASUREMENT
/end GROUP
/begin GROUP AAACalRegn03Rt01GroupB_Dummy_4.CalibrationPorts "MICROSAR RTE"
 /begin SUB_GROUP AAACalRegn03Rt01GroupB_Dummy_4.AssiHiFrqTqWhlImbRejctnTqX.Ary2D AAACalRegn03Rt01GroupB_Dummy_4.AssiHiFrqWhlImbRejctnBlndX.Ary2D AAACalRegn03Rt01GroupB_Dummy_4.AssiHiFrqWhlImbRejctnBlndY.Ary2D AAACalRegn03Rt01GroupB_Dummy_4.AssiHiFrqWhlImbRejctnGainY.Ary2D AAACalRegn03Rt01GroupB_Dummy_4.AssiMotTqWhlImbRejctnMaxX.Ary2D AAACalRegn03Rt01GroupB_Dummy_4.AssiMotTqWhlImbRejctnMaxY.Ary2D AAACalRegn03Rt01GroupB_Dummy_4.AssiWhlImbRejctnBlndScaX.Ary2D AAACalRegn03Rt01GroupB_Dummy_4.AssiWhlImbRejctnBlndScaY.Ary2D AAACalRegn03Rt01GroupB_Dummy_4.EotProtnDampgVehSpdTbl.Ary1D AAACalRegn03Rt01GroupB_Dummy_4.EotProtnEntrGainVehSpdTbl.Ary1D AAACalRegn03Rt01GroupB_Dummy_4.EotProtnEntrGainX.Ary2D AAACalRegn03Rt01GroupB_Dummy_4.EotProtnEntrGainY.Ary2D AAACalRegn03Rt01GroupB_Dummy_4.EotProtnExitDampgY.Ary2D AAACalRegn03Rt01GroupB_Dummy_4.EotProtnHwDegDampgX.Ary2D AAACalRegn03Rt01GroupB_Dummy_4.EotProtnNormDampgY.Ary2D AAACalRegn03Rt01GroupB_Dummy_4.InertiaCmpVelAssiBasdDampgRollgWhlImbRejctnOnY.Ary1D /end SUB_GROUP
 /begin FUNCTION_LIST /end FUNCTION_LIST
 /begin REF_CHARACTERISTIC /end REF_CHARACTERISTIC
 /begin REF_MEASUREMENT /end REF_MEASUREMENT
/end GROUP
/begin GROUP AAACalRegn03Rt01GroupB_Dummy_4.EotProtnDampgVehSpdTbl.Ary1D "MICROSAR RTE" /begin SUB_GROUP /end SUB_GROUP /begin FUNCTION_LIST /end FUNCTION_LIST
 /begin REF_CHARACTERISTIC AAACalRegn03Rt01GroupB_Dummy_4.EotProtnDampgVehSpdTbl.Ary1D /end REF_CHARACTERISTIC
 /begin REF_MEASUREMENT /end REF_MEASUREMENT
/end GROUP
/begin GROUP AAACalRegn03Rt01GroupB_Dummy_4.EotProtnEntrGainVehSpdTbl.Ary1D "MICROSAR RTE" /begin SUB_GROUP /end SUB_GROUP /begin FUNCTION_LIST /end FUNCTION_LIST
 /begin REF_CHARACTERISTIC AAACalRegn03Rt01GroupB_Dummy_4.EotProtnEntrGainVehSpdTbl.Ary1D /end REF_CHARACTERISTIC
 /begin REF_MEASUREMENT /end REF_MEASUREMENT
/end GROUP
/begin GROUP AAACalRegn03Rt01GroupB_Dummy_4.EotProtnEntrGainX.Ary2D "MICROSAR RTE" /begin SUB_GROUP /end SUB_GROUP /begin FUNCTION_LIST /end FUNCTION_LIST /begin REF_CHARACTERISTIC AAACalRegn03Rt01GroupB_Dummy_4.EotProtnEntrGainX.Ary2D /end REF_CHARACTERISTIC /begin REF_MEASUREMENT /end REF_MEASUREMENT /end GROUP
/begin GROUP AAACalRegn03Rt01GroupB_Dummy_4.EotProtnEntrGainY.Ary2D "MICROSAR RTE" /begin SUB_GROUP /end SUB_GROUP /begin FUNCTION_LIST /end FUNCTION_LIST /begin REF_CHARACTERISTIC AAACalRegn03Rt01GroupB_Dummy_4.EotProtnEntrGainY.Ary2D /end REF_CHARACTERISTIC /begin REF_MEASUREMENT /end REF_MEASUREMENT /end GROUP
/begin GROUP AAACalRegn03Rt01GroupB_Dummy_4.EotProtnExitDampgY.Ary2D "MICROSAR RTE" /begin SUB_GROUP /end SUB_GROUP /begin FUNCTION_LIST /end FUNCTION_LIST /begin REF_CHARACTERISTIC AAACalRegn03Rt01GroupB_Dummy_4.EotProtnExitDampgY.Ary2D /end REF_CHARACTERISTIC /begin REF_MEASUREMENT /end REF_MEASUREMENT /end GROUP
/begin GROUP AAACalRegn03Rt01GroupB_Dummy_4.EotProtnHwDegDampgX.Ary2D "MICROSAR RTE" /begin SUB_GROUP /end SUB_GROUP /begin FUNCTION_LIST /end FUNCTION_LIST /begin REF_CHARACTERISTIC AAACalRegn03Rt01GroupB_Dummy_4.EotProtnHwDegDampgX.Ary2D /end REF_CHARACTERISTIC /begin REF_MEASUREMENT /end REF_MEASUREMENT /end GROUP
/begin GROUP AAACalRegn03Rt01GroupB_Dummy_4.EotProtnNormDampgY.Ary2D "MICROSAR RTE" /begin SUB_GROUP /end SUB_GROUP /begin FUNCTION_LIST /end FUNCTION_LIST /begin REF_CHARACTERISTIC AAACalRegn03Rt01GroupB_Dummy_4.EotProtnNormDampgY.Ary2D /end REF_CHARACTERISTIC /begin REF_MEASUREMENT /end REF_MEASUREMENT /end GROUP
/begin GROUP AAACalRegn03Rt01GroupB_Dummy_4.InertiaCmpVelAssiBasdDampgRollgWhlImbRejctnOnY.Ary1D "MICROSAR RTE" /begin SUB_GROUP /end SUB_GROUP /begin FUNCTION_LIST /end FUNCTION_LIST
 /begin REF_CHARACTERISTIC AAACalRegn03Rt01GroupB_Dummy_4.InertiaCmpVelAssiBasdDampgRollgWhlImbRejctnOnY.Ary1D /end REF_CHARACTERISTIC
 /begin REF_MEASUREMENT /end REF_MEASUREMENT
/end GROUP
/begin GROUP AAACalRegn03Rt01_Dummy "MICROSAR RTE" /begin SUB_GROUP AAACalRegn03Rt01_Dummy.CalibrationPorts /end SUB_GROUP /begin FUNCTION_LIST /end FUNCTION_LIST /begin REF_CHARACTERISTIC /end REF_CHARACTERISTIC /begin REF_MEASUREMENT /end REF_MEASUREMENT /end GROUP
/begin GROUP AAACalRegn03Rt01_Dummy.CalibrationPorts "MICROSAR RTE"
 /begin SUB_GROUP AAACalRegn03Rt01_Dummy.InertiaCmpVelDampgFilFrq.Ary1D AAACalRegn03Rt01_Dummy.InertiaCmpVelDampgFilFrqWhlImbRejctnOn.Ary1D /end SUB_GROUP
 /begin FUNCTION_LIST /end FUNCTION_LIST
 /begin REF_CHARACTERISTIC /end REF_CHARACTERISTIC
 /begin REF_MEASUREMENT /end REF_MEASUREMENT
/end GROUP
/begin GROUP AAACalRegn03Rt01_Dummy.InertiaCmpVelDampgFilFrq.Ary1D "MICROSAR RTE" /begin SUB_GROUP /end SUB_GROUP /begin FUNCTION_LIST /end FUNCTION_LIST /begin REF_CHARACTERISTIC AAACalRegn03Rt01_Dummy.InertiaCmpVelDampgFilFrq.Ary1D /end REF_CHARACTERISTIC /begin REF_MEASUREMENT /end REF_MEASUREMENT /end GROUP
/begin GROUP AAACalRegn03Rt01_Dummy.InertiaCmpVelDampgFilFrqWhlImbRejctnOn.Ary1D "MICROSAR RTE" /begin SUB_GROUP /end SUB_GROUP /begin FUNCTION_LIST /end FUNCTION_LIST
 /begin REF_CHARACTERISTIC AAACalRegn03Rt01_Dummy.InertiaCmpVelDampgFilFrqWhlImbRejctnOn.Ary1D /end REF_CHARACTERISTIC
 /begin REF_MEASUREMENT /end REF_MEASUREMENT
/end GROUP
/begin GROUP AAACalRegn03Rt01_Dummy_1 "MICROSAR RTE" /begin SUB_GROUP AAACalRegn03Rt01_Dummy_1.CalibrationPorts /end SUB_GROUP /begin FUNCTION_LIST /end FUNCTION_LIST /begin REF_CHARACTERISTIC /end REF_CHARACTERISTIC /begin REF_MEASUREMENT /end REF_MEASUREMENT /end GROUP
/begin GROUP AAACalRegn03Rt01_Dummy_1.CalibrationPorts "MICROSAR RTE"
 /begin SUB_GROUP AAACalRegn03Rt01_Dummy_1.InertiaCmpVelDampgFilFrq.Ary1D AAACalRegn03Rt01_Dummy_1.InertiaCmpVelDampgFilFrqWhlImbRejctnOn.Ary1D /end SUB_GROUP
 /begin FUNCTION_LIST /end FUNCTION_LIST
 /begin REF_CHARACTERISTIC /end REF_CHARACTERISTIC
 /begin REF_MEASUREMENT /end REF_MEASUREMENT
/end GROUP
/begin GROUP AAACalRegn03Rt01_Dummy_1.InertiaCmpVelDampgFilFrq.Ary1D "MICROSAR RTE" /begin SUB_GROUP /end SUB_GROUP /begin FUNCTION_LIST /end FUNCTION_LIST /begin REF_CHARACTERISTIC AAACalRegn03Rt01_Dummy_1.InertiaCmpVelDampgFilFrq.Ary1D /end REF_CHARACTERISTIC /begin REF_MEASUREMENT /end REF_MEASUREMENT /end GROUP
/begin GROUP AAACalRegn03Rt01_Dummy_1.InertiaCmpVelDampgFilFrqWhlImbRejctnOn.Ary1D "MICROSAR RTE" /begin SUB_GROUP /end SUB_GROUP /begin FUNCTION_LIST /end FUNCTION_LIST
 /begin REF_CHARACTERISTIC AAACalRegn03Rt01_Dummy_1.InertiaCmpVelDampgFilFrqWhlImbRejctnOn.Ary1D /end REF_CHARACTERISTIC
 /begin REF_MEASUREMENT /end REF_MEASUREMENT
/end GROUP
/begin GROUP AAACalRegn03Rt01_Dummy_2 "MICROSAR RTE" /begin SUB_GROUP AAACalRegn03Rt01_Dummy_2.CalibrationPorts /end SUB_GROUP /begin FUNCTION_LIST /end FUNCTION_LIST /begin REF_CHARACTERISTIC /end REF_CHARACTERISTIC /begin REF_MEASUREMENT /end REF_MEASUREMENT /end GROUP
/begin GROUP AAACalRegn03Rt01_Dummy_2.CalibrationPorts "MICROSAR RTE"
 /begin SUB_GROUP AAACalRegn03Rt01_Dummy_2.InertiaCmpVelDampgFilFrq.Ary1D AAACalRegn03Rt01_Dummy_2.InertiaCmpVelDampgFilFrqWhlImbRejctnOn.Ary1D /end SUB_GROUP
 /begin FUNCTION_LIST /end FUNCTION_LIST
 /begin REF_CHARACTERISTIC /end REF_CHARACTERISTIC
 /begin REF_MEASUREMENT /end REF_MEASUREMENT
/end GROUP
/begin GROUP AAACalRegn03Rt01_Dummy_2.InertiaCmpVelDampgFilFrq.Ary1D "MICROSAR RTE" /begin SUB_GROUP /end SUB_GROUP /begin FUNCTION_LIST /end FUNCTION_LIST /begin REF_CHARACTERISTIC AAACalRegn03Rt01_Dummy_2.InertiaCmpVelDampgFilFrq.Ary1D /end REF_CHARACTERISTIC /begin REF_MEASUREMENT /end REF_MEASUREMENT /end GROUP
/begin GROUP AAACalRegn03Rt01_Dummy_2.InertiaCmpVelDampgFilFrqWhlImbRejctnOn.Ary1D "MICROSAR RTE" /begin SUB_GROUP /end SUB_GROUP /begin FUNCTION_LIST /end FUNCTION_LIST
 /begin REF_CHARACTERISTIC AAACalRegn03Rt01_Dummy_2.InertiaCmpVelDampgFilFrqWhlImbRejctnOn.Ary1D /end REF_CHARACTERISTIC
 /begin REF_MEASUREMENT /end REF_MEASUREMENT
/end GROUP
/begin GROUP AAACalRegn03Rt01_Dummy_3 "MICROSAR RTE" /begin SUB_GROUP AAACalRegn03Rt01_Dummy_3.CalibrationPorts /end SUB_GROUP /begin FUNCTION_LIST /end FUNCTION_LIST /begin REF_CHARACTERISTIC /end REF_CHARACTERISTIC /begin REF_MEASUREMENT /end REF_MEASUREMENT /end GROUP
/begin GROUP AAACalRegn03Rt01_Dummy_3.CalibrationPorts "MICROSAR RTE"
 /begin SUB_GROUP AAACalRegn03Rt01_Dummy_3.InertiaCmpVelDampgFilFrq.Ary1D AAACalRegn03Rt01_Dummy_3.InertiaCmpVelDampgFilFrqWhlImbRejctnOn.Ary1D /end SUB_GROUP
 /begin FUNCTION_LIST /end FUNCTION_LIST
 /begin REF_CHARACTERISTIC /end REF_CHARACTERISTIC
 /begin REF_MEASUREMENT /end REF_MEASUREMENT
/end GROUP
/begin GROUP AAACalRegn03Rt01_Dummy_3.InertiaCmpVelDampgFilFrq.Ary1D "MICROSAR RTE" /begin SUB_GROUP /end SUB_GROUP /begin FUNCTION_LIST /end FUNCTION_LIST /begin REF_CHARACTERISTIC AAACalRegn03Rt01_Dummy_3.InertiaCmpVelDampgFilFrq.Ary1D /end REF_CHARACTERISTIC /begin REF_MEASUREMENT /end REF_MEASUREMENT /end GROUP
/begin GROUP AAACalRegn03Rt01_Dummy_3.InertiaCmpVelDampgFilFrqWhlImbRejctnOn.Ary1D "MICROSAR RTE" /begin SUB_GROUP /end SUB_GROUP /begin FUNCTION_LIST /end FUNCTION_LIST
 /begin REF_CHARACTERISTIC AAACalRegn03Rt01_Dummy_3.InertiaCmpVelDampgFilFrqWhlImbRejctnOn.Ary1D /end REF_CHARACTERISTIC
 /begin REF_MEASUREMENT /end REF_MEASUREMENT
/end GROUP
/begin GROUP AAACalRegn03Rt01_Dummy_4 "MICROSAR RTE" /begin SUB_GROUP AAACalRegn03Rt01_Dummy_4.CalibrationPorts /end SUB_GROUP /begin FUNCTION_LIST /end FUNCTION_LIST /begin REF_CHARACTERISTIC /end REF_CHARACTERISTIC /begin REF_MEASUREMENT /end REF_MEASUREMENT /end GROUP
/begin GROUP AAACalRegn03Rt01_Dummy_4.CalibrationPorts "MICROSAR RTE"
 /begin SUB_GROUP AAACalRegn03Rt01_Dummy_4.InertiaCmpVelDampgFilFrq.Ary1D AAACalRegn03Rt01_Dummy_4.InertiaCmpVelDampgFilFrqWhlImbRejctnOn.Ary1D /end SUB_GROUP
 /begin FUNCTION_LIST /end FUNCTION_LIST
 /begin REF_CHARACTERISTIC /end REF_CHARACTERISTIC
 /begin REF_MEASUREMENT /end REF_MEASUREMENT
/end GROUP
/begin GROUP AAACalRegn03Rt01_Dummy_4.InertiaCmpVelDampgFilFrq.Ary1D "MICROSAR RTE" /begin SUB_GROUP /end SUB_GROUP /begin FUNCTION_LIST /end FUNCTION_LIST /begin REF_CHARACTERISTIC AAACalRegn03Rt01_Dummy_4.InertiaCmpVelDampgFilFrq.Ary1D /end REF_CHARACTERISTIC /begin REF_MEASUREMENT /end REF_MEASUREMENT /end GROUP
/begin GROUP AAACalRegn03Rt01_Dummy_4.InertiaCmpVelDampgFilFrqWhlImbRejctnOn.Ary1D "MICROSAR RTE" /begin SUB_GROUP /end SUB_GROUP /begin FUNCTION_LIST /end FUNCTION_LIST
 /begin REF_CHARACTERISTIC AAACalRegn03Rt01_Dummy_4.InertiaCmpVelDampgFilFrqWhlImbRejctnOn.Ary1D /end REF_CHARACTERISTIC
 /begin REF_MEASUREMENT /end REF_MEASUREMENT
/end GROUP
/begin GROUP Assi "MICROSAR RTE"
 /begin SUB_GROUP Assi.CalibrationPorts Assi.PerInstanceMemories Assi.ReceiverPorts Assi.SenderPorts /end SUB_GROUP
 /begin FUNCTION_LIST /end FUNCTION_LIST
 /begin REF_CHARACTERISTIC /end REF_CHARACTERISTIC
 /begin REF_MEASUREMENT /end REF_MEASUREMENT
/end GROUP
/begin GROUP Assi.AssiCmdBas.Val "MICROSAR RTE" /begin SUB_GROUP /end SUB_GROUP /begin FUNCTION_LIST /end FUNCTION_LIST /begin REF_CHARACTERISTIC /end REF_CHARACTERISTIC /begin REF_MEASUREMENT Assi.AssiCmdBas.Val /end REF_MEASUREMENT /end GROUP
/begin GROUP Assi.AssiCmdBasSca.Val "MICROSAR RTE" /begin SUB_GROUP /end SUB_GROUP /begin FUNCTION_LIST /end FUNCTION_LIST /begin REF_CHARACTERISTIC /end REF_CHARACTERISTIC /begin REF_MEASUREMENT Assi.AssiCmdBasSca.Val /end REF_MEASUREMENT /end GROUP
/begin GROUP Assi.AssiLnrGain.Val "MICROSAR RTE" /begin SUB_GROUP /end SUB_GROUP /begin FUNCTION_LIST /end FUNCTION_LIST /begin REF_CHARACTERISTIC /end REF_CHARACTERISTIC /begin REF_MEASUREMENT Assi.AssiLnrGain.Val /end REF_MEASUREMENT /end GROUP
/begin GROUP Assi.AssiLnrGainEna.Logl "MICROSAR RTE" /begin SUB_GROUP /end SUB_GROUP /begin FUNCTION_LIST /end FUNCTION_LIST /begin REF_CHARACTERISTIC /end REF_CHARACTERISTIC /begin REF_MEASUREMENT Assi.AssiLnrGainEna.Logl /end REF_MEASUREMENT /end GROUP
/begin GROUP Assi.AssiMotTqWhlImbRejctnMaxX.Ary2D "MICROSAR RTE" /begin SUB_GROUP /end SUB_GROUP /begin FUNCTION_LIST /end FUNCTION_LIST /begin REF_CHARACTERISTIC Assi.AssiMotTqWhlImbRejctnMaxX.Ary2D /end REF_CHARACTERISTIC /begin REF_MEASUREMENT /end REF_MEASUREMENT /end GROUP
/begin GROUP Assi.AssiMotTqWhlImbRejctnMaxY.Ary2D "MICROSAR RTE" /begin SUB_GROUP /end SUB_GROUP /begin FUNCTION_LIST /end FUNCTION_LIST /begin REF_CHARACTERISTIC Assi.AssiMotTqWhlImbRejctnMaxY.Ary2D /end REF_CHARACTERISTIC /begin REF_MEASUREMENT /end REF_MEASUREMENT /end GROUP
/begin GROUP Assi.AssiMotTqWhlImbRejctnMinX.Ary2D "MICROSAR RTE" /begin SUB_GROUP /end SUB_GROUP /begin FUNCTION_LIST /end FUNCTION_LIST /begin REF_CHARACTERISTIC Assi.AssiMotTqWhlImbRejctnMinX.Ary2D /end REF_CHARACTERISTIC /begin REF_MEASUREMENT /end REF_MEASUREMENT /end GROUP
/begin GROUP Assi.AssiMotTqWhlImbRejctnMinY.Ary2D "MICROSAR RTE" /begin SUB_GROUP /end SUB_GROUP /begin FUNCTION_LIST /end FUNCTION_LIST /begin REF_CHARACTERISTIC Assi.AssiMotTqWhlImbRejctnMinY.Ary2D /end REF_CHARACTERISTIC /begin REF_MEASUREMENT /end REF_MEASUREMENT /end GROUP
/begin GROUP Assi.AssiThermScaX.Ary1D "MICROSAR RTE" /begin SUB_GROUP /end SUB_GROUP /begin FUNCTION_LIST /end FUNCTION_LIST /begin REF_CHARACTERISTIC Assi.AssiThermScaX.Ary1D /end REF_CHARACTERISTIC /begin REF_MEASUREMENT /end REF_MEASUREMENT /end GROUP
/begin GROUP Assi.AssiThermScaY.Ary1D "MICROSAR RTE" /begin SUB_GROUP /end SUB_GROUP /begin FUNCTION_LIST /end FUNCTION_LIST /begin REF_CHARACTERISTIC Assi.AssiThermScaY.Ary1D /end REF_CHARACTERISTIC /begin REF_MEASUREMENT /end REF_MEASUREMENT /end GROUP
/begin GROUP Assi.AssiWhlImbRejctnBlndScaX.Ary2D "MICROSAR RTE" /begin SUB_GROUP /end SUB_GROUP /begin FUNCTION_LIST /end FUNCTION_LIST /begin REF_CHARACTERISTIC Assi.AssiWhlImbRejctnBlndScaX.Ary2D /end REF_CHARACTERISTIC /begin REF_MEASUREMENT /end REF_MEASUREMENT /end GROUP
/begin GROUP Assi.AssiWhlImbRejctnBlndScaY.Ary2D "MICROSAR RTE" /begin SUB_GROUP /end SUB_GROUP /begin FUNCTION_LIST /end FUNCTION_LIST /begin REF_CHARACTERISTIC Assi.AssiWhlImbRejctnBlndScaY.Ary2D /end REF_CHARACTERISTIC /begin REF_MEASUREMENT /end REF_MEASUREMENT /end GROUP
/begin GROUP Assi.CalibrationPorts "MICROSAR RTE"
 /begin SUB_GROUP Assi.AssiMotTqWhlImbRejctnMaxX.Ary2D Assi.AssiMotTqWhlImbRejctnMaxY.Ary2D Assi.AssiMotTqWhlImbRejctnMinX.Ary2D Assi.AssiMotTqWhlImbRejctnMinY.Ary2D Assi.AssiThermScaX.Ary1D Assi.AssiThermScaY.Ary1D Assi.AssiWhlImbRejctnBlndScaX.Ary2D Assi.AssiWhlImbRejctnBlndScaY.Ary2D Assi.SysGlbPrmVehSpd.Ary1D Assi.SysGlbPrmVehSpdBilnrSeln.Ary1D /end SUB_GROUP
 /begin FUNCTION_LIST /end FUNCTION_LIST
 /begin REF_CHARACTERISTIC /end REF_CHARACTERISTIC
 /begin REF_MEASUREMENT /end REF_MEASUREMENT
/end GROUP
/begin GROUP Assi.HwTq.Val "MICROSAR RTE" /begin SUB_GROUP /end SUB_GROUP /begin FUNCTION_LIST /end FUNCTION_LIST /begin REF_CHARACTERISTIC /end REF_CHARACTERISTIC /begin REF_MEASUREMENT Assi.HwTq.Val /end REF_MEASUREMENT /end GROUP
/begin GROUP Assi.HwTqHysOvrl.Val "MICROSAR RTE" /begin SUB_GROUP /end SUB_GROUP /begin FUNCTION_LIST /end FUNCTION_LIST /begin REF_CHARACTERISTIC /end REF_CHARACTERISTIC /begin REF_MEASUREMENT Assi.HwTqHysOvrl.Val /end REF_MEASUREMENT /end GROUP
/begin GROUP Assi.HwTqOvrl.Val "MICROSAR RTE" /begin SUB_GROUP /end SUB_GROUP /begin FUNCTION_LIST /end FUNCTION_LIST /begin REF_CHARACTERISTIC /end REF_CHARACTERISTIC /begin REF_MEASUREMENT Assi.HwTqOvrl.Val /end REF_MEASUREMENT /end GROUP
/begin GROUP Assi.PerInstanceMemories "MICROSAR RTE" /begin SUB_GROUP Assi.dAssiThermAssiSca Assi.dAssiWhlImbRejctnBlnd /end SUB_GROUP /begin FUNCTION_LIST /end FUNCTION_LIST /begin REF_CHARACTERISTIC /end REF_CHARACTERISTIC /begin REF_MEASUREMENT /end REF_MEASUREMENT /end GROUP
/begin GROUP Assi.ReceiverPorts "MICROSAR RTE"
 /begin SUB_GROUP Assi.AssiCmdBasSca.Val Assi.AssiLnrGain.Val Assi.AssiLnrGainEna.Logl Assi.HwTq.Val Assi.HwTqHysOvrl.Val Assi.HwTqOvrl.Val Assi.ThermLimSlowFilMax.Val Assi.VehSpd.Val Assi.WhlImbRejctnAmp.Val /end SUB_GROUP
 /begin FUNCTION_LIST /end FUNCTION_LIST
 /begin REF_CHARACTERISTIC /end REF_CHARACTERISTIC
 /begin REF_MEASUREMENT /end REF_MEASUREMENT
/end GROUP
/begin GROUP Assi.SenderPorts "MICROSAR RTE" /begin SUB_GROUP Assi.AssiCmdBas.Val /end SUB_GROUP /begin FUNCTION_LIST /end FUNCTION_LIST /begin REF_CHARACTERISTIC /end REF_CHARACTERISTIC /begin REF_MEASUREMENT /end REF_MEASUREMENT /end GROUP
/begin GROUP Assi.SysGlbPrmVehSpd.Ary1D "MICROSAR RTE" /begin SUB_GROUP /end SUB_GROUP /begin FUNCTION_LIST /end FUNCTION_LIST /begin REF_CHARACTERISTIC Assi.SysGlbPrmVehSpd.Ary1D /end REF_CHARACTERISTIC /begin REF_MEASUREMENT /end REF_MEASUREMENT /end GROUP
/begin GROUP Assi.SysGlbPrmVehSpdBilnrSeln.Ary1D "MICROSAR RTE" /begin SUB_GROUP /end SUB_GROUP /begin FUNCTION_LIST /end FUNCTION_LIST /begin REF_CHARACTERISTIC Assi.SysGlbPrmVehSpdBilnrSeln.Ary1D /end REF_CHARACTERISTIC /begin REF_MEASUREMENT /end REF_MEASUREMENT /end GROUP
/begin GROUP Assi.ThermLimSlowFilMax.Val "MICROSAR RTE" /begin SUB_GROUP /end SUB_GROUP /begin FUNCTION_LIST /end FUNCTION_LIST /begin REF_CHARACTERISTIC /end REF_CHARACTERISTIC /begin REF_MEASUREMENT Assi.ThermLimSlowFilMax.Val /end REF_MEASUREMENT /end GROUP
/begin GROUP Assi.VehSpd.Val "MICROSAR RTE" /begin SUB_GROUP /end SUB_GROUP /begin FUNCTION_LIST /end FUNCTION_LIST /begin REF_CHARACTERISTIC /end REF_CHARACTERISTIC /begin REF_MEASUREMENT Assi.VehSpd.Val /end REF_MEASUREMENT /end GROUP
/begin GROUP Assi.WhlImbRejctnAmp.Val "MICROSAR RTE" /begin SUB_GROUP /end SUB_GROUP /begin FUNCTION_LIST /end FUNCTION_LIST /begin REF_CHARACTERISTIC /end REF_CHARACTERISTIC /begin REF_MEASUREMENT Assi.WhlImbRejctnAmp.Val /end REF_MEASUREMENT /end GROUP
/begin GROUP Assi.dAssiThermAssiSca "MICROSAR RTE" /begin SUB_GROUP /end SUB_GROUP /begin FUNCTION_LIST /end FUNCTION_LIST /begin REF_CHARACTERISTIC /end REF_CHARACTERISTIC /begin REF_MEASUREMENT Assi.dAssiThermAssiSca /end REF_MEASUREMENT /end GROUP
/begin GROUP Assi.dAssiWhlImbRejctnBlnd "MICROSAR RTE" /begin SUB_GROUP /end SUB_GROUP /begin FUNCTION_LIST /end FUNCTION_LIST /begin REF_CHARACTERISTIC /end REF_CHARACTERISTIC /begin REF_MEASUREMENT Assi.dAssiWhlImbRejctnBlnd /end REF_MEASUREMENT /end GROUP
/begin GROUP AssiHiFrq "MICROSAR RTE"
 /begin SUB_GROUP AssiHiFrq.CalibrationPorts AssiHiFrq.PerInstanceMemories AssiHiFrq.ReceiverPorts AssiHiFrq.SenderPorts /end SUB_GROUP
 /begin FUNCTION_LIST /end FUNCTION_LIST
 /begin REF_CHARACTERISTIC /end REF_CHARACTERISTIC
 /begin REF_MEASUREMENT /end REF_MEASUREMENT
/end GROUP
/begin GROUP AssiHiFrq.AssiHiFrqCmd.Val "MICROSAR RTE" /begin SUB_GROUP /end SUB_GROUP /begin FUNCTION_LIST /end FUNCTION_LIST /begin REF_CHARACTERISTIC /end REF_CHARACTERISTIC /begin REF_MEASUREMENT AssiHiFrq.AssiHiFrqCmd.Val /end REF_MEASUREMENT /end GROUP
/begin GROUP AssiHiFrq.AssiHiFrqGainY.Ary2D "MICROSAR RTE" /begin SUB_GROUP /end SUB_GROUP /begin FUNCTION_LIST /end FUNCTION_LIST /begin REF_CHARACTERISTIC AssiHiFrq.AssiHiFrqGainY.Ary2D /end REF_CHARACTERISTIC /begin REF_MEASUREMENT /end REF_MEASUREMENT /end GROUP
/begin GROUP AssiHiFrq.AssiHiFrqHpFilFrq.Val "MICROSAR RTE" /begin SUB_GROUP /end SUB_GROUP /begin FUNCTION_LIST /end FUNCTION_LIST /begin REF_CHARACTERISTIC AssiHiFrq.AssiHiFrqHpFilFrq.Val /end REF_CHARACTERISTIC /begin REF_MEASUREMENT /end REF_MEASUREMENT /end GROUP
/begin GROUP AssiHiFrq.AssiHiFrqHpFilFrqY.Ary1D "MICROSAR RTE" /begin SUB_GROUP /end SUB_GROUP /begin FUNCTION_LIST /end FUNCTION_LIST /begin REF_CHARACTERISTIC AssiHiFrq.AssiHiFrqHpFilFrqY.Ary1D /end REF_CHARACTERISTIC /begin REF_MEASUREMENT /end REF_MEASUREMENT /end GROUP
/begin GROUP AssiHiFrq.AssiHiFrqTqWhlImbRejctnTqX.Ary2D "MICROSAR RTE" /begin SUB_GROUP /end SUB_GROUP /begin FUNCTION_LIST /end FUNCTION_LIST /begin REF_CHARACTERISTIC AssiHiFrq.AssiHiFrqTqWhlImbRejctnTqX.Ary2D /end REF_CHARACTERISTIC /begin REF_MEASUREMENT /end REF_MEASUREMENT /end GROUP
/begin GROUP AssiHiFrq.AssiHiFrqTqX.Ary2D "MICROSAR RTE" /begin SUB_GROUP /end SUB_GROUP /begin FUNCTION_LIST /end FUNCTION_LIST /begin REF_CHARACTERISTIC AssiHiFrq.AssiHiFrqTqX.Ary2D /end REF_CHARACTERISTIC /begin REF_MEASUREMENT /end REF_MEASUREMENT /end GROUP
/begin GROUP AssiHiFrq.AssiHiFrqWhlImbRejctnBlndX.Ary2D "MICROSAR RTE" /begin SUB_GROUP /end SUB_GROUP /begin FUNCTION_LIST /end FUNCTION_LIST /begin REF_CHARACTERISTIC AssiHiFrq.AssiHiFrqWhlImbRejctnBlndX.Ary2D /end REF_CHARACTERISTIC /begin REF_MEASUREMENT /end REF_MEASUREMENT /end GROUP
/begin GROUP AssiHiFrq.AssiHiFrqWhlImbRejctnBlndY.Ary2D "MICROSAR RTE" /begin SUB_GROUP /end SUB_GROUP /begin FUNCTION_LIST /end FUNCTION_LIST /begin REF_CHARACTERISTIC AssiHiFrq.AssiHiFrqWhlImbRejctnBlndY.Ary2D /end REF_CHARACTERISTIC /begin REF_MEASUREMENT /end REF_MEASUREMENT /end GROUP
/begin GROUP AssiHiFrq.AssiHiFrqWhlImbRejctnGainY.Ary2D "MICROSAR RTE" /begin SUB_GROUP /end SUB_GROUP /begin FUNCTION_LIST /end FUNCTION_LIST /begin REF_CHARACTERISTIC AssiHiFrq.AssiHiFrqWhlImbRejctnGainY.Ary2D /end REF_CHARACTERISTIC /begin REF_MEASUREMENT /end REF_MEASUREMENT /end GROUP
/begin GROUP AssiHiFrq.CalibrationPorts "MICROSAR RTE"
 /begin SUB_GROUP AssiHiFrq.AssiHiFrqGainY.Ary2D AssiHiFrq.AssiHiFrqHpFilFrq.Val AssiHiFrq.AssiHiFrqHpFilFrqY.Ary1D AssiHiFrq.AssiHiFrqTqWhlImbRejctnTqX.Ary2D AssiHiFrq.AssiHiFrqTqX.Ary2D AssiHiFrq.AssiHiFrqWhlImbRejctnBlndX.Ary2D AssiHiFrq.AssiHiFrqWhlImbRejctnBlndY.Ary2D AssiHiFrq.AssiHiFrqWhlImbRejctnGainY.Ary2D AssiHiFrq.SysGlbPrmVehSpdBilnrSeln.Ary1D /end SUB_GROUP
 /begin FUNCTION_LIST /end FUNCTION_LIST
 /begin REF_CHARACTERISTIC /end REF_CHARACTERISTIC
 /begin REF_MEASUREMENT /end REF_MEASUREMENT
/end GROUP
/begin GROUP AssiHiFrq.HwTq.Val "MICROSAR RTE" /begin SUB_GROUP /end SUB_GROUP /begin FUNCTION_LIST /end FUNCTION_LIST /begin REF_CHARACTERISTIC /end REF_CHARACTERISTIC /begin REF_MEASUREMENT AssiHiFrq.HwTq.Val /end REF_MEASUREMENT /end GROUP
/begin GROUP AssiHiFrq.HwTqHpFil "MICROSAR RTE" /begin SUB_GROUP /end SUB_GROUP /begin FUNCTION_LIST /end FUNCTION_LIST /begin REF_CHARACTERISTIC /end REF_CHARACTERISTIC
 /begin REF_MEASUREMENT AssiHiFrq.HwTqHpFil.CorrnFac AssiHiFrq.HwTqHpFil.FilLpRec.FilGain AssiHiFrq.HwTqHpFil.FilLpRec.FilSt /end REF_MEASUREMENT
/end GROUP
/begin GROUP AssiHiFrq.PerInstanceMemories "MICROSAR RTE"
 /begin SUB_GROUP AssiHiFrq.HwTqHpFil AssiHiFrq.dAssiHiFrqGain AssiHiFrq.dAssiHiFrqGainBlnd AssiHiFrq.dAssiHiFrqGainWhlImbRejtcnZero /end SUB_GROUP
 /begin FUNCTION_LIST /end FUNCTION_LIST
 /begin REF_CHARACTERISTIC /end REF_CHARACTERISTIC
 /begin REF_MEASUREMENT /end REF_MEASUREMENT
/end GROUP
/begin GROUP AssiHiFrq.ReceiverPorts "MICROSAR RTE"
 /begin SUB_GROUP AssiHiFrq.HwTq.Val AssiHiFrq.VehSpd.Val AssiHiFrq.WhlImbRejctnAmp.Val /end SUB_GROUP
 /begin FUNCTION_LIST /end FUNCTION_LIST
 /begin REF_CHARACTERISTIC /end REF_CHARACTERISTIC
 /begin REF_MEASUREMENT /end REF_MEASUREMENT
/end GROUP
/begin GROUP AssiHiFrq.SenderPorts "MICROSAR RTE" /begin SUB_GROUP AssiHiFrq.AssiHiFrqCmd.Val /end SUB_GROUP /begin FUNCTION_LIST /end FUNCTION_LIST /begin REF_CHARACTERISTIC /end REF_CHARACTERISTIC /begin REF_MEASUREMENT /end REF_MEASUREMENT /end GROUP
/begin GROUP AssiHiFrq.SysGlbPrmVehSpdBilnrSeln.Ary1D "MICROSAR RTE" /begin SUB_GROUP /end SUB_GROUP /begin FUNCTION_LIST /end FUNCTION_LIST /begin REF_CHARACTERISTIC AssiHiFrq.SysGlbPrmVehSpdBilnrSeln.Ary1D /end REF_CHARACTERISTIC /begin REF_MEASUREMENT /end REF_MEASUREMENT /end GROUP
/begin GROUP AssiHiFrq.VehSpd.Val "MICROSAR RTE" /begin SUB_GROUP /end SUB_GROUP /begin FUNCTION_LIST /end FUNCTION_LIST /begin REF_CHARACTERISTIC /end REF_CHARACTERISTIC /begin REF_MEASUREMENT AssiHiFrq.VehSpd.Val /end REF_MEASUREMENT /end GROUP
/begin GROUP AssiHiFrq.WhlImbRejctnAmp.Val "MICROSAR RTE" /begin SUB_GROUP /end SUB_GROUP /begin FUNCTION_LIST /end FUNCTION_LIST /begin REF_CHARACTERISTIC /end REF_CHARACTERISTIC /begin REF_MEASUREMENT AssiHiFrq.WhlImbRejctnAmp.Val /end REF_MEASUREMENT /end GROUP
/begin GROUP AssiHiFrq.dAssiHiFrqGain "MICROSAR RTE" /begin SUB_GROUP /end SUB_GROUP /begin FUNCTION_LIST /end FUNCTION_LIST /begin REF_CHARACTERISTIC /end REF_CHARACTERISTIC /begin REF_MEASUREMENT AssiHiFrq.dAssiHiFrqGain /end REF_MEASUREMENT /end GROUP
/begin GROUP AssiHiFrq.dAssiHiFrqGainBlnd "MICROSAR RTE" /begin SUB_GROUP /end SUB_GROUP /begin FUNCTION_LIST /end FUNCTION_LIST /begin REF_CHARACTERISTIC /end REF_CHARACTERISTIC /begin REF_MEASUREMENT AssiHiFrq.dAssiHiFrqGainBlnd /end REF_MEASUREMENT /end GROUP
/begin GROUP AssiHiFrq.dAssiHiFrqGainWhlImbRejtcnZero "MICROSAR RTE" /begin SUB_GROUP /end SUB_GROUP /begin FUNCTION_LIST /end FUNCTION_LIST /begin REF_CHARACTERISTIC /end REF_CHARACTERISTIC /begin REF_MEASUREMENT AssiHiFrq.dAssiHiFrqGainWhlImbRejtcnZero /end REF_MEASUREMENT /end GROUP
/begin GROUP AssiPahFwl "MICROSAR RTE"
 /begin SUB_GROUP AssiPahFwl.CalibrationPorts AssiPahFwl.PerInstanceMemories AssiPahFwl.ReceiverPorts AssiPahFwl.SenderPorts /end SUB_GROUP
 /begin FUNCTION_LIST /end FUNCTION_LIST
 /begin REF_CHARACTERISTIC /end REF_CHARACTERISTIC
 /begin REF_MEASUREMENT /end REF_MEASUREMENT
/end GROUP
/begin GROUP AssiPahFwl.AssiCmdBas.Val "MICROSAR RTE" /begin SUB_GROUP /end SUB_GROUP /begin FUNCTION_LIST /end FUNCTION_LIST /begin REF_CHARACTERISTIC /end REF_CHARACTERISTIC /begin REF_MEASUREMENT AssiPahFwl.AssiCmdBas.Val /end REF_MEASUREMENT /end GROUP
/begin GROUP AssiPahFwl.AssiCmdSum.Val "MICROSAR RTE" /begin SUB_GROUP /end SUB_GROUP /begin FUNCTION_LIST /end FUNCTION_LIST /begin REF_CHARACTERISTIC /end REF_CHARACTERISTIC /begin REF_MEASUREMENT AssiPahFwl.AssiCmdSum.Val /end REF_MEASUREMENT /end GROUP
/begin GROUP AssiPahFwl.AssiHiFrqCmd.Val "MICROSAR RTE" /begin SUB_GROUP /end SUB_GROUP /begin FUNCTION_LIST /end FUNCTION_LIST /begin REF_CHARACTERISTIC /end REF_CHARACTERISTIC /begin REF_MEASUREMENT AssiPahFwl.AssiHiFrqCmd.Val /end REF_MEASUREMENT /end GROUP
/begin GROUP AssiPahFwl.AssiLnrGainEna.Logl "MICROSAR RTE" /begin SUB_GROUP /end SUB_GROUP /begin FUNCTION_LIST /end FUNCTION_LIST /begin REF_CHARACTERISTIC /end REF_CHARACTERISTIC /begin REF_MEASUREMENT AssiPahFwl.AssiLnrGainEna.Logl /end REF_MEASUREMENT /end GROUP
/begin GROUP AssiPahFwl.AssiPahFwlCmdSplitLpFilFrq.Val "MICROSAR RTE" /begin SUB_GROUP /end SUB_GROUP /begin FUNCTION_LIST /end FUNCTION_LIST /begin REF_CHARACTERISTIC AssiPahFwl.AssiPahFwlCmdSplitLpFilFrq.Val /end REF_CHARACTERISTIC /begin REF_MEASUREMENT /end REF_MEASUREMENT /end GROUP
/begin GROUP AssiPahFwl.AssiPahFwlDftAssiX.Ary1D "MICROSAR RTE" /begin SUB_GROUP /end SUB_GROUP /begin FUNCTION_LIST /end FUNCTION_LIST /begin REF_CHARACTERISTIC AssiPahFwl.AssiPahFwlDftAssiX.Ary1D /end REF_CHARACTERISTIC /begin REF_MEASUREMENT /end REF_MEASUREMENT /end GROUP
/begin GROUP AssiPahFwl.AssiPahFwlDftAssiY.Ary1D "MICROSAR RTE" /begin SUB_GROUP /end SUB_GROUP /begin FUNCTION_LIST /end FUNCTION_LIST /begin REF_CHARACTERISTIC AssiPahFwl.AssiPahFwlDftAssiY.Ary1D /end REF_CHARACTERISTIC /begin REF_MEASUREMENT /end REF_MEASUREMENT /end GROUP
/begin GROUP AssiPahFwl.AssiPahFwlDiRcvr.Logl "MICROSAR RTE" /begin SUB_GROUP /end SUB_GROUP /begin FUNCTION_LIST /end FUNCTION_LIST /begin REF_CHARACTERISTIC AssiPahFwl.AssiPahFwlDiRcvr.Logl /end REF_CHARACTERISTIC /begin REF_MEASUREMENT /end REF_MEASUREMENT /end GROUP
/begin GROUP AssiPahFwl.AssiPahFwlFwlActvLpFilFrq.Val "MICROSAR RTE" /begin SUB_GROUP /end SUB_GROUP /begin FUNCTION_LIST /end FUNCTION_LIST /begin REF_CHARACTERISTIC AssiPahFwl.AssiPahFwlFwlActvLpFilFrq.Val /end REF_CHARACTERISTIC /begin REF_MEASUREMENT /end REF_MEASUREMENT /end GROUP
/begin GROUP AssiPahFwl.AssiPahFwlHiFrqUpprLimY.Ary2D "MICROSAR RTE" /begin SUB_GROUP /end SUB_GROUP /begin FUNCTION_LIST /end FUNCTION_LIST /begin REF_CHARACTERISTIC AssiPahFwl.AssiPahFwlHiFrqUpprLimY.Ary2D /end REF_CHARACTERISTIC /begin REF_MEASUREMENT /end REF_MEASUREMENT /end GROUP
/begin GROUP AssiPahFwl.AssiPahFwlHysCmpLim.Val "MICROSAR RTE" /begin SUB_GROUP /end SUB_GROUP /begin FUNCTION_LIST /end FUNCTION_LIST /begin REF_CHARACTERISTIC AssiPahFwl.AssiPahFwlHysCmpLim.Val /end REF_CHARACTERISTIC /begin REF_MEASUREMENT /end REF_MEASUREMENT /end GROUP
/begin GROUP AssiPahFwl.AssiPahFwlRestoreThd.Val "MICROSAR RTE" /begin SUB_GROUP /end SUB_GROUP /begin FUNCTION_LIST /end FUNCTION_LIST /begin REF_CHARACTERISTIC AssiPahFwl.AssiPahFwlRestoreThd.Val /end REF_CHARACTERISTIC /begin REF_MEASUREMENT /end REF_MEASUREMENT /end GROUP
/begin GROUP AssiPahFwl.AssiPahFwlUpprLimX.Ary2D "MICROSAR RTE" /begin SUB_GROUP /end SUB_GROUP /begin FUNCTION_LIST /end FUNCTION_LIST /begin REF_CHARACTERISTIC AssiPahFwl.AssiPahFwlUpprLimX.Ary2D /end REF_CHARACTERISTIC /begin REF_MEASUREMENT /end REF_MEASUREMENT /end GROUP
/begin GROUP AssiPahFwl.AssiPahFwlUpprLimY.Ary2D "MICROSAR RTE" /begin SUB_GROUP /end SUB_GROUP /begin FUNCTION_LIST /end FUNCTION_LIST /begin REF_CHARACTERISTIC AssiPahFwl.AssiPahFwlUpprLimY.Ary2D /end REF_CHARACTERISTIC /begin REF_MEASUREMENT /end REF_MEASUREMENT /end GROUP
/begin GROUP AssiPahFwl.AssiPahFwlVehSpd.Ary1D "MICROSAR RTE" /begin SUB_GROUP /end SUB_GROUP /begin FUNCTION_LIST /end FUNCTION_LIST /begin REF_CHARACTERISTIC AssiPahFwl.AssiPahFwlVehSpd.Ary1D /end REF_CHARACTERISTIC /begin REF_MEASUREMENT /end REF_MEASUREMENT /end GROUP
/begin GROUP AssiPahFwl.AssiPahLimrActv.Val "MICROSAR RTE" /begin SUB_GROUP /end SUB_GROUP /begin FUNCTION_LIST /end FUNCTION_LIST /begin REF_CHARACTERISTIC /end REF_CHARACTERISTIC /begin REF_MEASUREMENT AssiPahFwl.AssiPahLimrActv.Val /end REF_MEASUREMENT /end GROUP
/begin GROUP AssiPahFwl.AssiPrfmncPrev "MICROSAR RTE" /begin SUB_GROUP /end SUB_GROUP /begin FUNCTION_LIST /end FUNCTION_LIST /begin REF_CHARACTERISTIC /end REF_CHARACTERISTIC /begin REF_MEASUREMENT AssiPahFwl.AssiPrfmncPrev /end REF_MEASUREMENT /end GROUP
/begin GROUP AssiPahFwl.BasAssiPahFwlOverLimDiagcFailStep.Val "MICROSAR RTE" /begin SUB_GROUP /end SUB_GROUP /begin FUNCTION_LIST /end FUNCTION_LIST /begin REF_CHARACTERISTIC AssiPahFwl.BasAssiPahFwlOverLimDiagcFailStep.Val /end REF_CHARACTERISTIC /begin REF_MEASUREMENT /end REF_MEASUREMENT /end GROUP
/begin GROUP AssiPahFwl.BasAssiPahFwlOverLimDiagcPassStep.Val "MICROSAR RTE" /begin SUB_GROUP /end SUB_GROUP /begin FUNCTION_LIST /end FUNCTION_LIST /begin REF_CHARACTERISTIC AssiPahFwl.BasAssiPahFwlOverLimDiagcPassStep.Val /end REF_CHARACTERISTIC /begin REF_MEASUREMENT /end REF_MEASUREMENT /end GROUP
/begin GROUP AssiPahFwl.CalibrationPorts "MICROSAR RTE"
 /begin SUB_GROUP AssiPahFwl.AssiPahFwlCmdSplitLpFilFrq.Val AssiPahFwl.AssiPahFwlDftAssiX.Ary1D AssiPahFwl.AssiPahFwlDftAssiY.Ary1D AssiPahFwl.AssiPahFwlDiRcvr.Logl AssiPahFwl.AssiPahFwlFwlActvLpFilFrq.Val AssiPahFwl.AssiPahFwlHiFrqUpprLimY.Ary2D AssiPahFwl.AssiPahFwlHysCmpLim.Val AssiPahFwl.AssiPahFwlRestoreThd.Val AssiPahFwl.AssiPahFwlUpprLimX.Ary2D AssiPahFwl.AssiPahFwlUpprLimY.Ary2D AssiPahFwl.AssiPahFwlVehSpd.Ary1D AssiPahFwl.BasAssiPahFwlOverLimDiagcFailStep.Val AssiPahFwl.BasAssiPahFwlOverLimDiagcPassStep.Val AssiPahFwl.HiFrqAssiPahFwlOverLimDiagcFailStep.Val AssiPahFwl.HiFrqAssiPahFwlOverLimDiagcPassStep.Val /end SUB_GROUP
 /begin FUNCTION_LIST /end FUNCTION_LIST
 /begin REF_CHARACTERISTIC /end REF_CHARACTERISTIC
 /begin REF_MEASUREMENT /end REF_MEASUREMENT
/end GROUP
/begin GROUP AssiPahFwl.CombdAssiPrev "MICROSAR RTE" /begin SUB_GROUP /end SUB_GROUP /begin FUNCTION_LIST /end FUNCTION_LIST /begin REF_CHARACTERISTIC /end REF_CHARACTERISTIC /begin REF_MEASUREMENT AssiPahFwl.CombdAssiPrev /end REF_MEASUREMENT /end GROUP
/begin GROUP AssiPahFwl.FwlActvLpFilStVari "MICROSAR RTE" /begin SUB_GROUP /end SUB_GROUP /begin FUNCTION_LIST /end FUNCTION_LIST /begin REF_CHARACTERISTIC /end REF_CHARACTERISTIC
 /begin REF_MEASUREMENT AssiPahFwl.FwlActvLpFilStVari.FilGain AssiPahFwl.FwlActvLpFilStVari.FilSt /end REF_MEASUREMENT
/end GROUP
/begin GROUP AssiPahFwl.HiFrqAssiPahFwlOverLimDiagcFailStep.Val "MICROSAR RTE" /begin SUB_GROUP /end SUB_GROUP /begin FUNCTION_LIST /end FUNCTION_LIST /begin REF_CHARACTERISTIC AssiPahFwl.HiFrqAssiPahFwlOverLimDiagcFailStep.Val /end REF_CHARACTERISTIC /begin REF_MEASUREMENT /end REF_MEASUREMENT /end GROUP
/begin GROUP AssiPahFwl.HiFrqAssiPahFwlOverLimDiagcPassStep.Val "MICROSAR RTE" /begin SUB_GROUP /end SUB_GROUP /begin FUNCTION_LIST /end FUNCTION_LIST /begin REF_CHARACTERISTIC AssiPahFwl.HiFrqAssiPahFwlOverLimDiagcPassStep.Val /end REF_CHARACTERISTIC /begin REF_MEASUREMENT /end REF_MEASUREMENT /end GROUP
/begin GROUP AssiPahFwl.HiFrqCmdLpFilStVari "MICROSAR RTE" /begin SUB_GROUP /end SUB_GROUP /begin FUNCTION_LIST /end FUNCTION_LIST /begin REF_CHARACTERISTIC /end REF_CHARACTERISTIC
 /begin REF_MEASUREMENT AssiPahFwl.HiFrqCmdLpFilStVari.FilGain AssiPahFwl.HiFrqCmdLpFilStVari.FilSt /end REF_MEASUREMENT
/end GROUP
/begin GROUP AssiPahFwl.HwTq.Val "MICROSAR RTE" /begin SUB_GROUP /end SUB_GROUP /begin FUNCTION_LIST /end FUNCTION_LIST /begin REF_CHARACTERISTIC /end REF_CHARACTERISTIC /begin REF_MEASUREMENT AssiPahFwl.HwTq.Val /end REF_MEASUREMENT /end GROUP
/begin GROUP AssiPahFwl.HwTqOvrl.Val "MICROSAR RTE" /begin SUB_GROUP /end SUB_GROUP /begin FUNCTION_LIST /end FUNCTION_LIST /begin REF_CHARACTERISTIC /end REF_CHARACTERISTIC /begin REF_MEASUREMENT AssiPahFwl.HwTqOvrl.Val /end REF_MEASUREMENT /end GROUP
/begin GROUP AssiPahFwl.HysCmpCmd.Val "MICROSAR RTE" /begin SUB_GROUP /end SUB_GROUP /begin FUNCTION_LIST /end FUNCTION_LIST /begin REF_CHARACTERISTIC /end REF_CHARACTERISTIC /begin REF_MEASUREMENT AssiPahFwl.HysCmpCmd.Val /end REF_MEASUREMENT /end GROUP
/begin GROUP AssiPahFwl.LowrLimLpFilStVari "MICROSAR RTE" /begin SUB_GROUP /end SUB_GROUP /begin FUNCTION_LIST /end FUNCTION_LIST /begin REF_CHARACTERISTIC /end REF_CHARACTERISTIC
 /begin REF_MEASUREMENT AssiPahFwl.LowrLimLpFilStVari.FilGain AssiPahFwl.LowrLimLpFilStVari.FilSt /end REF_MEASUREMENT
/end GROUP
/begin GROUP AssiPahFwl.PerInstanceMemories "MICROSAR RTE"
 /begin SUB_GROUP AssiPahFwl.AssiPrfmncPrev AssiPahFwl.CombdAssiPrev AssiPahFwl.FwlActvLpFilStVari AssiPahFwl.HiFrqCmdLpFilStVari AssiPahFwl.LowrLimLpFilStVari AssiPahFwl.UpprLimLpFilStVari AssiPahFwl.dAssiPahFwlActvRaw AssiPahFwl.dAssiPahFwlBasAssiCmdOverLim AssiPahFwl.dAssiPahFwlBasAssiLimd AssiPahFwl.dAssiPahFwlBasAssiLowrLim AssiPahFwl.dAssiPahFwlBasAssiUpprLim AssiPahFwl.dAssiPahFwlHiFrqAssiLowrLimFild AssiPahFwl.dAssiPahFwlHiFrqAssiUpprLimFild AssiPahFwl.dAssiPahFwlHiFrqCmdHpPah AssiPahFwl.dAssiPahFwlHiFrqCmdLpPah AssiPahFwl.dAssiPahFwlHiFrqCmdOverLim AssiPahFwl.dAssiPahFwlHiFrqLpLimd AssiPahFwl.dAssiPahFwlSumInp /end SUB_GROUP
 /begin FUNCTION_LIST /end FUNCTION_LIST
 /begin REF_CHARACTERISTIC /end REF_CHARACTERISTIC
 /begin REF_MEASUREMENT /end REF_MEASUREMENT
/end GROUP
/begin GROUP AssiPahFwl.ReceiverPorts "MICROSAR RTE"
 /begin SUB_GROUP AssiPahFwl.AssiCmdBas.Val AssiPahFwl.AssiHiFrqCmd.Val AssiPahFwl.AssiLnrGainEna.Logl AssiPahFwl.HwTq.Val AssiPahFwl.HwTqOvrl.Val AssiPahFwl.HysCmpCmd.Val AssiPahFwl.VehSpd.Val /end SUB_GROUP
 /begin FUNCTION_LIST /end FUNCTION_LIST
 /begin REF_CHARACTERISTIC /end REF_CHARACTERISTIC
 /begin REF_MEASUREMENT /end REF_MEASUREMENT
/end GROUP
/begin GROUP AssiPahFwl.SenderPorts "MICROSAR RTE" /begin SUB_GROUP AssiPahFwl.AssiCmdSum.Val AssiPahFwl.AssiPahLimrActv.Val /end SUB_GROUP /begin FUNCTION_LIST /end FUNCTION_LIST /begin REF_CHARACTERISTIC /end REF_CHARACTERISTIC /begin REF_MEASUREMENT /end REF_MEASUREMENT /end GROUP
/begin GROUP AssiPahFwl.UpprLimLpFilStVari "MICROSAR RTE" /begin SUB_GROUP /end SUB_GROUP /begin FUNCTION_LIST /end FUNCTION_LIST /begin REF_CHARACTERISTIC /end REF_CHARACTERISTIC
 /begin REF_MEASUREMENT AssiPahFwl.UpprLimLpFilStVari.FilGain AssiPahFwl.UpprLimLpFilStVari.FilSt /end REF_MEASUREMENT
/end GROUP
/begin GROUP AssiPahFwl.VehSpd.Val "MICROSAR RTE" /begin SUB_GROUP /end SUB_GROUP /begin FUNCTION_LIST /end FUNCTION_LIST /begin REF_CHARACTERISTIC /end REF_CHARACTERISTIC /begin REF_MEASUREMENT AssiPahFwl.VehSpd.Val /end REF_MEASUREMENT /end GROUP
/begin GROUP AssiPahFwl.dAssiPahFwlActvRaw "MICROSAR RTE" /begin SUB_GROUP /end SUB_GROUP /begin FUNCTION_LIST /end FUNCTION_LIST /begin REF_CHARACTERISTIC /end REF_CHARACTERISTIC /begin REF_MEASUREMENT AssiPahFwl.dAssiPahFwlActvRaw /end REF_MEASUREMENT /end GROUP
/begin GROUP AssiPahFwl.dAssiPahFwlBasAssiCmdOverLim "MICROSAR RTE" /begin SUB_GROUP /end SUB_GROUP /begin FUNCTION_LIST /end FUNCTION_LIST /begin REF_CHARACTERISTIC /end REF_CHARACTERISTIC /begin REF_MEASUREMENT AssiPahFwl.dAssiPahFwlBasAssiCmdOverLim /end REF_MEASUREMENT /end GROUP
/begin GROUP AssiPahFwl.dAssiPahFwlBasAssiLimd "MICROSAR RTE" /begin SUB_GROUP /end SUB_GROUP /begin FUNCTION_LIST /end FUNCTION_LIST /begin REF_CHARACTERISTIC /end REF_CHARACTERISTIC /begin REF_MEASUREMENT AssiPahFwl.dAssiPahFwlBasAssiLimd /end REF_MEASUREMENT /end GROUP
/begin GROUP AssiPahFwl.dAssiPahFwlBasAssiLowrLim "MICROSAR RTE" /begin SUB_GROUP /end SUB_GROUP /begin FUNCTION_LIST /end FUNCTION_LIST /begin REF_CHARACTERISTIC /end REF_CHARACTERISTIC /begin REF_MEASUREMENT AssiPahFwl.dAssiPahFwlBasAssiLowrLim /end REF_MEASUREMENT /end GROUP
/begin GROUP AssiPahFwl.dAssiPahFwlBasAssiUpprLim "MICROSAR RTE" /begin SUB_GROUP /end SUB_GROUP /begin FUNCTION_LIST /end FUNCTION_LIST /begin REF_CHARACTERISTIC /end REF_CHARACTERISTIC /begin REF_MEASUREMENT AssiPahFwl.dAssiPahFwlBasAssiUpprLim /end REF_MEASUREMENT /end GROUP
/begin GROUP AssiPahFwl.dAssiPahFwlHiFrqAssiLowrLimFild "MICROSAR RTE" /begin SUB_GROUP /end SUB_GROUP /begin FUNCTION_LIST /end FUNCTION_LIST /begin REF_CHARACTERISTIC /end REF_CHARACTERISTIC /begin REF_MEASUREMENT AssiPahFwl.dAssiPahFwlHiFrqAssiLowrLimFild /end REF_MEASUREMENT /end GROUP
/begin GROUP AssiPahFwl.dAssiPahFwlHiFrqAssiUpprLimFild "MICROSAR RTE" /begin SUB_GROUP /end SUB_GROUP /begin FUNCTION_LIST /end FUNCTION_LIST /begin REF_CHARACTERISTIC /end REF_CHARACTERISTIC /begin REF_MEASUREMENT AssiPahFwl.dAssiPahFwlHiFrqAssiUpprLimFild /end REF_MEASUREMENT /end GROUP
/begin GROUP AssiPahFwl.dAssiPahFwlHiFrqCmdHpPah "MICROSAR RTE" /begin SUB_GROUP /end SUB_GROUP /begin FUNCTION_LIST /end FUNCTION_LIST /begin REF_CHARACTERISTIC /end REF_CHARACTERISTIC /begin REF_MEASUREMENT AssiPahFwl.dAssiPahFwlHiFrqCmdHpPah /end REF_MEASUREMENT /end GROUP
/begin GROUP AssiPahFwl.dAssiPahFwlHiFrqCmdLpPah "MICROSAR RTE" /begin SUB_GROUP /end SUB_GROUP /begin FUNCTION_LIST /end FUNCTION_LIST /begin REF_CHARACTERISTIC /end REF_CHARACTERISTIC /begin REF_MEASUREMENT AssiPahFwl.dAssiPahFwlHiFrqCmdLpPah /end REF_MEASUREMENT /end GROUP
/begin GROUP AssiPahFwl.dAssiPahFwlHiFrqCmdOverLim "MICROSAR RTE" /begin SUB_GROUP /end SUB_GROUP /begin FUNCTION_LIST /end FUNCTION_LIST /begin REF_CHARACTERISTIC /end REF_CHARACTERISTIC /begin REF_MEASUREMENT AssiPahFwl.dAssiPahFwlHiFrqCmdOverLim /end REF_MEASUREMENT /end GROUP
/begin GROUP AssiPahFwl.dAssiPahFwlHiFrqLpLimd "MICROSAR RTE" /begin SUB_GROUP /end SUB_GROUP /begin FUNCTION_LIST /end FUNCTION_LIST /begin REF_CHARACTERISTIC /end REF_CHARACTERISTIC /begin REF_MEASUREMENT AssiPahFwl.dAssiPahFwlHiFrqLpLimd /end REF_MEASUREMENT /end GROUP
/begin GROUP AssiPahFwl.dAssiPahFwlSumInp "MICROSAR RTE" /begin SUB_GROUP /end SUB_GROUP /begin FUNCTION_LIST /end FUNCTION_LIST /begin REF_CHARACTERISTIC /end REF_CHARACTERISTIC /begin REF_MEASUREMENT AssiPahFwl.dAssiPahFwlSumInp /end REF_MEASUREMENT /end GROUP
/begin GROUP AssiSumLim "MICROSAR RTE"
 /begin SUB_GROUP AssiSumLim.CalibrationPorts AssiSumLim.ReceiverPorts AssiSumLim.SenderPorts /end SUB_GROUP
 /begin FUNCTION_LIST /end FUNCTION_LIST
 /begin REF_CHARACTERISTIC /end REF_CHARACTERISTIC
 /begin REF_MEASUREMENT /end REF_MEASUREMENT
/end GROUP
/begin GROUP AssiSumLim.AssiCmd.Val "MICROSAR RTE" /begin SUB_GROUP /end SUB_GROUP /begin FUNCTION_LIST /end FUNCTION_LIST /begin REF_CHARACTERISTIC /end REF_CHARACTERISTIC /begin REF_MEASUREMENT AssiSumLim.AssiCmd.Val /end REF_MEASUREMENT /end GROUP
/begin GROUP AssiSumLim.AssiSumLimNtc0x0C4FailStep.Val "MICROSAR RTE" /begin SUB_GROUP /end SUB_GROUP /begin FUNCTION_LIST /end FUNCTION_LIST /begin REF_CHARACTERISTIC AssiSumLim.AssiSumLimNtc0x0C4FailStep.Val /end REF_CHARACTERISTIC /begin REF_MEASUREMENT /end REF_MEASUREMENT /end GROUP
/begin GROUP AssiSumLim.AssiSumLimNtc0x0C4PassStep.Val "MICROSAR RTE" /begin SUB_GROUP /end SUB_GROUP /begin FUNCTION_LIST /end FUNCTION_LIST /begin REF_CHARACTERISTIC AssiSumLim.AssiSumLimNtc0x0C4PassStep.Val /end REF_CHARACTERISTIC /begin REF_MEASUREMENT /end REF_MEASUREMENT /end GROUP
/begin GROUP AssiSumLim.AssiSumLimPullCmpLim.Val "MICROSAR RTE" /begin SUB_GROUP /end SUB_GROUP /begin FUNCTION_LIST /end FUNCTION_LIST /begin REF_CHARACTERISTIC AssiSumLim.AssiSumLimPullCmpLim.Val /end REF_CHARACTERISTIC /begin REF_MEASUREMENT /end REF_MEASUREMENT /end GROUP
/begin GROUP AssiSumLim.CalibrationPorts "MICROSAR RTE"
 /begin SUB_GROUP AssiSumLim.AssiSumLimNtc0x0C4FailStep.Val AssiSumLim.AssiSumLimNtc0x0C4PassStep.Val AssiSumLim.AssiSumLimPullCmpLim.Val /end SUB_GROUP
 /begin FUNCTION_LIST /end FUNCTION_LIST
 /begin REF_CHARACTERISTIC /end REF_CHARACTERISTIC
 /begin REF_MEASUREMENT /end REF_MEASUREMENT
/end GROUP
/begin GROUP AssiSumLim.DampgCmd.Val "MICROSAR RTE" /begin SUB_GROUP /end SUB_GROUP /begin FUNCTION_LIST /end FUNCTION_LIST /begin REF_CHARACTERISTIC /end REF_CHARACTERISTIC /begin REF_MEASUREMENT AssiSumLim.DampgCmd.Val /end REF_MEASUREMENT /end GROUP
/begin GROUP AssiSumLim.EotActvCmd.Val "MICROSAR RTE" /begin SUB_GROUP /end SUB_GROUP /begin FUNCTION_LIST /end FUNCTION_LIST /begin REF_CHARACTERISTIC /end REF_CHARACTERISTIC /begin REF_MEASUREMENT AssiSumLim.EotActvCmd.Val /end REF_MEASUREMENT /end GROUP
/begin GROUP AssiSumLim.EotAssiSca.Val "MICROSAR RTE" /begin SUB_GROUP /end SUB_GROUP /begin FUNCTION_LIST /end FUNCTION_LIST /begin REF_CHARACTERISTIC /end REF_CHARACTERISTIC /begin REF_MEASUREMENT AssiSumLim.EotAssiSca.Val /end REF_MEASUREMENT /end GROUP
/begin GROUP AssiSumLim.EotDampgCmd.Val "MICROSAR RTE" /begin SUB_GROUP /end SUB_GROUP /begin FUNCTION_LIST /end FUNCTION_LIST /begin REF_CHARACTERISTIC /end REF_CHARACTERISTIC /begin REF_MEASUREMENT AssiSumLim.EotDampgCmd.Val /end REF_MEASUREMENT /end GROUP
/begin GROUP AssiSumLim.EotMotTqLim.Val "MICROSAR RTE" /begin SUB_GROUP /end SUB_GROUP /begin FUNCTION_LIST /end FUNCTION_LIST /begin REF_CHARACTERISTIC /end REF_CHARACTERISTIC /begin REF_MEASUREMENT AssiSumLim.EotMotTqLim.Val /end REF_MEASUREMENT /end GROUP
/begin GROUP AssiSumLim.HwTqLoaMtgtnEna.Logl "MICROSAR RTE" /begin SUB_GROUP /end SUB_GROUP /begin FUNCTION_LIST /end FUNCTION_LIST /begin REF_CHARACTERISTIC /end REF_CHARACTERISTIC /begin REF_MEASUREMENT AssiSumLim.HwTqLoaMtgtnEna.Logl /end REF_MEASUREMENT /end GROUP
/begin GROUP AssiSumLim.MotTqCmd.Val "MICROSAR RTE" /begin SUB_GROUP /end SUB_GROUP /begin FUNCTION_LIST /end FUNCTION_LIST /begin REF_CHARACTERISTIC /end REF_CHARACTERISTIC /begin REF_MEASUREMENT AssiSumLim.MotTqCmd.Val /end REF_MEASUREMENT /end GROUP
/begin GROUP AssiSumLim.MotTqCmdLimDi.Logl "MICROSAR RTE" /begin SUB_GROUP /end SUB_GROUP /begin FUNCTION_LIST /end FUNCTION_LIST /begin REF_CHARACTERISTIC /end REF_CHARACTERISTIC /begin REF_MEASUREMENT AssiSumLim.MotTqCmdLimDi.Logl /end REF_MEASUREMENT /end GROUP
/begin GROUP AssiSumLim.MotTqCmdLimdPreStall.Val "MICROSAR RTE" /begin SUB_GROUP /end SUB_GROUP /begin FUNCTION_LIST /end FUNCTION_LIST /begin REF_CHARACTERISTIC /end REF_CHARACTERISTIC /begin REF_MEASUREMENT AssiSumLim.MotTqCmdLimdPreStall.Val /end REF_MEASUREMENT /end GROUP
/begin GROUP AssiSumLim.MotTqCmdLimrMin.Val "MICROSAR RTE" /begin SUB_GROUP /end SUB_GROUP /begin FUNCTION_LIST /end FUNCTION_LIST /begin REF_CHARACTERISTIC /end REF_CHARACTERISTIC /begin REF_MEASUREMENT AssiSumLim.MotTqCmdLimrMin.Val /end REF_MEASUREMENT /end GROUP
/begin GROUP AssiSumLim.MotTqCmdOvrl.Val "MICROSAR RTE" /begin SUB_GROUP /end SUB_GROUP /begin FUNCTION_LIST /end FUNCTION_LIST /begin REF_CHARACTERISTIC /end REF_CHARACTERISTIC /begin REF_MEASUREMENT AssiSumLim.MotTqCmdOvrl.Val /end REF_MEASUREMENT /end GROUP
/begin GROUP AssiSumLim.MotTqCmdPreLim.Val "MICROSAR RTE" /begin SUB_GROUP /end SUB_GROUP /begin FUNCTION_LIST /end FUNCTION_LIST /begin REF_CHARACTERISTIC /end REF_CHARACTERISTIC /begin REF_MEASUREMENT AssiSumLim.MotTqCmdPreLim.Val /end REF_MEASUREMENT /end GROUP
/begin GROUP AssiSumLim.PinionCentrLrnCmd.Val "MICROSAR RTE" /begin SUB_GROUP /end SUB_GROUP /begin FUNCTION_LIST /end FUNCTION_LIST /begin REF_CHARACTERISTIC /end REF_CHARACTERISTIC /begin REF_MEASUREMENT AssiSumLim.PinionCentrLrnCmd.Val /end REF_MEASUREMENT /end GROUP
/begin GROUP AssiSumLim.PinionCentrLrnEna.Logl "MICROSAR RTE" /begin SUB_GROUP /end SUB_GROUP /begin FUNCTION_LIST /end FUNCTION_LIST /begin REF_CHARACTERISTIC /end REF_CHARACTERISTIC /begin REF_MEASUREMENT AssiSumLim.PinionCentrLrnEna.Logl /end REF_MEASUREMENT /end GROUP
/begin GROUP AssiSumLim.PullCmpCmd.Val "MICROSAR RTE" /begin SUB_GROUP /end SUB_GROUP /begin FUNCTION_LIST /end FUNCTION_LIST /begin REF_CHARACTERISTIC /end REF_CHARACTERISTIC /begin REF_MEASUREMENT AssiSumLim.PullCmpCmd.Val /end REF_MEASUREMENT /end GROUP
/begin GROUP AssiSumLim.PwrLimrRednFac.Val "MICROSAR RTE" /begin SUB_GROUP /end SUB_GROUP /begin FUNCTION_LIST /end FUNCTION_LIST /begin REF_CHARACTERISTIC /end REF_CHARACTERISTIC /begin REF_MEASUREMENT AssiSumLim.PwrLimrRednFac.Val /end REF_MEASUREMENT /end GROUP
/begin GROUP AssiSumLim.ReceiverPorts "MICROSAR RTE"
 /begin SUB_GROUP AssiSumLim.AssiCmd.Val AssiSumLim.DampgCmd.Val AssiSumLim.EotActvCmd.Val AssiSumLim.EotAssiSca.Val AssiSumLim.EotDampgCmd.Val AssiSumLim.EotMotTqLim.Val AssiSumLim.HwTqLoaMtgtnEna.Logl AssiSumLim.MotTqCmdLimDi.Logl AssiSumLim.MotTqCmdOvrl.Val AssiSumLim.PinionCentrLrnCmd.Val AssiSumLim.PinionCentrLrnEna.Logl AssiSumLim.PullCmpCmd.Val AssiSumLim.PwrLimrRednFac.Val AssiSumLim.RtnCmd.Val AssiSumLim.StallMotTqLim.Val AssiSumLim.SysMotTqCmdSca.Val AssiSumLim.ThermMotTqLim.Val AssiSumLim.ThermRednFac.Val AssiSumLim.TqLoaCmd.Val AssiSumLim.TqSteerMtgtnCmd.Val AssiSumLim.VehSpd.Val AssiSumLim.VehSpdMotTqLim.Val AssiSumLim.WhlImbRejctnCmd.Val /end SUB_GROUP
 /begin FUNCTION_LIST /end FUNCTION_LIST
 /begin REF_CHARACTERISTIC /end REF_CHARACTERISTIC
 /begin REF_MEASUREMENT /end REF_MEASUREMENT
/end GROUP
/begin GROUP AssiSumLim.RtnCmd.Val "MICROSAR RTE" /begin SUB_GROUP /end SUB_GROUP /begin FUNCTION_LIST /end FUNCTION_LIST /begin REF_CHARACTERISTIC /end REF_CHARACTERISTIC /begin REF_MEASUREMENT AssiSumLim.RtnCmd.Val /end REF_MEASUREMENT /end GROUP
/begin GROUP AssiSumLim.SenderPorts "MICROSAR RTE"
 /begin SUB_GROUP AssiSumLim.MotTqCmd.Val AssiSumLim.MotTqCmdLimdPreStall.Val AssiSumLim.MotTqCmdLimrMin.Val AssiSumLim.MotTqCmdPreLim.Val AssiSumLim.SysProtnRednFac.Val /end SUB_GROUP
 /begin FUNCTION_LIST /end FUNCTION_LIST
 /begin REF_CHARACTERISTIC /end REF_CHARACTERISTIC
 /begin REF_MEASUREMENT /end REF_MEASUREMENT
/end GROUP
/begin GROUP AssiSumLim.StallMotTqLim.Val "MICROSAR RTE" /begin SUB_GROUP /end SUB_GROUP /begin FUNCTION_LIST /end FUNCTION_LIST /begin REF_CHARACTERISTIC /end REF_CHARACTERISTIC /begin REF_MEASUREMENT AssiSumLim.StallMotTqLim.Val /end REF_MEASUREMENT /end GROUP
/begin GROUP AssiSumLim.SysMotTqCmdSca.Val "MICROSAR RTE" /begin SUB_GROUP /end SUB_GROUP /begin FUNCTION_LIST /end FUNCTION_LIST /begin REF_CHARACTERISTIC /end REF_CHARACTERISTIC /begin REF_MEASUREMENT AssiSumLim.SysMotTqCmdSca.Val /end REF_MEASUREMENT /end GROUP
/begin GROUP AssiSumLim.SysProtnRednFac.Val "MICROSAR RTE" /begin SUB_GROUP /end SUB_GROUP /begin FUNCTION_LIST /end FUNCTION_LIST /begin REF_CHARACTERISTIC /end REF_CHARACTERISTIC /begin REF_MEASUREMENT AssiSumLim.SysProtnRednFac.Val /end REF_MEASUREMENT /end GROUP
/begin GROUP AssiSumLim.ThermMotTqLim.Val "MICROSAR RTE" /begin SUB_GROUP /end SUB_GROUP /begin FUNCTION_LIST /end FUNCTION_LIST /begin REF_CHARACTERISTIC /end REF_CHARACTERISTIC /begin REF_MEASUREMENT AssiSumLim.ThermMotTqLim.Val /end REF_MEASUREMENT /end GROUP
/begin GROUP AssiSumLim.ThermRednFac.Val "MICROSAR RTE" /begin SUB_GROUP /end SUB_GROUP /begin FUNCTION_LIST /end FUNCTION_LIST /begin REF_CHARACTERISTIC /end REF_CHARACTERISTIC /begin REF_MEASUREMENT AssiSumLim.ThermRednFac.Val /end REF_MEASUREMENT /end GROUP
/begin GROUP AssiSumLim.TqLoaCmd.Val "MICROSAR RTE" /begin SUB_GROUP /end SUB_GROUP /begin FUNCTION_LIST /end FUNCTION_LIST /begin REF_CHARACTERISTIC /end REF_CHARACTERISTIC /begin REF_MEASUREMENT AssiSumLim.TqLoaCmd.Val /end REF_MEASUREMENT /end GROUP
/begin GROUP AssiSumLim.TqSteerMtgtnCmd.Val "MICROSAR RTE" /begin SUB_GROUP /end SUB_GROUP /begin FUNCTION_LIST /end FUNCTION_LIST /begin REF_CHARACTERISTIC /end REF_CHARACTERISTIC /begin REF_MEASUREMENT AssiSumLim.TqSteerMtgtnCmd.Val /end REF_MEASUREMENT /end GROUP
/begin GROUP AssiSumLim.VehSpd.Val "MICROSAR RTE" /begin SUB_GROUP /end SUB_GROUP /begin FUNCTION_LIST /end FUNCTION_LIST /begin REF_CHARACTERISTIC /end REF_CHARACTERISTIC /begin REF_MEASUREMENT AssiSumLim.VehSpd.Val /end REF_MEASUREMENT /end GROUP
/begin GROUP AssiSumLim.VehSpdMotTqLim.Val "MICROSAR RTE" /begin SUB_GROUP /end SUB_GROUP /begin FUNCTION_LIST /end FUNCTION_LIST /begin REF_CHARACTERISTIC /end REF_CHARACTERISTIC /begin REF_MEASUREMENT AssiSumLim.VehSpdMotTqLim.Val /end REF_MEASUREMENT /end GROUP
/begin GROUP AssiSumLim.WhlImbRejctnCmd.Val "MICROSAR RTE" /begin SUB_GROUP /end SUB_GROUP /begin FUNCTION_LIST /end FUNCTION_LIST /begin REF_CHARACTERISTIC /end REF_CHARACTERISTIC /begin REF_MEASUREMENT AssiSumLim.WhlImbRejctnCmd.Val /end REF_MEASUREMENT /end GROUP
/begin GROUP BattVltg "MICROSAR RTE"
 /begin SUB_GROUP BattVltg.CalibrationPorts BattVltg.ReceiverPorts BattVltg.SenderPorts /end SUB_GROUP
 /begin FUNCTION_LIST /end FUNCTION_LIST
 /begin REF_CHARACTERISTIC /end REF_CHARACTERISTIC
 /begin REF_MEASUREMENT /end REF_MEASUREMENT
/end GROUP
/begin GROUP BattVltg.BattSwdVltgCorrlnSts.Val "MICROSAR RTE" /begin SUB_GROUP /end SUB_GROUP /begin FUNCTION_LIST /end FUNCTION_LIST /begin REF_CHARACTERISTIC /end REF_CHARACTERISTIC /begin REF_MEASUREMENT BattVltg.BattSwdVltgCorrlnSts.Val /end REF_MEASUREMENT /end GROUP
/begin GROUP BattVltg.BattVltg.Val "MICROSAR RTE" /begin SUB_GROUP /end SUB_GROUP /begin FUNCTION_LIST /end FUNCTION_LIST /begin REF_CHARACTERISTIC /end REF_CHARACTERISTIC /begin REF_MEASUREMENT BattVltg.BattVltg.Val /end REF_MEASUREMENT /end GROUP
/begin GROUP BattVltg.BattVltgCorrlnSysMinVltg.Val "MICROSAR RTE" /begin SUB_GROUP /end SUB_GROUP /begin FUNCTION_LIST /end FUNCTION_LIST /begin REF_CHARACTERISTIC BattVltg.BattVltgCorrlnSysMinVltg.Val /end REF_CHARACTERISTIC /begin REF_MEASUREMENT /end REF_MEASUREMENT /end GROUP
/begin GROUP BattVltg.BattVltgSwd1.Val "MICROSAR RTE" /begin SUB_GROUP /end SUB_GROUP /begin FUNCTION_LIST /end FUNCTION_LIST /begin REF_CHARACTERISTIC /end REF_CHARACTERISTIC /begin REF_MEASUREMENT BattVltg.BattVltgSwd1.Val /end REF_MEASUREMENT /end GROUP
/begin GROUP BattVltg.BattVltgSwd2.Val "MICROSAR RTE" /begin SUB_GROUP /end SUB_GROUP /begin FUNCTION_LIST /end FUNCTION_LIST /begin REF_CHARACTERISTIC /end REF_CHARACTERISTIC /begin REF_MEASUREMENT BattVltg.BattVltgSwd2.Val /end REF_MEASUREMENT /end GROUP
/begin GROUP BattVltg.BattVltgSwdMax.Val "MICROSAR RTE" /begin SUB_GROUP /end SUB_GROUP /begin FUNCTION_LIST /end FUNCTION_LIST /begin REF_CHARACTERISTIC BattVltg.BattVltgSwdMax.Val /end REF_CHARACTERISTIC /begin REF_MEASUREMENT /end REF_MEASUREMENT /end GROUP
/begin GROUP BattVltg.BrdgVltg.Val "MICROSAR RTE" /begin SUB_GROUP /end SUB_GROUP /begin FUNCTION_LIST /end FUNCTION_LIST /begin REF_CHARACTERISTIC /end REF_CHARACTERISTIC /begin REF_MEASUREMENT BattVltg.BrdgVltg.Val /end REF_MEASUREMENT /end GROUP
/begin GROUP BattVltg.BrdgVltgMax.Val "MICROSAR RTE" /begin SUB_GROUP /end SUB_GROUP /begin FUNCTION_LIST /end FUNCTION_LIST /begin REF_CHARACTERISTIC BattVltg.BrdgVltgMax.Val /end REF_CHARACTERISTIC /begin REF_MEASUREMENT /end REF_MEASUREMENT /end GROUP
/begin GROUP BattVltg.CalibrationPorts "MICROSAR RTE"
 /begin SUB_GROUP BattVltg.BattVltgCorrlnSysMinVltg.Val BattVltg.BattVltgSwdMax.Val BattVltg.BrdgVltgMax.Val /end SUB_GROUP
 /begin FUNCTION_LIST /end FUNCTION_LIST
 /begin REF_CHARACTERISTIC /end REF_CHARACTERISTIC
 /begin REF_MEASUREMENT /end REF_MEASUREMENT
/end GROUP
/begin GROUP BattVltg.ReceiverPorts "MICROSAR RTE"
 /begin SUB_GROUP BattVltg.BattSwdVltgCorrlnSts.Val BattVltg.BattVltg.Val BattVltg.BattVltgSwd1.Val BattVltg.BattVltgSwd2.Val /end SUB_GROUP
 /begin FUNCTION_LIST /end FUNCTION_LIST
 /begin REF_CHARACTERISTIC /end REF_CHARACTERISTIC
 /begin REF_MEASUREMENT /end REF_MEASUREMENT
/end GROUP
/begin GROUP BattVltg.SenderPorts "MICROSAR RTE" /begin SUB_GROUP BattVltg.BrdgVltg.Val /end SUB_GROUP /begin FUNCTION_LIST /end FUNCTION_LIST /begin REF_CHARACTERISTIC /end REF_CHARACTERISTIC /begin REF_MEASUREMENT /end REF_MEASUREMENT /end GROUP
/begin GROUP BattVltgCorrln "MICROSAR RTE"
 /begin SUB_GROUP BattVltgCorrln.CalibrationPorts BattVltgCorrln.PerInstanceMemories BattVltgCorrln.ReceiverPorts BattVltgCorrln.SenderPorts /end SUB_GROUP
 /begin FUNCTION_LIST /end FUNCTION_LIST
 /begin REF_CHARACTERISTIC /end REF_CHARACTERISTIC
 /begin REF_MEASUREMENT /end REF_MEASUREMENT
/end GROUP
/begin GROUP BattVltgCorrln.BattSwdVltgCorrlnSts.Val "MICROSAR RTE" /begin SUB_GROUP /end SUB_GROUP /begin FUNCTION_LIST /end FUNCTION_LIST /begin REF_CHARACTERISTIC /end REF_CHARACTERISTIC /begin REF_MEASUREMENT BattVltgCorrln.BattSwdVltgCorrlnSts.Val /end REF_MEASUREMENT /end GROUP
/begin GROUP BattVltgCorrln.BattVltg.Val "MICROSAR RTE" /begin SUB_GROUP /end SUB_GROUP /begin FUNCTION_LIST /end FUNCTION_LIST /begin REF_CHARACTERISTIC /end REF_CHARACTERISTIC /begin REF_MEASUREMENT BattVltgCorrln.BattVltg.Val /end REF_MEASUREMENT /end GROUP
/begin GROUP BattVltgCorrln.BattVltgAdcFaild.Logl "MICROSAR RTE" /begin SUB_GROUP /end SUB_GROUP /begin FUNCTION_LIST /end FUNCTION_LIST /begin REF_CHARACTERISTIC /end REF_CHARACTERISTIC /begin REF_MEASUREMENT BattVltgCorrln.BattVltgAdcFaild.Logl /end REF_MEASUREMENT /end GROUP
/begin GROUP BattVltgCorrln.BattVltgCorrlnAllwdVltgDif.Val "MICROSAR RTE" /begin SUB_GROUP /end SUB_GROUP /begin FUNCTION_LIST /end FUNCTION_LIST /begin REF_CHARACTERISTIC BattVltgCorrln.BattVltgCorrlnAllwdVltgDif.Val /end REF_CHARACTERISTIC /begin REF_MEASUREMENT /end REF_MEASUREMENT /end GROUP
/begin GROUP BattVltgCorrln.BattVltgCorrlnBattLoVltg.Val "MICROSAR RTE" /begin SUB_GROUP /end SUB_GROUP /begin FUNCTION_LIST /end FUNCTION_LIST /begin REF_CHARACTERISTIC BattVltgCorrln.BattVltgCorrlnBattLoVltg.Val /end REF_CHARACTERISTIC /begin REF_MEASUREMENT /end REF_MEASUREMENT /end GROUP
/begin GROUP BattVltgCorrln.BattVltgCorrlnBattOverVltg.Val "MICROSAR RTE" /begin SUB_GROUP /end SUB_GROUP /begin FUNCTION_LIST /end FUNCTION_LIST /begin REF_CHARACTERISTIC BattVltgCorrln.BattVltgCorrlnBattOverVltg.Val /end REF_CHARACTERISTIC /begin REF_MEASUREMENT /end REF_MEASUREMENT /end GROUP
/begin GROUP BattVltgCorrln.BattVltgCorrlnBattUnderVltg.Val "MICROSAR RTE" /begin SUB_GROUP /end SUB_GROUP /begin FUNCTION_LIST /end FUNCTION_LIST /begin REF_CHARACTERISTIC BattVltgCorrln.BattVltgCorrlnBattUnderVltg.Val /end REF_CHARACTERISTIC /begin REF_MEASUREMENT /end REF_MEASUREMENT /end GROUP
/begin GROUP BattVltgCorrln.BattVltgCorrlnIdptSig.Val "MICROSAR RTE" /begin SUB_GROUP /end SUB_GROUP /begin FUNCTION_LIST /end FUNCTION_LIST /begin REF_CHARACTERISTIC /end REF_CHARACTERISTIC /begin REF_MEASUREMENT BattVltgCorrln.BattVltgCorrlnIdptSig.Val /end REF_MEASUREMENT /end GROUP
/begin GROUP BattVltgCorrln.BattVltgCorrlnNtc0x03C0x0440x04CFailStep.Val "MICROSAR RTE" /begin SUB_GROUP /end SUB_GROUP /begin FUNCTION_LIST /end FUNCTION_LIST
 /begin REF_CHARACTERISTIC BattVltgCorrln.BattVltgCorrlnNtc0x03C0x0440x04CFailStep.Val /end REF_CHARACTERISTIC
 /begin REF_MEASUREMENT /end REF_MEASUREMENT
/end GROUP
/begin GROUP BattVltgCorrln.BattVltgCorrlnNtc0x03C0x0440x04CPassStep.Val "MICROSAR RTE" /begin SUB_GROUP /end SUB_GROUP /begin FUNCTION_LIST /end FUNCTION_LIST
 /begin REF_CHARACTERISTIC BattVltgCorrln.BattVltgCorrlnNtc0x03C0x0440x04CPassStep.Val /end REF_CHARACTERISTIC
 /begin REF_MEASUREMENT /end REF_MEASUREMENT
/end GROUP
/begin GROUP BattVltgCorrln.BattVltgCorrlnNtc0x03DFailStep.Val "MICROSAR RTE" /begin SUB_GROUP /end SUB_GROUP /begin FUNCTION_LIST /end FUNCTION_LIST /begin REF_CHARACTERISTIC BattVltgCorrln.BattVltgCorrlnNtc0x03DFailStep.Val /end REF_CHARACTERISTIC /begin REF_MEASUREMENT /end REF_MEASUREMENT /end GROUP
/begin GROUP BattVltgCorrln.BattVltgCorrlnNtc0x03DPassStep.Val "MICROSAR RTE" /begin SUB_GROUP /end SUB_GROUP /begin FUNCTION_LIST /end FUNCTION_LIST /begin REF_CHARACTERISTIC BattVltgCorrln.BattVltgCorrlnNtc0x03DPassStep.Val /end REF_CHARACTERISTIC /begin REF_MEASUREMENT /end REF_MEASUREMENT /end GROUP
/begin GROUP BattVltgCorrln.BattVltgCorrlnNtc0x0B0FailStep.Val "MICROSAR RTE" /begin SUB_GROUP /end SUB_GROUP /begin FUNCTION_LIST /end FUNCTION_LIST /begin REF_CHARACTERISTIC BattVltgCorrln.BattVltgCorrlnNtc0x0B0FailStep.Val /end REF_CHARACTERISTIC /begin REF_MEASUREMENT /end REF_MEASUREMENT /end GROUP
/begin GROUP BattVltgCorrln.BattVltgCorrlnNtc0x0B0PassStep.Val "MICROSAR RTE" /begin SUB_GROUP /end SUB_GROUP /begin FUNCTION_LIST /end FUNCTION_LIST /begin REF_CHARACTERISTIC BattVltgCorrln.BattVltgCorrlnNtc0x0B0PassStep.Val /end REF_CHARACTERISTIC /begin REF_MEASUREMENT /end REF_MEASUREMENT /end GROUP
/begin GROUP BattVltgCorrln.BattVltgCorrlnNtc0x0B1FailStep.Val "MICROSAR RTE" /begin SUB_GROUP /end SUB_GROUP /begin FUNCTION_LIST /end FUNCTION_LIST /begin REF_CHARACTERISTIC BattVltgCorrln.BattVltgCorrlnNtc0x0B1FailStep.Val /end REF_CHARACTERISTIC /begin REF_MEASUREMENT /end REF_MEASUREMENT /end GROUP
/begin GROUP BattVltgCorrln.BattVltgCorrlnNtc0x0B1PassStep.Val "MICROSAR RTE" /begin SUB_GROUP /end SUB_GROUP /begin FUNCTION_LIST /end FUNCTION_LIST /begin REF_CHARACTERISTIC BattVltgCorrln.BattVltgCorrlnNtc0x0B1PassStep.Val /end REF_CHARACTERISTIC /begin REF_MEASUREMENT /end REF_MEASUREMENT /end GROUP
/begin GROUP BattVltgCorrln.BattVltgCorrlnNtc0x0B5FailStep.Val "MICROSAR RTE" /begin SUB_GROUP /end SUB_GROUP /begin FUNCTION_LIST /end FUNCTION_LIST /begin REF_CHARACTERISTIC BattVltgCorrln.BattVltgCorrlnNtc0x0B5FailStep.Val /end REF_CHARACTERISTIC /begin REF_MEASUREMENT /end REF_MEASUREMENT /end GROUP
/begin GROUP BattVltgCorrln.BattVltgCorrlnNtc0x0B5PassStep.Val "MICROSAR RTE" /begin SUB_GROUP /end SUB_GROUP /begin FUNCTION_LIST /end FUNCTION_LIST /begin REF_CHARACTERISTIC BattVltgCorrln.BattVltgCorrlnNtc0x0B5PassStep.Val /end REF_CHARACTERISTIC /begin REF_MEASUREMENT /end REF_MEASUREMENT /end GROUP
/begin GROUP BattVltgCorrln.BattVltgCorrlnRcvrlBattLoVltg.Val "MICROSAR RTE" /begin SUB_GROUP /end SUB_GROUP /begin FUNCTION_LIST /end FUNCTION_LIST /begin REF_CHARACTERISTIC BattVltgCorrln.BattVltgCorrlnRcvrlBattLoVltg.Val /end REF_CHARACTERISTIC /begin REF_MEASUREMENT /end REF_MEASUREMENT /end GROUP
/begin GROUP BattVltgCorrln.BattVltgCorrlnRcvrlBattOverVltg.Val "MICROSAR RTE" /begin SUB_GROUP /end SUB_GROUP /begin FUNCTION_LIST /end FUNCTION_LIST /begin REF_CHARACTERISTIC BattVltgCorrln.BattVltgCorrlnRcvrlBattOverVltg.Val /end REF_CHARACTERISTIC /begin REF_MEASUREMENT /end REF_MEASUREMENT /end GROUP
/begin GROUP BattVltgCorrln.BattVltgCorrlnRcvrlBattUnderVltg.Val "MICROSAR RTE" /begin SUB_GROUP /end SUB_GROUP /begin FUNCTION_LIST /end FUNCTION_LIST /begin REF_CHARACTERISTIC BattVltgCorrln.BattVltgCorrlnRcvrlBattUnderVltg.Val /end REF_CHARACTERISTIC /begin REF_MEASUREMENT /end REF_MEASUREMENT /end GROUP
/begin GROUP BattVltgCorrln.BattVltgCorrlnSysMinVltg.Val "MICROSAR RTE" /begin SUB_GROUP /end SUB_GROUP /begin FUNCTION_LIST /end FUNCTION_LIST /begin REF_CHARACTERISTIC BattVltgCorrln.BattVltgCorrlnSysMinVltg.Val /end REF_CHARACTERISTIC /begin REF_MEASUREMENT /end REF_MEASUREMENT /end GROUP
/begin GROUP BattVltgCorrln.BattVltgSwd1.Val "MICROSAR RTE" /begin SUB_GROUP /end SUB_GROUP /begin FUNCTION_LIST /end FUNCTION_LIST /begin REF_CHARACTERISTIC /end REF_CHARACTERISTIC /begin REF_MEASUREMENT BattVltgCorrln.BattVltgSwd1.Val /end REF_MEASUREMENT /end GROUP
/begin GROUP BattVltgCorrln.BattVltgSwd1AdcFaild.Logl "MICROSAR RTE" /begin SUB_GROUP /end SUB_GROUP /begin FUNCTION_LIST /end FUNCTION_LIST /begin REF_CHARACTERISTIC /end REF_CHARACTERISTIC /begin REF_MEASUREMENT BattVltgCorrln.BattVltgSwd1AdcFaild.Logl /end REF_MEASUREMENT /end GROUP
/begin GROUP BattVltgCorrln.BattVltgSwd2.Val "MICROSAR RTE" /begin SUB_GROUP /end SUB_GROUP /begin FUNCTION_LIST /end FUNCTION_LIST /begin REF_CHARACTERISTIC /end REF_CHARACTERISTIC /begin REF_MEASUREMENT BattVltgCorrln.BattVltgSwd2.Val /end REF_MEASUREMENT /end GROUP
/begin GROUP BattVltgCorrln.BattVltgSwd2AdcFaild.Logl "MICROSAR RTE" /begin SUB_GROUP /end SUB_GROUP /begin FUNCTION_LIST /end FUNCTION_LIST /begin REF_CHARACTERISTIC /end REF_CHARACTERISTIC /begin REF_MEASUREMENT BattVltgCorrln.BattVltgSwd2AdcFaild.Logl /end REF_MEASUREMENT /end GROUP
/begin GROUP BattVltgCorrln.BattVltgSwdMax.Val "MICROSAR RTE" /begin SUB_GROUP /end SUB_GROUP /begin FUNCTION_LIST /end FUNCTION_LIST /begin REF_CHARACTERISTIC BattVltgCorrln.BattVltgSwdMax.Val /end REF_CHARACTERISTIC /begin REF_MEASUREMENT /end REF_MEASUREMENT /end GROUP
/begin GROUP BattVltgCorrln.CalibrationPorts "MICROSAR RTE"
 /begin SUB_GROUP BattVltgCorrln.BattVltgCorrlnAllwdVltgDif.Val BattVltgCorrln.BattVltgCorrlnBattLoVltg.Val BattVltgCorrln.BattVltgCorrlnBattOverVltg.Val BattVltgCorrln.BattVltgCorrlnBattUnderVltg.Val BattVltgCorrln.BattVltgCorrlnNtc0x03C0x0440x04CFailStep.Val BattVltgCorrln.BattVltgCorrlnNtc0x03C0x0440x04CPassStep.Val BattVltgCorrln.BattVltgCorrlnNtc0x03DFailStep.Val BattVltgCorrln.BattVltgCorrlnNtc0x03DPassStep.Val BattVltgCorrln.BattVltgCorrlnNtc0x0B0FailStep.Val BattVltgCorrln.BattVltgCorrlnNtc0x0B0PassStep.Val BattVltgCorrln.BattVltgCorrlnNtc0x0B1FailStep.Val BattVltgCorrln.BattVltgCorrlnNtc0x0B1PassStep.Val BattVltgCorrln.BattVltgCorrlnNtc0x0B5FailStep.Val BattVltgCorrln.BattVltgCorrlnNtc0x0B5PassStep.Val BattVltgCorrln.BattVltgCorrlnRcvrlBattLoVltg.Val BattVltgCorrln.BattVltgCorrlnRcvrlBattOverVltg.Val BattVltgCorrln.BattVltgCorrlnRcvrlBattUnderVltg.Val BattVltgCorrln.BattVltgCorrlnSysMinVltg.Val BattVltgCorrln.BattVltgSwdMax.Val /end SUB_GROUP
 /begin FUNCTION_LIST /end FUNCTION_LIST
 /begin REF_CHARACTERISTIC /end REF_CHARACTERISTIC
 /begin REF_MEASUREMENT /end REF_MEASUREMENT
/end GROUP
/begin GROUP BattVltgCorrln.DftBrdgVltgActv.Logl "MICROSAR RTE" /begin SUB_GROUP /end SUB_GROUP /begin FUNCTION_LIST /end FUNCTION_LIST /begin REF_CHARACTERISTIC /end REF_CHARACTERISTIC /begin REF_MEASUREMENT BattVltgCorrln.DftBrdgVltgActv.Logl /end REF_MEASUREMENT /end GROUP
/begin GROUP BattVltgCorrln.DiagcStsIvtr1Inactv.Logl "MICROSAR RTE" /begin SUB_GROUP /end SUB_GROUP /begin FUNCTION_LIST /end FUNCTION_LIST /begin REF_CHARACTERISTIC /end REF_CHARACTERISTIC /begin REF_MEASUREMENT BattVltgCorrln.DiagcStsIvtr1Inactv.Logl /end REF_MEASUREMENT /end GROUP
/begin GROUP BattVltgCorrln.DiagcStsIvtr2Inactv.Logl "MICROSAR RTE" /begin SUB_GROUP /end SUB_GROUP /begin FUNCTION_LIST /end FUNCTION_LIST /begin REF_CHARACTERISTIC /end REF_CHARACTERISTIC /begin REF_MEASUREMENT BattVltgCorrln.DiagcStsIvtr2Inactv.Logl /end REF_MEASUREMENT /end GROUP
/begin GROUP BattVltgCorrln.InhbBattVltgDiagc.Logl "MICROSAR RTE" /begin SUB_GROUP /end SUB_GROUP /begin FUNCTION_LIST /end FUNCTION_LIST /begin REF_CHARACTERISTIC /end REF_CHARACTERISTIC /begin REF_MEASUREMENT BattVltgCorrln.InhbBattVltgDiagc.Logl /end REF_MEASUREMENT /end GROUP
/begin GROUP BattVltgCorrln.PerInstanceMemories "MICROSAR RTE"
 /begin SUB_GROUP BattVltgCorrln.dBattVltgCorrlnBattVltgOk BattVltgCorrln.dBattVltgCorrlnBattVltgRngOk BattVltgCorrln.dBattVltgCorrlnBattVltgSwd1Ok BattVltgCorrln.dBattVltgCorrlnBattVltgSwd1RngOk BattVltgCorrln.dBattVltgCorrlnBattVltgSwd2Ok BattVltgCorrln.dBattVltgCorrlnBattVltgSwd2RngOk BattVltgCorrln.dBattVltgCorrlnNtc0x03CQlfrSts BattVltgCorrln.dBattVltgCorrlnNtc0x03DQlfrSts BattVltgCorrln.dBattVltgCorrlnNtc0x044QlfrSts BattVltgCorrln.dBattVltgCorrlnNtc0x04CQlfrSts /end SUB_GROUP
 /begin FUNCTION_LIST /end FUNCTION_LIST
 /begin REF_CHARACTERISTIC /end REF_CHARACTERISTIC
 /begin REF_MEASUREMENT /end REF_MEASUREMENT
/end GROUP
/begin GROUP BattVltgCorrln.ReceiverPorts "MICROSAR RTE"
 /begin SUB_GROUP BattVltgCorrln.BattVltg.Val BattVltgCorrln.BattVltgAdcFaild.Logl BattVltgCorrln.BattVltgSwd1.Val BattVltgCorrln.BattVltgSwd1AdcFaild.Logl BattVltgCorrln.BattVltgSwd2.Val BattVltgCorrln.BattVltgSwd2AdcFaild.Logl BattVltgCorrln.DiagcStsIvtr1Inactv.Logl BattVltgCorrln.DiagcStsIvtr2Inactv.Logl BattVltgCorrln.InhbBattVltgDiagc.Logl BattVltgCorrln.StrtUpSt.Val BattVltgCorrln.SysSt.Val /end SUB_GROUP
 /begin FUNCTION_LIST /end FUNCTION_LIST
 /begin REF_CHARACTERISTIC /end REF_CHARACTERISTIC
 /begin REF_MEASUREMENT /end REF_MEASUREMENT
/end GROUP
/begin GROUP BattVltgCorrln.SenderPorts "MICROSAR RTE"
 /begin SUB_GROUP BattVltgCorrln.BattSwdVltgCorrlnSts.Val BattVltgCorrln.BattVltgCorrlnIdptSig.Val BattVltgCorrln.DftBrdgVltgActv.Logl BattVltgCorrln.SwdVltgLimd.Logl /end SUB_GROUP
 /begin FUNCTION_LIST /end FUNCTION_LIST
 /begin REF_CHARACTERISTIC /end REF_CHARACTERISTIC
 /begin REF_MEASUREMENT /end REF_MEASUREMENT
/end GROUP
/begin GROUP BattVltgCorrln.StrtUpSt.Val "MICROSAR RTE" /begin SUB_GROUP /end SUB_GROUP /begin FUNCTION_LIST /end FUNCTION_LIST /begin REF_CHARACTERISTIC /end REF_CHARACTERISTIC /begin REF_MEASUREMENT BattVltgCorrln.StrtUpSt.Val /end REF_MEASUREMENT /end GROUP
/begin GROUP BattVltgCorrln.SwdVltgLimd.Logl "MICROSAR RTE" /begin SUB_GROUP /end SUB_GROUP /begin FUNCTION_LIST /end FUNCTION_LIST /begin REF_CHARACTERISTIC /end REF_CHARACTERISTIC /begin REF_MEASUREMENT BattVltgCorrln.SwdVltgLimd.Logl /end REF_MEASUREMENT /end GROUP
/begin GROUP BattVltgCorrln.SysSt.Val "MICROSAR RTE" /begin SUB_GROUP /end SUB_GROUP /begin FUNCTION_LIST /end FUNCTION_LIST /begin REF_CHARACTERISTIC /end REF_CHARACTERISTIC /begin REF_MEASUREMENT BattVltgCorrln.SysSt.Val /end REF_MEASUREMENT /end GROUP
/begin GROUP BattVltgCorrln.dBattVltgCorrlnBattVltgOk "MICROSAR RTE" /begin SUB_GROUP /end SUB_GROUP /begin FUNCTION_LIST /end FUNCTION_LIST /begin REF_CHARACTERISTIC /end REF_CHARACTERISTIC /begin REF_MEASUREMENT BattVltgCorrln.dBattVltgCorrlnBattVltgOk /end REF_MEASUREMENT /end GROUP
/begin GROUP BattVltgCorrln.dBattVltgCorrlnBattVltgRngOk "MICROSAR RTE" /begin SUB_GROUP /end SUB_GROUP /begin FUNCTION_LIST /end FUNCTION_LIST /begin REF_CHARACTERISTIC /end REF_CHARACTERISTIC /begin REF_MEASUREMENT BattVltgCorrln.dBattVltgCorrlnBattVltgRngOk /end REF_MEASUREMENT /end GROUP
/begin GROUP BattVltgCorrln.dBattVltgCorrlnBattVltgSwd1Ok "MICROSAR RTE" /begin SUB_GROUP /end SUB_GROUP /begin FUNCTION_LIST /end FUNCTION_LIST /begin REF_CHARACTERISTIC /end REF_CHARACTERISTIC /begin REF_MEASUREMENT BattVltgCorrln.dBattVltgCorrlnBattVltgSwd1Ok /end REF_MEASUREMENT /end GROUP
/begin GROUP BattVltgCorrln.dBattVltgCorrlnBattVltgSwd1RngOk "MICROSAR RTE" /begin SUB_GROUP /end SUB_GROUP /begin FUNCTION_LIST /end FUNCTION_LIST /begin REF_CHARACTERISTIC /end REF_CHARACTERISTIC /begin REF_MEASUREMENT BattVltgCorrln.dBattVltgCorrlnBattVltgSwd1RngOk /end REF_MEASUREMENT /end GROUP
/begin GROUP BattVltgCorrln.dBattVltgCorrlnBattVltgSwd2Ok "MICROSAR RTE" /begin SUB_GROUP /end SUB_GROUP /begin FUNCTION_LIST /end FUNCTION_LIST /begin REF_CHARACTERISTIC /end REF_CHARACTERISTIC /begin REF_MEASUREMENT BattVltgCorrln.dBattVltgCorrlnBattVltgSwd2Ok /end REF_MEASUREMENT /end GROUP
/begin GROUP BattVltgCorrln.dBattVltgCorrlnBattVltgSwd2RngOk "MICROSAR RTE" /begin SUB_GROUP /end SUB_GROUP /begin FUNCTION_LIST /end FUNCTION_LIST /begin REF_CHARACTERISTIC /end REF_CHARACTERISTIC /begin REF_MEASUREMENT BattVltgCorrln.dBattVltgCorrlnBattVltgSwd2RngOk /end REF_MEASUREMENT /end GROUP
/begin GROUP BattVltgCorrln.dBattVltgCorrlnNtc0x03CQlfrSts "MICROSAR RTE" /begin SUB_GROUP /end SUB_GROUP /begin FUNCTION_LIST /end FUNCTION_LIST /begin REF_CHARACTERISTIC /end REF_CHARACTERISTIC /begin REF_MEASUREMENT BattVltgCorrln.dBattVltgCorrlnNtc0x03CQlfrSts /end REF_MEASUREMENT /end GROUP
/begin GROUP BattVltgCorrln.dBattVltgCorrlnNtc0x03DQlfrSts "MICROSAR RTE" /begin SUB_GROUP /end SUB_GROUP /begin FUNCTION_LIST /end FUNCTION_LIST /begin REF_CHARACTERISTIC /end REF_CHARACTERISTIC /begin REF_MEASUREMENT BattVltgCorrln.dBattVltgCorrlnNtc0x03DQlfrSts /end REF_MEASUREMENT /end GROUP
/begin GROUP BattVltgCorrln.dBattVltgCorrlnNtc0x044QlfrSts "MICROSAR RTE" /begin SUB_GROUP /end SUB_GROUP /begin FUNCTION_LIST /end FUNCTION_LIST /begin REF_CHARACTERISTIC /end REF_CHARACTERISTIC /begin REF_MEASUREMENT BattVltgCorrln.dBattVltgCorrlnNtc0x044QlfrSts /end REF_MEASUREMENT /end GROUP
/begin GROUP BattVltgCorrln.dBattVltgCorrlnNtc0x04CQlfrSts "MICROSAR RTE" /begin SUB_GROUP /end SUB_GROUP /begin FUNCTION_LIST /end FUNCTION_LIST /begin REF_CHARACTERISTIC /end REF_CHARACTERISTIC /begin REF_MEASUREMENT BattVltgCorrln.dBattVltgCorrlnNtc0x04CQlfrSts /end REF_MEASUREMENT /end GROUP
/begin GROUP CDD_Adc0CfgAndUse "MICROSAR RTE" /begin SUB_GROUP CDD_Adc0CfgAndUse.PerInstanceMemories /end SUB_GROUP /begin FUNCTION_LIST /end FUNCTION_LIST /begin REF_CHARACTERISTIC /end REF_CHARACTERISTIC /begin REF_MEASUREMENT /end REF_MEASUREMENT /end GROUP
/begin GROUP CDD_Adc0CfgAndUse.Adc0DiagcEndPtr "MICROSAR RTE" /begin SUB_GROUP /end SUB_GROUP /begin FUNCTION_LIST /end FUNCTION_LIST /begin REF_CHARACTERISTIC /end REF_CHARACTERISTIC /begin REF_MEASUREMENT CDD_Adc0CfgAndUse.Adc0DiagcEndPtr /end REF_MEASUREMENT /end GROUP
/begin GROUP CDD_Adc0CfgAndUse.Adc0DiagcStrtPtr "MICROSAR RTE" /begin SUB_GROUP /end SUB_GROUP /begin FUNCTION_LIST /end FUNCTION_LIST /begin REF_CHARACTERISTIC /end REF_CHARACTERISTIC /begin REF_MEASUREMENT CDD_Adc0CfgAndUse.Adc0DiagcStrtPtr /end REF_MEASUREMENT /end GROUP
/begin GROUP CDD_Adc0CfgAndUse.PerInstanceMemories "MICROSAR RTE"
 /begin SUB_GROUP CDD_Adc0CfgAndUse.Adc0DiagcEndPtr CDD_Adc0CfgAndUse.Adc0DiagcStrtPtr /end SUB_GROUP
 /begin FUNCTION_LIST /end FUNCTION_LIST
 /begin REF_CHARACTERISTIC /end REF_CHARACTERISTIC
 /begin REF_MEASUREMENT /end REF_MEASUREMENT
/end GROUP
/begin GROUP CDD_Adc1CfgAndUse "MICROSAR RTE"
 /begin SUB_GROUP CDD_Adc1CfgAndUse.PerInstanceMemories CDD_Adc1CfgAndUse.ReceiverPorts /end SUB_GROUP
 /begin FUNCTION_LIST /end FUNCTION_LIST
 /begin REF_CHARACTERISTIC /end REF_CHARACTERISTIC
 /begin REF_MEASUREMENT /end REF_MEASUREMENT
/end GROUP
/begin GROUP CDD_Adc1CfgAndUse.Adc1DiagcEndPtr "MICROSAR RTE" /begin SUB_GROUP /end SUB_GROUP /begin FUNCTION_LIST /end FUNCTION_LIST /begin REF_CHARACTERISTIC /end REF_CHARACTERISTIC /begin REF_MEASUREMENT CDD_Adc1CfgAndUse.Adc1DiagcEndPtr /end REF_MEASUREMENT /end GROUP
/begin GROUP CDD_Adc1CfgAndUse.Adc1DiagcStrtPtr "MICROSAR RTE" /begin SUB_GROUP /end SUB_GROUP /begin FUNCTION_LIST /end FUNCTION_LIST /begin REF_CHARACTERISTIC /end REF_CHARACTERISTIC /begin REF_MEASUREMENT CDD_Adc1CfgAndUse.Adc1DiagcStrtPtr /end REF_MEASUREMENT /end GROUP
/begin GROUP CDD_Adc1CfgAndUse.AdcDiagcEndPtrOutp.Val "MICROSAR RTE" /begin SUB_GROUP /end SUB_GROUP /begin FUNCTION_LIST /end FUNCTION_LIST /begin REF_CHARACTERISTIC /end REF_CHARACTERISTIC /begin REF_MEASUREMENT CDD_Adc1CfgAndUse.AdcDiagcEndPtrOutp.Val /end REF_MEASUREMENT /end GROUP
/begin GROUP CDD_Adc1CfgAndUse.AdcDiagcStrtPtrOutp.Val "MICROSAR RTE" /begin SUB_GROUP /end SUB_GROUP /begin FUNCTION_LIST /end FUNCTION_LIST /begin REF_CHARACTERISTIC /end REF_CHARACTERISTIC /begin REF_MEASUREMENT CDD_Adc1CfgAndUse.AdcDiagcStrtPtrOutp.Val /end REF_MEASUREMENT /end GROUP
/begin GROUP CDD_Adc1CfgAndUse.PerInstanceMemories "MICROSAR RTE"
 /begin SUB_GROUP CDD_Adc1CfgAndUse.Adc1DiagcEndPtr CDD_Adc1CfgAndUse.Adc1DiagcStrtPtr /end SUB_GROUP
 /begin FUNCTION_LIST /end FUNCTION_LIST
 /begin REF_CHARACTERISTIC /end REF_CHARACTERISTIC
 /begin REF_MEASUREMENT /end REF_MEASUREMENT
/end GROUP
/begin GROUP CDD_Adc1CfgAndUse.ReceiverPorts "MICROSAR RTE"
 /begin SUB_GROUP CDD_Adc1CfgAndUse.AdcDiagcEndPtrOutp.Val CDD_Adc1CfgAndUse.AdcDiagcStrtPtrOutp.Val /end SUB_GROUP
 /begin FUNCTION_LIST /end FUNCTION_LIST
 /begin REF_CHARACTERISTIC /end REF_CHARACTERISTIC
 /begin REF_MEASUREMENT /end REF_MEASUREMENT
/end GROUP
/begin GROUP CDD_AdcDiagc "MICROSAR RTE"
 /begin SUB_GROUP CDD_AdcDiagc.CalibrationPorts CDD_AdcDiagc.PerInstanceMemories CDD_AdcDiagc.ReceiverPorts CDD_AdcDiagc.SenderPorts /end SUB_GROUP
 /begin FUNCTION_LIST /end FUNCTION_LIST
 /begin REF_CHARACTERISTIC /end REF_CHARACTERISTIC
 /begin REF_MEASUREMENT /end REF_MEASUREMENT
/end GROUP
/begin GROUP CDD_AdcDiagc.Adc0Faild.Logl "MICROSAR RTE" /begin SUB_GROUP /end SUB_GROUP /begin FUNCTION_LIST /end FUNCTION_LIST /begin REF_CHARACTERISTIC /end REF_CHARACTERISTIC /begin REF_MEASUREMENT CDD_AdcDiagc.Adc0Faild.Logl /end REF_MEASUREMENT /end GROUP
/begin GROUP CDD_AdcDiagc.Adc0FltCntSt0 "MICROSAR RTE" /begin SUB_GROUP /end SUB_GROUP /begin FUNCTION_LIST /end FUNCTION_LIST /begin REF_CHARACTERISTIC /end REF_CHARACTERISTIC /begin REF_MEASUREMENT CDD_AdcDiagc.Adc0FltCntSt0 /end REF_MEASUREMENT /end GROUP
/begin GROUP CDD_AdcDiagc.Adc0FltCntSt2 "MICROSAR RTE" /begin SUB_GROUP /end SUB_GROUP /begin FUNCTION_LIST /end FUNCTION_LIST /begin REF_CHARACTERISTIC /end REF_CHARACTERISTIC /begin REF_MEASUREMENT CDD_AdcDiagc.Adc0FltCntSt2 /end REF_MEASUREMENT /end GROUP
/begin GROUP CDD_AdcDiagc.Adc0FltCntSt4 "MICROSAR RTE" /begin SUB_GROUP /end SUB_GROUP /begin FUNCTION_LIST /end FUNCTION_LIST /begin REF_CHARACTERISTIC /end REF_CHARACTERISTIC /begin REF_MEASUREMENT CDD_AdcDiagc.Adc0FltCntSt4 /end REF_MEASUREMENT /end GROUP
/begin GROUP CDD_AdcDiagc.Adc0FltCntSt6 "MICROSAR RTE" /begin SUB_GROUP /end SUB_GROUP /begin FUNCTION_LIST /end FUNCTION_LIST /begin REF_CHARACTERISTIC /end REF_CHARACTERISTIC /begin REF_MEASUREMENT CDD_AdcDiagc.Adc0FltCntSt6 /end REF_MEASUREMENT /end GROUP
/begin GROUP CDD_AdcDiagc.Adc0ScanGroup2Ref0.Val "MICROSAR RTE" /begin SUB_GROUP /end SUB_GROUP /begin FUNCTION_LIST /end FUNCTION_LIST /begin REF_CHARACTERISTIC /end REF_CHARACTERISTIC /begin REF_MEASUREMENT CDD_AdcDiagc.Adc0ScanGroup2Ref0.Val /end REF_MEASUREMENT /end GROUP
/begin GROUP CDD_AdcDiagc.Adc0ScanGroup2Ref1.Val "MICROSAR RTE" /begin SUB_GROUP /end SUB_GROUP /begin FUNCTION_LIST /end FUNCTION_LIST /begin REF_CHARACTERISTIC /end REF_CHARACTERISTIC /begin REF_MEASUREMENT CDD_AdcDiagc.Adc0ScanGroup2Ref1.Val /end REF_MEASUREMENT /end GROUP
/begin GROUP CDD_AdcDiagc.Adc0ScanGroup2RefFltCntSt "MICROSAR RTE" /begin SUB_GROUP /end SUB_GROUP /begin FUNCTION_LIST /end FUNCTION_LIST /begin REF_CHARACTERISTIC /end REF_CHARACTERISTIC /begin REF_MEASUREMENT CDD_AdcDiagc.Adc0ScanGroup2RefFltCntSt /end REF_MEASUREMENT /end GROUP
/begin GROUP CDD_AdcDiagc.Adc0ScanGroup3Ref0.Val "MICROSAR RTE" /begin SUB_GROUP /end SUB_GROUP /begin FUNCTION_LIST /end FUNCTION_LIST /begin REF_CHARACTERISTIC /end REF_CHARACTERISTIC /begin REF_MEASUREMENT CDD_AdcDiagc.Adc0ScanGroup3Ref0.Val /end REF_MEASUREMENT /end GROUP
/begin GROUP CDD_AdcDiagc.Adc0ScanGroup3Ref1.Val "MICROSAR RTE" /begin SUB_GROUP /end SUB_GROUP /begin FUNCTION_LIST /end FUNCTION_LIST /begin REF_CHARACTERISTIC /end REF_CHARACTERISTIC /begin REF_MEASUREMENT CDD_AdcDiagc.Adc0ScanGroup3Ref1.Val /end REF_MEASUREMENT /end GROUP
/begin GROUP CDD_AdcDiagc.Adc0ScanGroup3RefFltCntSt "MICROSAR RTE" /begin SUB_GROUP /end SUB_GROUP /begin FUNCTION_LIST /end FUNCTION_LIST /begin REF_CHARACTERISTIC /end REF_CHARACTERISTIC /begin REF_MEASUREMENT CDD_AdcDiagc.Adc0ScanGroup3RefFltCntSt /end REF_MEASUREMENT /end GROUP
/begin GROUP CDD_AdcDiagc.Adc0SelfDiag0.Val "MICROSAR RTE" /begin SUB_GROUP /end SUB_GROUP /begin FUNCTION_LIST /end FUNCTION_LIST /begin REF_CHARACTERISTIC /end REF_CHARACTERISTIC /begin REF_MEASUREMENT CDD_AdcDiagc.Adc0SelfDiag0.Val /end REF_MEASUREMENT /end GROUP
/begin GROUP CDD_AdcDiagc.Adc0SelfDiag2.Val "MICROSAR RTE" /begin SUB_GROUP /end SUB_GROUP /begin FUNCTION_LIST /end FUNCTION_LIST /begin REF_CHARACTERISTIC /end REF_CHARACTERISTIC /begin REF_MEASUREMENT CDD_AdcDiagc.Adc0SelfDiag2.Val /end REF_MEASUREMENT /end GROUP
/begin GROUP CDD_AdcDiagc.Adc0SelfDiag4.Val "MICROSAR RTE" /begin SUB_GROUP /end SUB_GROUP /begin FUNCTION_LIST /end FUNCTION_LIST /begin REF_CHARACTERISTIC /end REF_CHARACTERISTIC /begin REF_MEASUREMENT CDD_AdcDiagc.Adc0SelfDiag4.Val /end REF_MEASUREMENT /end GROUP
/begin GROUP CDD_AdcDiagc.Adc1Faild.Logl "MICROSAR RTE" /begin SUB_GROUP /end SUB_GROUP /begin FUNCTION_LIST /end FUNCTION_LIST /begin REF_CHARACTERISTIC /end REF_CHARACTERISTIC /begin REF_MEASUREMENT CDD_AdcDiagc.Adc1Faild.Logl /end REF_MEASUREMENT /end GROUP
/begin GROUP CDD_AdcDiagc.Adc1FltCntSt0 "MICROSAR RTE" /begin SUB_GROUP /end SUB_GROUP /begin FUNCTION_LIST /end FUNCTION_LIST /begin REF_CHARACTERISTIC /end REF_CHARACTERISTIC /begin REF_MEASUREMENT CDD_AdcDiagc.Adc1FltCntSt0 /end REF_MEASUREMENT /end GROUP
/begin GROUP CDD_AdcDiagc.Adc1FltCntSt2 "MICROSAR RTE" /begin SUB_GROUP /end SUB_GROUP /begin FUNCTION_LIST /end FUNCTION_LIST /begin REF_CHARACTERISTIC /end REF_CHARACTERISTIC /begin REF_MEASUREMENT CDD_AdcDiagc.Adc1FltCntSt2 /end REF_MEASUREMENT /end GROUP
/begin GROUP CDD_AdcDiagc.Adc1FltCntSt4 "MICROSAR RTE" /begin SUB_GROUP /end SUB_GROUP /begin FUNCTION_LIST /end FUNCTION_LIST /begin REF_CHARACTERISTIC /end REF_CHARACTERISTIC /begin REF_MEASUREMENT CDD_AdcDiagc.Adc1FltCntSt4 /end REF_MEASUREMENT /end GROUP
/begin GROUP CDD_AdcDiagc.Adc1FltCntSt6 "MICROSAR RTE" /begin SUB_GROUP /end SUB_GROUP /begin FUNCTION_LIST /end FUNCTION_LIST /begin REF_CHARACTERISTIC /end REF_CHARACTERISTIC /begin REF_MEASUREMENT CDD_AdcDiagc.Adc1FltCntSt6 /end REF_MEASUREMENT /end GROUP
/begin GROUP CDD_AdcDiagc.Adc1ScanGroup2Ref0.Val "MICROSAR RTE" /begin SUB_GROUP /end SUB_GROUP /begin FUNCTION_LIST /end FUNCTION_LIST /begin REF_CHARACTERISTIC /end REF_CHARACTERISTIC /begin REF_MEASUREMENT CDD_AdcDiagc.Adc1ScanGroup2Ref0.Val /end REF_MEASUREMENT /end GROUP
/begin GROUP CDD_AdcDiagc.Adc1ScanGroup2Ref1.Val "MICROSAR RTE" /begin SUB_GROUP /end SUB_GROUP /begin FUNCTION_LIST /end FUNCTION_LIST /begin REF_CHARACTERISTIC /end REF_CHARACTERISTIC /begin REF_MEASUREMENT CDD_AdcDiagc.Adc1ScanGroup2Ref1.Val /end REF_MEASUREMENT /end GROUP
/begin GROUP CDD_AdcDiagc.Adc1ScanGroup2RefFltCntSt "MICROSAR RTE" /begin SUB_GROUP /end SUB_GROUP /begin FUNCTION_LIST /end FUNCTION_LIST /begin REF_CHARACTERISTIC /end REF_CHARACTERISTIC /begin REF_MEASUREMENT CDD_AdcDiagc.Adc1ScanGroup2RefFltCntSt /end REF_MEASUREMENT /end GROUP
/begin GROUP CDD_AdcDiagc.Adc1ScanGroup3Ref0.Val "MICROSAR RTE" /begin SUB_GROUP /end SUB_GROUP /begin FUNCTION_LIST /end FUNCTION_LIST /begin REF_CHARACTERISTIC /end REF_CHARACTERISTIC /begin REF_MEASUREMENT CDD_AdcDiagc.Adc1ScanGroup3Ref0.Val /end REF_MEASUREMENT /end GROUP
/begin GROUP CDD_AdcDiagc.Adc1ScanGroup3Ref1.Val "MICROSAR RTE" /begin SUB_GROUP /end SUB_GROUP /begin FUNCTION_LIST /end FUNCTION_LIST /begin REF_CHARACTERISTIC /end REF_CHARACTERISTIC /begin REF_MEASUREMENT CDD_AdcDiagc.Adc1ScanGroup3Ref1.Val /end REF_MEASUREMENT /end GROUP
/begin GROUP CDD_AdcDiagc.Adc1ScanGroup3RefFltCntSt "MICROSAR RTE" /begin SUB_GROUP /end SUB_GROUP /begin FUNCTION_LIST /end FUNCTION_LIST /begin REF_CHARACTERISTIC /end REF_CHARACTERISTIC /begin REF_MEASUREMENT CDD_AdcDiagc.Adc1ScanGroup3RefFltCntSt /end REF_MEASUREMENT /end GROUP
/begin GROUP CDD_AdcDiagc.Adc1SelfDiag0.Val "MICROSAR RTE" /begin SUB_GROUP /end SUB_GROUP /begin FUNCTION_LIST /end FUNCTION_LIST /begin REF_CHARACTERISTIC /end REF_CHARACTERISTIC /begin REF_MEASUREMENT CDD_AdcDiagc.Adc1SelfDiag0.Val /end REF_MEASUREMENT /end GROUP
/begin GROUP CDD_AdcDiagc.Adc1SelfDiag2.Val "MICROSAR RTE" /begin SUB_GROUP /end SUB_GROUP /begin FUNCTION_LIST /end FUNCTION_LIST /begin REF_CHARACTERISTIC /end REF_CHARACTERISTIC /begin REF_MEASUREMENT CDD_AdcDiagc.Adc1SelfDiag2.Val /end REF_MEASUREMENT /end GROUP
/begin GROUP CDD_AdcDiagc.Adc1SelfDiag4.Val "MICROSAR RTE" /begin SUB_GROUP /end SUB_GROUP /begin FUNCTION_LIST /end FUNCTION_LIST /begin REF_CHARACTERISTIC /end REF_CHARACTERISTIC /begin REF_MEASUREMENT CDD_AdcDiagc.Adc1SelfDiag4.Val /end REF_MEASUREMENT /end GROUP
/begin GROUP CDD_AdcDiagc.AdcDiagcEndPtr "MICROSAR RTE" /begin SUB_GROUP /end SUB_GROUP /begin FUNCTION_LIST /end FUNCTION_LIST /begin REF_CHARACTERISTIC /end REF_CHARACTERISTIC /begin REF_MEASUREMENT CDD_AdcDiagc.AdcDiagcEndPtr /end REF_MEASUREMENT /end GROUP
/begin GROUP CDD_AdcDiagc.AdcDiagcEndPtrOutp.Val "MICROSAR RTE" /begin SUB_GROUP /end SUB_GROUP /begin FUNCTION_LIST /end FUNCTION_LIST /begin REF_CHARACTERISTIC /end REF_CHARACTERISTIC /begin REF_MEASUREMENT CDD_AdcDiagc.AdcDiagcEndPtrOutp.Val /end REF_MEASUREMENT /end GROUP
/begin GROUP CDD_AdcDiagc.AdcDiagcNtc0x032FailStep.Val "MICROSAR RTE" /begin SUB_GROUP /end SUB_GROUP /begin FUNCTION_LIST /end FUNCTION_LIST /begin REF_CHARACTERISTIC CDD_AdcDiagc.AdcDiagcNtc0x032FailStep.Val /end REF_CHARACTERISTIC /begin REF_MEASUREMENT /end REF_MEASUREMENT /end GROUP
/begin RECORD_LAYOUT RTE_RL_UWORD FNC_VALUES 1 UWORD ROW_DIR DIRECT /end RECORD_LAYOUT
/begin RECORD_LAYOUT RTE_RL_SWORD FNC_VALUES 1 SWORD ROW_DIR DIRECT /end RECORD_LAYOUT
/begin RECORD_LAYOUT RTE_RL_FLOAT32_IEEE FNC_VALUES 1 FLOAT32_IEEE ROW_DIR DIRECT /end RECORD_LAYOUT
/begin RECORD_LAYOUT RTE_RL_BOOLEAN FNC_VALUES 1 UBYTE ROW_DIR DIRECT /end RECORD_LAYOUT
/**********************************************************************************************************************
* COMPU_METHOD / COMPU_VTAB_RANGE
*********************************************************************************************************************/
/begin COMPU_METHOD RTE_CM_BOOLEAN "" TAB_VERB "%3.1" "" COMPU_TAB_REF RTE_CM_BOOLEAN /end COMPU_METHOD
/begin COMPU_VTAB_RANGE RTE_CM_BOOLEAN "" 2 0 0 "false" 1 255 "true" /end COMPU_VTAB_RANGE
/begin COMPU_METHOD RTE_CM_ENUM_SysSt1 "" TAB_VERB "%.1" "" COMPU_TAB_REF RTE_CM_ENUM_SysSt1 /end COMPU_METHOD
/begin COMPU_VTAB_RANGE RTE_CM_ENUM_SysSt1 "" 4 0 0 "SYSST_DI" 1 1 "SYSST_OFF" 2 2 "SYSST_ENA" 3 3 "SYSST_WRMININ" /end COMPU_VTAB_RANGE
/begin COMPU_METHOD RTE_CM_ENUM_SigQlfr1 "" TAB_VERB "%.1" "" COMPU_TAB_REF RTE_CM_ENUM_SigQlfr1 /end COMPU_METHOD
/begin COMPU_VTAB_RANGE RTE_CM_ENUM_SigQlfr1 "" 3 0 0 "SIGQLFR_NORES" 1 1 "SIGQLFR_PASSD" 2 2 "SIGQLFR_FAILD" /end COMPU_VTAB_RANGE
/begin COMPU_METHOD RTE_CM_Tq6 "" RAT_FUNC "%.1" "HwNm" COEFFS 0 256 0 0 0 1 /end COMPU_METHOD
/begin COMPU_METHOD RTE_CM_Tq11 "" RAT_FUNC "%.1" "MotNm" COEFFS 0 2048 0 0 0 1 /end COMPU_METHOD
/begin COMPU_METHOD RTE_CM_Uls4 "" RAT_FUNC "%.1" "Uls" COEFFS 0 16384 0 0 0 1 /end COMPU_METHOD
/begin COMPU_METHOD RTE_CM_Tq12 "" RAT_FUNC "%.1" "MotNm" COEFFS 0 2048 0 0 0 1 /end COMPU_METHOD
/begin COMPU_METHOD RTE_CM_Spd2 "" RAT_FUNC "%.1" "kph" COEFFS 0 128 0 0 0 1 /end COMPU_METHOD
